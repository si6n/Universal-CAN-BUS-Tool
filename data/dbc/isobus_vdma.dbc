VERSION "created by canmatrix"

NS_ :

BS_:

BU_:

BO_ 2566092544 VDMA_F377_Fuel_Cell_System_Opera: 8 Vector__XXX
 SG_ Fuel_Cell_System_Operating_State : 0|64@1+ (1,0) [0|18446744073709551615] "" Vector__XXX

BO_ 2566092800 VDMA_F378_Fuel_Cell_System_Opera: 8 Vector__XXX
 SG_ Fuel_Cell_System_Operations_Requ : 0|64@1+ (1,0) [0|18446744073709551615] "" Vector__XXX

BO_ 2566093056 VDMA_F379_Fuel_Cell_Stack_Inform: 8 Vector__XXX
 SG_ Fuel_Cell_Stack_Information_RawP : 0|64@1+ (1,0) [0|18446744073709551615] "" Vector__XXX

BO_ 2566093312 VDMA_F37A_Fuel_Cell_System_Coola: 8 Vector__XXX
 SG_ Fuel_Cell_System_Coolant_Fan_1_S : 0|64@1+ (1,0) [0|18446744073709551615] "" Vector__XXX

BO_ 2566093568 VDMA_F37B_Fuel_Cell_System_Coola: 8 Vector__XXX
 SG_ Fuel_Cell_System_Coolant_Fan_2_S : 0|64@1+ (1,0) [0|18446744073709551615] "" Vector__XXX

BO_ 2566093824 VDMA_F37C_Fuel_Cell_System_Coola: 8 Vector__XXX
 SG_ Fuel_Cell_System_Coolant_Fan_3_S : 0|64@1+ (1,0) [0|18446744073709551615] "" Vector__XXX

BO_ 2566094080 VDMA_F37D_Fuel_Cell_System_Coola: 8 Vector__XXX
 SG_ Fuel_Cell_System_Coolant_Fan_4_S : 0|64@1+ (1,0) [0|18446744073709551615] "" Vector__XXX

BO_ 2566094336 VDMA_F37E_HVESS_Coolant_Pump_1_S: 8 Vector__XXX
 SG_ HVESS_Coolant_Pump_1_Status_2_Ra : 0|64@1+ (1,0) [0|18446744073709551615] "" Vector__XXX

BO_ 2566094592 VDMA_F37F_HVESS_Coolant_Pump_2_S: 8 Vector__XXX
 SG_ HVESS_Coolant_Pump_2_Status_2_Ra : 0|64@1+ (1,0) [0|18446744073709551615] "" Vector__XXX

BO_ 2566094848 VDMA_F380_High_Voltage_Energy_St: 8 Vector__XXX
 SG_ High_Voltage_Energy_Storage_Syst : 0|64@1+ (1,0) [0|18446744073709551615] "" Vector__XXX

BO_ 2566095104 VDMA_F381_PTO_Drive_Engagement_2: 8 Vector__XXX
 SG_ PTO_Drive_Engagement_2_RawPayloa : 0|64@1+ (1,0) [0|18446744073709551615] "" Vector__XXX

BO_ 2566095360 VDMA_F382_Fuel_Cell_System_Hydro: 8 Vector__XXX
 SG_ Fuel_Cell_System_Hydrogen_Pressu : 0|64@1+ (1,0) [0|18446744073709551615] "" Vector__XXX

BO_ 2566095616 VDMA_F383_Engine_Gas_Flow_Rate_2: 8 Vector__XXX
 SG_ Engine_Gas_Flow_Rate_2_RawPayloa : 0|64@1+ (1,0) [0|18446744073709551615] "" Vector__XXX

BO_ 2566095872 VDMA_F384_Engine_Supercharger_In: 8 Vector__XXX
 SG_ Engine_Supercharger_Information_ : 0|64@1+ (1,0) [0|18446744073709551615] "" Vector__XXX

BO_ 2566096128 VDMA_F385_Engine_Disconnect_Clut: 8 Vector__XXX
 SG_ Engine_Disconnect_Clutch_RawPayl : 0|64@1+ (1,0) [0|18446744073709551615] "" Vector__XXX

BO_ 2566478080 VDMA_F959_GNSS_Correction_Data: 8 Vector__XXX
 SG_ GNSS_Correction_Data_RawPayload : 0|64@1+ (1,0) [0|18446744073709551615] "" Vector__XXX

BO_ 2566478336 VDMA_F95A_Engine_Crankcase_Venti: 8 Vector__XXX
 SG_ Engine_Crankcase_Ventilation_Hea : 0|64@1+ (1,0) [0|18446744073709551615] "" Vector__XXX

BO_ 2566478592 VDMA_F95B_Engine_Crankcase_Venti: 8 Vector__XXX
 SG_ Engine_Crankcase_Ventilation_Hea : 0|64@1+ (1,0) [0|18446744073709551615] "" Vector__XXX

BO_ 2566478848 VDMA_F95C_Engine_Crankcase_Venti: 8 Vector__XXX
 SG_ Engine_Crankcase_Ventilation_Hea : 0|64@1+ (1,0) [0|18446744073709551615] "" Vector__XXX

BO_ 2566479104 VDMA_F95D_Air_Fuel_Ratio_2: 8 Vector__XXX
 SG_ Air_Fuel_Ratio_2_RawPayload : 0|64@1+ (1,0) [0|18446744073709551615] "" Vector__XXX

BO_ 2566479360 VDMA_F95E_OBFCM_Engine_Output_En: 8 Vector__XXX
 SG_ OBFCM_Engine_Output_Energy_Stati : 0|64@1+ (1,0) [0|18446744073709551615] "" Vector__XXX

BO_ 2566479616 VDMA_F95F_OBFCM_Vehicle_Distance: 8 Vector__XXX
 SG_ OBFCM_Vehicle_Distance_Static_Da : 0|64@1+ (1,0) [0|18446744073709551615] "" Vector__XXX

BO_ 2566479872 VDMA_F960_OBFCM_Fuel_2_Static_Da: 8 Vector__XXX
 SG_ OBFCM_Fuel_2_Static_Data_RawPayl : 0|64@1+ (1,0) [0|18446744073709551615] "" Vector__XXX

BO_ 2566480128 VDMA_F961_OBFCM_Fuel_1_Static_Da: 8 Vector__XXX
 SG_ OBFCM_Fuel_1_Static_Data_RawPayl : 0|64@1+ (1,0) [0|18446744073709551615] "" Vector__XXX

BO_ 2566480384 VDMA_F962_OBFCM_Counters: 8 Vector__XXX
 SG_ OBFCM_Counters_RawPayload : 0|64@1+ (1,0) [0|18446744073709551615] "" Vector__XXX

BO_ 2566480640 VDMA_F963_OBFCM_Accumulators: 8 Vector__XXX
 SG_ OBFCM_Accumulators_RawPayload : 0|64@1+ (1,0) [0|18446744073709551615] "" Vector__XXX

BO_ 2566480896 VDMA_F964_OBFCM_Fuel_Consumption: 8 Vector__XXX
 SG_ OBFCM_Fuel_Consumption_RawPayloa : 0|64@1+ (1,0) [0|18446744073709551615] "" Vector__XXX

BO_ 2566481152 VDMA_F965_Engine_VVT_System_Data: 8 Vector__XXX
 SG_ Engine_VVT_System_Data_RawPayloa : 0|64@1+ (1,0) [0|18446744073709551615] "" Vector__XXX

BO_ 2566481408 VDMA_F966_Maintenance_Informatio: 8 Vector__XXX
 SG_ Maintenance_Information_2_RawPay : 0|64@1+ (1,0) [0|18446744073709551615] "" Vector__XXX

BO_ 2566481664 VDMA_F967_Alternate_Fuel_7: 8 Vector__XXX
 SG_ Alternate_Fuel_7_RawPayload : 0|64@1+ (1,0) [0|18446744073709551615] "" Vector__XXX

BO_ 2566481920 VDMA_F968_Engine_Catalyst_Divert: 8 Vector__XXX
 SG_ Engine_Catalyst_Diverter_Actuato : 0|64@1+ (1,0) [0|18446744073709551615] "" Vector__XXX

BO_ 2566482176 VDMA_F969_Electronic_Logging_Dev: 8 Vector__XXX
 SG_ Electronic_Logging_Device_Hours_ : 0|64@1+ (1,0) [0|18446744073709551615] "" Vector__XXX

BO_ 2566482432 VDMA_F96A_ER_DC_DC_Converter_4_R: 8 Vector__XXX
 SG_ ER_DC_DC_Converter_4_References_ : 0|64@1+ (1,0) [0|18446744073709551615] "" Vector__XXX

BO_ 2566482688 VDMA_F96B_ER_DC_DC_Converter_4_P: 8 Vector__XXX
 SG_ ER_DC_DC_Converter_4_Power_Limit : 0|64@1+ (1,0) [0|18446744073709551615] "" Vector__XXX

BO_ 2566482944 VDMA_F96C_ER_DC_DC_Converter_4_C: 8 Vector__XXX
 SG_ ER_DC_DC_Converter_4_Current_Lim : 0|64@1+ (1,0) [0|18446744073709551615] "" Vector__XXX

BO_ 2566483200 VDMA_F96D_ER_DC_DC_Converter_4_V: 8 Vector__XXX
 SG_ ER_DC_DC_Converter_4_Voltage_Lim : 0|64@1+ (1,0) [0|18446744073709551615] "" Vector__XXX

BO_ 2566483456 VDMA_F96E_ER_DC_DC_Converter_4_T: 8 Vector__XXX
 SG_ ER_DC_DC_Converter_4_Temperature : 0|64@1+ (1,0) [0|18446744073709551615] "" Vector__XXX

BO_ 2566483712 VDMA_F96F_ER_DC_DC_Converter_4_P: 8 Vector__XXX
 SG_ ER_DC_DC_Converter_4_Power_Limit : 0|64@1+ (1,0) [0|18446744073709551615] "" Vector__XXX

BO_ 2566483968 VDMA_F970_ER_DC_DC_Converter_4_C: 8 Vector__XXX
 SG_ ER_DC_DC_Converter_4_Current_Lim : 0|64@1+ (1,0) [0|18446744073709551615] "" Vector__XXX

BO_ 2566484224 VDMA_F971_ER_DC_DC_Converter_4_V: 8 Vector__XXX
 SG_ ER_DC_DC_Converter_4_Voltage_Lim : 0|64@1+ (1,0) [0|18446744073709551615] "" Vector__XXX

BO_ 2566484480 VDMA_F972_ER_DC_DC_Converter_4_L: 8 Vector__XXX
 SG_ ER_DC_DC_Converter_4_Low_Voltage : 0|64@1+ (1,0) [0|18446744073709551615] "" Vector__XXX

BO_ 2566484736 VDMA_F973_ER_DC_DC_Converter_4_P: 8 Vector__XXX
 SG_ ER_DC_DC_Converter_4_Power_and_C : 0|64@1+ (1,0) [0|18446744073709551615] "" Vector__XXX

BO_ 2566484992 VDMA_F974_ER_DC_DC_Converter_4_V: 8 Vector__XXX
 SG_ ER_DC_DC_Converter_4_Voltage_and : 0|64@1+ (1,0) [0|18446744073709551615] "" Vector__XXX

BO_ 2566485248 VDMA_F975_ER_DC_DC_Converter_4_O: 8 Vector__XXX
 SG_ ER_DC_DC_Converter_4_Operating_S : 0|64@1+ (1,0) [0|18446744073709551615] "" Vector__XXX

BO_ 2566485504 VDMA_F976_ER_DC_DC_Converter_4_C: 8 Vector__XXX
 SG_ ER_DC_DC_Converter_4_Control_Raw : 0|64@1+ (1,0) [0|18446744073709551615] "" Vector__XXX

BO_ 2566485760 VDMA_F977_ER_DC_DC_Converter_3_R: 8 Vector__XXX
 SG_ ER_DC_DC_Converter_3_References_ : 0|64@1+ (1,0) [0|18446744073709551615] "" Vector__XXX

BO_ 2566486016 VDMA_F978_ER_DC_DC_Converter_3_P: 8 Vector__XXX
 SG_ ER_DC_DC_Converter_3_Power_Limit : 0|64@1+ (1,0) [0|18446744073709551615] "" Vector__XXX

BO_ 2566486272 VDMA_F979_ER_DC_DC_Converter_3_C: 8 Vector__XXX
 SG_ ER_DC_DC_Converter_3_Current_Lim : 0|64@1+ (1,0) [0|18446744073709551615] "" Vector__XXX

BO_ 2566486528 VDMA_F97A_ER_DC_DC_Converter_3_V: 8 Vector__XXX
 SG_ ER_DC_DC_Converter_3_Voltage_Lim : 0|64@1+ (1,0) [0|18446744073709551615] "" Vector__XXX

BO_ 2566486784 VDMA_F97B_ER_DC_DC_Converter_3_T: 8 Vector__XXX
 SG_ ER_DC_DC_Converter_3_Temperature : 0|64@1+ (1,0) [0|18446744073709551615] "" Vector__XXX

BO_ 2566487040 VDMA_F97C_ER_DC_DC_Converter_3_P: 8 Vector__XXX
 SG_ ER_DC_DC_Converter_3_Power_Limit : 0|64@1+ (1,0) [0|18446744073709551615] "" Vector__XXX

BO_ 2566487296 VDMA_F97D_ER_DC_DC_Converter_3_C: 8 Vector__XXX
 SG_ ER_DC_DC_Converter_3_Current_Lim : 0|64@1+ (1,0) [0|18446744073709551615] "" Vector__XXX

BO_ 2566487552 VDMA_F97E_ER_DC_DC_Converter_3_V: 8 Vector__XXX
 SG_ ER_DC_DC_Converter_3_Voltage_Lim : 0|64@1+ (1,0) [0|18446744073709551615] "" Vector__XXX

BO_ 2566487808 VDMA_F97F_ER_DC_DC_Converter_3_L: 8 Vector__XXX
 SG_ ER_DC_DC_Converter_3_Low_Voltage : 0|64@1+ (1,0) [0|18446744073709551615] "" Vector__XXX

BO_ 2566488064 VDMA_F980_ER_DC_DC_Converter_3_P: 8 Vector__XXX
 SG_ ER_DC_DC_Converter_3_Power_and_C : 0|64@1+ (1,0) [0|18446744073709551615] "" Vector__XXX

BO_ 2566488320 VDMA_F981_ER_DC_DC_Converter_3_V: 8 Vector__XXX
 SG_ ER_DC_DC_Converter_3_Voltage_and : 0|64@1+ (1,0) [0|18446744073709551615] "" Vector__XXX

BO_ 2566488576 VDMA_F982_ER_DC_DC_Converter_3_O: 8 Vector__XXX
 SG_ ER_DC_DC_Converter_3_Operating_S : 0|64@1+ (1,0) [0|18446744073709551615] "" Vector__XXX

BO_ 2566488832 VDMA_F983_ER_DC_DC_Converter_3_C: 8 Vector__XXX
 SG_ ER_DC_DC_Converter_3_Control_Raw : 0|64@1+ (1,0) [0|18446744073709551615] "" Vector__XXX

BO_ 2566489088 VDMA_F984_ER_DC_DC_Converter_2_R: 8 Vector__XXX
 SG_ ER_DC_DC_Converter_2_References_ : 0|64@1+ (1,0) [0|18446744073709551615] "" Vector__XXX

BO_ 2566489344 VDMA_F985_ER_DC_DC_Converter_2_P: 8 Vector__XXX
 SG_ ER_DC_DC_Converter_2_Power_Limit : 0|64@1+ (1,0) [0|18446744073709551615] "" Vector__XXX

BO_ 2566489600 VDMA_F986_ER_DC_DC_Converter_2_C: 8 Vector__XXX
 SG_ ER_DC_DC_Converter_2_Current_Lim : 0|64@1+ (1,0) [0|18446744073709551615] "" Vector__XXX

BO_ 2566489856 VDMA_F987_ER_DC_DC_Converter_2_V: 8 Vector__XXX
 SG_ ER_DC_DC_Converter_2_Voltage_Lim : 0|64@1+ (1,0) [0|18446744073709551615] "" Vector__XXX

BO_ 2566490112 VDMA_F988_ER_DC_DC_Converter_2_T: 8 Vector__XXX
 SG_ ER_DC_DC_Converter_2_Temperature : 0|64@1+ (1,0) [0|18446744073709551615] "" Vector__XXX

BO_ 2566490368 VDMA_F989_ER_DC_DC_Converter_2_P: 8 Vector__XXX
 SG_ ER_DC_DC_Converter_2_Power_Limit : 0|64@1+ (1,0) [0|18446744073709551615] "" Vector__XXX

BO_ 2566490624 VDMA_F98A_ER_DC_DC_Converter_2_C: 8 Vector__XXX
 SG_ ER_DC_DC_Converter_2_Current_Lim : 0|64@1+ (1,0) [0|18446744073709551615] "" Vector__XXX

BO_ 2566490880 VDMA_F98B_ER_DC_DC_Converter_2_V: 8 Vector__XXX
 SG_ ER_DC_DC_Converter_2_Voltage_Lim : 0|64@1+ (1,0) [0|18446744073709551615] "" Vector__XXX

BO_ 2566491136 VDMA_F98C_ER_DC_DC_Converter_2_L: 8 Vector__XXX
 SG_ ER_DC_DC_Converter_2_Low_Voltage : 0|64@1+ (1,0) [0|18446744073709551615] "" Vector__XXX

BO_ 2566491392 VDMA_F98D_ER_DC_DC_Converter_2_P: 8 Vector__XXX
 SG_ ER_DC_DC_Converter_2_Power_and_C : 0|64@1+ (1,0) [0|18446744073709551615] "" Vector__XXX

BO_ 2566491648 VDMA_F98E_ER_DC_DC_Converter_2_V: 8 Vector__XXX
 SG_ ER_DC_DC_Converter_2_Voltage_and : 0|64@1+ (1,0) [0|18446744073709551615] "" Vector__XXX

BO_ 2566491904 VDMA_F98F_ER_DC_DC_Converter_2_O: 8 Vector__XXX
 SG_ ER_DC_DC_Converter_2_Operating_S : 0|64@1+ (1,0) [0|18446744073709551615] "" Vector__XXX

BO_ 2566492160 VDMA_F990_ER_DC_DC_Converter_2_C: 8 Vector__XXX
 SG_ ER_DC_DC_Converter_2_Control_Raw : 0|64@1+ (1,0) [0|18446744073709551615] "" Vector__XXX

BO_ 2566492416 VDMA_F991_ER_DC_DC_Converter_1_R: 8 Vector__XXX
 SG_ ER_DC_DC_Converter_1_References_ : 0|64@1+ (1,0) [0|18446744073709551615] "" Vector__XXX

BO_ 2566492672 VDMA_F992_ER_DC_DC_Converter_1_P: 8 Vector__XXX
 SG_ ER_DC_DC_Converter_1_Power_Limit : 0|64@1+ (1,0) [0|18446744073709551615] "" Vector__XXX

BO_ 2566492928 VDMA_F993_ER_DC_DC_Converter_1_C: 8 Vector__XXX
 SG_ ER_DC_DC_Converter_1_Current_Lim : 0|64@1+ (1,0) [0|18446744073709551615] "" Vector__XXX

BO_ 2566493184 VDMA_F994_ER_DC_DC_Converter_1_V: 8 Vector__XXX
 SG_ ER_DC_DC_Converter_1_Voltage_Lim : 0|64@1+ (1,0) [0|18446744073709551615] "" Vector__XXX

BO_ 2566493440 VDMA_F995_ER_DC_DC_Converter_1_T: 8 Vector__XXX
 SG_ ER_DC_DC_Converter_1_Temperature : 0|64@1+ (1,0) [0|18446744073709551615] "" Vector__XXX

BO_ 2566493696 VDMA_F996_ER_DC_DC_Converter_1_P: 8 Vector__XXX
 SG_ ER_DC_DC_Converter_1_Power_Limit : 0|64@1+ (1,0) [0|18446744073709551615] "" Vector__XXX

BO_ 2566493952 VDMA_F997_ER_DC_DC_Converter_1_C: 8 Vector__XXX
 SG_ ER_DC_DC_Converter_1_Current_Lim : 0|64@1+ (1,0) [0|18446744073709551615] "" Vector__XXX

BO_ 2566494208 VDMA_F998_ER_DC_DC_Converter_1_V: 8 Vector__XXX
 SG_ ER_DC_DC_Converter_1_Voltage_Lim : 0|64@1+ (1,0) [0|18446744073709551615] "" Vector__XXX

BO_ 2566494464 VDMA_F999_ER_DC_DC_Converter_1_L: 8 Vector__XXX
 SG_ ER_DC_DC_Converter_1_Low_Voltage : 0|64@1+ (1,0) [0|18446744073709551615] "" Vector__XXX

BO_ 2566494720 VDMA_F99A_ER_DC_DC_Converter_1_P: 8 Vector__XXX
 SG_ ER_DC_DC_Converter_1_Power_and_C : 0|64@1+ (1,0) [0|18446744073709551615] "" Vector__XXX

BO_ 2566494976 VDMA_F99B_ER_DC_DC_Converter_1_V: 8 Vector__XXX
 SG_ ER_DC_DC_Converter_1_Voltage_and : 0|64@1+ (1,0) [0|18446744073709551615] "" Vector__XXX

BO_ 2566495232 VDMA_F99C_ER_DC_DC_Converter_1_O: 8 Vector__XXX
 SG_ ER_DC_DC_Converter_1_Operating_S : 0|64@1+ (1,0) [0|18446744073709551615] "" Vector__XXX

BO_ 2566495488 VDMA_F99D_ER_DC_DC_Converter_1_C: 8 Vector__XXX
 SG_ ER_DC_DC_Converter_1_Control_Raw : 0|64@1+ (1,0) [0|18446744073709551615] "" Vector__XXX

BO_ 2566495744 VDMA_F99E_Cab_Air_Quality_System: 8 Vector__XXX
 SG_ Cab_Air_Quality_System_Informati : 0|64@1+ (1,0) [0|18446744073709551615] "" Vector__XXX

BO_ 2566496000 VDMA_F99F_Cab_Air_Quality_System: 8 Vector__XXX
 SG_ Cab_Air_Quality_System_Informati : 0|64@1+ (1,0) [0|18446744073709551615] "" Vector__XXX

BO_ 2566496256 VDMA_F9A0_Well_Stimulation_Pump_: 8 Vector__XXX
 SG_ Well_Stimulation_Pump_System_6_R : 0|64@1+ (1,0) [0|18446744073709551615] "" Vector__XXX

BO_ 2566496512 VDMA_F9A1_Engine_Fuel_Lube_Syste: 8 Vector__XXX
 SG_ Engine_Fuel_Lube_Systems_4_RawPa : 0|64@1+ (1,0) [0|18446744073709551615] "" Vector__XXX

BO_ 2566496768 VDMA_F9A2_Alternate_Fuel_6: 8 Vector__XXX
 SG_ Alternate_Fuel_6_RawPayload : 0|64@1+ (1,0) [0|18446744073709551615] "" Vector__XXX

BO_ 2566497024 VDMA_F9A3_Engine_Catalyst_Divert: 8 Vector__XXX
 SG_ Engine_Catalyst_Diverter_Actuato : 0|64@1+ (1,0) [0|18446744073709551615] "" Vector__XXX

BO_ 2566497280 VDMA_F9A4_Ambient_Conditions_4: 8 Vector__XXX
 SG_ Ambient_Conditions_4_RawPayload : 0|64@1+ (1,0) [0|18446744073709551615] "" Vector__XXX

BO_ 2566497536 VDMA_F9A5_Engine_Exhaust_Particu: 8 Vector__XXX
 SG_ Engine_Exhaust_Particulate_Contr : 0|64@1+ (1,0) [0|18446744073709551615] "" Vector__XXX

BO_ 2566497792 VDMA_F9A6_Engine_Exhaust_Particu: 8 Vector__XXX
 SG_ Engine_Exhaust_Particulate_Contr : 0|64@1+ (1,0) [0|18446744073709551615] "" Vector__XXX

BO_ 2566498048 VDMA_F9A7_Aftertreatment_System_: 8 Vector__XXX
 SG_ Aftertreatment_System_Informatio : 0|64@1+ (1,0) [0|18446744073709551615] "" Vector__XXX

BO_ 2566498304 VDMA_F9A8_Aftertreatment_System_: 8 Vector__XXX
 SG_ Aftertreatment_System_Informatio : 0|64@1+ (1,0) [0|18446744073709551615] "" Vector__XXX

BO_ 2566498560 VDMA_F9A9_Aftertreatment_System_: 8 Vector__XXX
 SG_ Aftertreatment_System_Informatio : 0|64@1+ (1,0) [0|18446744073709551615] "" Vector__XXX

BO_ 2566498816 VDMA_F9AA_Aftertreatment_System_: 8 Vector__XXX
 SG_ Aftertreatment_System_Informatio : 0|64@1+ (1,0) [0|18446744073709551615] "" Vector__XXX

BO_ 2566499072 VDMA_F9AB_Aftertreatment_System_: 8 Vector__XXX
 SG_ Aftertreatment_System_Informatio : 0|64@1+ (1,0) [0|18446744073709551615] "" Vector__XXX

BO_ 2566499328 VDMA_F9AC_Aftertreatment_System_: 8 Vector__XXX
 SG_ Aftertreatment_System_Informatio : 0|64@1+ (1,0) [0|18446744073709551615] "" Vector__XXX

BO_ 2566499584 VDMA_F9AD_Aftertreatment_System_: 8 Vector__XXX
 SG_ Aftertreatment_System_Informatio : 0|64@1+ (1,0) [0|18446744073709551615] "" Vector__XXX

BO_ 2566499840 VDMA_F9AE_Aftertreatment_System_: 8 Vector__XXX
 SG_ Aftertreatment_System_Informatio : 0|64@1+ (1,0) [0|18446744073709551615] "" Vector__XXX

BO_ 2566500096 VDMA_F9AF_Aftertreatment_System_: 8 Vector__XXX
 SG_ Aftertreatment_System_Informatio : 0|64@1+ (1,0) [0|18446744073709551615] "" Vector__XXX

BO_ 2566500352 VDMA_F9B0_Aftertreatment_System_: 8 Vector__XXX
 SG_ Aftertreatment_System_Informatio : 0|64@1+ (1,0) [0|18446744073709551615] "" Vector__XXX

BO_ 2566500608 VDMA_F9B1_Aftertreatment_System_: 8 Vector__XXX
 SG_ Aftertreatment_System_Informatio : 0|64@1+ (1,0) [0|18446744073709551615] "" Vector__XXX

BO_ 2566500864 VDMA_F9B2_Aftertreatment_System_: 8 Vector__XXX
 SG_ Aftertreatment_System_Informatio : 0|64@1+ (1,0) [0|18446744073709551615] "" Vector__XXX

BO_ 2566501120 VDMA_F9B3_Route_Attributes_Profi: 8 Vector__XXX
 SG_ Route_Attributes_Profile_RawPayl : 0|64@1+ (1,0) [0|18446744073709551615] "" Vector__XXX

BO_ 2566501376 VDMA_F9B4_Genset_Supporting_Func: 8 Vector__XXX
 SG_ Genset_Supporting_Functions_2_Ra : 0|64@1+ (1,0) [0|18446744073709551615] "" Vector__XXX

BO_ 2566501632 VDMA_F9B5_Alternator_Information: 8 Vector__XXX
 SG_ Alternator_Information_2_RawPayl : 0|64@1+ (1,0) [0|18446744073709551615] "" Vector__XXX

BO_ 2566501888 VDMA_F9B6_Well_Stimulation_Pump_: 8 Vector__XXX
 SG_ Well_Stimulation_Pump_System_5_R : 0|64@1+ (1,0) [0|18446744073709551615] "" Vector__XXX

BO_ 2566502144 VDMA_F9B7_Well_Stimulation_Pump_: 8 Vector__XXX
 SG_ Well_Stimulation_Pump_System_4_R : 0|64@1+ (1,0) [0|18446744073709551615] "" Vector__XXX

BO_ 2566502400 VDMA_F9B8_Tire_Information: 8 Vector__XXX
 SG_ Tire_Information_RawPayload : 0|64@1+ (1,0) [0|18446744073709551615] "" Vector__XXX

BO_ 2566502656 VDMA_F9B9_Hydrogen_System_Status: 8 Vector__XXX
 SG_ Hydrogen_System_Status_RawPayloa : 0|64@1+ (1,0) [0|18446744073709551615] "" Vector__XXX

BO_ 2566502912 VDMA_F9BA_Route_Waypoint_GPS_Coo: 8 Vector__XXX
 SG_ Route_Waypoint_GPS_Coordinates_R : 0|64@1+ (1,0) [0|18446744073709551615] "" Vector__XXX

BO_ 2566503168 VDMA_F9BB_Route_Information: 8 Vector__XXX
 SG_ Route_Information_RawPayload : 0|64@1+ (1,0) [0|18446744073709551615] "" Vector__XXX

BO_ 2566503424 VDMA_F9BC_Engine_Fluid_Level_Pre: 8 Vector__XXX
 SG_ Engine_Fluid_Level_Pressure_15_R : 0|64@1+ (1,0) [0|18446744073709551615] "" Vector__XXX

BO_ 2566503680 VDMA_F9BD_Fuel_Cell_System_Coola: 8 Vector__XXX
 SG_ Fuel_Cell_System_Coolant_Informa : 0|64@1+ (1,0) [0|18446744073709551615] "" Vector__XXX

BO_ 2566503936 VDMA_F9BE_Transmission_Configura: 8 Vector__XXX
 SG_ Transmission_Configuration_3_Raw : 0|64@1+ (1,0) [0|18446744073709551615] "" Vector__XXX

BO_ 2566504192 VDMA_F9BF_Enrichment_Information: 8 Vector__XXX
 SG_ Enrichment_Information_RawPayloa : 0|64@1+ (1,0) [0|18446744073709551615] "" Vector__XXX

BO_ 2566504448 VDMA_F9C0_Fuel_Cell_System_Volta: 8 Vector__XXX
 SG_ Fuel_Cell_System_Voltage_Limit_C : 0|64@1+ (1,0) [0|18446744073709551615] "" Vector__XXX

BO_ 2566504960 VDMA_F9C2_Hydrogen_System_Inform: 8 Vector__XXX
 SG_ Hydrogen_System_Information_RawP : 0|64@1+ (1,0) [0|18446744073709551615] "" Vector__XXX

BO_ 2566505216 VDMA_F9C3_Auxiliary_Input_Output: 8 Vector__XXX
 SG_ Auxiliary_Input_Output_Status_17 : 0|64@1+ (1,0) [0|18446744073709551615] "" Vector__XXX

BO_ 2566505472 VDMA_F9C4_Auxiliary_Input_Output: 8 Vector__XXX
 SG_ Auxiliary_Input_Output_Status_16 : 0|64@1+ (1,0) [0|18446744073709551615] "" Vector__XXX

BO_ 2566505728 VDMA_F9C5_Auxiliary_Input_Output: 8 Vector__XXX
 SG_ Auxiliary_Input_Output_Status_15 : 0|64@1+ (1,0) [0|18446744073709551615] "" Vector__XXX

BO_ 2566505984 VDMA_F9C6_Auxiliary_Input_Output: 8 Vector__XXX
 SG_ Auxiliary_Input_Output_Status_14 : 0|64@1+ (1,0) [0|18446744073709551615] "" Vector__XXX

BO_ 2566506240 VDMA_F9C7_Auxiliary_Input_Output: 8 Vector__XXX
 SG_ Auxiliary_Input_Output_Status_13 : 0|64@1+ (1,0) [0|18446744073709551615] "" Vector__XXX

BO_ 2566506496 VDMA_F9C8_Auxiliary_Input_Output: 8 Vector__XXX
 SG_ Auxiliary_Input_Output_Status_12 : 0|64@1+ (1,0) [0|18446744073709551615] "" Vector__XXX

BO_ 2566506752 VDMA_F9C9_Auxiliary_Input_Output: 8 Vector__XXX
 SG_ Auxiliary_Input_Output_Status_11 : 0|64@1+ (1,0) [0|18446744073709551615] "" Vector__XXX

BO_ 2566507008 VDMA_F9CA_Auxiliary_Input_Output: 8 Vector__XXX
 SG_ Auxiliary_Input_Output_Status_10 : 0|64@1+ (1,0) [0|18446744073709551615] "" Vector__XXX

BO_ 2566507264 VDMA_F9CB_Auxiliary_Input_Output: 8 Vector__XXX
 SG_ Auxiliary_Input_Output_Status_9_ : 0|64@1+ (1,0) [0|18446744073709551615] "" Vector__XXX

BO_ 2566507520 VDMA_F9CC_Auxiliary_Input_Output: 8 Vector__XXX
 SG_ Auxiliary_Input_Output_Status_8_ : 0|64@1+ (1,0) [0|18446744073709551615] "" Vector__XXX

BO_ 2566507776 VDMA_F9CD_Aftertreatment_System_: 8 Vector__XXX
 SG_ Aftertreatment_System_Informatio : 0|64@1+ (1,0) [0|18446744073709551615] "" Vector__XXX

BO_ 2566508032 VDMA_F9CE_Brake_Temperature_6: 8 Vector__XXX
 SG_ Brake_Temperature_6_RawPayload : 0|64@1+ (1,0) [0|18446744073709551615] "" Vector__XXX

BO_ 2566508288 VDMA_F9CF_Brake_Temperature_5: 8 Vector__XXX
 SG_ Brake_Temperature_5_RawPayload : 0|64@1+ (1,0) [0|18446744073709551615] "" Vector__XXX

BO_ 2566508544 VDMA_F9D0_Brake_Temperature_4: 8 Vector__XXX
 SG_ Brake_Temperature_4_RawPayload : 0|64@1+ (1,0) [0|18446744073709551615] "" Vector__XXX

BO_ 2566508800 VDMA_F9D1_Brake_Temperature_3: 8 Vector__XXX
 SG_ Brake_Temperature_3_RawPayload : 0|64@1+ (1,0) [0|18446744073709551615] "" Vector__XXX

BO_ 2566509056 VDMA_F9D2_Brake_Temperature_2: 8 Vector__XXX
 SG_ Brake_Temperature_2_RawPayload : 0|64@1+ (1,0) [0|18446744073709551615] "" Vector__XXX

BO_ 2566509312 VDMA_F9D3_Brake_Temperature_1: 8 Vector__XXX
 SG_ Brake_Temperature_1_RawPayload : 0|64@1+ (1,0) [0|18446744073709551615] "" Vector__XXX

BO_ 2566509568 VDMA_F9D4_Wheel_Brake_Lining_Rem: 8 Vector__XXX
 SG_ Wheel_Brake_Lining_Remaining_Inf : 0|64@1+ (1,0) [0|18446744073709551615] "" Vector__XXX

BO_ 2566509824 VDMA_F9D5_Wheel_Brake_Lining_Rem: 8 Vector__XXX
 SG_ Wheel_Brake_Lining_Remaining_Inf : 0|64@1+ (1,0) [0|18446744073709551615] "" Vector__XXX

BO_ 2566510080 VDMA_F9D6_High_Voltage_Bus_Conta: 8 Vector__XXX
 SG_ High_Voltage_Bus_Contactor_Statu : 0|64@1+ (1,0) [0|18446744073709551615] "" Vector__XXX

BO_ 2566510336 VDMA_F9D7_High_Voltage_Bus_Conta: 8 Vector__XXX
 SG_ High_Voltage_Bus_Contactor_Statu : 0|64@1+ (1,0) [0|18446744073709551615] "" Vector__XXX

BO_ 2566510592 VDMA_F9D8_High_Voltage_Bus_Conne: 8 Vector__XXX
 SG_ High_Voltage_Bus_Connection_Comm : 0|64@1+ (1,0) [0|18446744073709551615] "" Vector__XXX

BO_ 2566510848 VDMA_F9D9_Cab_Illumination_Data: 8 Vector__XXX
 SG_ Cab_Illumination_Data_RawPayload : 0|64@1+ (1,0) [0|18446744073709551615] "" Vector__XXX

BO_ 2566511104 VDMA_F9DA_Service_Needed_DTC_Inf: 8 Vector__XXX
 SG_ Service_Needed_DTC_Information_R : 0|64@1+ (1,0) [0|18446744073709551615] "" Vector__XXX

BO_ 2566511360 VDMA_F9DB_EVSE_Status_2: 8 Vector__XXX
 SG_ EVSE_Status_2_RawPayload : 0|64@1+ (1,0) [0|18446744073709551615] "" Vector__XXX

BO_ 2566511616 VDMA_F9DC_High_Voltage_Energy_St: 8 Vector__XXX
 SG_ High_Voltage_Energy_Storage_Syst : 0|64@1+ (1,0) [0|18446744073709551615] "" Vector__XXX

BO_ 2566511872 VDMA_F9DD_High_Voltage_Energy_St: 8 Vector__XXX
 SG_ High_Voltage_Energy_Storage_Syst : 0|64@1+ (1,0) [0|18446744073709551615] "" Vector__XXX

BO_ 2566512128 VDMA_F9DE_High_Voltage_Energy_St: 8 Vector__XXX
 SG_ High_Voltage_Energy_Storage_Syst : 0|64@1+ (1,0) [0|18446744073709551615] "" Vector__XXX

BO_ 2566512384 VDMA_F9DF_HVESS_Coolant_Pump_1_S: 8 Vector__XXX
 SG_ HVESS_Coolant_Pump_1_Status_1_Ra : 0|64@1+ (1,0) [0|18446744073709551615] "" Vector__XXX

BO_ 2566512640 VDMA_F9E0_HVESS_Coolant_Pump_1_C: 8 Vector__XXX
 SG_ HVESS_Coolant_Pump_1_Command_Raw : 0|64@1+ (1,0) [0|18446744073709551615] "" Vector__XXX

BO_ 2566512896 VDMA_F9E1_HVESS_Coolant_Pump_2_S: 8 Vector__XXX
 SG_ HVESS_Coolant_Pump_2_Status_1_Ra : 0|64@1+ (1,0) [0|18446744073709551615] "" Vector__XXX

BO_ 2566513152 VDMA_F9E2_HVESS_Coolant_Pump_2_C: 8 Vector__XXX
 SG_ HVESS_Coolant_Pump_2_Command_Raw : 0|64@1+ (1,0) [0|18446744073709551615] "" Vector__XXX

BO_ 2566513408 VDMA_F9E3_Hydrogen_Sensor_Inform: 8 Vector__XXX
 SG_ Hydrogen_Sensor_Information_RawP : 0|64@1+ (1,0) [0|18446744073709551615] "" Vector__XXX

BO_ 2566513664 VDMA_F9E4_Operator_Inducement_In: 8 Vector__XXX
 SG_ Operator_Inducement_Information_ : 0|64@1+ (1,0) [0|18446744073709551615] "" Vector__XXX

BO_ 2566513920 VDMA_F9E5_Operator_Inducement_Ve: 8 Vector__XXX
 SG_ Operator_Inducement_Vehicle_Spee : 0|64@1+ (1,0) [0|18446744073709551615] "" Vector__XXX

BO_ 2566514176 VDMA_F9E6_Operator_Inducement_Ve: 8 Vector__XXX
 SG_ Operator_Inducement_Vehicle_Spee : 0|64@1+ (1,0) [0|18446744073709551615] "" Vector__XXX

BO_ 2566514432 VDMA_F9E7_Engine_Protection_Spee: 8 Vector__XXX
 SG_ Engine_Protection_Speed_Derate_I : 0|64@1+ (1,0) [0|18446744073709551615] "" Vector__XXX

BO_ 2566514688 VDMA_F9E8_Engine_Protection_Torq: 8 Vector__XXX
 SG_ Engine_Protection_Torque_Derate_ : 0|64@1+ (1,0) [0|18446744073709551615] "" Vector__XXX

BO_ 2566514944 VDMA_F9E9_Aftertreatment_System_: 8 Vector__XXX
 SG_ Aftertreatment_System_Informatio : 0|64@1+ (1,0) [0|18446744073709551615] "" Vector__XXX

BO_ 2566515200 VDMA_F9EA_SAE_J2012_3_Byte_DTC_D: 8 Vector__XXX
 SG_ SAE_J2012_3_Byte_DTC_Display_Raw : 0|64@1+ (1,0) [0|18446744073709551615] "" Vector__XXX

BO_ 2566515456 VDMA_F9EB_High_Voltage_Energy_St: 8 Vector__XXX
 SG_ High_Voltage_Energy_Storage_Syst : 0|64@1+ (1,0) [0|18446744073709551615] "" Vector__XXX

BO_ 2566515712 VDMA_F9EC_High_Voltage_Energy_St: 8 Vector__XXX
 SG_ High_Voltage_Energy_Storage_Syst : 0|64@1+ (1,0) [0|18446744073709551615] "" Vector__XXX

BO_ 2566515968 VDMA_F9ED_High_Voltage_Energy_St: 8 Vector__XXX
 SG_ High_Voltage_Energy_Storage_Syst : 0|64@1+ (1,0) [0|18446744073709551615] "" Vector__XXX

BO_ 2566516224 VDMA_F9EE_Engine_Cylinder_Averag: 8 Vector__XXX
 SG_ Engine_Cylinder_Average_Ignition : 0|64@1+ (1,0) [0|18446744073709551615] "" Vector__XXX

BO_ 2566516480 VDMA_F9EF_Engine_Cylinder_Averag: 8 Vector__XXX
 SG_ Engine_Cylinder_Average_Ignition : 0|64@1+ (1,0) [0|18446744073709551615] "" Vector__XXX

BO_ 2566516736 VDMA_F9F0_Engine_Cylinder_Averag: 8 Vector__XXX
 SG_ Engine_Cylinder_Average_Ignition : 0|64@1+ (1,0) [0|18446744073709551615] "" Vector__XXX

BO_ 2566516992 VDMA_F9F1_Engine_Cylinder_Averag: 8 Vector__XXX
 SG_ Engine_Cylinder_Average_Ignition : 0|64@1+ (1,0) [0|18446744073709551615] "" Vector__XXX

BO_ 2566517248 VDMA_F9F2_Engine_Cylinder_Averag: 8 Vector__XXX
 SG_ Engine_Cylinder_Average_Ignition : 0|64@1+ (1,0) [0|18446744073709551615] "" Vector__XXX

BO_ 2566517504 VDMA_F9F3_Engine_Indicated_Mean_: 8 Vector__XXX
 SG_ Engine_Indicated_Mean_Effective_ : 0|64@1+ (1,0) [0|18446744073709551615] "" Vector__XXX

BO_ 2566517760 VDMA_F9F4_Engine_Indicated_Mean_: 8 Vector__XXX
 SG_ Engine_Indicated_Mean_Effective_ : 0|64@1+ (1,0) [0|18446744073709551615] "" Vector__XXX

BO_ 2566518016 VDMA_F9F5_Engine_Indicated_Mean_: 8 Vector__XXX
 SG_ Engine_Indicated_Mean_Effective_ : 0|64@1+ (1,0) [0|18446744073709551615] "" Vector__XXX

BO_ 2566518272 VDMA_F9F6_Fuel_Cell_System_Coola: 8 Vector__XXX
 SG_ Fuel_Cell_System_Coolant_Fan_1_C : 0|64@1+ (1,0) [0|18446744073709551615] "" Vector__XXX

BO_ 2566518528 VDMA_F9F7_Fuel_Cell_System_Coola: 8 Vector__XXX
 SG_ Fuel_Cell_System_Coolant_Fan_1_S : 0|64@1+ (1,0) [0|18446744073709551615] "" Vector__XXX

BO_ 2566518784 VDMA_F9F8_Fuel_Cell_System_Coola: 8 Vector__XXX
 SG_ Fuel_Cell_System_Coolant_Fan_2_C : 0|64@1+ (1,0) [0|18446744073709551615] "" Vector__XXX

BO_ 2566519040 VDMA_F9F9_Fuel_Cell_System_Coola: 8 Vector__XXX
 SG_ Fuel_Cell_System_Coolant_Fan_2_S : 0|64@1+ (1,0) [0|18446744073709551615] "" Vector__XXX

BO_ 2566519296 VDMA_F9FA_Fuel_Cell_System_Coola: 8 Vector__XXX
 SG_ Fuel_Cell_System_Coolant_Fan_3_C : 0|64@1+ (1,0) [0|18446744073709551615] "" Vector__XXX

BO_ 2566519552 VDMA_F9FB_Fuel_Cell_System_Coola: 8 Vector__XXX
 SG_ Fuel_Cell_System_Coolant_Fan_3_S : 0|64@1+ (1,0) [0|18446744073709551615] "" Vector__XXX

BO_ 2566519808 VDMA_F9FC_Fuel_Cell_System_Coola: 8 Vector__XXX
 SG_ Fuel_Cell_System_Coolant_Fan_4_C : 0|64@1+ (1,0) [0|18446744073709551615] "" Vector__XXX

BO_ 2566520064 VDMA_F9FD_Fuel_Cell_System_Coola: 8 Vector__XXX
 SG_ Fuel_Cell_System_Coolant_Fan_4_S : 0|64@1+ (1,0) [0|18446744073709551615] "" Vector__XXX

BO_ 2566520320 VDMA_F9FE_APIs_Supported: 8 Vector__XXX
 SG_ APIs_Supported_RawPayload : 0|64@1+ (1,0) [0|18446744073709551615] "" Vector__XXX

BO_ 2566520576 VDMA_F9FF_Fuel_Cell_System_Confi: 8 Vector__XXX
 SG_ Fuel_Cell_System_Configuration_R : 0|64@1+ (1,0) [0|18446744073709551615] "" Vector__XXX

BO_ 2566520832 VDMA_FA00_Fuel_Cell_System_Coola: 8 Vector__XXX
 SG_ Fuel_Cell_System_Coolant_Informa : 0|64@1+ (1,0) [0|18446744073709551615] "" Vector__XXX

BO_ 2566521088 VDMA_FA01_Fuel_Cell_System_Coola: 8 Vector__XXX
 SG_ Fuel_Cell_System_Coolant_Informa : 0|64@1+ (1,0) [0|18446744073709551615] "" Vector__XXX

BO_ 2566522368 VDMA_FA06_Dash_Display_3: 8 Vector__XXX
 SG_ Dash_Display_3_RawPayload : 0|64@1+ (1,0) [0|18446744073709551615] "" Vector__XXX

BO_ 2566522624 VDMA_FA07_Vehicle_Speed_Profile: 8 Vector__XXX
 SG_ Vehicle_Speed_Profile_RawPayload : 0|64@1+ (1,0) [0|18446744073709551615] "" Vector__XXX

BO_ 2566522880 VDMA_FA08_Reference_Time: 8 Vector__XXX
 SG_ Reference_Time_RawPayload : 0|64@1+ (1,0) [0|18446744073709551615] "" Vector__XXX

BO_ 2566523136 VDMA_FA09_Software_History: 8 Vector__XXX
 SG_ Software_History_RawPayload : 0|64@1+ (1,0) [0|18446744073709551615] "" Vector__XXX

BO_ 2566523392 VDMA_FA0A_Motor_Generator_1_Ther: 8 Vector__XXX
 SG_ Motor_Generator_1_Thermal_Perfor : 0|64@1+ (1,0) [0|18446744073709551615] "" Vector__XXX

BO_ 2566523648 VDMA_FA0B_Motor_Generator_2_Ther: 8 Vector__XXX
 SG_ Motor_Generator_2_Thermal_Perfor : 0|64@1+ (1,0) [0|18446744073709551615] "" Vector__XXX

BO_ 2566523904 VDMA_FA0C_Motor_Generator_3_Ther: 8 Vector__XXX
 SG_ Motor_Generator_3_Thermal_Perfor : 0|64@1+ (1,0) [0|18446744073709551615] "" Vector__XXX

BO_ 2566524160 VDMA_FA0D_Motor_Generator_4_Ther: 8 Vector__XXX
 SG_ Motor_Generator_4_Thermal_Perfor : 0|64@1+ (1,0) [0|18446744073709551615] "" Vector__XXX

BO_ 2566524416 VDMA_FA0E_Motor_Generator_5_Ther: 8 Vector__XXX
 SG_ Motor_Generator_5_Thermal_Perfor : 0|64@1+ (1,0) [0|18446744073709551615] "" Vector__XXX

BO_ 2566524672 VDMA_FA0F_Motor_Generator_6_Ther: 8 Vector__XXX
 SG_ Motor_Generator_6_Thermal_Perfor : 0|64@1+ (1,0) [0|18446744073709551615] "" Vector__XXX

BO_ 2566524928 VDMA_FA10_On_Board_Programming_E: 8 Vector__XXX
 SG_ On_Board_Programming_Event_Time_ : 0|64@1+ (1,0) [0|18446744073709551615] "" Vector__XXX

BO_ 2566525184 VDMA_FA11_Aftertreatment_1_Light: 8 Vector__XXX
 SG_ Aftertreatment_1_Light_Off_SCR_S : 0|64@1+ (1,0) [0|18446744073709551615] "" Vector__XXX

BO_ 2566525440 VDMA_FA12_Motor_Generator_Locati: 8 Vector__XXX
 SG_ Motor_Generator_Location_Extende : 0|64@1+ (1,0) [0|18446744073709551615] "" Vector__XXX

BO_ 2566525696 VDMA_FA13_Cold_Start_Emissions_R: 8 Vector__XXX
 SG_ Cold_Start_Emissions_Reduction_S : 0|64@1+ (1,0) [0|18446744073709551615] "" Vector__XXX

BO_ 2566525952 VDMA_FA14_Cold_Start_Emissions_R: 8 Vector__XXX
 SG_ Cold_Start_Emissions_Reduction_S : 0|64@1+ (1,0) [0|18446744073709551615] "" Vector__XXX

BO_ 2566526208 VDMA_FA15_Genset_Supporting_Func: 8 Vector__XXX
 SG_ Genset_Supporting_Functions_RawP : 0|64@1+ (1,0) [0|18446744073709551615] "" Vector__XXX

BO_ 2566526464 VDMA_FA16_High_Voltage_Energy_St: 8 Vector__XXX
 SG_ High_Voltage_Energy_Storage_Syst : 0|64@1+ (1,0) [0|18446744073709551615] "" Vector__XXX

BO_ 2566526720 VDMA_FA17_High_Voltage_Energy_St: 8 Vector__XXX
 SG_ High_Voltage_Energy_Storage_Syst : 0|64@1+ (1,0) [0|18446744073709551615] "" Vector__XXX

BO_ 2566526976 VDMA_FA18_High_Voltage_Energy_St: 8 Vector__XXX
 SG_ High_Voltage_Energy_Storage_Syst : 0|64@1+ (1,0) [0|18446744073709551615] "" Vector__XXX

BO_ 2566527232 VDMA_FA19_High_Voltage_Energy_St: 8 Vector__XXX
 SG_ High_Voltage_Energy_Storage_Syst : 0|64@1+ (1,0) [0|18446744073709551615] "" Vector__XXX

BO_ 2566527488 VDMA_FA1A_Electronic_Engine_Cont: 8 Vector__XXX
 SG_ Electronic_Engine_Controller_23_ : 0|64@1+ (1,0) [0|18446744073709551615] "" Vector__XXX

BO_ 2566527744 VDMA_FA1B_Electronic_Engine_Cont: 8 Vector__XXX
 SG_ Electronic_Engine_Controller_24_ : 0|64@1+ (1,0) [0|18446744073709551615] "" Vector__XXX

BO_ 2566528000 VDMA_FA1C_Electronic_Engine_Cont: 8 Vector__XXX
 SG_ Electronic_Engine_Controller_25_ : 0|64@1+ (1,0) [0|18446744073709551615] "" Vector__XXX

BO_ 2566528256 VDMA_FA1D_High_Voltage_Bus_Conne: 8 Vector__XXX
 SG_ High_Voltage_Bus_Connection_Comm : 0|64@1+ (1,0) [0|18446744073709551615] "" Vector__XXX

BO_ 2566528512 VDMA_FA1E_High_Voltage_Bus_Conta: 8 Vector__XXX
 SG_ High_Voltage_Bus_Contactor_Statu : 0|64@1+ (1,0) [0|18446744073709551615] "" Vector__XXX

BO_ 2566528768 VDMA_FA1F_Aftertreatment_System_: 8 Vector__XXX
 SG_ Aftertreatment_System_Informatio : 0|64@1+ (1,0) [0|18446744073709551615] "" Vector__XXX

BO_ 2566529024 VDMA_FA20_EV_Multi_Connection_DC: 8 Vector__XXX
 SG_ EV_Multi_Connection_DC_Charging_ : 0|64@1+ (1,0) [0|18446744073709551615] "" Vector__XXX

BO_ 2566529280 VDMA_FA21_EV_Multi_Connection_Ch: 8 Vector__XXX
 SG_ EV_Multi_Connection_Charging_In_ : 0|64@1+ (1,0) [0|18446744073709551615] "" Vector__XXX

BO_ 2566529536 VDMA_FA22_Sensor_Supply_Voltage: 8 Vector__XXX
 SG_ Sensor_Supply_Voltage_RawPayload : 0|64@1+ (1,0) [0|18446744073709551615] "" Vector__XXX

BO_ 2566529792 VDMA_FA23_Motor_Generator_Locati: 8 Vector__XXX
 SG_ Motor_Generator_Location_obsolet : 0|64@1+ (1,0) [0|18446744073709551615] "" Vector__XXX

BO_ 2566530048 VDMA_FA24_High_Voltage_Energy_St: 8 Vector__XXX
 SG_ High_Voltage_Energy_Storage_Syst : 0|64@1+ (1,0) [0|18446744073709551615] "" Vector__XXX

BO_ 2566530304 VDMA_FA25_High_Voltage_Energy_St: 8 Vector__XXX
 SG_ High_Voltage_Energy_Storage_Syst : 0|64@1+ (1,0) [0|18446744073709551615] "" Vector__XXX

BO_ 2566530560 VDMA_FA26_High_Voltage_Energy_St: 8 Vector__XXX
 SG_ High_Voltage_Energy_Storage_Syst : 0|64@1+ (1,0) [0|18446744073709551615] "" Vector__XXX

BO_ 2566530816 VDMA_FA27_High_Voltage_Energy_St: 8 Vector__XXX
 SG_ High_Voltage_Energy_Storage_Pack : 0|64@1+ (1,0) [0|18446744073709551615] "" Vector__XXX

BO_ 2566531072 VDMA_FA28_High_Voltage_Energy_St: 8 Vector__XXX
 SG_ High_Voltage_Energy_Storage_Pack : 0|64@1+ (1,0) [0|18446744073709551615] "" Vector__XXX

BO_ 2566531328 VDMA_FA29_High_Voltage_Energy_St: 8 Vector__XXX
 SG_ High_Voltage_Energy_Storage_Pack : 0|64@1+ (1,0) [0|18446744073709551615] "" Vector__XXX

BO_ 2566531584 VDMA_FA2A_High_Voltage_Energy_St: 8 Vector__XXX
 SG_ High_Voltage_Energy_Storage_Pack : 0|64@1+ (1,0) [0|18446744073709551615] "" Vector__XXX

BO_ 2566531840 VDMA_FA2B_High_Voltage_Energy_St: 8 Vector__XXX
 SG_ High_Voltage_Energy_Storage_Pack : 0|64@1+ (1,0) [0|18446744073709551615] "" Vector__XXX

BO_ 2566532096 VDMA_FA2C_High_Voltage_Energy_St: 8 Vector__XXX
 SG_ High_Voltage_Energy_Storage_Pack : 0|64@1+ (1,0) [0|18446744073709551615] "" Vector__XXX

BO_ 2566532352 VDMA_FA2D_High_Voltage_Energy_St: 8 Vector__XXX
 SG_ High_Voltage_Energy_Storage_Pack : 0|64@1+ (1,0) [0|18446744073709551615] "" Vector__XXX

BO_ 2566532608 VDMA_FA2E_High_Voltage_Energy_St: 8 Vector__XXX
 SG_ High_Voltage_Energy_Storage_Pack : 0|64@1+ (1,0) [0|18446744073709551615] "" Vector__XXX

BO_ 2566532864 VDMA_FA2F_High_Voltage_Energy_St: 8 Vector__XXX
 SG_ High_Voltage_Energy_Storage_Pack : 0|64@1+ (1,0) [0|18446744073709551615] "" Vector__XXX

BO_ 2566533120 VDMA_FA30_High_Voltage_Energy_St: 8 Vector__XXX
 SG_ High_Voltage_Energy_Storage_Pack : 0|64@1+ (1,0) [0|18446744073709551615] "" Vector__XXX

BO_ 2566533376 VDMA_FA31_High_Voltage_Energy_St: 8 Vector__XXX
 SG_ High_Voltage_Energy_Storage_Pack : 0|64@1+ (1,0) [0|18446744073709551615] "" Vector__XXX

BO_ 2566533632 VDMA_FA32_High_Voltage_Energy_St: 8 Vector__XXX
 SG_ High_Voltage_Energy_Storage_Pack : 0|64@1+ (1,0) [0|18446744073709551615] "" Vector__XXX

BO_ 2566533888 VDMA_FA33_Multi_Color_Indicator_: 8 Vector__XXX
 SG_ Multi_Color_Indicator_Lamp_Comma : 0|64@1+ (1,0) [0|18446744073709551615] "" Vector__XXX

BO_ 2566534144 VDMA_FA34_Multi_Color_Indicator_: 8 Vector__XXX
 SG_ Multi_Color_Indicator_Lamp_Statu : 0|64@1+ (1,0) [0|18446744073709551615] "" Vector__XXX

BO_ 2566534400 VDMA_FA35_Refuse_Truck_Body_Info: 8 Vector__XXX
 SG_ Refuse_Truck_Body_Information_Ra : 0|64@1+ (1,0) [0|18446744073709551615] "" Vector__XXX

BO_ 2566534656 VDMA_FA36_Engine_Fluid_Level_Pre: 8 Vector__XXX
 SG_ Engine_Fluid_Level_Pressure_14_R : 0|64@1+ (1,0) [0|18446744073709551615] "" Vector__XXX

BO_ 2566534912 VDMA_FA37_Well_Stimulation_Trans: 8 Vector__XXX
 SG_ Well_Stimulation_Transmission_Co : 0|64@1+ (1,0) [0|18446744073709551615] "" Vector__XXX

BO_ 2566535168 VDMA_FA38_Well_Stimulation_Pump_: 8 Vector__XXX
 SG_ Well_Stimulation_Pump_Protection : 0|64@1+ (1,0) [0|18446744073709551615] "" Vector__XXX

BO_ 2566535424 VDMA_FA39_Well_Stimulation_Pump_: 8 Vector__XXX
 SG_ Well_Stimulation_Pump_Protection : 0|64@1+ (1,0) [0|18446744073709551615] "" Vector__XXX

BO_ 2566535680 VDMA_FA3A_Electric_PTO_Drive_Eng: 8 Vector__XXX
 SG_ Electric_PTO_Drive_Engagement_1_ : 0|64@1+ (1,0) [0|18446744073709551615] "" Vector__XXX

BO_ 2566535936 VDMA_FA3B_Electric_PTO_1_Informa: 8 Vector__XXX
 SG_ Electric_PTO_1_Information_RawPa : 0|64@1+ (1,0) [0|18446744073709551615] "" Vector__XXX

BO_ 2566536192 VDMA_FA3C_Engine_Exhaust_O2_Sens: 8 Vector__XXX
 SG_ Engine_Exhaust_O2_Sensor_Informa : 0|64@1+ (1,0) [0|18446744073709551615] "" Vector__XXX

BO_ 2566536448 VDMA_FA3D_Gaseous_Fuel_Supply_Pr: 8 Vector__XXX
 SG_ Gaseous_Fuel_Supply_Pressure_3_R : 0|64@1+ (1,0) [0|18446744073709551615] "" Vector__XXX

BO_ 2566536704 VDMA_FA3E_Traffic_Signage: 8 Vector__XXX
 SG_ Traffic_Signage_RawPayload : 0|64@1+ (1,0) [0|18446744073709551615] "" Vector__XXX

BO_ 2566536960 VDMA_FA3F_Engine_Configuration_4: 8 Vector__XXX
 SG_ Engine_Configuration_4_RawPayloa : 0|64@1+ (1,0) [0|18446744073709551615] "" Vector__XXX

BO_ 2566537216 VDMA_FA40_Electronic_Transmissio: 8 Vector__XXX
 SG_ Electronic_Transmission_Controll : 0|64@1+ (1,0) [0|18446744073709551615] "" Vector__XXX

BO_ 2566537472 VDMA_FA41_Automated_Driving_Syst: 8 Vector__XXX
 SG_ Automated_Driving_System_Network : 0|64@1+ (1,0) [0|18446744073709551615] "" Vector__XXX

BO_ 2566537728 VDMA_FA42_Automated_Driving_Syst: 8 Vector__XXX
 SG_ Automated_Driving_System_Network : 0|64@1+ (1,0) [0|18446744073709551615] "" Vector__XXX

BO_ 2566537984 VDMA_FA43_Hybrid_or_EV_System_In: 8 Vector__XXX
 SG_ Hybrid_or_EV_System_Inputs_2_Raw : 0|64@1+ (1,0) [0|18446744073709551615] "" Vector__XXX

BO_ 2566538240 VDMA_FA44_Engine_Speed_Load_Fact: 8 Vector__XXX
 SG_ Engine_Speed_Load_Factor_Informa : 0|64@1+ (1,0) [0|18446744073709551615] "" Vector__XXX

BO_ 2566538496 VDMA_FA45_Generator_Trip_Energy_: 8 Vector__XXX
 SG_ Generator_Trip_Energy_2_RawPaylo : 0|64@1+ (1,0) [0|18446744073709551615] "" Vector__XXX

BO_ 2566538752 VDMA_FA46_Security_System_Machin: 8 Vector__XXX
 SG_ Security_System_Machine_Operatio : 0|64@1+ (1,0) [0|18446744073709551615] "" Vector__XXX

BO_ 2566539008 VDMA_FA47_Engine_Fuel_Actuator_S: 8 Vector__XXX
 SG_ Engine_Fuel_Actuator_Service_Mod : 0|64@1+ (1,0) [0|18446744073709551615] "" Vector__XXX

BO_ 2566539264 VDMA_FA48_Steering_Wheel_Control: 8 Vector__XXX
 SG_ Steering_Wheel_Controls_RawPaylo : 0|64@1+ (1,0) [0|18446744073709551615] "" Vector__XXX

BO_ 2566539520 VDMA_FA49_Park_Assist: 8 Vector__XXX
 SG_ Park_Assist_RawPayload : 0|64@1+ (1,0) [0|18446744073709551615] "" Vector__XXX

BO_ 2566539776 VDMA_FA4A_Extended_DTC_informati: 8 Vector__XXX
 SG_ Extended_DTC_information_RawPayl : 0|64@1+ (1,0) [0|18446744073709551615] "" Vector__XXX

BO_ 2566540032 VDMA_FA4B_Aftertreatment_2_SCR_D: 8 Vector__XXX
 SG_ Aftertreatment_2_SCR_Dosing_Syst : 0|64@1+ (1,0) [0|18446744073709551615] "" Vector__XXX

BO_ 2566540288 VDMA_FA4C_Aftertreatment_1_SCR_D: 8 Vector__XXX
 SG_ Aftertreatment_1_SCR_Dosing_Syst : 0|64@1+ (1,0) [0|18446744073709551615] "" Vector__XXX

BO_ 2566540544 VDMA_FA4D_EV_Economy_Information: 8 Vector__XXX
 SG_ EV_Economy_Information_RawPayloa : 0|64@1+ (1,0) [0|18446744073709551615] "" Vector__XXX

BO_ 2566540800 VDMA_FA4E_Automated_Driving_Syst: 8 Vector__XXX
 SG_ Automated_Driving_System_Status_ : 0|64@1+ (1,0) [0|18446744073709551615] "" Vector__XXX

BO_ 2566541056 VDMA_FA4F_Automated_Driving_Syst: 8 Vector__XXX
 SG_ Automated_Driving_System_Control : 0|64@1+ (1,0) [0|18446744073709551615] "" Vector__XXX

BO_ 2566541312 VDMA_FA50_Aftercooler_Valve: 8 Vector__XXX
 SG_ Aftercooler_Valve_RawPayload : 0|64@1+ (1,0) [0|18446744073709551615] "" Vector__XXX

BO_ 2566541568 VDMA_FA51_Engine_Radiator_1: 8 Vector__XXX
 SG_ Engine_Radiator_1_RawPayload : 0|64@1+ (1,0) [0|18446744073709551615] "" Vector__XXX

BO_ 2566541824 VDMA_FA52_Engine_Radiator_2: 8 Vector__XXX
 SG_ Engine_Radiator_2_RawPayload : 0|64@1+ (1,0) [0|18446744073709551615] "" Vector__XXX

BO_ 2566542080 VDMA_FA53_Genset_Enclosure_Venti: 8 Vector__XXX
 SG_ Genset_Enclosure_Ventilation_Raw : 0|64@1+ (1,0) [0|18446744073709551615] "" Vector__XXX

BO_ 2566542336 VDMA_FA54_Heat_Exchanger_1: 8 Vector__XXX
 SG_ Heat_Exchanger_1_RawPayload : 0|64@1+ (1,0) [0|18446744073709551615] "" Vector__XXX

BO_ 2566542592 VDMA_FA55_Heat_Exchanger_2: 8 Vector__XXX
 SG_ Heat_Exchanger_2_RawPayload : 0|64@1+ (1,0) [0|18446744073709551615] "" Vector__XXX

BO_ 2566542848 VDMA_FA56_Heat_Exchanger_3: 8 Vector__XXX
 SG_ Heat_Exchanger_3_RawPayload : 0|64@1+ (1,0) [0|18446744073709551615] "" Vector__XXX

BO_ 2566543104 VDMA_FA57_Heat_Exchanger_4: 8 Vector__XXX
 SG_ Heat_Exchanger_4_RawPayload : 0|64@1+ (1,0) [0|18446744073709551615] "" Vector__XXX

BO_ 2566543360 VDMA_FA58_Engine_Exhaust_Gas_Hea: 8 Vector__XXX
 SG_ Engine_Exhaust_Gas_Heat_Exchange : 0|64@1+ (1,0) [0|18446744073709551615] "" Vector__XXX

BO_ 2566543616 VDMA_FA59_Genset_Enclosure_Venti: 8 Vector__XXX
 SG_ Genset_Enclosure_Ventilation_Lou : 0|64@1+ (1,0) [0|18446744073709551615] "" Vector__XXX

BO_ 2566543872 VDMA_FA5A_Genset_External_Coolan: 8 Vector__XXX
 SG_ Genset_External_Coolant_System_R : 0|64@1+ (1,0) [0|18446744073709551615] "" Vector__XXX

BO_ 2566544128 VDMA_FA5B_EV_DC_Status_1: 8 Vector__XXX
 SG_ EV_DC_Status_1_RawPayload : 0|64@1+ (1,0) [0|18446744073709551615] "" Vector__XXX

BO_ 2566544384 VDMA_FA5C_EVSE_DC_Charging_Limit: 8 Vector__XXX
 SG_ EVSE_DC_Charging_Limits_3_RawPay : 0|64@1+ (1,0) [0|18446744073709551615] "" Vector__XXX

BO_ 2566544640 VDMA_FA5D_EVSE_Power_Max_Schedul: 8 Vector__XXX
 SG_ EVSE_Power_Max_Schedule_RawPaylo : 0|64@1+ (1,0) [0|18446744073709551615] "" Vector__XXX

BO_ 2566544896 VDMA_FA5E_EV_Charge_Profile: 8 Vector__XXX
 SG_ EV_Charge_Profile_RawPayload : 0|64@1+ (1,0) [0|18446744073709551615] "" Vector__XXX

BO_ 2566545152 VDMA_FA5F_EV_DC_Charging_Limits_: 8 Vector__XXX
 SG_ EV_DC_Charging_Limits_2_RawPaylo : 0|64@1+ (1,0) [0|18446744073709551615] "" Vector__XXX

BO_ 2566545408 VDMA_FA60_EV_DC_Charging_In_Prog: 8 Vector__XXX
 SG_ EV_DC_Charging_In_Progress_RawPa : 0|64@1+ (1,0) [0|18446744073709551615] "" Vector__XXX

BO_ 2566545920 VDMA_FA62_Lighting_Data_2: 8 Vector__XXX
 SG_ Lighting_Data_2_RawPayload : 0|64@1+ (1,0) [0|18446744073709551615] "" Vector__XXX

BO_ 2566546176 VDMA_FA63_Lighting_Command_2: 8 Vector__XXX
 SG_ Lighting_Command_2_RawPayload : 0|64@1+ (1,0) [0|18446744073709551615] "" Vector__XXX

BO_ 2566546432 VDMA_FA64_Aftertreatment_System_: 8 Vector__XXX
 SG_ Aftertreatment_System_Informatio : 0|64@1+ (1,0) [0|18446744073709551615] "" Vector__XXX

BO_ 2566546688 VDMA_FA65_Aftertreatment_System_: 8 Vector__XXX
 SG_ Aftertreatment_System_Informatio : 0|64@1+ (1,0) [0|18446744073709551615] "" Vector__XXX

BO_ 2566546944 VDMA_FA66_Aftertreatment_System_: 8 Vector__XXX
 SG_ Aftertreatment_System_Informatio : 0|64@1+ (1,0) [0|18446744073709551615] "" Vector__XXX

BO_ 2566547200 VDMA_FA67_Fluid_Resistance_1: 8 Vector__XXX
 SG_ Fluid_Resistance_1_RawPayload : 0|64@1+ (1,0) [0|18446744073709551615] "" Vector__XXX

BO_ 2566547456 VDMA_FA68_Power_Converter_2_Isol: 8 Vector__XXX
 SG_ Power_Converter_2_Isolation_Inte : 0|64@1+ (1,0) [0|18446744073709551615] "" Vector__XXX

BO_ 2566547712 VDMA_FA69_Power_Converter_1_Isol: 8 Vector__XXX
 SG_ Power_Converter_1_Isolation_Inte : 0|64@1+ (1,0) [0|18446744073709551615] "" Vector__XXX

BO_ 2566547968 VDMA_FA6A_Power_Converter_2_Limi: 8 Vector__XXX
 SG_ Power_Converter_2_Limits_Request : 0|64@1+ (1,0) [0|18446744073709551615] "" Vector__XXX

BO_ 2566548224 VDMA_FA6B_Power_Converter_2_Limi: 8 Vector__XXX
 SG_ Power_Converter_2_Limits_Request : 0|64@1+ (1,0) [0|18446744073709551615] "" Vector__XXX

BO_ 2566548480 VDMA_FA6C_Power_Converter_2_Limi: 8 Vector__XXX
 SG_ Power_Converter_2_Limits_Request : 0|64@1+ (1,0) [0|18446744073709551615] "" Vector__XXX

BO_ 2566548736 VDMA_FA6D_Power_Converter_1_Limi: 8 Vector__XXX
 SG_ Power_Converter_1_Limits_Request : 0|64@1+ (1,0) [0|18446744073709551615] "" Vector__XXX

BO_ 2566548992 VDMA_FA6E_Power_Converter_1_Limi: 8 Vector__XXX
 SG_ Power_Converter_1_Limits_Request : 0|64@1+ (1,0) [0|18446744073709551615] "" Vector__XXX

BO_ 2566549248 VDMA_FA6F_Power_Converter_1_Limi: 8 Vector__XXX
 SG_ Power_Converter_1_Limits_Request : 0|64@1+ (1,0) [0|18446744073709551615] "" Vector__XXX

BO_ 2566549504 VDMA_FA70_Inverter_1_Lifetime_Da: 8 Vector__XXX
 SG_ Inverter_1_Lifetime_Data_RawPayl : 0|64@1+ (1,0) [0|18446744073709551615] "" Vector__XXX

BO_ 2566549760 VDMA_FA71_Inverter_2_Lifetime_Da: 8 Vector__XXX
 SG_ Inverter_2_Lifetime_Data_RawPayl : 0|64@1+ (1,0) [0|18446744073709551615] "" Vector__XXX

BO_ 2566550016 VDMA_FA72_Power_Converter_2_Acti: 8 Vector__XXX
 SG_ Power_Converter_2_Active_Power_L : 0|64@1+ (1,0) [0|18446744073709551615] "" Vector__XXX

BO_ 2566550272 VDMA_FA73_Power_Converter_1_Acti: 8 Vector__XXX
 SG_ Power_Converter_1_Active_Power_L : 0|64@1+ (1,0) [0|18446744073709551615] "" Vector__XXX

BO_ 2566550528 VDMA_FA74_Power_Converter_2_Refe: 8 Vector__XXX
 SG_ Power_Converter_2_Reference_1_Ra : 0|64@1+ (1,0) [0|18446744073709551615] "" Vector__XXX

BO_ 2566550784 VDMA_FA75_Power_Converter_2_Refe: 8 Vector__XXX
 SG_ Power_Converter_2_Reference_2_Ra : 0|64@1+ (1,0) [0|18446744073709551615] "" Vector__XXX

BO_ 2566551040 VDMA_FA76_Power_Converter_2_Temp: 8 Vector__XXX
 SG_ Power_Converter_2_Temperature_Ra : 0|64@1+ (1,0) [0|18446744073709551615] "" Vector__XXX

BO_ 2566551296 VDMA_FA77_Power_Converter_1_Temp: 8 Vector__XXX
 SG_ Power_Converter_1_Temperature_Ra : 0|64@1+ (1,0) [0|18446744073709551615] "" Vector__XXX

BO_ 2566551552 VDMA_FA78_Power_Converter_1_Refe: 8 Vector__XXX
 SG_ Power_Converter_1_Reference_2_Ra : 0|64@1+ (1,0) [0|18446744073709551615] "" Vector__XXX

BO_ 2566551808 VDMA_FA79_Power_Converter_1_Refe: 8 Vector__XXX
 SG_ Power_Converter_1_Reference_1_Ra : 0|64@1+ (1,0) [0|18446744073709551615] "" Vector__XXX

BO_ 2566552064 VDMA_FA7A_Power_Converter_1_Phas: 8 Vector__XXX
 SG_ Power_Converter_1_Phase_Current_ : 0|64@1+ (1,0) [0|18446744073709551615] "" Vector__XXX

BO_ 2566552320 VDMA_FA7B_Power_Converter_2_Phas: 8 Vector__XXX
 SG_ Power_Converter_2_Phase_Current_ : 0|64@1+ (1,0) [0|18446744073709551615] "" Vector__XXX

BO_ 2566552576 VDMA_FA7C_Power_Converter_1_Phas: 8 Vector__XXX
 SG_ Power_Converter_1_Phase_Voltage_ : 0|64@1+ (1,0) [0|18446744073709551615] "" Vector__XXX

BO_ 2566552832 VDMA_FA7D_Power_Converter_2_Phas: 8 Vector__XXX
 SG_ Power_Converter_2_Phase_Voltage_ : 0|64@1+ (1,0) [0|18446744073709551615] "" Vector__XXX

BO_ 2566553088 VDMA_FA7E_Power_Converter_Power_: 8 Vector__XXX
 SG_ Power_Converter_Power_Module_Swi : 0|64@1+ (1,0) [0|18446744073709551615] "" Vector__XXX

BO_ 2566553344 VDMA_FA7F_Power_Converter_1_Powe: 8 Vector__XXX
 SG_ Power_Converter_1_Power_Module_S : 0|64@1+ (1,0) [0|18446744073709551615] "" Vector__XXX

BO_ 2566553600 VDMA_FA80_Power_Converter_2_Powe: 8 Vector__XXX
 SG_ Power_Converter_2_Power_Module_S : 0|64@1+ (1,0) [0|18446744073709551615] "" Vector__XXX

BO_ 2566553856 VDMA_FA81_Power_Converter_Totals: 8 Vector__XXX
 SG_ Power_Converter_Totals_1_RawPayl : 0|64@1+ (1,0) [0|18446744073709551615] "" Vector__XXX

BO_ 2566554112 VDMA_FA82_Transformer_Temperatur: 8 Vector__XXX
 SG_ Transformer_Temperatures_RawPayl : 0|64@1+ (1,0) [0|18446744073709551615] "" Vector__XXX

BO_ 2566554368 VDMA_FA83_Electrified_Accessory_: 8 Vector__XXX
 SG_ Electrified_Accessory_Engine_Coo : 0|64@1+ (1,0) [0|18446744073709551615] "" Vector__XXX

BO_ 2566554624 VDMA_FA84_High_Voltage_Energy_St: 8 Vector__XXX
 SG_ High_Voltage_Energy_Storage_Pack : 0|64@1+ (1,0) [0|18446744073709551615] "" Vector__XXX

BO_ 2566554880 VDMA_FA85_High_Voltage_Energy_St: 8 Vector__XXX
 SG_ High_Voltage_Energy_Storage_Pack : 0|64@1+ (1,0) [0|18446744073709551615] "" Vector__XXX

BO_ 2566555136 VDMA_FA86_High_Voltage_Energy_St: 8 Vector__XXX
 SG_ High_Voltage_Energy_Storage_Pack : 0|64@1+ (1,0) [0|18446744073709551615] "" Vector__XXX

BO_ 2566555392 VDMA_FA87_High_Voltage_Energy_St: 8 Vector__XXX
 SG_ High_Voltage_Energy_Storage_Pack : 0|64@1+ (1,0) [0|18446744073709551615] "" Vector__XXX

BO_ 2566555648 VDMA_FA88_High_Voltage_Energy_St: 8 Vector__XXX
 SG_ High_Voltage_Energy_Storage_Pack : 0|64@1+ (1,0) [0|18446744073709551615] "" Vector__XXX

BO_ 2566555904 VDMA_FA89_High_Voltage_Energy_St: 8 Vector__XXX
 SG_ High_Voltage_Energy_Storage_Pack : 0|64@1+ (1,0) [0|18446744073709551615] "" Vector__XXX

BO_ 2566556160 VDMA_FA8A_High_Voltage_Energy_St: 8 Vector__XXX
 SG_ High_Voltage_Energy_Storage_Pack : 0|64@1+ (1,0) [0|18446744073709551615] "" Vector__XXX

BO_ 2566556416 VDMA_FA8B_High_Voltage_Energy_St: 8 Vector__XXX
 SG_ High_Voltage_Energy_Storage_Pack : 0|64@1+ (1,0) [0|18446744073709551615] "" Vector__XXX

BO_ 2566556672 VDMA_FA8C_High_Voltage_Energy_St: 8 Vector__XXX
 SG_ High_Voltage_Energy_Storage_Pack : 0|64@1+ (1,0) [0|18446744073709551615] "" Vector__XXX

BO_ 2566556928 VDMA_FA8D_High_Voltage_Energy_St: 8 Vector__XXX
 SG_ High_Voltage_Energy_Storage_Pack : 0|64@1+ (1,0) [0|18446744073709551615] "" Vector__XXX

BO_ 2566557184 VDMA_FA8E_High_Voltage_Energy_St: 8 Vector__XXX
 SG_ High_Voltage_Energy_Storage_Pack : 0|64@1+ (1,0) [0|18446744073709551615] "" Vector__XXX

BO_ 2566557440 VDMA_FA8F_High_Voltage_Energy_St: 8 Vector__XXX
 SG_ High_Voltage_Energy_Storage_Pack : 0|64@1+ (1,0) [0|18446744073709551615] "" Vector__XXX

BO_ 2566557696 VDMA_FA90_High_Voltage_Energy_St: 8 Vector__XXX
 SG_ High_Voltage_Energy_Storage_Pack : 0|64@1+ (1,0) [0|18446744073709551615] "" Vector__XXX

BO_ 2566557952 VDMA_FA91_High_Voltage_Energy_St: 8 Vector__XXX
 SG_ High_Voltage_Energy_Storage_Pack : 0|64@1+ (1,0) [0|18446744073709551615] "" Vector__XXX

BO_ 2566558208 VDMA_FA92_High_Voltage_Energy_St: 8 Vector__XXX
 SG_ High_Voltage_Energy_Storage_Pack : 0|64@1+ (1,0) [0|18446744073709551615] "" Vector__XXX

BO_ 2566558464 VDMA_FA93_High_Voltage_Energy_St: 8 Vector__XXX
 SG_ High_Voltage_Energy_Storage_Pack : 0|64@1+ (1,0) [0|18446744073709551615] "" Vector__XXX

BO_ 2566558720 VDMA_FA94_High_Voltage_Energy_St: 8 Vector__XXX
 SG_ High_Voltage_Energy_Storage_Pack : 0|64@1+ (1,0) [0|18446744073709551615] "" Vector__XXX

BO_ 2566558976 VDMA_FA95_High_Voltage_Energy_St: 8 Vector__XXX
 SG_ High_Voltage_Energy_Storage_Pack : 0|64@1+ (1,0) [0|18446744073709551615] "" Vector__XXX

BO_ 2566559232 VDMA_FA96_High_Voltage_Energy_St: 8 Vector__XXX
 SG_ High_Voltage_Energy_Storage_Pack : 0|64@1+ (1,0) [0|18446744073709551615] "" Vector__XXX

BO_ 2566559488 VDMA_FA97_High_Voltage_Energy_St: 8 Vector__XXX
 SG_ High_Voltage_Energy_Storage_Pack : 0|64@1+ (1,0) [0|18446744073709551615] "" Vector__XXX

BO_ 2566559744 VDMA_FA98_High_Voltage_Energy_St: 8 Vector__XXX
 SG_ High_Voltage_Energy_Storage_Pack : 0|64@1+ (1,0) [0|18446744073709551615] "" Vector__XXX

BO_ 2566560000 VDMA_FA99_High_Voltage_Energy_St: 8 Vector__XXX
 SG_ High_Voltage_Energy_Storage_Pack : 0|64@1+ (1,0) [0|18446744073709551615] "" Vector__XXX

BO_ 2566560256 VDMA_FA9A_High_Voltage_Energy_St: 8 Vector__XXX
 SG_ High_Voltage_Energy_Storage_Pack : 0|64@1+ (1,0) [0|18446744073709551615] "" Vector__XXX

BO_ 2566560512 VDMA_FA9B_High_Voltage_Energy_St: 8 Vector__XXX
 SG_ High_Voltage_Energy_Storage_Pack : 0|64@1+ (1,0) [0|18446744073709551615] "" Vector__XXX

BO_ 2566560768 VDMA_FA9C_High_Voltage_Energy_St: 8 Vector__XXX
 SG_ High_Voltage_Energy_Storage_Pack : 0|64@1+ (1,0) [0|18446744073709551615] "" Vector__XXX

BO_ 2566561024 VDMA_FA9D_High_Voltage_Energy_St: 8 Vector__XXX
 SG_ High_Voltage_Energy_Storage_Pack : 0|64@1+ (1,0) [0|18446744073709551615] "" Vector__XXX

BO_ 2566561280 VDMA_FA9E_High_Voltage_Energy_St: 8 Vector__XXX
 SG_ High_Voltage_Energy_Storage_Pack : 0|64@1+ (1,0) [0|18446744073709551615] "" Vector__XXX

BO_ 2566561536 VDMA_FA9F_High_Voltage_Energy_St: 8 Vector__XXX
 SG_ High_Voltage_Energy_Storage_Pack : 0|64@1+ (1,0) [0|18446744073709551615] "" Vector__XXX

BO_ 2566561792 VDMA_FAA0_High_Voltage_Energy_St: 8 Vector__XXX
 SG_ High_Voltage_Energy_Storage_Pack : 0|64@1+ (1,0) [0|18446744073709551615] "" Vector__XXX

BO_ 2566562048 VDMA_FAA1_High_Voltage_Energy_St: 8 Vector__XXX
 SG_ High_Voltage_Energy_Storage_Pack : 0|64@1+ (1,0) [0|18446744073709551615] "" Vector__XXX

BO_ 2566562304 VDMA_FAA2_High_Voltage_Energy_St: 8 Vector__XXX
 SG_ High_Voltage_Energy_Storage_Pack : 0|64@1+ (1,0) [0|18446744073709551615] "" Vector__XXX

BO_ 2566562560 VDMA_FAA3_High_Voltage_Energy_St: 8 Vector__XXX
 SG_ High_Voltage_Energy_Storage_Pack : 0|64@1+ (1,0) [0|18446744073709551615] "" Vector__XXX

BO_ 2566562816 VDMA_FAA4_Automated_Driving_Syst: 8 Vector__XXX
 SG_ Automated_Driving_System_Control : 0|64@1+ (1,0) [0|18446744073709551615] "" Vector__XXX

BO_ 2566563072 VDMA_FAA5_Dual_Fuel_Mode_3: 8 Vector__XXX
 SG_ Dual_Fuel_Mode_3_RawPayload : 0|64@1+ (1,0) [0|18446744073709551615] "" Vector__XXX

BO_ 2566563328 VDMA_FAA6_Dual_Fuel_Mode_2: 8 Vector__XXX
 SG_ Dual_Fuel_Mode_2_RawPayload : 0|64@1+ (1,0) [0|18446744073709551615] "" Vector__XXX

BO_ 2566563584 VDMA_FAA7_Dual_Fuel_Mode_1: 8 Vector__XXX
 SG_ Dual_Fuel_Mode_1_RawPayload : 0|64@1+ (1,0) [0|18446744073709551615] "" Vector__XXX

BO_ 2566563840 VDMA_FAA8_Transmission_1_History: 8 Vector__XXX
 SG_ Transmission_1_History_RawPayloa : 0|64@1+ (1,0) [0|18446744073709551615] "" Vector__XXX

BO_ 2566564096 VDMA_FAA9_Transmission_Shaft_Twi: 8 Vector__XXX
 SG_ Transmission_Shaft_Twist_Informa : 0|64@1+ (1,0) [0|18446744073709551615] "" Vector__XXX

BO_ 2566564352 VDMA_FAAA_Electronic_Auxiliary_T: 8 Vector__XXX
 SG_ Electronic_Auxiliary_Transmissio : 0|64@1+ (1,0) [0|18446744073709551615] "" Vector__XXX

BO_ 2566564608 VDMA_FAAB_High_Voltage_Energy_St: 8 Vector__XXX
 SG_ High_Voltage_Energy_Storage_Pack : 0|64@1+ (1,0) [0|18446744073709551615] "" Vector__XXX

BO_ 2566564864 VDMA_FAAC_High_Voltage_Energy_St: 8 Vector__XXX
 SG_ High_Voltage_Energy_Storage_Pack : 0|64@1+ (1,0) [0|18446744073709551615] "" Vector__XXX

BO_ 2566565120 VDMA_FAAD_High_Voltage_Energy_St: 8 Vector__XXX
 SG_ High_Voltage_Energy_Storage_Pack : 0|64@1+ (1,0) [0|18446744073709551615] "" Vector__XXX

CM_ BO_ 2566092544  "Source: isobus.net VDMA Data Dictionary (https://www.isobus.net/isobus/pGNAndSPN/7748?type=PGN)";
CM_ BO_ 2566092800  "Source: isobus.net VDMA Data Dictionary (https://www.isobus.net/isobus/pGNAndSPN/7751?type=PGN)";
CM_ BO_ 2566093056  "Source: isobus.net VDMA Data Dictionary (https://www.isobus.net/isobus/pGNAndSPN/7753?type=PGN)";
CM_ BO_ 2566093312  "Source: isobus.net VDMA Data Dictionary (https://www.isobus.net/isobus/pGNAndSPN/7758?type=PGN)";
CM_ BO_ 2566093568  "Source: isobus.net VDMA Data Dictionary (https://www.isobus.net/isobus/pGNAndSPN/7763?type=PGN)";
CM_ BO_ 2566093824  "Source: isobus.net VDMA Data Dictionary (https://www.isobus.net/isobus/pGNAndSPN/7768?type=PGN)";
CM_ BO_ 2566094080  "Source: isobus.net VDMA Data Dictionary (https://www.isobus.net/isobus/pGNAndSPN/7773?type=PGN)";
CM_ BO_ 2566094336  "Source: isobus.net VDMA Data Dictionary (https://www.isobus.net/isobus/pGNAndSPN/7778?type=PGN)";
CM_ BO_ 2566094592  "Source: isobus.net VDMA Data Dictionary (https://www.isobus.net/isobus/pGNAndSPN/7783?type=PGN)";
CM_ BO_ 2566094848  "Source: isobus.net VDMA Data Dictionary (https://www.isobus.net/isobus/pGNAndSPN/7789?type=PGN)";
CM_ BO_ 2566095104  "Source: isobus.net VDMA Data Dictionary (https://www.isobus.net/isobus/pGNAndSPN/7795?type=PGN)";
CM_ BO_ 2566095360  "Source: isobus.net VDMA Data Dictionary (https://www.isobus.net/isobus/pGNAndSPN/7798?type=PGN)";
CM_ BO_ 2566095616  "Source: isobus.net VDMA Data Dictionary (https://www.isobus.net/isobus/pGNAndSPN/7801?type=PGN)";
CM_ BO_ 2566095872  "Source: isobus.net VDMA Data Dictionary (https://www.isobus.net/isobus/pGNAndSPN/7807?type=PGN)";
CM_ BO_ 2566096128  "Source: isobus.net VDMA Data Dictionary (https://www.isobus.net/isobus/pGNAndSPN/7813?type=PGN)";
CM_ BO_ 2566478080  "Source: isobus.net VDMA Data Dictionary (https://www.isobus.net/isobus/pGNAndSPN/7815?type=PGN)";
CM_ BO_ 2566478336  "Source: isobus.net VDMA Data Dictionary (https://www.isobus.net/isobus/pGNAndSPN/7817?type=PGN)";
CM_ BO_ 2566478592  "Source: isobus.net VDMA Data Dictionary (https://www.isobus.net/isobus/pGNAndSPN/7821?type=PGN)";
CM_ BO_ 2566478848  "Source: isobus.net VDMA Data Dictionary (https://www.isobus.net/isobus/pGNAndSPN/7825?type=PGN)";
CM_ BO_ 2566479104  "Source: isobus.net VDMA Data Dictionary (https://www.isobus.net/isobus/pGNAndSPN/7827?type=PGN)";
CM_ BO_ 2566479360  "Source: isobus.net VDMA Data Dictionary (https://www.isobus.net/isobus/pGNAndSPN/7982?type=PGN)";
CM_ BO_ 2566479616  "Source: isobus.net VDMA Data Dictionary (https://www.isobus.net/isobus/pGNAndSPN/8137?type=PGN)";
CM_ BO_ 2566479872  "Source: isobus.net VDMA Data Dictionary (https://www.isobus.net/isobus/pGNAndSPN/8292?type=PGN)";
CM_ BO_ 2566480128  "Source: isobus.net VDMA Data Dictionary (https://www.isobus.net/isobus/pGNAndSPN/8447?type=PGN)";
CM_ BO_ 2566480384  "Source: isobus.net VDMA Data Dictionary (https://www.isobus.net/isobus/pGNAndSPN/8449?type=PGN)";
CM_ BO_ 2566480640  "Source: isobus.net VDMA Data Dictionary (https://www.isobus.net/isobus/pGNAndSPN/8455?type=PGN)";
CM_ BO_ 2566480896  "Source: isobus.net VDMA Data Dictionary (https://www.isobus.net/isobus/pGNAndSPN/8456?type=PGN)";
CM_ BO_ 2566481152  "Source: isobus.net VDMA Data Dictionary (https://www.isobus.net/isobus/pGNAndSPN/8460?type=PGN)";
CM_ BO_ 2566481408  "Source: isobus.net VDMA Data Dictionary (https://www.isobus.net/isobus/pGNAndSPN/8461?type=PGN)";
CM_ BO_ 2566481664  "Source: isobus.net VDMA Data Dictionary (https://www.isobus.net/isobus/pGNAndSPN/8469?type=PGN)";
CM_ BO_ 2566481920  "Source: isobus.net VDMA Data Dictionary (https://www.isobus.net/isobus/pGNAndSPN/8471?type=PGN)";
CM_ BO_ 2566482176  "Source: isobus.net VDMA Data Dictionary (https://www.isobus.net/isobus/pGNAndSPN/8475?type=PGN)";
CM_ BO_ 2566482432  "Source: isobus.net VDMA Data Dictionary (https://www.isobus.net/isobus/pGNAndSPN/8480?type=PGN)";
CM_ BO_ 2566482688  "Source: isobus.net VDMA Data Dictionary (https://www.isobus.net/isobus/pGNAndSPN/8484?type=PGN)";
CM_ BO_ 2566482944  "Source: isobus.net VDMA Data Dictionary (https://www.isobus.net/isobus/pGNAndSPN/8488?type=PGN)";
CM_ BO_ 2566483200  "Source: isobus.net VDMA Data Dictionary (https://www.isobus.net/isobus/pGNAndSPN/8492?type=PGN)";
CM_ BO_ 2566483456  "Source: isobus.net VDMA Data Dictionary (https://www.isobus.net/isobus/pGNAndSPN/8497?type=PGN)";
CM_ BO_ 2566483712  "Source: isobus.net VDMA Data Dictionary (https://www.isobus.net/isobus/pGNAndSPN/8501?type=PGN)";
CM_ BO_ 2566483968  "Source: isobus.net VDMA Data Dictionary (https://www.isobus.net/isobus/pGNAndSPN/8505?type=PGN)";
CM_ BO_ 2566484224  "Source: isobus.net VDMA Data Dictionary (https://www.isobus.net/isobus/pGNAndSPN/8509?type=PGN)";
CM_ BO_ 2566484480  "Source: isobus.net VDMA Data Dictionary (https://www.isobus.net/isobus/pGNAndSPN/8511?type=PGN)";
CM_ BO_ 2566484736  "Source: isobus.net VDMA Data Dictionary (https://www.isobus.net/isobus/pGNAndSPN/8515?type=PGN)";
CM_ BO_ 2566484992  "Source: isobus.net VDMA Data Dictionary (https://www.isobus.net/isobus/pGNAndSPN/8519?type=PGN)";
CM_ BO_ 2566485248  "Source: isobus.net VDMA Data Dictionary (https://www.isobus.net/isobus/pGNAndSPN/8536?type=PGN)";
CM_ BO_ 2566485504  "Source: isobus.net VDMA Data Dictionary (https://www.isobus.net/isobus/pGNAndSPN/8540?type=PGN)";
CM_ BO_ 2566485760  "Source: isobus.net VDMA Data Dictionary (https://www.isobus.net/isobus/pGNAndSPN/8545?type=PGN)";
CM_ BO_ 2566486016  "Source: isobus.net VDMA Data Dictionary (https://www.isobus.net/isobus/pGNAndSPN/8549?type=PGN)";
CM_ BO_ 2566486272  "Source: isobus.net VDMA Data Dictionary (https://www.isobus.net/isobus/pGNAndSPN/8553?type=PGN)";
CM_ BO_ 2566486528  "Source: isobus.net VDMA Data Dictionary (https://www.isobus.net/isobus/pGNAndSPN/8557?type=PGN)";
CM_ BO_ 2566486784  "Source: isobus.net VDMA Data Dictionary (https://www.isobus.net/isobus/pGNAndSPN/8562?type=PGN)";
CM_ BO_ 2566487040  "Source: isobus.net VDMA Data Dictionary (https://www.isobus.net/isobus/pGNAndSPN/8566?type=PGN)";
CM_ BO_ 2566487296  "Source: isobus.net VDMA Data Dictionary (https://www.isobus.net/isobus/pGNAndSPN/8570?type=PGN)";
CM_ BO_ 2566487552  "Source: isobus.net VDMA Data Dictionary (https://www.isobus.net/isobus/pGNAndSPN/8574?type=PGN)";
CM_ BO_ 2566487808  "Source: isobus.net VDMA Data Dictionary (https://www.isobus.net/isobus/pGNAndSPN/8576?type=PGN)";
CM_ BO_ 2566488064  "Source: isobus.net VDMA Data Dictionary (https://www.isobus.net/isobus/pGNAndSPN/8580?type=PGN)";
CM_ BO_ 2566488320  "Source: isobus.net VDMA Data Dictionary (https://www.isobus.net/isobus/pGNAndSPN/8584?type=PGN)";
CM_ BO_ 2566488576  "Source: isobus.net VDMA Data Dictionary (https://www.isobus.net/isobus/pGNAndSPN/8601?type=PGN)";
CM_ BO_ 2566488832  "Source: isobus.net VDMA Data Dictionary (https://www.isobus.net/isobus/pGNAndSPN/8605?type=PGN)";
CM_ BO_ 2566489088  "Source: isobus.net VDMA Data Dictionary (https://www.isobus.net/isobus/pGNAndSPN/8610?type=PGN)";
CM_ BO_ 2566489344  "Source: isobus.net VDMA Data Dictionary (https://www.isobus.net/isobus/pGNAndSPN/8614?type=PGN)";
CM_ BO_ 2566489600  "Source: isobus.net VDMA Data Dictionary (https://www.isobus.net/isobus/pGNAndSPN/8618?type=PGN)";
CM_ BO_ 2566489856  "Source: isobus.net VDMA Data Dictionary (https://www.isobus.net/isobus/pGNAndSPN/8622?type=PGN)";
CM_ BO_ 2566490112  "Source: isobus.net VDMA Data Dictionary (https://www.isobus.net/isobus/pGNAndSPN/8627?type=PGN)";
CM_ BO_ 2566490368  "Source: isobus.net VDMA Data Dictionary (https://www.isobus.net/isobus/pGNAndSPN/8631?type=PGN)";
CM_ BO_ 2566490624  "Source: isobus.net VDMA Data Dictionary (https://www.isobus.net/isobus/pGNAndSPN/8635?type=PGN)";
CM_ BO_ 2566490880  "Source: isobus.net VDMA Data Dictionary (https://www.isobus.net/isobus/pGNAndSPN/8639?type=PGN)";
CM_ BO_ 2566491136  "Source: isobus.net VDMA Data Dictionary (https://www.isobus.net/isobus/pGNAndSPN/8641?type=PGN)";
CM_ BO_ 2566491392  "Source: isobus.net VDMA Data Dictionary (https://www.isobus.net/isobus/pGNAndSPN/8645?type=PGN)";
CM_ BO_ 2566491648  "Source: isobus.net VDMA Data Dictionary (https://www.isobus.net/isobus/pGNAndSPN/8649?type=PGN)";
CM_ BO_ 2566491904  "Source: isobus.net VDMA Data Dictionary (https://www.isobus.net/isobus/pGNAndSPN/8666?type=PGN)";
CM_ BO_ 2566492160  "Source: isobus.net VDMA Data Dictionary (https://www.isobus.net/isobus/pGNAndSPN/8670?type=PGN)";
CM_ BO_ 2566492416  "Source: isobus.net VDMA Data Dictionary (https://www.isobus.net/isobus/pGNAndSPN/8675?type=PGN)";
CM_ BO_ 2566492672  "Source: isobus.net VDMA Data Dictionary (https://www.isobus.net/isobus/pGNAndSPN/8679?type=PGN)";
CM_ BO_ 2566492928  "Source: isobus.net VDMA Data Dictionary (https://www.isobus.net/isobus/pGNAndSPN/8683?type=PGN)";
CM_ BO_ 2566493184  "Source: isobus.net VDMA Data Dictionary (https://www.isobus.net/isobus/pGNAndSPN/8687?type=PGN)";
CM_ BO_ 2566493440  "Source: isobus.net VDMA Data Dictionary (https://www.isobus.net/isobus/pGNAndSPN/8692?type=PGN)";
CM_ BO_ 2566493696  "Source: isobus.net VDMA Data Dictionary (https://www.isobus.net/isobus/pGNAndSPN/8696?type=PGN)";
CM_ BO_ 2566493952  "Source: isobus.net VDMA Data Dictionary (https://www.isobus.net/isobus/pGNAndSPN/8700?type=PGN)";
CM_ BO_ 2566494208  "Source: isobus.net VDMA Data Dictionary (https://www.isobus.net/isobus/pGNAndSPN/8704?type=PGN)";
CM_ BO_ 2566494464  "Source: isobus.net VDMA Data Dictionary (https://www.isobus.net/isobus/pGNAndSPN/8706?type=PGN)";
CM_ BO_ 2566494720  "Source: isobus.net VDMA Data Dictionary (https://www.isobus.net/isobus/pGNAndSPN/8710?type=PGN)";
CM_ BO_ 2566494976  "Source: isobus.net VDMA Data Dictionary (https://www.isobus.net/isobus/pGNAndSPN/8714?type=PGN)";
CM_ BO_ 2566495232  "Source: isobus.net VDMA Data Dictionary (https://www.isobus.net/isobus/pGNAndSPN/8731?type=PGN)";
CM_ BO_ 2566495488  "Source: isobus.net VDMA Data Dictionary (https://www.isobus.net/isobus/pGNAndSPN/8735?type=PGN)";
CM_ BO_ 2566495744  "Source: isobus.net VDMA Data Dictionary (https://www.isobus.net/isobus/pGNAndSPN/8739?type=PGN)";
CM_ BO_ 2566496000  "Source: isobus.net VDMA Data Dictionary (https://www.isobus.net/isobus/pGNAndSPN/8745?type=PGN)";
CM_ BO_ 2566496256  "Source: isobus.net VDMA Data Dictionary (https://www.isobus.net/isobus/pGNAndSPN/8749?type=PGN)";
CM_ BO_ 2566496512  "Source: isobus.net VDMA Data Dictionary (https://www.isobus.net/isobus/pGNAndSPN/8755?type=PGN)";
CM_ BO_ 2566496768  "Source: isobus.net VDMA Data Dictionary (https://www.isobus.net/isobus/pGNAndSPN/8760?type=PGN)";
CM_ BO_ 2566497024  "Source: isobus.net VDMA Data Dictionary (https://www.isobus.net/isobus/pGNAndSPN/8763?type=PGN)";
CM_ BO_ 2566497280  "Source: isobus.net VDMA Data Dictionary (https://www.isobus.net/isobus/pGNAndSPN/8767?type=PGN)";
CM_ BO_ 2566497536  "Source: isobus.net VDMA Data Dictionary (https://www.isobus.net/isobus/pGNAndSPN/8769?type=PGN)";
CM_ BO_ 2566497792  "Source: isobus.net VDMA Data Dictionary (https://www.isobus.net/isobus/pGNAndSPN/8771?type=PGN)";
CM_ BO_ 2566498048  "Source: isobus.net VDMA Data Dictionary (https://www.isobus.net/isobus/pGNAndSPN/8773?type=PGN)";
CM_ BO_ 2566498304  "Source: isobus.net VDMA Data Dictionary (https://www.isobus.net/isobus/pGNAndSPN/8775?type=PGN)";
CM_ BO_ 2566498560  "Source: isobus.net VDMA Data Dictionary (https://www.isobus.net/isobus/pGNAndSPN/8777?type=PGN)";
CM_ BO_ 2566498816  "Source: isobus.net VDMA Data Dictionary (https://www.isobus.net/isobus/pGNAndSPN/8779?type=PGN)";
CM_ BO_ 2566499072  "Source: isobus.net VDMA Data Dictionary (https://www.isobus.net/isobus/pGNAndSPN/8781?type=PGN)";
CM_ BO_ 2566499328  "Source: isobus.net VDMA Data Dictionary (https://www.isobus.net/isobus/pGNAndSPN/8783?type=PGN)";
CM_ BO_ 2566499584  "Source: isobus.net VDMA Data Dictionary (https://www.isobus.net/isobus/pGNAndSPN/8785?type=PGN)";
CM_ BO_ 2566499840  "Source: isobus.net VDMA Data Dictionary (https://www.isobus.net/isobus/pGNAndSPN/8787?type=PGN)";
CM_ BO_ 2566500096  "Source: isobus.net VDMA Data Dictionary (https://www.isobus.net/isobus/pGNAndSPN/8789?type=PGN)";
CM_ BO_ 2566500352  "Source: isobus.net VDMA Data Dictionary (https://www.isobus.net/isobus/pGNAndSPN/8791?type=PGN)";
CM_ BO_ 2566500608  "Source: isobus.net VDMA Data Dictionary (https://www.isobus.net/isobus/pGNAndSPN/8793?type=PGN)";
CM_ BO_ 2566500864  "Source: isobus.net VDMA Data Dictionary (https://www.isobus.net/isobus/pGNAndSPN/8795?type=PGN)";
CM_ BO_ 2566501120  "Source: isobus.net VDMA Data Dictionary (https://www.isobus.net/isobus/pGNAndSPN/8805?type=PGN)";
CM_ BO_ 2566501376  "Source: isobus.net VDMA Data Dictionary (https://www.isobus.net/isobus/pGNAndSPN/8806?type=PGN)";
CM_ BO_ 2566501632  "Source: isobus.net VDMA Data Dictionary (https://www.isobus.net/isobus/pGNAndSPN/8811?type=PGN)";
CM_ BO_ 2566501888  "Source: isobus.net VDMA Data Dictionary (https://www.isobus.net/isobus/pGNAndSPN/8815?type=PGN)";
CM_ BO_ 2566502144  "Source: isobus.net VDMA Data Dictionary (https://www.isobus.net/isobus/pGNAndSPN/8818?type=PGN)";
CM_ BO_ 2566502400  "Source: isobus.net VDMA Data Dictionary (https://www.isobus.net/isobus/pGNAndSPN/8819?type=PGN)";
CM_ BO_ 2566502656  "Source: isobus.net VDMA Data Dictionary (https://www.isobus.net/isobus/pGNAndSPN/8821?type=PGN)";
CM_ BO_ 2566502912  "Source: isobus.net VDMA Data Dictionary (https://www.isobus.net/isobus/pGNAndSPN/8824?type=PGN)";
CM_ BO_ 2566503168  "Source: isobus.net VDMA Data Dictionary (https://www.isobus.net/isobus/pGNAndSPN/8828?type=PGN)";
CM_ BO_ 2566503424  "Source: isobus.net VDMA Data Dictionary (https://www.isobus.net/isobus/pGNAndSPN/8830?type=PGN)";
CM_ BO_ 2566503680  "Source: isobus.net VDMA Data Dictionary (https://www.isobus.net/isobus/pGNAndSPN/8832?type=PGN)";
CM_ BO_ 2566503936  "Source: isobus.net VDMA Data Dictionary (https://www.isobus.net/isobus/pGNAndSPN/8852?type=PGN)";
CM_ BO_ 2566504192  "Source: isobus.net VDMA Data Dictionary (https://www.isobus.net/isobus/pGNAndSPN/8860?type=PGN)";
CM_ BO_ 2566504448  "Source: isobus.net VDMA Data Dictionary (https://www.isobus.net/isobus/pGNAndSPN/8865?type=PGN)";
CM_ BO_ 2566504960  "Source: isobus.net VDMA Data Dictionary (https://www.isobus.net/isobus/pGNAndSPN/8867?type=PGN)";
CM_ BO_ 2566505216  "Source: isobus.net VDMA Data Dictionary (https://www.isobus.net/isobus/pGNAndSPN/8871?type=PGN)";
CM_ BO_ 2566505472  "Source: isobus.net VDMA Data Dictionary (https://www.isobus.net/isobus/pGNAndSPN/8875?type=PGN)";
CM_ BO_ 2566505728  "Source: isobus.net VDMA Data Dictionary (https://www.isobus.net/isobus/pGNAndSPN/8879?type=PGN)";
CM_ BO_ 2566505984  "Source: isobus.net VDMA Data Dictionary (https://www.isobus.net/isobus/pGNAndSPN/8883?type=PGN)";
CM_ BO_ 2566506240  "Source: isobus.net VDMA Data Dictionary (https://www.isobus.net/isobus/pGNAndSPN/8887?type=PGN)";
CM_ BO_ 2566506496  "Source: isobus.net VDMA Data Dictionary (https://www.isobus.net/isobus/pGNAndSPN/8891?type=PGN)";
CM_ BO_ 2566506752  "Source: isobus.net VDMA Data Dictionary (https://www.isobus.net/isobus/pGNAndSPN/8895?type=PGN)";
CM_ BO_ 2566507008  "Source: isobus.net VDMA Data Dictionary (https://www.isobus.net/isobus/pGNAndSPN/8899?type=PGN)";
CM_ BO_ 2566507264  "Source: isobus.net VDMA Data Dictionary (https://www.isobus.net/isobus/pGNAndSPN/8903?type=PGN)";
CM_ BO_ 2566507520  "Source: isobus.net VDMA Data Dictionary (https://www.isobus.net/isobus/pGNAndSPN/8907?type=PGN)";
CM_ BO_ 2566507776  "Source: isobus.net VDMA Data Dictionary (https://www.isobus.net/isobus/pGNAndSPN/8909?type=PGN)";
CM_ BO_ 2566508032  "Source: isobus.net VDMA Data Dictionary (https://www.isobus.net/isobus/pGNAndSPN/8911?type=PGN)";
CM_ BO_ 2566508288  "Source: isobus.net VDMA Data Dictionary (https://www.isobus.net/isobus/pGNAndSPN/8915?type=PGN)";
CM_ BO_ 2566508544  "Source: isobus.net VDMA Data Dictionary (https://www.isobus.net/isobus/pGNAndSPN/8919?type=PGN)";
CM_ BO_ 2566508800  "Source: isobus.net VDMA Data Dictionary (https://www.isobus.net/isobus/pGNAndSPN/8923?type=PGN)";
CM_ BO_ 2566509056  "Source: isobus.net VDMA Data Dictionary (https://www.isobus.net/isobus/pGNAndSPN/8927?type=PGN)";
CM_ BO_ 2566509312  "Source: isobus.net VDMA Data Dictionary (https://www.isobus.net/isobus/pGNAndSPN/8931?type=PGN)";
CM_ BO_ 2566509568  "Source: isobus.net VDMA Data Dictionary (https://www.isobus.net/isobus/pGNAndSPN/8937?type=PGN)";
CM_ BO_ 2566509824  "Source: isobus.net VDMA Data Dictionary (https://www.isobus.net/isobus/pGNAndSPN/8945?type=PGN)";
CM_ BO_ 2566510080  "Source: isobus.net VDMA Data Dictionary (https://www.isobus.net/isobus/pGNAndSPN/8964?type=PGN)";
CM_ BO_ 2566510336  "Source: isobus.net VDMA Data Dictionary (https://www.isobus.net/isobus/pGNAndSPN/8991?type=PGN)";
CM_ BO_ 2566510592  "Source: isobus.net VDMA Data Dictionary (https://www.isobus.net/isobus/pGNAndSPN/9002?type=PGN)";
CM_ BO_ 2566510848  "Source: isobus.net VDMA Data Dictionary (https://www.isobus.net/isobus/pGNAndSPN/9004?type=PGN)";
CM_ BO_ 2566511104  "Source: isobus.net VDMA Data Dictionary (https://www.isobus.net/isobus/pGNAndSPN/9008?type=PGN)";
CM_ BO_ 2566511360  "Source: isobus.net VDMA Data Dictionary (https://www.isobus.net/isobus/pGNAndSPN/9012?type=PGN)";
CM_ BO_ 2566511616  "Source: isobus.net VDMA Data Dictionary (https://www.isobus.net/isobus/pGNAndSPN/9016?type=PGN)";
CM_ BO_ 2566511872  "Source: isobus.net VDMA Data Dictionary (https://www.isobus.net/isobus/pGNAndSPN/9020?type=PGN)";
CM_ BO_ 2566512128  "Source: isobus.net VDMA Data Dictionary (https://www.isobus.net/isobus/pGNAndSPN/9024?type=PGN)";
CM_ BO_ 2566512384  "Source: isobus.net VDMA Data Dictionary (https://www.isobus.net/isobus/pGNAndSPN/9032?type=PGN)";
CM_ BO_ 2566512640  "Source: isobus.net VDMA Data Dictionary (https://www.isobus.net/isobus/pGNAndSPN/9039?type=PGN)";
CM_ BO_ 2566512896  "Source: isobus.net VDMA Data Dictionary (https://www.isobus.net/isobus/pGNAndSPN/9047?type=PGN)";
CM_ BO_ 2566513152  "Source: isobus.net VDMA Data Dictionary (https://www.isobus.net/isobus/pGNAndSPN/9054?type=PGN)";
CM_ BO_ 2566513408  "Source: isobus.net VDMA Data Dictionary (https://www.isobus.net/isobus/pGNAndSPN/9058?type=PGN)";
CM_ BO_ 2566513664  "Source: isobus.net VDMA Data Dictionary (https://www.isobus.net/isobus/pGNAndSPN/9061?type=PGN)";
CM_ BO_ 2566513920  "Source: isobus.net VDMA Data Dictionary (https://www.isobus.net/isobus/pGNAndSPN/9064?type=PGN)";
CM_ BO_ 2566514176  "Source: isobus.net VDMA Data Dictionary (https://www.isobus.net/isobus/pGNAndSPN/9067?type=PGN)";
CM_ BO_ 2566514432  "Source: isobus.net VDMA Data Dictionary (https://www.isobus.net/isobus/pGNAndSPN/9073?type=PGN)";
CM_ BO_ 2566514688  "Source: isobus.net VDMA Data Dictionary (https://www.isobus.net/isobus/pGNAndSPN/9080?type=PGN)";
CM_ BO_ 2566514944  "Source: isobus.net VDMA Data Dictionary (https://www.isobus.net/isobus/pGNAndSPN/9082?type=PGN)";
CM_ BO_ 2566515200  "Source: isobus.net VDMA Data Dictionary (https://www.isobus.net/isobus/pGNAndSPN/9088?type=PGN)";
CM_ BO_ 2566515456  "Source: isobus.net VDMA Data Dictionary (https://www.isobus.net/isobus/pGNAndSPN/9098?type=PGN)";
CM_ BO_ 2566515712  "Source: isobus.net VDMA Data Dictionary (https://www.isobus.net/isobus/pGNAndSPN/9108?type=PGN)";
CM_ BO_ 2566515968  "Source: isobus.net VDMA Data Dictionary (https://www.isobus.net/isobus/pGNAndSPN/9109?type=PGN)";
CM_ BO_ 2566516224  "Source: isobus.net VDMA Data Dictionary (https://www.isobus.net/isobus/pGNAndSPN/9113?type=PGN)";
CM_ BO_ 2566516480  "Source: isobus.net VDMA Data Dictionary (https://www.isobus.net/isobus/pGNAndSPN/9117?type=PGN)";
CM_ BO_ 2566516736  "Source: isobus.net VDMA Data Dictionary (https://www.isobus.net/isobus/pGNAndSPN/9121?type=PGN)";
CM_ BO_ 2566516992  "Source: isobus.net VDMA Data Dictionary (https://www.isobus.net/isobus/pGNAndSPN/9125?type=PGN)";
CM_ BO_ 2566517248  "Source: isobus.net VDMA Data Dictionary (https://www.isobus.net/isobus/pGNAndSPN/9129?type=PGN)";
CM_ BO_ 2566517504  "Source: isobus.net VDMA Data Dictionary (https://www.isobus.net/isobus/pGNAndSPN/9137?type=PGN)";
CM_ BO_ 2566517760  "Source: isobus.net VDMA Data Dictionary (https://www.isobus.net/isobus/pGNAndSPN/9145?type=PGN)";
CM_ BO_ 2566518016  "Source: isobus.net VDMA Data Dictionary (https://www.isobus.net/isobus/pGNAndSPN/9153?type=PGN)";
CM_ BO_ 2566518272  "Source: isobus.net VDMA Data Dictionary (https://www.isobus.net/isobus/pGNAndSPN/9160?type=PGN)";
CM_ BO_ 2566518528  "Source: isobus.net VDMA Data Dictionary (https://www.isobus.net/isobus/pGNAndSPN/9168?type=PGN)";
CM_ BO_ 2566518784  "Source: isobus.net VDMA Data Dictionary (https://www.isobus.net/isobus/pGNAndSPN/9175?type=PGN)";
CM_ BO_ 2566519040  "Source: isobus.net VDMA Data Dictionary (https://www.isobus.net/isobus/pGNAndSPN/9183?type=PGN)";
CM_ BO_ 2566519296  "Source: isobus.net VDMA Data Dictionary (https://www.isobus.net/isobus/pGNAndSPN/9190?type=PGN)";
CM_ BO_ 2566519552  "Source: isobus.net VDMA Data Dictionary (https://www.isobus.net/isobus/pGNAndSPN/9198?type=PGN)";
CM_ BO_ 2566519808  "Source: isobus.net VDMA Data Dictionary (https://www.isobus.net/isobus/pGNAndSPN/9205?type=PGN)";
CM_ BO_ 2566520064  "Source: isobus.net VDMA Data Dictionary (https://www.isobus.net/isobus/pGNAndSPN/9213?type=PGN)";
CM_ BO_ 2566520320  "Source: isobus.net VDMA Data Dictionary (https://www.isobus.net/isobus/pGNAndSPN/9222?type=PGN)";
CM_ BO_ 2566520576  "Source: isobus.net VDMA Data Dictionary (https://www.isobus.net/isobus/pGNAndSPN/9227?type=PGN)";
CM_ BO_ 2566520832  "Source: isobus.net VDMA Data Dictionary (https://www.isobus.net/isobus/pGNAndSPN/9231?type=PGN)";
CM_ BO_ 2566521088  "Source: isobus.net VDMA Data Dictionary (https://www.isobus.net/isobus/pGNAndSPN/9236?type=PGN)";
CM_ BO_ 2566522368  "Source: isobus.net VDMA Data Dictionary (https://www.isobus.net/isobus/pGNAndSPN/9238?type=PGN)";
CM_ BO_ 2566522624  "Source: isobus.net VDMA Data Dictionary (https://www.isobus.net/isobus/pGNAndSPN/9241?type=PGN)";
CM_ BO_ 2566522880  "Source: isobus.net VDMA Data Dictionary (https://www.isobus.net/isobus/pGNAndSPN/9245?type=PGN)";
CM_ BO_ 2566523136  "Source: isobus.net VDMA Data Dictionary (https://www.isobus.net/isobus/pGNAndSPN/9246?type=PGN)";
CM_ BO_ 2566523392  "Source: isobus.net VDMA Data Dictionary (https://www.isobus.net/isobus/pGNAndSPN/9248?type=PGN)";
CM_ BO_ 2566523648  "Source: isobus.net VDMA Data Dictionary (https://www.isobus.net/isobus/pGNAndSPN/9250?type=PGN)";
CM_ BO_ 2566523904  "Source: isobus.net VDMA Data Dictionary (https://www.isobus.net/isobus/pGNAndSPN/9252?type=PGN)";
CM_ BO_ 2566524160  "Source: isobus.net VDMA Data Dictionary (https://www.isobus.net/isobus/pGNAndSPN/9254?type=PGN)";
CM_ BO_ 2566524416  "Source: isobus.net VDMA Data Dictionary (https://www.isobus.net/isobus/pGNAndSPN/9256?type=PGN)";
CM_ BO_ 2566524672  "Source: isobus.net VDMA Data Dictionary (https://www.isobus.net/isobus/pGNAndSPN/9258?type=PGN)";
CM_ BO_ 2566524928  "Source: isobus.net VDMA Data Dictionary (https://www.isobus.net/isobus/pGNAndSPN/9266?type=PGN)";
CM_ BO_ 2566525184  "Source: isobus.net VDMA Data Dictionary (https://www.isobus.net/isobus/pGNAndSPN/9268?type=PGN)";
CM_ BO_ 2566525440  "Source: isobus.net VDMA Data Dictionary (https://www.isobus.net/isobus/pGNAndSPN/9276?type=PGN)";
CM_ BO_ 2566525696  "Source: isobus.net VDMA Data Dictionary (https://www.isobus.net/isobus/pGNAndSPN/9286?type=PGN)";
CM_ BO_ 2566525952  "Source: isobus.net VDMA Data Dictionary (https://www.isobus.net/isobus/pGNAndSPN/9296?type=PGN)";
CM_ BO_ 2566526208  "Source: isobus.net VDMA Data Dictionary (https://www.isobus.net/isobus/pGNAndSPN/9300?type=PGN)";
CM_ BO_ 2566526464  "Source: isobus.net VDMA Data Dictionary (https://www.isobus.net/isobus/pGNAndSPN/9304?type=PGN)";
CM_ BO_ 2566526720  "Source: isobus.net VDMA Data Dictionary (https://www.isobus.net/isobus/pGNAndSPN/9308?type=PGN)";
CM_ BO_ 2566526976  "Source: isobus.net VDMA Data Dictionary (https://www.isobus.net/isobus/pGNAndSPN/9312?type=PGN)";
CM_ BO_ 2566527232  "Source: isobus.net VDMA Data Dictionary (https://www.isobus.net/isobus/pGNAndSPN/9316?type=PGN)";
CM_ BO_ 2566527488  "Source: isobus.net VDMA Data Dictionary (https://www.isobus.net/isobus/pGNAndSPN/9318?type=PGN)";
CM_ BO_ 2566527744  "Source: isobus.net VDMA Data Dictionary (https://www.isobus.net/isobus/pGNAndSPN/9324?type=PGN)";
CM_ BO_ 2566528000  "Source: isobus.net VDMA Data Dictionary (https://www.isobus.net/isobus/pGNAndSPN/9330?type=PGN)";
CM_ BO_ 2566528256  "Source: isobus.net VDMA Data Dictionary (https://www.isobus.net/isobus/pGNAndSPN/9357?type=PGN)";
CM_ BO_ 2566528512  "Source: isobus.net VDMA Data Dictionary (https://www.isobus.net/isobus/pGNAndSPN/9384?type=PGN)";
CM_ BO_ 2566528768  "Source: isobus.net VDMA Data Dictionary (https://www.isobus.net/isobus/pGNAndSPN/9385?type=PGN)";
CM_ BO_ 2566529024  "Source: isobus.net VDMA Data Dictionary (https://www.isobus.net/isobus/pGNAndSPN/9390?type=PGN)";
CM_ BO_ 2566529280  "Source: isobus.net VDMA Data Dictionary (https://www.isobus.net/isobus/pGNAndSPN/9396?type=PGN)";
CM_ BO_ 2566529536  "Source: isobus.net VDMA Data Dictionary (https://www.isobus.net/isobus/pGNAndSPN/9403?type=PGN)";
CM_ BO_ 2566529792  "Source: isobus.net VDMA Data Dictionary (https://www.isobus.net/isobus/pGNAndSPN/9410?type=PGN)";
CM_ BO_ 2566530048  "Source: isobus.net VDMA Data Dictionary (https://www.isobus.net/isobus/pGNAndSPN/9417?type=PGN)";
CM_ BO_ 2566530304  "Source: isobus.net VDMA Data Dictionary (https://www.isobus.net/isobus/pGNAndSPN/9421?type=PGN)";
CM_ BO_ 2566530560  "Source: isobus.net VDMA Data Dictionary (https://www.isobus.net/isobus/pGNAndSPN/9425?type=PGN)";
CM_ BO_ 2566530816  "Source: isobus.net VDMA Data Dictionary (https://www.isobus.net/isobus/pGNAndSPN/9441?type=PGN)";
CM_ BO_ 2566531072  "Source: isobus.net VDMA Data Dictionary (https://www.isobus.net/isobus/pGNAndSPN/9457?type=PGN)";
CM_ BO_ 2566531328  "Source: isobus.net VDMA Data Dictionary (https://www.isobus.net/isobus/pGNAndSPN/9473?type=PGN)";
CM_ BO_ 2566531584  "Source: isobus.net VDMA Data Dictionary (https://www.isobus.net/isobus/pGNAndSPN/9489?type=PGN)";
CM_ BO_ 2566531840  "Source: isobus.net VDMA Data Dictionary (https://www.isobus.net/isobus/pGNAndSPN/9505?type=PGN)";
CM_ BO_ 2566532096  "Source: isobus.net VDMA Data Dictionary (https://www.isobus.net/isobus/pGNAndSPN/9521?type=PGN)";
CM_ BO_ 2566532352  "Source: isobus.net VDMA Data Dictionary (https://www.isobus.net/isobus/pGNAndSPN/9537?type=PGN)";
CM_ BO_ 2566532608  "Source: isobus.net VDMA Data Dictionary (https://www.isobus.net/isobus/pGNAndSPN/9553?type=PGN)";
CM_ BO_ 2566532864  "Source: isobus.net VDMA Data Dictionary (https://www.isobus.net/isobus/pGNAndSPN/9569?type=PGN)";
CM_ BO_ 2566533120  "Source: isobus.net VDMA Data Dictionary (https://www.isobus.net/isobus/pGNAndSPN/9585?type=PGN)";
CM_ BO_ 2566533376  "Source: isobus.net VDMA Data Dictionary (https://www.isobus.net/isobus/pGNAndSPN/9601?type=PGN)";
CM_ BO_ 2566533632  "Source: isobus.net VDMA Data Dictionary (https://www.isobus.net/isobus/pGNAndSPN/9617?type=PGN)";
CM_ BO_ 2566533888  "Source: isobus.net VDMA Data Dictionary (https://www.isobus.net/isobus/pGNAndSPN/9631?type=PGN)";
CM_ BO_ 2566534144  "Source: isobus.net VDMA Data Dictionary (https://www.isobus.net/isobus/pGNAndSPN/9647?type=PGN)";
CM_ BO_ 2566534400  "Source: isobus.net VDMA Data Dictionary (https://www.isobus.net/isobus/pGNAndSPN/9652?type=PGN)";
CM_ BO_ 2566534656  "Source: isobus.net VDMA Data Dictionary (https://www.isobus.net/isobus/pGNAndSPN/9656?type=PGN)";
CM_ BO_ 2566534912  "Source: isobus.net VDMA Data Dictionary (https://www.isobus.net/isobus/pGNAndSPN/9663?type=PGN)";
CM_ BO_ 2566535168  "Source: isobus.net VDMA Data Dictionary (https://www.isobus.net/isobus/pGNAndSPN/9671?type=PGN)";
CM_ BO_ 2566535424  "Source: isobus.net VDMA Data Dictionary (https://www.isobus.net/isobus/pGNAndSPN/9678?type=PGN)";
CM_ BO_ 2566535680  "Source: isobus.net VDMA Data Dictionary (https://www.isobus.net/isobus/pGNAndSPN/9686?type=PGN)";
CM_ BO_ 2566535936  "Source: isobus.net VDMA Data Dictionary (https://www.isobus.net/isobus/pGNAndSPN/9689?type=PGN)";
CM_ BO_ 2566536192  "Source: isobus.net VDMA Data Dictionary (https://www.isobus.net/isobus/pGNAndSPN/9693?type=PGN)";
CM_ BO_ 2566536448  "Source: isobus.net VDMA Data Dictionary (https://www.isobus.net/isobus/pGNAndSPN/9698?type=PGN)";
CM_ BO_ 2566536704  "Source: isobus.net VDMA Data Dictionary (https://www.isobus.net/isobus/pGNAndSPN/9699?type=PGN)";
CM_ BO_ 2566536960  "Source: isobus.net VDMA Data Dictionary (https://www.isobus.net/isobus/pGNAndSPN/9701?type=PGN)";
CM_ BO_ 2566537216  "Source: isobus.net VDMA Data Dictionary (https://www.isobus.net/isobus/pGNAndSPN/9706?type=PGN)";
CM_ BO_ 2566537472  "Source: isobus.net VDMA Data Dictionary (https://www.isobus.net/isobus/pGNAndSPN/9714?type=PGN)";
CM_ BO_ 2566537728  "Source: isobus.net VDMA Data Dictionary (https://www.isobus.net/isobus/pGNAndSPN/9722?type=PGN)";
CM_ BO_ 2566537984  "Source: isobus.net VDMA Data Dictionary (https://www.isobus.net/isobus/pGNAndSPN/9723?type=PGN)";
CM_ BO_ 2566538240  "Source: isobus.net VDMA Data Dictionary (https://www.isobus.net/isobus/pGNAndSPN/9725?type=PGN)";
CM_ BO_ 2566538496  "Source: isobus.net VDMA Data Dictionary (https://www.isobus.net/isobus/pGNAndSPN/9726?type=PGN)";
CM_ BO_ 2566538752  "Source: isobus.net VDMA Data Dictionary (https://www.isobus.net/isobus/pGNAndSPN/9731?type=PGN)";
CM_ BO_ 2566539008  "Source: isobus.net VDMA Data Dictionary (https://www.isobus.net/isobus/pGNAndSPN/9733?type=PGN)";
CM_ BO_ 2566539264  "Source: isobus.net VDMA Data Dictionary (https://www.isobus.net/isobus/pGNAndSPN/9740?type=PGN)";
CM_ BO_ 2566539520  "Source: isobus.net VDMA Data Dictionary (https://www.isobus.net/isobus/pGNAndSPN/9742?type=PGN)";
CM_ BO_ 2566539776  "Source: isobus.net VDMA Data Dictionary (https://www.isobus.net/isobus/pGNAndSPN/9743?type=PGN)";
CM_ BO_ 2566540032  "Source: isobus.net VDMA Data Dictionary (https://www.isobus.net/isobus/pGNAndSPN/9745?type=PGN)";
CM_ BO_ 2566540288  "Source: isobus.net VDMA Data Dictionary (https://www.isobus.net/isobus/pGNAndSPN/9747?type=PGN)";
CM_ BO_ 2566540544  "Source: isobus.net VDMA Data Dictionary (https://www.isobus.net/isobus/pGNAndSPN/9749?type=PGN)";
CM_ BO_ 2566540800  "Source: isobus.net VDMA Data Dictionary (https://www.isobus.net/isobus/pGNAndSPN/9761?type=PGN)";
CM_ BO_ 2566541056  "Source: isobus.net VDMA Data Dictionary (https://www.isobus.net/isobus/pGNAndSPN/9765?type=PGN)";
CM_ BO_ 2566541312  "Source: isobus.net VDMA Data Dictionary (https://www.isobus.net/isobus/pGNAndSPN/9770?type=PGN)";
CM_ BO_ 2566541568  "Source: isobus.net VDMA Data Dictionary (https://www.isobus.net/isobus/pGNAndSPN/9781?type=PGN)";
CM_ BO_ 2566541824  "Source: isobus.net VDMA Data Dictionary (https://www.isobus.net/isobus/pGNAndSPN/9791?type=PGN)";
CM_ BO_ 2566542080  "Source: isobus.net VDMA Data Dictionary (https://www.isobus.net/isobus/pGNAndSPN/9795?type=PGN)";
CM_ BO_ 2566542336  "Source: isobus.net VDMA Data Dictionary (https://www.isobus.net/isobus/pGNAndSPN/9799?type=PGN)";
CM_ BO_ 2566542592  "Source: isobus.net VDMA Data Dictionary (https://www.isobus.net/isobus/pGNAndSPN/9803?type=PGN)";
CM_ BO_ 2566542848  "Source: isobus.net VDMA Data Dictionary (https://www.isobus.net/isobus/pGNAndSPN/9807?type=PGN)";
CM_ BO_ 2566543104  "Source: isobus.net VDMA Data Dictionary (https://www.isobus.net/isobus/pGNAndSPN/9811?type=PGN)";
CM_ BO_ 2566543360  "Source: isobus.net VDMA Data Dictionary (https://www.isobus.net/isobus/pGNAndSPN/9814?type=PGN)";
CM_ BO_ 2566543616  "Source: isobus.net VDMA Data Dictionary (https://www.isobus.net/isobus/pGNAndSPN/9820?type=PGN)";
CM_ BO_ 2566543872  "Source: isobus.net VDMA Data Dictionary (https://www.isobus.net/isobus/pGNAndSPN/9826?type=PGN)";
CM_ BO_ 2566544128  "Source: isobus.net VDMA Data Dictionary (https://www.isobus.net/isobus/pGNAndSPN/9829?type=PGN)";
CM_ BO_ 2566544384  "Source: isobus.net VDMA Data Dictionary (https://www.isobus.net/isobus/pGNAndSPN/9830?type=PGN)";
CM_ BO_ 2566544640  "Source: isobus.net VDMA Data Dictionary (https://www.isobus.net/isobus/pGNAndSPN/9837?type=PGN)";
CM_ BO_ 2566544896  "Source: isobus.net VDMA Data Dictionary (https://www.isobus.net/isobus/pGNAndSPN/9840?type=PGN)";
CM_ BO_ 2566545152  "Source: isobus.net VDMA Data Dictionary (https://www.isobus.net/isobus/pGNAndSPN/9844?type=PGN)";
CM_ BO_ 2566545408  "Source: isobus.net VDMA Data Dictionary (https://www.isobus.net/isobus/pGNAndSPN/9849?type=PGN)";
CM_ BO_ 2566545920  "Source: isobus.net VDMA Data Dictionary (https://www.isobus.net/isobus/pGNAndSPN/9850?type=PGN)";
CM_ BO_ 2566546176  "Source: isobus.net VDMA Data Dictionary (https://www.isobus.net/isobus/pGNAndSPN/9852?type=PGN)";
CM_ BO_ 2566546432  "Source: isobus.net VDMA Data Dictionary (https://www.isobus.net/isobus/pGNAndSPN/9854?type=PGN)";
CM_ BO_ 2566546688  "Source: isobus.net VDMA Data Dictionary (https://www.isobus.net/isobus/pGNAndSPN/9856?type=PGN)";
CM_ BO_ 2566546944  "Source: isobus.net VDMA Data Dictionary (https://www.isobus.net/isobus/pGNAndSPN/9858?type=PGN)";
CM_ BO_ 2566547200  "Source: isobus.net VDMA Data Dictionary (https://www.isobus.net/isobus/pGNAndSPN/9860?type=PGN)";
CM_ BO_ 2566547456  "Source: isobus.net VDMA Data Dictionary (https://www.isobus.net/isobus/pGNAndSPN/9864?type=PGN)";
CM_ BO_ 2566547712  "Source: isobus.net VDMA Data Dictionary (https://www.isobus.net/isobus/pGNAndSPN/9868?type=PGN)";
CM_ BO_ 2566547968  "Source: isobus.net VDMA Data Dictionary (https://www.isobus.net/isobus/pGNAndSPN/9874?type=PGN)";
CM_ BO_ 2566548224  "Source: isobus.net VDMA Data Dictionary (https://www.isobus.net/isobus/pGNAndSPN/9880?type=PGN)";
CM_ BO_ 2566548480  "Source: isobus.net VDMA Data Dictionary (https://www.isobus.net/isobus/pGNAndSPN/9886?type=PGN)";
CM_ BO_ 2566548736  "Source: isobus.net VDMA Data Dictionary (https://www.isobus.net/isobus/pGNAndSPN/9892?type=PGN)";
CM_ BO_ 2566548992  "Source: isobus.net VDMA Data Dictionary (https://www.isobus.net/isobus/pGNAndSPN/9898?type=PGN)";
CM_ BO_ 2566549248  "Source: isobus.net VDMA Data Dictionary (https://www.isobus.net/isobus/pGNAndSPN/9904?type=PGN)";
CM_ BO_ 2566549504  "Source: isobus.net VDMA Data Dictionary (https://www.isobus.net/isobus/pGNAndSPN/9908?type=PGN)";
CM_ BO_ 2566549760  "Source: isobus.net VDMA Data Dictionary (https://www.isobus.net/isobus/pGNAndSPN/9912?type=PGN)";
CM_ BO_ 2566550016  "Source: isobus.net VDMA Data Dictionary (https://www.isobus.net/isobus/pGNAndSPN/9930?type=PGN)";
CM_ BO_ 2566550272  "Source: isobus.net VDMA Data Dictionary (https://www.isobus.net/isobus/pGNAndSPN/9948?type=PGN)";
CM_ BO_ 2566550528  "Source: isobus.net VDMA Data Dictionary (https://www.isobus.net/isobus/pGNAndSPN/9953?type=PGN)";
CM_ BO_ 2566550784  "Source: isobus.net VDMA Data Dictionary (https://www.isobus.net/isobus/pGNAndSPN/9957?type=PGN)";
CM_ BO_ 2566551040  "Source: isobus.net VDMA Data Dictionary (https://www.isobus.net/isobus/pGNAndSPN/9961?type=PGN)";
CM_ BO_ 2566551296  "Source: isobus.net VDMA Data Dictionary (https://www.isobus.net/isobus/pGNAndSPN/9965?type=PGN)";
CM_ BO_ 2566551552  "Source: isobus.net VDMA Data Dictionary (https://www.isobus.net/isobus/pGNAndSPN/9969?type=PGN)";
CM_ BO_ 2566551808  "Source: isobus.net VDMA Data Dictionary (https://www.isobus.net/isobus/pGNAndSPN/9974?type=PGN)";
CM_ BO_ 2566552064  "Source: isobus.net VDMA Data Dictionary (https://www.isobus.net/isobus/pGNAndSPN/9977?type=PGN)";
CM_ BO_ 2566552320  "Source: isobus.net VDMA Data Dictionary (https://www.isobus.net/isobus/pGNAndSPN/9980?type=PGN)";
CM_ BO_ 2566552576  "Source: isobus.net VDMA Data Dictionary (https://www.isobus.net/isobus/pGNAndSPN/9983?type=PGN)";
CM_ BO_ 2566552832  "Source: isobus.net VDMA Data Dictionary (https://www.isobus.net/isobus/pGNAndSPN/9986?type=PGN)";
CM_ BO_ 2566553088  "Source: isobus.net VDMA Data Dictionary (https://www.isobus.net/isobus/pGNAndSPN/9992?type=PGN)";
CM_ BO_ 2566553344  "Source: isobus.net VDMA Data Dictionary (https://www.isobus.net/isobus/pGNAndSPN/9995?type=PGN)";
CM_ BO_ 2566553600  "Source: isobus.net VDMA Data Dictionary (https://www.isobus.net/isobus/pGNAndSPN/9998?type=PGN)";
CM_ BO_ 2566553856  "Source: isobus.net VDMA Data Dictionary (https://www.isobus.net/isobus/pGNAndSPN/10002?type=PGN)";
CM_ BO_ 2566554112  "Source: isobus.net VDMA Data Dictionary (https://www.isobus.net/isobus/pGNAndSPN/10008?type=PGN)";
CM_ BO_ 2566554368  "Source: isobus.net VDMA Data Dictionary (https://www.isobus.net/isobus/pGNAndSPN/10016?type=PGN)";
CM_ BO_ 2566554624  "Source: isobus.net VDMA Data Dictionary (https://www.isobus.net/isobus/pGNAndSPN/10022?type=PGN)";
CM_ BO_ 2566554880  "Source: isobus.net VDMA Data Dictionary (https://www.isobus.net/isobus/pGNAndSPN/10032?type=PGN)";
CM_ BO_ 2566555136  "Source: isobus.net VDMA Data Dictionary (https://www.isobus.net/isobus/pGNAndSPN/10038?type=PGN)";
CM_ BO_ 2566555392  "Source: isobus.net VDMA Data Dictionary (https://www.isobus.net/isobus/pGNAndSPN/10048?type=PGN)";
CM_ BO_ 2566555648  "Source: isobus.net VDMA Data Dictionary (https://www.isobus.net/isobus/pGNAndSPN/10054?type=PGN)";
CM_ BO_ 2566555904  "Source: isobus.net VDMA Data Dictionary (https://www.isobus.net/isobus/pGNAndSPN/10064?type=PGN)";
CM_ BO_ 2566556160  "Source: isobus.net VDMA Data Dictionary (https://www.isobus.net/isobus/pGNAndSPN/10070?type=PGN)";
CM_ BO_ 2566556416  "Source: isobus.net VDMA Data Dictionary (https://www.isobus.net/isobus/pGNAndSPN/10080?type=PGN)";
CM_ BO_ 2566556672  "Source: isobus.net VDMA Data Dictionary (https://www.isobus.net/isobus/pGNAndSPN/10086?type=PGN)";
CM_ BO_ 2566556928  "Source: isobus.net VDMA Data Dictionary (https://www.isobus.net/isobus/pGNAndSPN/10096?type=PGN)";
CM_ BO_ 2566557184  "Source: isobus.net VDMA Data Dictionary (https://www.isobus.net/isobus/pGNAndSPN/10102?type=PGN)";
CM_ BO_ 2566557440  "Source: isobus.net VDMA Data Dictionary (https://www.isobus.net/isobus/pGNAndSPN/10112?type=PGN)";
CM_ BO_ 2566557696  "Source: isobus.net VDMA Data Dictionary (https://www.isobus.net/isobus/pGNAndSPN/10118?type=PGN)";
CM_ BO_ 2566557952  "Source: isobus.net VDMA Data Dictionary (https://www.isobus.net/isobus/pGNAndSPN/10128?type=PGN)";
CM_ BO_ 2566558208  "Source: isobus.net VDMA Data Dictionary (https://www.isobus.net/isobus/pGNAndSPN/10134?type=PGN)";
CM_ BO_ 2566558464  "Source: isobus.net VDMA Data Dictionary (https://www.isobus.net/isobus/pGNAndSPN/10144?type=PGN)";
CM_ BO_ 2566558720  "Source: isobus.net VDMA Data Dictionary (https://www.isobus.net/isobus/pGNAndSPN/10150?type=PGN)";
CM_ BO_ 2566558976  "Source: isobus.net VDMA Data Dictionary (https://www.isobus.net/isobus/pGNAndSPN/10160?type=PGN)";
CM_ BO_ 2566559232  "Source: isobus.net VDMA Data Dictionary (https://www.isobus.net/isobus/pGNAndSPN/10166?type=PGN)";
CM_ BO_ 2566559488  "Source: isobus.net VDMA Data Dictionary (https://www.isobus.net/isobus/pGNAndSPN/10176?type=PGN)";
CM_ BO_ 2566559744  "Source: isobus.net VDMA Data Dictionary (https://www.isobus.net/isobus/pGNAndSPN/10182?type=PGN)";
CM_ BO_ 2566560000  "Source: isobus.net VDMA Data Dictionary (https://www.isobus.net/isobus/pGNAndSPN/10192?type=PGN)";
CM_ BO_ 2566560256  "Source: isobus.net VDMA Data Dictionary (https://www.isobus.net/isobus/pGNAndSPN/10198?type=PGN)";
CM_ BO_ 2566560512  "Source: isobus.net VDMA Data Dictionary (https://www.isobus.net/isobus/pGNAndSPN/10208?type=PGN)";
CM_ BO_ 2566560768  "Source: isobus.net VDMA Data Dictionary (https://www.isobus.net/isobus/pGNAndSPN/10214?type=PGN)";
CM_ BO_ 2566561024  "Source: isobus.net VDMA Data Dictionary (https://www.isobus.net/isobus/pGNAndSPN/10224?type=PGN)";
CM_ BO_ 2566561280  "Source: isobus.net VDMA Data Dictionary (https://www.isobus.net/isobus/pGNAndSPN/10230?type=PGN)";
CM_ BO_ 2566561536  "Source: isobus.net VDMA Data Dictionary (https://www.isobus.net/isobus/pGNAndSPN/10240?type=PGN)";
CM_ BO_ 2566561792  "Source: isobus.net VDMA Data Dictionary (https://www.isobus.net/isobus/pGNAndSPN/10246?type=PGN)";
CM_ BO_ 2566562048  "Source: isobus.net VDMA Data Dictionary (https://www.isobus.net/isobus/pGNAndSPN/10256?type=PGN)";
CM_ BO_ 2566562304  "Source: isobus.net VDMA Data Dictionary (https://www.isobus.net/isobus/pGNAndSPN/10262?type=PGN)";
CM_ BO_ 2566562560  "Source: isobus.net VDMA Data Dictionary (https://www.isobus.net/isobus/pGNAndSPN/10272?type=PGN)";
CM_ BO_ 2566562816  "Source: isobus.net VDMA Data Dictionary (https://www.isobus.net/isobus/pGNAndSPN/10277?type=PGN)";
CM_ BO_ 2566563072  "Source: isobus.net VDMA Data Dictionary (https://www.isobus.net/isobus/pGNAndSPN/10280?type=PGN)";
CM_ BO_ 2566563328  "Source: isobus.net VDMA Data Dictionary (https://www.isobus.net/isobus/pGNAndSPN/10282?type=PGN)";
CM_ BO_ 2566563584  "Source: isobus.net VDMA Data Dictionary (https://www.isobus.net/isobus/pGNAndSPN/10287?type=PGN)";
CM_ BO_ 2566563840  "Source: isobus.net VDMA Data Dictionary (https://www.isobus.net/isobus/pGNAndSPN/10290?type=PGN)";
CM_ BO_ 2566564096  "Source: isobus.net VDMA Data Dictionary (https://www.isobus.net/isobus/pGNAndSPN/10293?type=PGN)";
CM_ BO_ 2566564352  "Source: isobus.net VDMA Data Dictionary (https://www.isobus.net/isobus/pGNAndSPN/10295?type=PGN)";
CM_ BO_ 2566564608  "Source: isobus.net VDMA Data Dictionary (https://www.isobus.net/isobus/pGNAndSPN/10305?type=PGN)";
CM_ BO_ 2566564864  "Source: isobus.net VDMA Data Dictionary (https://www.isobus.net/isobus/pGNAndSPN/10311?type=PGN)";
CM_ BO_ 2566565120  "Source: isobus.net VDMA Data Dictionary (https://www.isobus.net/isobus/pGNAndSPN/10321?type=PGN)";
CM_ SG_ 2566092544 Fuel_Cell_System_Operating_State "Generic 8-byte raw payload. Detail page: https://www.isobus.net/isobus/pGNAndSPN/7748?type=PGN. Signal-level enrichment via PR welcome  see CONTRIBUTING.md.";
CM_ SG_ 2566092800 Fuel_Cell_System_Operations_Requ "Generic 8-byte raw payload. Detail page: https://www.isobus.net/isobus/pGNAndSPN/7751?type=PGN. Signal-level enrichment via PR welcome  see CONTRIBUTING.md.";
CM_ SG_ 2566093056 Fuel_Cell_Stack_Information_RawP "Generic 8-byte raw payload. Detail page: https://www.isobus.net/isobus/pGNAndSPN/7753?type=PGN. Signal-level enrichment via PR welcome  see CONTRIBUTING.md.";
CM_ SG_ 2566093312 Fuel_Cell_System_Coolant_Fan_1_S "Generic 8-byte raw payload. Detail page: https://www.isobus.net/isobus/pGNAndSPN/7758?type=PGN. Signal-level enrichment via PR welcome  see CONTRIBUTING.md.";
CM_ SG_ 2566093568 Fuel_Cell_System_Coolant_Fan_2_S "Generic 8-byte raw payload. Detail page: https://www.isobus.net/isobus/pGNAndSPN/7763?type=PGN. Signal-level enrichment via PR welcome  see CONTRIBUTING.md.";
CM_ SG_ 2566093824 Fuel_Cell_System_Coolant_Fan_3_S "Generic 8-byte raw payload. Detail page: https://www.isobus.net/isobus/pGNAndSPN/7768?type=PGN. Signal-level enrichment via PR welcome  see CONTRIBUTING.md.";
CM_ SG_ 2566094080 Fuel_Cell_System_Coolant_Fan_4_S "Generic 8-byte raw payload. Detail page: https://www.isobus.net/isobus/pGNAndSPN/7773?type=PGN. Signal-level enrichment via PR welcome  see CONTRIBUTING.md.";
CM_ SG_ 2566094336 HVESS_Coolant_Pump_1_Status_2_Ra "Generic 8-byte raw payload. Detail page: https://www.isobus.net/isobus/pGNAndSPN/7778?type=PGN. Signal-level enrichment via PR welcome  see CONTRIBUTING.md.";
CM_ SG_ 2566094592 HVESS_Coolant_Pump_2_Status_2_Ra "Generic 8-byte raw payload. Detail page: https://www.isobus.net/isobus/pGNAndSPN/7783?type=PGN. Signal-level enrichment via PR welcome  see CONTRIBUTING.md.";
CM_ SG_ 2566094848 High_Voltage_Energy_Storage_Syst "Generic 8-byte raw payload. Detail page: https://www.isobus.net/isobus/pGNAndSPN/7789?type=PGN. Signal-level enrichment via PR welcome  see CONTRIBUTING.md.";
CM_ SG_ 2566095104 PTO_Drive_Engagement_2_RawPayloa "Generic 8-byte raw payload. Detail page: https://www.isobus.net/isobus/pGNAndSPN/7795?type=PGN. Signal-level enrichment via PR welcome  see CONTRIBUTING.md.";
CM_ SG_ 2566095360 Fuel_Cell_System_Hydrogen_Pressu "Generic 8-byte raw payload. Detail page: https://www.isobus.net/isobus/pGNAndSPN/7798?type=PGN. Signal-level enrichment via PR welcome  see CONTRIBUTING.md.";
CM_ SG_ 2566095616 Engine_Gas_Flow_Rate_2_RawPayloa "Generic 8-byte raw payload. Detail page: https://www.isobus.net/isobus/pGNAndSPN/7801?type=PGN. Signal-level enrichment via PR welcome  see CONTRIBUTING.md.";
CM_ SG_ 2566095872 Engine_Supercharger_Information_ "Generic 8-byte raw payload. Detail page: https://www.isobus.net/isobus/pGNAndSPN/7807?type=PGN. Signal-level enrichment via PR welcome  see CONTRIBUTING.md.";
CM_ SG_ 2566096128 Engine_Disconnect_Clutch_RawPayl "Generic 8-byte raw payload. Detail page: https://www.isobus.net/isobus/pGNAndSPN/7813?type=PGN. Signal-level enrichment via PR welcome  see CONTRIBUTING.md.";
CM_ SG_ 2566478080 GNSS_Correction_Data_RawPayload "Generic 8-byte raw payload. Detail page: https://www.isobus.net/isobus/pGNAndSPN/7815?type=PGN. Signal-level enrichment via PR welcome  see CONTRIBUTING.md.";
CM_ SG_ 2566478336 Engine_Crankcase_Ventilation_Hea "Generic 8-byte raw payload. Detail page: https://www.isobus.net/isobus/pGNAndSPN/7817?type=PGN. Signal-level enrichment via PR welcome  see CONTRIBUTING.md.";
CM_ SG_ 2566478592 Engine_Crankcase_Ventilation_Hea "Generic 8-byte raw payload. Detail page: https://www.isobus.net/isobus/pGNAndSPN/7821?type=PGN. Signal-level enrichment via PR welcome  see CONTRIBUTING.md.";
CM_ SG_ 2566478848 Engine_Crankcase_Ventilation_Hea "Generic 8-byte raw payload. Detail page: https://www.isobus.net/isobus/pGNAndSPN/7825?type=PGN. Signal-level enrichment via PR welcome  see CONTRIBUTING.md.";
CM_ SG_ 2566479104 Air_Fuel_Ratio_2_RawPayload "Generic 8-byte raw payload. Detail page: https://www.isobus.net/isobus/pGNAndSPN/7827?type=PGN. Signal-level enrichment via PR welcome  see CONTRIBUTING.md.";
CM_ SG_ 2566479360 OBFCM_Engine_Output_Energy_Stati "Generic 8-byte raw payload. Detail page: https://www.isobus.net/isobus/pGNAndSPN/7982?type=PGN. Signal-level enrichment via PR welcome  see CONTRIBUTING.md.";
CM_ SG_ 2566479616 OBFCM_Vehicle_Distance_Static_Da "Generic 8-byte raw payload. Detail page: https://www.isobus.net/isobus/pGNAndSPN/8137?type=PGN. Signal-level enrichment via PR welcome  see CONTRIBUTING.md.";
CM_ SG_ 2566479872 OBFCM_Fuel_2_Static_Data_RawPayl "Generic 8-byte raw payload. Detail page: https://www.isobus.net/isobus/pGNAndSPN/8292?type=PGN. Signal-level enrichment via PR welcome  see CONTRIBUTING.md.";
CM_ SG_ 2566480128 OBFCM_Fuel_1_Static_Data_RawPayl "Generic 8-byte raw payload. Detail page: https://www.isobus.net/isobus/pGNAndSPN/8447?type=PGN. Signal-level enrichment via PR welcome  see CONTRIBUTING.md.";
CM_ SG_ 2566480384 OBFCM_Counters_RawPayload "Generic 8-byte raw payload. Detail page: https://www.isobus.net/isobus/pGNAndSPN/8449?type=PGN. Signal-level enrichment via PR welcome  see CONTRIBUTING.md.";
CM_ SG_ 2566480640 OBFCM_Accumulators_RawPayload "Generic 8-byte raw payload. Detail page: https://www.isobus.net/isobus/pGNAndSPN/8455?type=PGN. Signal-level enrichment via PR welcome  see CONTRIBUTING.md.";
CM_ SG_ 2566480896 OBFCM_Fuel_Consumption_RawPayloa "Generic 8-byte raw payload. Detail page: https://www.isobus.net/isobus/pGNAndSPN/8456?type=PGN. Signal-level enrichment via PR welcome  see CONTRIBUTING.md.";
CM_ SG_ 2566481152 Engine_VVT_System_Data_RawPayloa "Generic 8-byte raw payload. Detail page: https://www.isobus.net/isobus/pGNAndSPN/8460?type=PGN. Signal-level enrichment via PR welcome  see CONTRIBUTING.md.";
CM_ SG_ 2566481408 Maintenance_Information_2_RawPay "Generic 8-byte raw payload. Detail page: https://www.isobus.net/isobus/pGNAndSPN/8461?type=PGN. Signal-level enrichment via PR welcome  see CONTRIBUTING.md.";
CM_ SG_ 2566481664 Alternate_Fuel_7_RawPayload "Generic 8-byte raw payload. Detail page: https://www.isobus.net/isobus/pGNAndSPN/8469?type=PGN. Signal-level enrichment via PR welcome  see CONTRIBUTING.md.";
CM_ SG_ 2566481920 Engine_Catalyst_Diverter_Actuato "Generic 8-byte raw payload. Detail page: https://www.isobus.net/isobus/pGNAndSPN/8471?type=PGN. Signal-level enrichment via PR welcome  see CONTRIBUTING.md.";
CM_ SG_ 2566482176 Electronic_Logging_Device_Hours_ "Generic 8-byte raw payload. Detail page: https://www.isobus.net/isobus/pGNAndSPN/8475?type=PGN. Signal-level enrichment via PR welcome  see CONTRIBUTING.md.";
CM_ SG_ 2566482432 ER_DC_DC_Converter_4_References_ "Generic 8-byte raw payload. Detail page: https://www.isobus.net/isobus/pGNAndSPN/8480?type=PGN. Signal-level enrichment via PR welcome  see CONTRIBUTING.md.";
CM_ SG_ 2566482688 ER_DC_DC_Converter_4_Power_Limit "Generic 8-byte raw payload. Detail page: https://www.isobus.net/isobus/pGNAndSPN/8484?type=PGN. Signal-level enrichment via PR welcome  see CONTRIBUTING.md.";
CM_ SG_ 2566482944 ER_DC_DC_Converter_4_Current_Lim "Generic 8-byte raw payload. Detail page: https://www.isobus.net/isobus/pGNAndSPN/8488?type=PGN. Signal-level enrichment via PR welcome  see CONTRIBUTING.md.";
CM_ SG_ 2566483200 ER_DC_DC_Converter_4_Voltage_Lim "Generic 8-byte raw payload. Detail page: https://www.isobus.net/isobus/pGNAndSPN/8492?type=PGN. Signal-level enrichment via PR welcome  see CONTRIBUTING.md.";
CM_ SG_ 2566483456 ER_DC_DC_Converter_4_Temperature "Generic 8-byte raw payload. Detail page: https://www.isobus.net/isobus/pGNAndSPN/8497?type=PGN. Signal-level enrichment via PR welcome  see CONTRIBUTING.md.";
CM_ SG_ 2566483712 ER_DC_DC_Converter_4_Power_Limit "Generic 8-byte raw payload. Detail page: https://www.isobus.net/isobus/pGNAndSPN/8501?type=PGN. Signal-level enrichment via PR welcome  see CONTRIBUTING.md.";
CM_ SG_ 2566483968 ER_DC_DC_Converter_4_Current_Lim "Generic 8-byte raw payload. Detail page: https://www.isobus.net/isobus/pGNAndSPN/8505?type=PGN. Signal-level enrichment via PR welcome  see CONTRIBUTING.md.";
CM_ SG_ 2566484224 ER_DC_DC_Converter_4_Voltage_Lim "Generic 8-byte raw payload. Detail page: https://www.isobus.net/isobus/pGNAndSPN/8509?type=PGN. Signal-level enrichment via PR welcome  see CONTRIBUTING.md.";
CM_ SG_ 2566484480 ER_DC_DC_Converter_4_Low_Voltage "Generic 8-byte raw payload. Detail page: https://www.isobus.net/isobus/pGNAndSPN/8511?type=PGN. Signal-level enrichment via PR welcome  see CONTRIBUTING.md.";
CM_ SG_ 2566484736 ER_DC_DC_Converter_4_Power_and_C "Generic 8-byte raw payload. Detail page: https://www.isobus.net/isobus/pGNAndSPN/8515?type=PGN. Signal-level enrichment via PR welcome  see CONTRIBUTING.md.";
CM_ SG_ 2566484992 ER_DC_DC_Converter_4_Voltage_and "Generic 8-byte raw payload. Detail page: https://www.isobus.net/isobus/pGNAndSPN/8519?type=PGN. Signal-level enrichment via PR welcome  see CONTRIBUTING.md.";
CM_ SG_ 2566485248 ER_DC_DC_Converter_4_Operating_S "Generic 8-byte raw payload. Detail page: https://www.isobus.net/isobus/pGNAndSPN/8536?type=PGN. Signal-level enrichment via PR welcome  see CONTRIBUTING.md.";
CM_ SG_ 2566485504 ER_DC_DC_Converter_4_Control_Raw "Generic 8-byte raw payload. Detail page: https://www.isobus.net/isobus/pGNAndSPN/8540?type=PGN. Signal-level enrichment via PR welcome  see CONTRIBUTING.md.";
CM_ SG_ 2566485760 ER_DC_DC_Converter_3_References_ "Generic 8-byte raw payload. Detail page: https://www.isobus.net/isobus/pGNAndSPN/8545?type=PGN. Signal-level enrichment via PR welcome  see CONTRIBUTING.md.";
CM_ SG_ 2566486016 ER_DC_DC_Converter_3_Power_Limit "Generic 8-byte raw payload. Detail page: https://www.isobus.net/isobus/pGNAndSPN/8549?type=PGN. Signal-level enrichment via PR welcome  see CONTRIBUTING.md.";
CM_ SG_ 2566486272 ER_DC_DC_Converter_3_Current_Lim "Generic 8-byte raw payload. Detail page: https://www.isobus.net/isobus/pGNAndSPN/8553?type=PGN. Signal-level enrichment via PR welcome  see CONTRIBUTING.md.";
CM_ SG_ 2566486528 ER_DC_DC_Converter_3_Voltage_Lim "Generic 8-byte raw payload. Detail page: https://www.isobus.net/isobus/pGNAndSPN/8557?type=PGN. Signal-level enrichment via PR welcome  see CONTRIBUTING.md.";
CM_ SG_ 2566486784 ER_DC_DC_Converter_3_Temperature "Generic 8-byte raw payload. Detail page: https://www.isobus.net/isobus/pGNAndSPN/8562?type=PGN. Signal-level enrichment via PR welcome  see CONTRIBUTING.md.";
CM_ SG_ 2566487040 ER_DC_DC_Converter_3_Power_Limit "Generic 8-byte raw payload. Detail page: https://www.isobus.net/isobus/pGNAndSPN/8566?type=PGN. Signal-level enrichment via PR welcome  see CONTRIBUTING.md.";
CM_ SG_ 2566487296 ER_DC_DC_Converter_3_Current_Lim "Generic 8-byte raw payload. Detail page: https://www.isobus.net/isobus/pGNAndSPN/8570?type=PGN. Signal-level enrichment via PR welcome  see CONTRIBUTING.md.";
CM_ SG_ 2566487552 ER_DC_DC_Converter_3_Voltage_Lim "Generic 8-byte raw payload. Detail page: https://www.isobus.net/isobus/pGNAndSPN/8574?type=PGN. Signal-level enrichment via PR welcome  see CONTRIBUTING.md.";
CM_ SG_ 2566487808 ER_DC_DC_Converter_3_Low_Voltage "Generic 8-byte raw payload. Detail page: https://www.isobus.net/isobus/pGNAndSPN/8576?type=PGN. Signal-level enrichment via PR welcome  see CONTRIBUTING.md.";
CM_ SG_ 2566488064 ER_DC_DC_Converter_3_Power_and_C "Generic 8-byte raw payload. Detail page: https://www.isobus.net/isobus/pGNAndSPN/8580?type=PGN. Signal-level enrichment via PR welcome  see CONTRIBUTING.md.";
CM_ SG_ 2566488320 ER_DC_DC_Converter_3_Voltage_and "Generic 8-byte raw payload. Detail page: https://www.isobus.net/isobus/pGNAndSPN/8584?type=PGN. Signal-level enrichment via PR welcome  see CONTRIBUTING.md.";
CM_ SG_ 2566488576 ER_DC_DC_Converter_3_Operating_S "Generic 8-byte raw payload. Detail page: https://www.isobus.net/isobus/pGNAndSPN/8601?type=PGN. Signal-level enrichment via PR welcome  see CONTRIBUTING.md.";
CM_ SG_ 2566488832 ER_DC_DC_Converter_3_Control_Raw "Generic 8-byte raw payload. Detail page: https://www.isobus.net/isobus/pGNAndSPN/8605?type=PGN. Signal-level enrichment via PR welcome  see CONTRIBUTING.md.";
CM_ SG_ 2566489088 ER_DC_DC_Converter_2_References_ "Generic 8-byte raw payload. Detail page: https://www.isobus.net/isobus/pGNAndSPN/8610?type=PGN. Signal-level enrichment via PR welcome  see CONTRIBUTING.md.";
CM_ SG_ 2566489344 ER_DC_DC_Converter_2_Power_Limit "Generic 8-byte raw payload. Detail page: https://www.isobus.net/isobus/pGNAndSPN/8614?type=PGN. Signal-level enrichment via PR welcome  see CONTRIBUTING.md.";
CM_ SG_ 2566489600 ER_DC_DC_Converter_2_Current_Lim "Generic 8-byte raw payload. Detail page: https://www.isobus.net/isobus/pGNAndSPN/8618?type=PGN. Signal-level enrichment via PR welcome  see CONTRIBUTING.md.";
CM_ SG_ 2566489856 ER_DC_DC_Converter_2_Voltage_Lim "Generic 8-byte raw payload. Detail page: https://www.isobus.net/isobus/pGNAndSPN/8622?type=PGN. Signal-level enrichment via PR welcome  see CONTRIBUTING.md.";
CM_ SG_ 2566490112 ER_DC_DC_Converter_2_Temperature "Generic 8-byte raw payload. Detail page: https://www.isobus.net/isobus/pGNAndSPN/8627?type=PGN. Signal-level enrichment via PR welcome  see CONTRIBUTING.md.";
CM_ SG_ 2566490368 ER_DC_DC_Converter_2_Power_Limit "Generic 8-byte raw payload. Detail page: https://www.isobus.net/isobus/pGNAndSPN/8631?type=PGN. Signal-level enrichment via PR welcome  see CONTRIBUTING.md.";
CM_ SG_ 2566490624 ER_DC_DC_Converter_2_Current_Lim "Generic 8-byte raw payload. Detail page: https://www.isobus.net/isobus/pGNAndSPN/8635?type=PGN. Signal-level enrichment via PR welcome  see CONTRIBUTING.md.";
CM_ SG_ 2566490880 ER_DC_DC_Converter_2_Voltage_Lim "Generic 8-byte raw payload. Detail page: https://www.isobus.net/isobus/pGNAndSPN/8639?type=PGN. Signal-level enrichment via PR welcome  see CONTRIBUTING.md.";
CM_ SG_ 2566491136 ER_DC_DC_Converter_2_Low_Voltage "Generic 8-byte raw payload. Detail page: https://www.isobus.net/isobus/pGNAndSPN/8641?type=PGN. Signal-level enrichment via PR welcome  see CONTRIBUTING.md.";
CM_ SG_ 2566491392 ER_DC_DC_Converter_2_Power_and_C "Generic 8-byte raw payload. Detail page: https://www.isobus.net/isobus/pGNAndSPN/8645?type=PGN. Signal-level enrichment via PR welcome  see CONTRIBUTING.md.";
CM_ SG_ 2566491648 ER_DC_DC_Converter_2_Voltage_and "Generic 8-byte raw payload. Detail page: https://www.isobus.net/isobus/pGNAndSPN/8649?type=PGN. Signal-level enrichment via PR welcome  see CONTRIBUTING.md.";
CM_ SG_ 2566491904 ER_DC_DC_Converter_2_Operating_S "Generic 8-byte raw payload. Detail page: https://www.isobus.net/isobus/pGNAndSPN/8666?type=PGN. Signal-level enrichment via PR welcome  see CONTRIBUTING.md.";
CM_ SG_ 2566492160 ER_DC_DC_Converter_2_Control_Raw "Generic 8-byte raw payload. Detail page: https://www.isobus.net/isobus/pGNAndSPN/8670?type=PGN. Signal-level enrichment via PR welcome  see CONTRIBUTING.md.";
CM_ SG_ 2566492416 ER_DC_DC_Converter_1_References_ "Generic 8-byte raw payload. Detail page: https://www.isobus.net/isobus/pGNAndSPN/8675?type=PGN. Signal-level enrichment via PR welcome  see CONTRIBUTING.md.";
CM_ SG_ 2566492672 ER_DC_DC_Converter_1_Power_Limit "Generic 8-byte raw payload. Detail page: https://www.isobus.net/isobus/pGNAndSPN/8679?type=PGN. Signal-level enrichment via PR welcome  see CONTRIBUTING.md.";
CM_ SG_ 2566492928 ER_DC_DC_Converter_1_Current_Lim "Generic 8-byte raw payload. Detail page: https://www.isobus.net/isobus/pGNAndSPN/8683?type=PGN. Signal-level enrichment via PR welcome  see CONTRIBUTING.md.";
CM_ SG_ 2566493184 ER_DC_DC_Converter_1_Voltage_Lim "Generic 8-byte raw payload. Detail page: https://www.isobus.net/isobus/pGNAndSPN/8687?type=PGN. Signal-level enrichment via PR welcome  see CONTRIBUTING.md.";
CM_ SG_ 2566493440 ER_DC_DC_Converter_1_Temperature "Generic 8-byte raw payload. Detail page: https://www.isobus.net/isobus/pGNAndSPN/8692?type=PGN. Signal-level enrichment via PR welcome  see CONTRIBUTING.md.";
CM_ SG_ 2566493696 ER_DC_DC_Converter_1_Power_Limit "Generic 8-byte raw payload. Detail page: https://www.isobus.net/isobus/pGNAndSPN/8696?type=PGN. Signal-level enrichment via PR welcome  see CONTRIBUTING.md.";
CM_ SG_ 2566493952 ER_DC_DC_Converter_1_Current_Lim "Generic 8-byte raw payload. Detail page: https://www.isobus.net/isobus/pGNAndSPN/8700?type=PGN. Signal-level enrichment via PR welcome  see CONTRIBUTING.md.";
CM_ SG_ 2566494208 ER_DC_DC_Converter_1_Voltage_Lim "Generic 8-byte raw payload. Detail page: https://www.isobus.net/isobus/pGNAndSPN/8704?type=PGN. Signal-level enrichment via PR welcome  see CONTRIBUTING.md.";
CM_ SG_ 2566494464 ER_DC_DC_Converter_1_Low_Voltage "Generic 8-byte raw payload. Detail page: https://www.isobus.net/isobus/pGNAndSPN/8706?type=PGN. Signal-level enrichment via PR welcome  see CONTRIBUTING.md.";
CM_ SG_ 2566494720 ER_DC_DC_Converter_1_Power_and_C "Generic 8-byte raw payload. Detail page: https://www.isobus.net/isobus/pGNAndSPN/8710?type=PGN. Signal-level enrichment via PR welcome  see CONTRIBUTING.md.";
CM_ SG_ 2566494976 ER_DC_DC_Converter_1_Voltage_and "Generic 8-byte raw payload. Detail page: https://www.isobus.net/isobus/pGNAndSPN/8714?type=PGN. Signal-level enrichment via PR welcome  see CONTRIBUTING.md.";
CM_ SG_ 2566495232 ER_DC_DC_Converter_1_Operating_S "Generic 8-byte raw payload. Detail page: https://www.isobus.net/isobus/pGNAndSPN/8731?type=PGN. Signal-level enrichment via PR welcome  see CONTRIBUTING.md.";
CM_ SG_ 2566495488 ER_DC_DC_Converter_1_Control_Raw "Generic 8-byte raw payload. Detail page: https://www.isobus.net/isobus/pGNAndSPN/8735?type=PGN. Signal-level enrichment via PR welcome  see CONTRIBUTING.md.";
CM_ SG_ 2566495744 Cab_Air_Quality_System_Informati "Generic 8-byte raw payload. Detail page: https://www.isobus.net/isobus/pGNAndSPN/8739?type=PGN. Signal-level enrichment via PR welcome  see CONTRIBUTING.md.";
CM_ SG_ 2566496000 Cab_Air_Quality_System_Informati "Generic 8-byte raw payload. Detail page: https://www.isobus.net/isobus/pGNAndSPN/8745?type=PGN. Signal-level enrichment via PR welcome  see CONTRIBUTING.md.";
CM_ SG_ 2566496256 Well_Stimulation_Pump_System_6_R "Generic 8-byte raw payload. Detail page: https://www.isobus.net/isobus/pGNAndSPN/8749?type=PGN. Signal-level enrichment via PR welcome  see CONTRIBUTING.md.";
CM_ SG_ 2566496512 Engine_Fuel_Lube_Systems_4_RawPa "Generic 8-byte raw payload. Detail page: https://www.isobus.net/isobus/pGNAndSPN/8755?type=PGN. Signal-level enrichment via PR welcome  see CONTRIBUTING.md.";
CM_ SG_ 2566496768 Alternate_Fuel_6_RawPayload "Generic 8-byte raw payload. Detail page: https://www.isobus.net/isobus/pGNAndSPN/8760?type=PGN. Signal-level enrichment via PR welcome  see CONTRIBUTING.md.";
CM_ SG_ 2566497024 Engine_Catalyst_Diverter_Actuato "Generic 8-byte raw payload. Detail page: https://www.isobus.net/isobus/pGNAndSPN/8763?type=PGN. Signal-level enrichment via PR welcome  see CONTRIBUTING.md.";
CM_ SG_ 2566497280 Ambient_Conditions_4_RawPayload "Generic 8-byte raw payload. Detail page: https://www.isobus.net/isobus/pGNAndSPN/8767?type=PGN. Signal-level enrichment via PR welcome  see CONTRIBUTING.md.";
CM_ SG_ 2566497536 Engine_Exhaust_Particulate_Contr "Generic 8-byte raw payload. Detail page: https://www.isobus.net/isobus/pGNAndSPN/8769?type=PGN. Signal-level enrichment via PR welcome  see CONTRIBUTING.md.";
CM_ SG_ 2566497792 Engine_Exhaust_Particulate_Contr "Generic 8-byte raw payload. Detail page: https://www.isobus.net/isobus/pGNAndSPN/8771?type=PGN. Signal-level enrichment via PR welcome  see CONTRIBUTING.md.";
CM_ SG_ 2566498048 Aftertreatment_System_Informatio "Generic 8-byte raw payload. Detail page: https://www.isobus.net/isobus/pGNAndSPN/8773?type=PGN. Signal-level enrichment via PR welcome  see CONTRIBUTING.md.";
CM_ SG_ 2566498304 Aftertreatment_System_Informatio "Generic 8-byte raw payload. Detail page: https://www.isobus.net/isobus/pGNAndSPN/8775?type=PGN. Signal-level enrichment via PR welcome  see CONTRIBUTING.md.";
CM_ SG_ 2566498560 Aftertreatment_System_Informatio "Generic 8-byte raw payload. Detail page: https://www.isobus.net/isobus/pGNAndSPN/8777?type=PGN. Signal-level enrichment via PR welcome  see CONTRIBUTING.md.";
CM_ SG_ 2566498816 Aftertreatment_System_Informatio "Generic 8-byte raw payload. Detail page: https://www.isobus.net/isobus/pGNAndSPN/8779?type=PGN. Signal-level enrichment via PR welcome  see CONTRIBUTING.md.";
CM_ SG_ 2566499072 Aftertreatment_System_Informatio "Generic 8-byte raw payload. Detail page: https://www.isobus.net/isobus/pGNAndSPN/8781?type=PGN. Signal-level enrichment via PR welcome  see CONTRIBUTING.md.";
CM_ SG_ 2566499328 Aftertreatment_System_Informatio "Generic 8-byte raw payload. Detail page: https://www.isobus.net/isobus/pGNAndSPN/8783?type=PGN. Signal-level enrichment via PR welcome  see CONTRIBUTING.md.";
CM_ SG_ 2566499584 Aftertreatment_System_Informatio "Generic 8-byte raw payload. Detail page: https://www.isobus.net/isobus/pGNAndSPN/8785?type=PGN. Signal-level enrichment via PR welcome  see CONTRIBUTING.md.";
CM_ SG_ 2566499840 Aftertreatment_System_Informatio "Generic 8-byte raw payload. Detail page: https://www.isobus.net/isobus/pGNAndSPN/8787?type=PGN. Signal-level enrichment via PR welcome  see CONTRIBUTING.md.";
CM_ SG_ 2566500096 Aftertreatment_System_Informatio "Generic 8-byte raw payload. Detail page: https://www.isobus.net/isobus/pGNAndSPN/8789?type=PGN. Signal-level enrichment via PR welcome  see CONTRIBUTING.md.";
CM_ SG_ 2566500352 Aftertreatment_System_Informatio "Generic 8-byte raw payload. Detail page: https://www.isobus.net/isobus/pGNAndSPN/8791?type=PGN. Signal-level enrichment via PR welcome  see CONTRIBUTING.md.";
CM_ SG_ 2566500608 Aftertreatment_System_Informatio "Generic 8-byte raw payload. Detail page: https://www.isobus.net/isobus/pGNAndSPN/8793?type=PGN. Signal-level enrichment via PR welcome  see CONTRIBUTING.md.";
CM_ SG_ 2566500864 Aftertreatment_System_Informatio "Generic 8-byte raw payload. Detail page: https://www.isobus.net/isobus/pGNAndSPN/8795?type=PGN. Signal-level enrichment via PR welcome  see CONTRIBUTING.md.";
CM_ SG_ 2566501120 Route_Attributes_Profile_RawPayl "Generic 8-byte raw payload. Detail page: https://www.isobus.net/isobus/pGNAndSPN/8805?type=PGN. Signal-level enrichment via PR welcome  see CONTRIBUTING.md.";
CM_ SG_ 2566501376 Genset_Supporting_Functions_2_Ra "Generic 8-byte raw payload. Detail page: https://www.isobus.net/isobus/pGNAndSPN/8806?type=PGN. Signal-level enrichment via PR welcome  see CONTRIBUTING.md.";
CM_ SG_ 2566501632 Alternator_Information_2_RawPayl "Generic 8-byte raw payload. Detail page: https://www.isobus.net/isobus/pGNAndSPN/8811?type=PGN. Signal-level enrichment via PR welcome  see CONTRIBUTING.md.";
CM_ SG_ 2566501888 Well_Stimulation_Pump_System_5_R "Generic 8-byte raw payload. Detail page: https://www.isobus.net/isobus/pGNAndSPN/8815?type=PGN. Signal-level enrichment via PR welcome  see CONTRIBUTING.md.";
CM_ SG_ 2566502144 Well_Stimulation_Pump_System_4_R "Generic 8-byte raw payload. Detail page: https://www.isobus.net/isobus/pGNAndSPN/8818?type=PGN. Signal-level enrichment via PR welcome  see CONTRIBUTING.md.";
CM_ SG_ 2566502400 Tire_Information_RawPayload "Generic 8-byte raw payload. Detail page: https://www.isobus.net/isobus/pGNAndSPN/8819?type=PGN. Signal-level enrichment via PR welcome  see CONTRIBUTING.md.";
CM_ SG_ 2566502656 Hydrogen_System_Status_RawPayloa "Generic 8-byte raw payload. Detail page: https://www.isobus.net/isobus/pGNAndSPN/8821?type=PGN. Signal-level enrichment via PR welcome  see CONTRIBUTING.md.";
CM_ SG_ 2566502912 Route_Waypoint_GPS_Coordinates_R "Generic 8-byte raw payload. Detail page: https://www.isobus.net/isobus/pGNAndSPN/8824?type=PGN. Signal-level enrichment via PR welcome  see CONTRIBUTING.md.";
CM_ SG_ 2566503168 Route_Information_RawPayload "Generic 8-byte raw payload. Detail page: https://www.isobus.net/isobus/pGNAndSPN/8828?type=PGN. Signal-level enrichment via PR welcome  see CONTRIBUTING.md.";
CM_ SG_ 2566503424 Engine_Fluid_Level_Pressure_15_R "Generic 8-byte raw payload. Detail page: https://www.isobus.net/isobus/pGNAndSPN/8830?type=PGN. Signal-level enrichment via PR welcome  see CONTRIBUTING.md.";
CM_ SG_ 2566503680 Fuel_Cell_System_Coolant_Informa "Generic 8-byte raw payload. Detail page: https://www.isobus.net/isobus/pGNAndSPN/8832?type=PGN. Signal-level enrichment via PR welcome  see CONTRIBUTING.md.";
CM_ SG_ 2566503936 Transmission_Configuration_3_Raw "Generic 8-byte raw payload. Detail page: https://www.isobus.net/isobus/pGNAndSPN/8852?type=PGN. Signal-level enrichment via PR welcome  see CONTRIBUTING.md.";
CM_ SG_ 2566504192 Enrichment_Information_RawPayloa "Generic 8-byte raw payload. Detail page: https://www.isobus.net/isobus/pGNAndSPN/8860?type=PGN. Signal-level enrichment via PR welcome  see CONTRIBUTING.md.";
CM_ SG_ 2566504448 Fuel_Cell_System_Voltage_Limit_C "Generic 8-byte raw payload. Detail page: https://www.isobus.net/isobus/pGNAndSPN/8865?type=PGN. Signal-level enrichment via PR welcome  see CONTRIBUTING.md.";
CM_ SG_ 2566504960 Hydrogen_System_Information_RawP "Generic 8-byte raw payload. Detail page: https://www.isobus.net/isobus/pGNAndSPN/8867?type=PGN. Signal-level enrichment via PR welcome  see CONTRIBUTING.md.";
CM_ SG_ 2566505216 Auxiliary_Input_Output_Status_17 "Generic 8-byte raw payload. Detail page: https://www.isobus.net/isobus/pGNAndSPN/8871?type=PGN. Signal-level enrichment via PR welcome  see CONTRIBUTING.md.";
CM_ SG_ 2566505472 Auxiliary_Input_Output_Status_16 "Generic 8-byte raw payload. Detail page: https://www.isobus.net/isobus/pGNAndSPN/8875?type=PGN. Signal-level enrichment via PR welcome  see CONTRIBUTING.md.";
CM_ SG_ 2566505728 Auxiliary_Input_Output_Status_15 "Generic 8-byte raw payload. Detail page: https://www.isobus.net/isobus/pGNAndSPN/8879?type=PGN. Signal-level enrichment via PR welcome  see CONTRIBUTING.md.";
CM_ SG_ 2566505984 Auxiliary_Input_Output_Status_14 "Generic 8-byte raw payload. Detail page: https://www.isobus.net/isobus/pGNAndSPN/8883?type=PGN. Signal-level enrichment via PR welcome  see CONTRIBUTING.md.";
CM_ SG_ 2566506240 Auxiliary_Input_Output_Status_13 "Generic 8-byte raw payload. Detail page: https://www.isobus.net/isobus/pGNAndSPN/8887?type=PGN. Signal-level enrichment via PR welcome  see CONTRIBUTING.md.";
CM_ SG_ 2566506496 Auxiliary_Input_Output_Status_12 "Generic 8-byte raw payload. Detail page: https://www.isobus.net/isobus/pGNAndSPN/8891?type=PGN. Signal-level enrichment via PR welcome  see CONTRIBUTING.md.";
CM_ SG_ 2566506752 Auxiliary_Input_Output_Status_11 "Generic 8-byte raw payload. Detail page: https://www.isobus.net/isobus/pGNAndSPN/8895?type=PGN. Signal-level enrichment via PR welcome  see CONTRIBUTING.md.";
CM_ SG_ 2566507008 Auxiliary_Input_Output_Status_10 "Generic 8-byte raw payload. Detail page: https://www.isobus.net/isobus/pGNAndSPN/8899?type=PGN. Signal-level enrichment via PR welcome  see CONTRIBUTING.md.";
CM_ SG_ 2566507264 Auxiliary_Input_Output_Status_9_ "Generic 8-byte raw payload. Detail page: https://www.isobus.net/isobus/pGNAndSPN/8903?type=PGN. Signal-level enrichment via PR welcome  see CONTRIBUTING.md.";
CM_ SG_ 2566507520 Auxiliary_Input_Output_Status_8_ "Generic 8-byte raw payload. Detail page: https://www.isobus.net/isobus/pGNAndSPN/8907?type=PGN. Signal-level enrichment via PR welcome  see CONTRIBUTING.md.";
CM_ SG_ 2566507776 Aftertreatment_System_Informatio "Generic 8-byte raw payload. Detail page: https://www.isobus.net/isobus/pGNAndSPN/8909?type=PGN. Signal-level enrichment via PR welcome  see CONTRIBUTING.md.";
CM_ SG_ 2566508032 Brake_Temperature_6_RawPayload "Generic 8-byte raw payload. Detail page: https://www.isobus.net/isobus/pGNAndSPN/8911?type=PGN. Signal-level enrichment via PR welcome  see CONTRIBUTING.md.";
CM_ SG_ 2566508288 Brake_Temperature_5_RawPayload "Generic 8-byte raw payload. Detail page: https://www.isobus.net/isobus/pGNAndSPN/8915?type=PGN. Signal-level enrichment via PR welcome  see CONTRIBUTING.md.";
CM_ SG_ 2566508544 Brake_Temperature_4_RawPayload "Generic 8-byte raw payload. Detail page: https://www.isobus.net/isobus/pGNAndSPN/8919?type=PGN. Signal-level enrichment via PR welcome  see CONTRIBUTING.md.";
CM_ SG_ 2566508800 Brake_Temperature_3_RawPayload "Generic 8-byte raw payload. Detail page: https://www.isobus.net/isobus/pGNAndSPN/8923?type=PGN. Signal-level enrichment via PR welcome  see CONTRIBUTING.md.";
CM_ SG_ 2566509056 Brake_Temperature_2_RawPayload "Generic 8-byte raw payload. Detail page: https://www.isobus.net/isobus/pGNAndSPN/8927?type=PGN. Signal-level enrichment via PR welcome  see CONTRIBUTING.md.";
CM_ SG_ 2566509312 Brake_Temperature_1_RawPayload "Generic 8-byte raw payload. Detail page: https://www.isobus.net/isobus/pGNAndSPN/8931?type=PGN. Signal-level enrichment via PR welcome  see CONTRIBUTING.md.";
CM_ SG_ 2566509568 Wheel_Brake_Lining_Remaining_Inf "Generic 8-byte raw payload. Detail page: https://www.isobus.net/isobus/pGNAndSPN/8937?type=PGN. Signal-level enrichment via PR welcome  see CONTRIBUTING.md.";
CM_ SG_ 2566509824 Wheel_Brake_Lining_Remaining_Inf "Generic 8-byte raw payload. Detail page: https://www.isobus.net/isobus/pGNAndSPN/8945?type=PGN. Signal-level enrichment via PR welcome  see CONTRIBUTING.md.";
CM_ SG_ 2566510080 High_Voltage_Bus_Contactor_Statu "Generic 8-byte raw payload. Detail page: https://www.isobus.net/isobus/pGNAndSPN/8964?type=PGN. Signal-level enrichment via PR welcome  see CONTRIBUTING.md.";
CM_ SG_ 2566510336 High_Voltage_Bus_Contactor_Statu "Generic 8-byte raw payload. Detail page: https://www.isobus.net/isobus/pGNAndSPN/8991?type=PGN. Signal-level enrichment via PR welcome  see CONTRIBUTING.md.";
CM_ SG_ 2566510592 High_Voltage_Bus_Connection_Comm "Generic 8-byte raw payload. Detail page: https://www.isobus.net/isobus/pGNAndSPN/9002?type=PGN. Signal-level enrichment via PR welcome  see CONTRIBUTING.md.";
CM_ SG_ 2566510848 Cab_Illumination_Data_RawPayload "Generic 8-byte raw payload. Detail page: https://www.isobus.net/isobus/pGNAndSPN/9004?type=PGN. Signal-level enrichment via PR welcome  see CONTRIBUTING.md.";
CM_ SG_ 2566511104 Service_Needed_DTC_Information_R "Generic 8-byte raw payload. Detail page: https://www.isobus.net/isobus/pGNAndSPN/9008?type=PGN. Signal-level enrichment via PR welcome  see CONTRIBUTING.md.";
CM_ SG_ 2566511360 EVSE_Status_2_RawPayload "Generic 8-byte raw payload. Detail page: https://www.isobus.net/isobus/pGNAndSPN/9012?type=PGN. Signal-level enrichment via PR welcome  see CONTRIBUTING.md.";
CM_ SG_ 2566511616 High_Voltage_Energy_Storage_Syst "Generic 8-byte raw payload. Detail page: https://www.isobus.net/isobus/pGNAndSPN/9016?type=PGN. Signal-level enrichment via PR welcome  see CONTRIBUTING.md.";
CM_ SG_ 2566511872 High_Voltage_Energy_Storage_Syst "Generic 8-byte raw payload. Detail page: https://www.isobus.net/isobus/pGNAndSPN/9020?type=PGN. Signal-level enrichment via PR welcome  see CONTRIBUTING.md.";
CM_ SG_ 2566512128 High_Voltage_Energy_Storage_Syst "Generic 8-byte raw payload. Detail page: https://www.isobus.net/isobus/pGNAndSPN/9024?type=PGN. Signal-level enrichment via PR welcome  see CONTRIBUTING.md.";
CM_ SG_ 2566512384 HVESS_Coolant_Pump_1_Status_1_Ra "Generic 8-byte raw payload. Detail page: https://www.isobus.net/isobus/pGNAndSPN/9032?type=PGN. Signal-level enrichment via PR welcome  see CONTRIBUTING.md.";
CM_ SG_ 2566512640 HVESS_Coolant_Pump_1_Command_Raw "Generic 8-byte raw payload. Detail page: https://www.isobus.net/isobus/pGNAndSPN/9039?type=PGN. Signal-level enrichment via PR welcome  see CONTRIBUTING.md.";
CM_ SG_ 2566512896 HVESS_Coolant_Pump_2_Status_1_Ra "Generic 8-byte raw payload. Detail page: https://www.isobus.net/isobus/pGNAndSPN/9047?type=PGN. Signal-level enrichment via PR welcome  see CONTRIBUTING.md.";
CM_ SG_ 2566513152 HVESS_Coolant_Pump_2_Command_Raw "Generic 8-byte raw payload. Detail page: https://www.isobus.net/isobus/pGNAndSPN/9054?type=PGN. Signal-level enrichment via PR welcome  see CONTRIBUTING.md.";
CM_ SG_ 2566513408 Hydrogen_Sensor_Information_RawP "Generic 8-byte raw payload. Detail page: https://www.isobus.net/isobus/pGNAndSPN/9058?type=PGN. Signal-level enrichment via PR welcome  see CONTRIBUTING.md.";
CM_ SG_ 2566513664 Operator_Inducement_Information_ "Generic 8-byte raw payload. Detail page: https://www.isobus.net/isobus/pGNAndSPN/9061?type=PGN. Signal-level enrichment via PR welcome  see CONTRIBUTING.md.";
CM_ SG_ 2566513920 Operator_Inducement_Vehicle_Spee "Generic 8-byte raw payload. Detail page: https://www.isobus.net/isobus/pGNAndSPN/9064?type=PGN. Signal-level enrichment via PR welcome  see CONTRIBUTING.md.";
CM_ SG_ 2566514176 Operator_Inducement_Vehicle_Spee "Generic 8-byte raw payload. Detail page: https://www.isobus.net/isobus/pGNAndSPN/9067?type=PGN. Signal-level enrichment via PR welcome  see CONTRIBUTING.md.";
CM_ SG_ 2566514432 Engine_Protection_Speed_Derate_I "Generic 8-byte raw payload. Detail page: https://www.isobus.net/isobus/pGNAndSPN/9073?type=PGN. Signal-level enrichment via PR welcome  see CONTRIBUTING.md.";
CM_ SG_ 2566514688 Engine_Protection_Torque_Derate_ "Generic 8-byte raw payload. Detail page: https://www.isobus.net/isobus/pGNAndSPN/9080?type=PGN. Signal-level enrichment via PR welcome  see CONTRIBUTING.md.";
CM_ SG_ 2566514944 Aftertreatment_System_Informatio "Generic 8-byte raw payload. Detail page: https://www.isobus.net/isobus/pGNAndSPN/9082?type=PGN. Signal-level enrichment via PR welcome  see CONTRIBUTING.md.";
CM_ SG_ 2566515200 SAE_J2012_3_Byte_DTC_Display_Raw "Generic 8-byte raw payload. Detail page: https://www.isobus.net/isobus/pGNAndSPN/9088?type=PGN. Signal-level enrichment via PR welcome  see CONTRIBUTING.md.";
CM_ SG_ 2566515456 High_Voltage_Energy_Storage_Syst "Generic 8-byte raw payload. Detail page: https://www.isobus.net/isobus/pGNAndSPN/9098?type=PGN. Signal-level enrichment via PR welcome  see CONTRIBUTING.md.";
CM_ SG_ 2566515712 High_Voltage_Energy_Storage_Syst "Generic 8-byte raw payload. Detail page: https://www.isobus.net/isobus/pGNAndSPN/9108?type=PGN. Signal-level enrichment via PR welcome  see CONTRIBUTING.md.";
CM_ SG_ 2566515968 High_Voltage_Energy_Storage_Syst "Generic 8-byte raw payload. Detail page: https://www.isobus.net/isobus/pGNAndSPN/9109?type=PGN. Signal-level enrichment via PR welcome  see CONTRIBUTING.md.";
CM_ SG_ 2566516224 Engine_Cylinder_Average_Ignition "Generic 8-byte raw payload. Detail page: https://www.isobus.net/isobus/pGNAndSPN/9113?type=PGN. Signal-level enrichment via PR welcome  see CONTRIBUTING.md.";
CM_ SG_ 2566516480 Engine_Cylinder_Average_Ignition "Generic 8-byte raw payload. Detail page: https://www.isobus.net/isobus/pGNAndSPN/9117?type=PGN. Signal-level enrichment via PR welcome  see CONTRIBUTING.md.";
CM_ SG_ 2566516736 Engine_Cylinder_Average_Ignition "Generic 8-byte raw payload. Detail page: https://www.isobus.net/isobus/pGNAndSPN/9121?type=PGN. Signal-level enrichment via PR welcome  see CONTRIBUTING.md.";
CM_ SG_ 2566516992 Engine_Cylinder_Average_Ignition "Generic 8-byte raw payload. Detail page: https://www.isobus.net/isobus/pGNAndSPN/9125?type=PGN. Signal-level enrichment via PR welcome  see CONTRIBUTING.md.";
CM_ SG_ 2566517248 Engine_Cylinder_Average_Ignition "Generic 8-byte raw payload. Detail page: https://www.isobus.net/isobus/pGNAndSPN/9129?type=PGN. Signal-level enrichment via PR welcome  see CONTRIBUTING.md.";
CM_ SG_ 2566517504 Engine_Indicated_Mean_Effective_ "Generic 8-byte raw payload. Detail page: https://www.isobus.net/isobus/pGNAndSPN/9137?type=PGN. Signal-level enrichment via PR welcome  see CONTRIBUTING.md.";
CM_ SG_ 2566517760 Engine_Indicated_Mean_Effective_ "Generic 8-byte raw payload. Detail page: https://www.isobus.net/isobus/pGNAndSPN/9145?type=PGN. Signal-level enrichment via PR welcome  see CONTRIBUTING.md.";
CM_ SG_ 2566518016 Engine_Indicated_Mean_Effective_ "Generic 8-byte raw payload. Detail page: https://www.isobus.net/isobus/pGNAndSPN/9153?type=PGN. Signal-level enrichment via PR welcome  see CONTRIBUTING.md.";
CM_ SG_ 2566518272 Fuel_Cell_System_Coolant_Fan_1_C "Generic 8-byte raw payload. Detail page: https://www.isobus.net/isobus/pGNAndSPN/9160?type=PGN. Signal-level enrichment via PR welcome  see CONTRIBUTING.md.";
CM_ SG_ 2566518528 Fuel_Cell_System_Coolant_Fan_1_S "Generic 8-byte raw payload. Detail page: https://www.isobus.net/isobus/pGNAndSPN/9168?type=PGN. Signal-level enrichment via PR welcome  see CONTRIBUTING.md.";
CM_ SG_ 2566518784 Fuel_Cell_System_Coolant_Fan_2_C "Generic 8-byte raw payload. Detail page: https://www.isobus.net/isobus/pGNAndSPN/9175?type=PGN. Signal-level enrichment via PR welcome  see CONTRIBUTING.md.";
CM_ SG_ 2566519040 Fuel_Cell_System_Coolant_Fan_2_S "Generic 8-byte raw payload. Detail page: https://www.isobus.net/isobus/pGNAndSPN/9183?type=PGN. Signal-level enrichment via PR welcome  see CONTRIBUTING.md.";
CM_ SG_ 2566519296 Fuel_Cell_System_Coolant_Fan_3_C "Generic 8-byte raw payload. Detail page: https://www.isobus.net/isobus/pGNAndSPN/9190?type=PGN. Signal-level enrichment via PR welcome  see CONTRIBUTING.md.";
CM_ SG_ 2566519552 Fuel_Cell_System_Coolant_Fan_3_S "Generic 8-byte raw payload. Detail page: https://www.isobus.net/isobus/pGNAndSPN/9198?type=PGN. Signal-level enrichment via PR welcome  see CONTRIBUTING.md.";
CM_ SG_ 2566519808 Fuel_Cell_System_Coolant_Fan_4_C "Generic 8-byte raw payload. Detail page: https://www.isobus.net/isobus/pGNAndSPN/9205?type=PGN. Signal-level enrichment via PR welcome  see CONTRIBUTING.md.";
CM_ SG_ 2566520064 Fuel_Cell_System_Coolant_Fan_4_S "Generic 8-byte raw payload. Detail page: https://www.isobus.net/isobus/pGNAndSPN/9213?type=PGN. Signal-level enrichment via PR welcome  see CONTRIBUTING.md.";
CM_ SG_ 2566520320 APIs_Supported_RawPayload "Generic 8-byte raw payload. Detail page: https://www.isobus.net/isobus/pGNAndSPN/9222?type=PGN. Signal-level enrichment via PR welcome  see CONTRIBUTING.md.";
CM_ SG_ 2566520576 Fuel_Cell_System_Configuration_R "Generic 8-byte raw payload. Detail page: https://www.isobus.net/isobus/pGNAndSPN/9227?type=PGN. Signal-level enrichment via PR welcome  see CONTRIBUTING.md.";
CM_ SG_ 2566520832 Fuel_Cell_System_Coolant_Informa "Generic 8-byte raw payload. Detail page: https://www.isobus.net/isobus/pGNAndSPN/9231?type=PGN. Signal-level enrichment via PR welcome  see CONTRIBUTING.md.";
CM_ SG_ 2566521088 Fuel_Cell_System_Coolant_Informa "Generic 8-byte raw payload. Detail page: https://www.isobus.net/isobus/pGNAndSPN/9236?type=PGN. Signal-level enrichment via PR welcome  see CONTRIBUTING.md.";
CM_ SG_ 2566522368 Dash_Display_3_RawPayload "Generic 8-byte raw payload. Detail page: https://www.isobus.net/isobus/pGNAndSPN/9238?type=PGN. Signal-level enrichment via PR welcome  see CONTRIBUTING.md.";
CM_ SG_ 2566522624 Vehicle_Speed_Profile_RawPayload "Generic 8-byte raw payload. Detail page: https://www.isobus.net/isobus/pGNAndSPN/9241?type=PGN. Signal-level enrichment via PR welcome  see CONTRIBUTING.md.";
CM_ SG_ 2566522880 Reference_Time_RawPayload "Generic 8-byte raw payload. Detail page: https://www.isobus.net/isobus/pGNAndSPN/9245?type=PGN. Signal-level enrichment via PR welcome  see CONTRIBUTING.md.";
CM_ SG_ 2566523136 Software_History_RawPayload "Generic 8-byte raw payload. Detail page: https://www.isobus.net/isobus/pGNAndSPN/9246?type=PGN. Signal-level enrichment via PR welcome  see CONTRIBUTING.md.";
CM_ SG_ 2566523392 Motor_Generator_1_Thermal_Perfor "Generic 8-byte raw payload. Detail page: https://www.isobus.net/isobus/pGNAndSPN/9248?type=PGN. Signal-level enrichment via PR welcome  see CONTRIBUTING.md.";
CM_ SG_ 2566523648 Motor_Generator_2_Thermal_Perfor "Generic 8-byte raw payload. Detail page: https://www.isobus.net/isobus/pGNAndSPN/9250?type=PGN. Signal-level enrichment via PR welcome  see CONTRIBUTING.md.";
CM_ SG_ 2566523904 Motor_Generator_3_Thermal_Perfor "Generic 8-byte raw payload. Detail page: https://www.isobus.net/isobus/pGNAndSPN/9252?type=PGN. Signal-level enrichment via PR welcome  see CONTRIBUTING.md.";
CM_ SG_ 2566524160 Motor_Generator_4_Thermal_Perfor "Generic 8-byte raw payload. Detail page: https://www.isobus.net/isobus/pGNAndSPN/9254?type=PGN. Signal-level enrichment via PR welcome  see CONTRIBUTING.md.";
CM_ SG_ 2566524416 Motor_Generator_5_Thermal_Perfor "Generic 8-byte raw payload. Detail page: https://www.isobus.net/isobus/pGNAndSPN/9256?type=PGN. Signal-level enrichment via PR welcome  see CONTRIBUTING.md.";
CM_ SG_ 2566524672 Motor_Generator_6_Thermal_Perfor "Generic 8-byte raw payload. Detail page: https://www.isobus.net/isobus/pGNAndSPN/9258?type=PGN. Signal-level enrichment via PR welcome  see CONTRIBUTING.md.";
CM_ SG_ 2566524928 On_Board_Programming_Event_Time_ "Generic 8-byte raw payload. Detail page: https://www.isobus.net/isobus/pGNAndSPN/9266?type=PGN. Signal-level enrichment via PR welcome  see CONTRIBUTING.md.";
CM_ SG_ 2566525184 Aftertreatment_1_Light_Off_SCR_S "Generic 8-byte raw payload. Detail page: https://www.isobus.net/isobus/pGNAndSPN/9268?type=PGN. Signal-level enrichment via PR welcome  see CONTRIBUTING.md.";
CM_ SG_ 2566525440 Motor_Generator_Location_Extende "Generic 8-byte raw payload. Detail page: https://www.isobus.net/isobus/pGNAndSPN/9276?type=PGN. Signal-level enrichment via PR welcome  see CONTRIBUTING.md.";
CM_ SG_ 2566525696 Cold_Start_Emissions_Reduction_S "Generic 8-byte raw payload. Detail page: https://www.isobus.net/isobus/pGNAndSPN/9286?type=PGN. Signal-level enrichment via PR welcome  see CONTRIBUTING.md.";
CM_ SG_ 2566525952 Cold_Start_Emissions_Reduction_S "Generic 8-byte raw payload. Detail page: https://www.isobus.net/isobus/pGNAndSPN/9296?type=PGN. Signal-level enrichment via PR welcome  see CONTRIBUTING.md.";
CM_ SG_ 2566526208 Genset_Supporting_Functions_RawP "Generic 8-byte raw payload. Detail page: https://www.isobus.net/isobus/pGNAndSPN/9300?type=PGN. Signal-level enrichment via PR welcome  see CONTRIBUTING.md.";
CM_ SG_ 2566526464 High_Voltage_Energy_Storage_Syst "Generic 8-byte raw payload. Detail page: https://www.isobus.net/isobus/pGNAndSPN/9304?type=PGN. Signal-level enrichment via PR welcome  see CONTRIBUTING.md.";
CM_ SG_ 2566526720 High_Voltage_Energy_Storage_Syst "Generic 8-byte raw payload. Detail page: https://www.isobus.net/isobus/pGNAndSPN/9308?type=PGN. Signal-level enrichment via PR welcome  see CONTRIBUTING.md.";
CM_ SG_ 2566526976 High_Voltage_Energy_Storage_Syst "Generic 8-byte raw payload. Detail page: https://www.isobus.net/isobus/pGNAndSPN/9312?type=PGN. Signal-level enrichment via PR welcome  see CONTRIBUTING.md.";
CM_ SG_ 2566527232 High_Voltage_Energy_Storage_Syst "Generic 8-byte raw payload. Detail page: https://www.isobus.net/isobus/pGNAndSPN/9316?type=PGN. Signal-level enrichment via PR welcome  see CONTRIBUTING.md.";
CM_ SG_ 2566527488 Electronic_Engine_Controller_23_ "Generic 8-byte raw payload. Detail page: https://www.isobus.net/isobus/pGNAndSPN/9318?type=PGN. Signal-level enrichment via PR welcome  see CONTRIBUTING.md.";
CM_ SG_ 2566527744 Electronic_Engine_Controller_24_ "Generic 8-byte raw payload. Detail page: https://www.isobus.net/isobus/pGNAndSPN/9324?type=PGN. Signal-level enrichment via PR welcome  see CONTRIBUTING.md.";
CM_ SG_ 2566528000 Electronic_Engine_Controller_25_ "Generic 8-byte raw payload. Detail page: https://www.isobus.net/isobus/pGNAndSPN/9330?type=PGN. Signal-level enrichment via PR welcome  see CONTRIBUTING.md.";
CM_ SG_ 2566528256 High_Voltage_Bus_Connection_Comm "Generic 8-byte raw payload. Detail page: https://www.isobus.net/isobus/pGNAndSPN/9357?type=PGN. Signal-level enrichment via PR welcome  see CONTRIBUTING.md.";
CM_ SG_ 2566528512 High_Voltage_Bus_Contactor_Statu "Generic 8-byte raw payload. Detail page: https://www.isobus.net/isobus/pGNAndSPN/9384?type=PGN. Signal-level enrichment via PR welcome  see CONTRIBUTING.md.";
CM_ SG_ 2566528768 Aftertreatment_System_Informatio "Generic 8-byte raw payload. Detail page: https://www.isobus.net/isobus/pGNAndSPN/9385?type=PGN. Signal-level enrichment via PR welcome  see CONTRIBUTING.md.";
CM_ SG_ 2566529024 EV_Multi_Connection_DC_Charging_ "Generic 8-byte raw payload. Detail page: https://www.isobus.net/isobus/pGNAndSPN/9390?type=PGN. Signal-level enrichment via PR welcome  see CONTRIBUTING.md.";
CM_ SG_ 2566529280 EV_Multi_Connection_Charging_In_ "Generic 8-byte raw payload. Detail page: https://www.isobus.net/isobus/pGNAndSPN/9396?type=PGN. Signal-level enrichment via PR welcome  see CONTRIBUTING.md.";
CM_ SG_ 2566529536 Sensor_Supply_Voltage_RawPayload "Generic 8-byte raw payload. Detail page: https://www.isobus.net/isobus/pGNAndSPN/9403?type=PGN. Signal-level enrichment via PR welcome  see CONTRIBUTING.md.";
CM_ SG_ 2566529792 Motor_Generator_Location_obsolet "Generic 8-byte raw payload. Detail page: https://www.isobus.net/isobus/pGNAndSPN/9410?type=PGN. Signal-level enrichment via PR welcome  see CONTRIBUTING.md.";
CM_ SG_ 2566530048 High_Voltage_Energy_Storage_Syst "Generic 8-byte raw payload. Detail page: https://www.isobus.net/isobus/pGNAndSPN/9417?type=PGN. Signal-level enrichment via PR welcome  see CONTRIBUTING.md.";
CM_ SG_ 2566530304 High_Voltage_Energy_Storage_Syst "Generic 8-byte raw payload. Detail page: https://www.isobus.net/isobus/pGNAndSPN/9421?type=PGN. Signal-level enrichment via PR welcome  see CONTRIBUTING.md.";
CM_ SG_ 2566530560 High_Voltage_Energy_Storage_Syst "Generic 8-byte raw payload. Detail page: https://www.isobus.net/isobus/pGNAndSPN/9425?type=PGN. Signal-level enrichment via PR welcome  see CONTRIBUTING.md.";
CM_ SG_ 2566530816 High_Voltage_Energy_Storage_Pack "Generic 8-byte raw payload. Detail page: https://www.isobus.net/isobus/pGNAndSPN/9441?type=PGN. Signal-level enrichment via PR welcome  see CONTRIBUTING.md.";
CM_ SG_ 2566531072 High_Voltage_Energy_Storage_Pack "Generic 8-byte raw payload. Detail page: https://www.isobus.net/isobus/pGNAndSPN/9457?type=PGN. Signal-level enrichment via PR welcome  see CONTRIBUTING.md.";
CM_ SG_ 2566531328 High_Voltage_Energy_Storage_Pack "Generic 8-byte raw payload. Detail page: https://www.isobus.net/isobus/pGNAndSPN/9473?type=PGN. Signal-level enrichment via PR welcome  see CONTRIBUTING.md.";
CM_ SG_ 2566531584 High_Voltage_Energy_Storage_Pack "Generic 8-byte raw payload. Detail page: https://www.isobus.net/isobus/pGNAndSPN/9489?type=PGN. Signal-level enrichment via PR welcome  see CONTRIBUTING.md.";
CM_ SG_ 2566531840 High_Voltage_Energy_Storage_Pack "Generic 8-byte raw payload. Detail page: https://www.isobus.net/isobus/pGNAndSPN/9505?type=PGN. Signal-level enrichment via PR welcome  see CONTRIBUTING.md.";
CM_ SG_ 2566532096 High_Voltage_Energy_Storage_Pack "Generic 8-byte raw payload. Detail page: https://www.isobus.net/isobus/pGNAndSPN/9521?type=PGN. Signal-level enrichment via PR welcome  see CONTRIBUTING.md.";
CM_ SG_ 2566532352 High_Voltage_Energy_Storage_Pack "Generic 8-byte raw payload. Detail page: https://www.isobus.net/isobus/pGNAndSPN/9537?type=PGN. Signal-level enrichment via PR welcome  see CONTRIBUTING.md.";
CM_ SG_ 2566532608 High_Voltage_Energy_Storage_Pack "Generic 8-byte raw payload. Detail page: https://www.isobus.net/isobus/pGNAndSPN/9553?type=PGN. Signal-level enrichment via PR welcome  see CONTRIBUTING.md.";
CM_ SG_ 2566532864 High_Voltage_Energy_Storage_Pack "Generic 8-byte raw payload. Detail page: https://www.isobus.net/isobus/pGNAndSPN/9569?type=PGN. Signal-level enrichment via PR welcome  see CONTRIBUTING.md.";
CM_ SG_ 2566533120 High_Voltage_Energy_Storage_Pack "Generic 8-byte raw payload. Detail page: https://www.isobus.net/isobus/pGNAndSPN/9585?type=PGN. Signal-level enrichment via PR welcome  see CONTRIBUTING.md.";
CM_ SG_ 2566533376 High_Voltage_Energy_Storage_Pack "Generic 8-byte raw payload. Detail page: https://www.isobus.net/isobus/pGNAndSPN/9601?type=PGN. Signal-level enrichment via PR welcome  see CONTRIBUTING.md.";
CM_ SG_ 2566533632 High_Voltage_Energy_Storage_Pack "Generic 8-byte raw payload. Detail page: https://www.isobus.net/isobus/pGNAndSPN/9617?type=PGN. Signal-level enrichment via PR welcome  see CONTRIBUTING.md.";
CM_ SG_ 2566533888 Multi_Color_Indicator_Lamp_Comma "Generic 8-byte raw payload. Detail page: https://www.isobus.net/isobus/pGNAndSPN/9631?type=PGN. Signal-level enrichment via PR welcome  see CONTRIBUTING.md.";
CM_ SG_ 2566534144 Multi_Color_Indicator_Lamp_Statu "Generic 8-byte raw payload. Detail page: https://www.isobus.net/isobus/pGNAndSPN/9647?type=PGN. Signal-level enrichment via PR welcome  see CONTRIBUTING.md.";
CM_ SG_ 2566534400 Refuse_Truck_Body_Information_Ra "Generic 8-byte raw payload. Detail page: https://www.isobus.net/isobus/pGNAndSPN/9652?type=PGN. Signal-level enrichment via PR welcome  see CONTRIBUTING.md.";
CM_ SG_ 2566534656 Engine_Fluid_Level_Pressure_14_R "Generic 8-byte raw payload. Detail page: https://www.isobus.net/isobus/pGNAndSPN/9656?type=PGN. Signal-level enrichment via PR welcome  see CONTRIBUTING.md.";
CM_ SG_ 2566534912 Well_Stimulation_Transmission_Co "Generic 8-byte raw payload. Detail page: https://www.isobus.net/isobus/pGNAndSPN/9663?type=PGN. Signal-level enrichment via PR welcome  see CONTRIBUTING.md.";
CM_ SG_ 2566535168 Well_Stimulation_Pump_Protection "Generic 8-byte raw payload. Detail page: https://www.isobus.net/isobus/pGNAndSPN/9671?type=PGN. Signal-level enrichment via PR welcome  see CONTRIBUTING.md.";
CM_ SG_ 2566535424 Well_Stimulation_Pump_Protection "Generic 8-byte raw payload. Detail page: https://www.isobus.net/isobus/pGNAndSPN/9678?type=PGN. Signal-level enrichment via PR welcome  see CONTRIBUTING.md.";
CM_ SG_ 2566535680 Electric_PTO_Drive_Engagement_1_ "Generic 8-byte raw payload. Detail page: https://www.isobus.net/isobus/pGNAndSPN/9686?type=PGN. Signal-level enrichment via PR welcome  see CONTRIBUTING.md.";
CM_ SG_ 2566535936 Electric_PTO_1_Information_RawPa "Generic 8-byte raw payload. Detail page: https://www.isobus.net/isobus/pGNAndSPN/9689?type=PGN. Signal-level enrichment via PR welcome  see CONTRIBUTING.md.";
CM_ SG_ 2566536192 Engine_Exhaust_O2_Sensor_Informa "Generic 8-byte raw payload. Detail page: https://www.isobus.net/isobus/pGNAndSPN/9693?type=PGN. Signal-level enrichment via PR welcome  see CONTRIBUTING.md.";
CM_ SG_ 2566536448 Gaseous_Fuel_Supply_Pressure_3_R "Generic 8-byte raw payload. Detail page: https://www.isobus.net/isobus/pGNAndSPN/9698?type=PGN. Signal-level enrichment via PR welcome  see CONTRIBUTING.md.";
CM_ SG_ 2566536704 Traffic_Signage_RawPayload "Generic 8-byte raw payload. Detail page: https://www.isobus.net/isobus/pGNAndSPN/9699?type=PGN. Signal-level enrichment via PR welcome  see CONTRIBUTING.md.";
CM_ SG_ 2566536960 Engine_Configuration_4_RawPayloa "Generic 8-byte raw payload. Detail page: https://www.isobus.net/isobus/pGNAndSPN/9701?type=PGN. Signal-level enrichment via PR welcome  see CONTRIBUTING.md.";
CM_ SG_ 2566537216 Electronic_Transmission_Controll "Generic 8-byte raw payload. Detail page: https://www.isobus.net/isobus/pGNAndSPN/9706?type=PGN. Signal-level enrichment via PR welcome  see CONTRIBUTING.md.";
CM_ SG_ 2566537472 Automated_Driving_System_Network "Generic 8-byte raw payload. Detail page: https://www.isobus.net/isobus/pGNAndSPN/9714?type=PGN. Signal-level enrichment via PR welcome  see CONTRIBUTING.md.";
CM_ SG_ 2566537728 Automated_Driving_System_Network "Generic 8-byte raw payload. Detail page: https://www.isobus.net/isobus/pGNAndSPN/9722?type=PGN. Signal-level enrichment via PR welcome  see CONTRIBUTING.md.";
CM_ SG_ 2566537984 Hybrid_or_EV_System_Inputs_2_Raw "Generic 8-byte raw payload. Detail page: https://www.isobus.net/isobus/pGNAndSPN/9723?type=PGN. Signal-level enrichment via PR welcome  see CONTRIBUTING.md.";
CM_ SG_ 2566538240 Engine_Speed_Load_Factor_Informa "Generic 8-byte raw payload. Detail page: https://www.isobus.net/isobus/pGNAndSPN/9725?type=PGN. Signal-level enrichment via PR welcome  see CONTRIBUTING.md.";
CM_ SG_ 2566538496 Generator_Trip_Energy_2_RawPaylo "Generic 8-byte raw payload. Detail page: https://www.isobus.net/isobus/pGNAndSPN/9726?type=PGN. Signal-level enrichment via PR welcome  see CONTRIBUTING.md.";
CM_ SG_ 2566538752 Security_System_Machine_Operatio "Generic 8-byte raw payload. Detail page: https://www.isobus.net/isobus/pGNAndSPN/9731?type=PGN. Signal-level enrichment via PR welcome  see CONTRIBUTING.md.";
CM_ SG_ 2566539008 Engine_Fuel_Actuator_Service_Mod "Generic 8-byte raw payload. Detail page: https://www.isobus.net/isobus/pGNAndSPN/9733?type=PGN. Signal-level enrichment via PR welcome  see CONTRIBUTING.md.";
CM_ SG_ 2566539264 Steering_Wheel_Controls_RawPaylo "Generic 8-byte raw payload. Detail page: https://www.isobus.net/isobus/pGNAndSPN/9740?type=PGN. Signal-level enrichment via PR welcome  see CONTRIBUTING.md.";
CM_ SG_ 2566539520 Park_Assist_RawPayload "Generic 8-byte raw payload. Detail page: https://www.isobus.net/isobus/pGNAndSPN/9742?type=PGN. Signal-level enrichment via PR welcome  see CONTRIBUTING.md.";
CM_ SG_ 2566539776 Extended_DTC_information_RawPayl "Generic 8-byte raw payload. Detail page: https://www.isobus.net/isobus/pGNAndSPN/9743?type=PGN. Signal-level enrichment via PR welcome  see CONTRIBUTING.md.";
CM_ SG_ 2566540032 Aftertreatment_2_SCR_Dosing_Syst "Generic 8-byte raw payload. Detail page: https://www.isobus.net/isobus/pGNAndSPN/9745?type=PGN. Signal-level enrichment via PR welcome  see CONTRIBUTING.md.";
CM_ SG_ 2566540288 Aftertreatment_1_SCR_Dosing_Syst "Generic 8-byte raw payload. Detail page: https://www.isobus.net/isobus/pGNAndSPN/9747?type=PGN. Signal-level enrichment via PR welcome  see CONTRIBUTING.md.";
CM_ SG_ 2566540544 EV_Economy_Information_RawPayloa "Generic 8-byte raw payload. Detail page: https://www.isobus.net/isobus/pGNAndSPN/9749?type=PGN. Signal-level enrichment via PR welcome  see CONTRIBUTING.md.";
CM_ SG_ 2566540800 Automated_Driving_System_Status_ "Generic 8-byte raw payload. Detail page: https://www.isobus.net/isobus/pGNAndSPN/9761?type=PGN. Signal-level enrichment via PR welcome  see CONTRIBUTING.md.";
CM_ SG_ 2566541056 Automated_Driving_System_Control "Generic 8-byte raw payload. Detail page: https://www.isobus.net/isobus/pGNAndSPN/9765?type=PGN. Signal-level enrichment via PR welcome  see CONTRIBUTING.md.";
CM_ SG_ 2566541312 Aftercooler_Valve_RawPayload "Generic 8-byte raw payload. Detail page: https://www.isobus.net/isobus/pGNAndSPN/9770?type=PGN. Signal-level enrichment via PR welcome  see CONTRIBUTING.md.";
CM_ SG_ 2566541568 Engine_Radiator_1_RawPayload "Generic 8-byte raw payload. Detail page: https://www.isobus.net/isobus/pGNAndSPN/9781?type=PGN. Signal-level enrichment via PR welcome  see CONTRIBUTING.md.";
CM_ SG_ 2566541824 Engine_Radiator_2_RawPayload "Generic 8-byte raw payload. Detail page: https://www.isobus.net/isobus/pGNAndSPN/9791?type=PGN. Signal-level enrichment via PR welcome  see CONTRIBUTING.md.";
CM_ SG_ 2566542080 Genset_Enclosure_Ventilation_Raw "Generic 8-byte raw payload. Detail page: https://www.isobus.net/isobus/pGNAndSPN/9795?type=PGN. Signal-level enrichment via PR welcome  see CONTRIBUTING.md.";
CM_ SG_ 2566542336 Heat_Exchanger_1_RawPayload "Generic 8-byte raw payload. Detail page: https://www.isobus.net/isobus/pGNAndSPN/9799?type=PGN. Signal-level enrichment via PR welcome  see CONTRIBUTING.md.";
CM_ SG_ 2566542592 Heat_Exchanger_2_RawPayload "Generic 8-byte raw payload. Detail page: https://www.isobus.net/isobus/pGNAndSPN/9803?type=PGN. Signal-level enrichment via PR welcome  see CONTRIBUTING.md.";
CM_ SG_ 2566542848 Heat_Exchanger_3_RawPayload "Generic 8-byte raw payload. Detail page: https://www.isobus.net/isobus/pGNAndSPN/9807?type=PGN. Signal-level enrichment via PR welcome  see CONTRIBUTING.md.";
CM_ SG_ 2566543104 Heat_Exchanger_4_RawPayload "Generic 8-byte raw payload. Detail page: https://www.isobus.net/isobus/pGNAndSPN/9811?type=PGN. Signal-level enrichment via PR welcome  see CONTRIBUTING.md.";
CM_ SG_ 2566543360 Engine_Exhaust_Gas_Heat_Exchange "Generic 8-byte raw payload. Detail page: https://www.isobus.net/isobus/pGNAndSPN/9814?type=PGN. Signal-level enrichment via PR welcome  see CONTRIBUTING.md.";
CM_ SG_ 2566543616 Genset_Enclosure_Ventilation_Lou "Generic 8-byte raw payload. Detail page: https://www.isobus.net/isobus/pGNAndSPN/9820?type=PGN. Signal-level enrichment via PR welcome  see CONTRIBUTING.md.";
CM_ SG_ 2566543872 Genset_External_Coolant_System_R "Generic 8-byte raw payload. Detail page: https://www.isobus.net/isobus/pGNAndSPN/9826?type=PGN. Signal-level enrichment via PR welcome  see CONTRIBUTING.md.";
CM_ SG_ 2566544128 EV_DC_Status_1_RawPayload "Generic 8-byte raw payload. Detail page: https://www.isobus.net/isobus/pGNAndSPN/9829?type=PGN. Signal-level enrichment via PR welcome  see CONTRIBUTING.md.";
CM_ SG_ 2566544384 EVSE_DC_Charging_Limits_3_RawPay "Generic 8-byte raw payload. Detail page: https://www.isobus.net/isobus/pGNAndSPN/9830?type=PGN. Signal-level enrichment via PR welcome  see CONTRIBUTING.md.";
CM_ SG_ 2566544640 EVSE_Power_Max_Schedule_RawPaylo "Generic 8-byte raw payload. Detail page: https://www.isobus.net/isobus/pGNAndSPN/9837?type=PGN. Signal-level enrichment via PR welcome  see CONTRIBUTING.md.";
CM_ SG_ 2566544896 EV_Charge_Profile_RawPayload "Generic 8-byte raw payload. Detail page: https://www.isobus.net/isobus/pGNAndSPN/9840?type=PGN. Signal-level enrichment via PR welcome  see CONTRIBUTING.md.";
CM_ SG_ 2566545152 EV_DC_Charging_Limits_2_RawPaylo "Generic 8-byte raw payload. Detail page: https://www.isobus.net/isobus/pGNAndSPN/9844?type=PGN. Signal-level enrichment via PR welcome  see CONTRIBUTING.md.";
CM_ SG_ 2566545408 EV_DC_Charging_In_Progress_RawPa "Generic 8-byte raw payload. Detail page: https://www.isobus.net/isobus/pGNAndSPN/9849?type=PGN. Signal-level enrichment via PR welcome  see CONTRIBUTING.md.";
CM_ SG_ 2566545920 Lighting_Data_2_RawPayload "Generic 8-byte raw payload. Detail page: https://www.isobus.net/isobus/pGNAndSPN/9850?type=PGN. Signal-level enrichment via PR welcome  see CONTRIBUTING.md.";
CM_ SG_ 2566546176 Lighting_Command_2_RawPayload "Generic 8-byte raw payload. Detail page: https://www.isobus.net/isobus/pGNAndSPN/9852?type=PGN. Signal-level enrichment via PR welcome  see CONTRIBUTING.md.";
CM_ SG_ 2566546432 Aftertreatment_System_Informatio "Generic 8-byte raw payload. Detail page: https://www.isobus.net/isobus/pGNAndSPN/9854?type=PGN. Signal-level enrichment via PR welcome  see CONTRIBUTING.md.";
CM_ SG_ 2566546688 Aftertreatment_System_Informatio "Generic 8-byte raw payload. Detail page: https://www.isobus.net/isobus/pGNAndSPN/9856?type=PGN. Signal-level enrichment via PR welcome  see CONTRIBUTING.md.";
CM_ SG_ 2566546944 Aftertreatment_System_Informatio "Generic 8-byte raw payload. Detail page: https://www.isobus.net/isobus/pGNAndSPN/9858?type=PGN. Signal-level enrichment via PR welcome  see CONTRIBUTING.md.";
CM_ SG_ 2566547200 Fluid_Resistance_1_RawPayload "Generic 8-byte raw payload. Detail page: https://www.isobus.net/isobus/pGNAndSPN/9860?type=PGN. Signal-level enrichment via PR welcome  see CONTRIBUTING.md.";
CM_ SG_ 2566547456 Power_Converter_2_Isolation_Inte "Generic 8-byte raw payload. Detail page: https://www.isobus.net/isobus/pGNAndSPN/9864?type=PGN. Signal-level enrichment via PR welcome  see CONTRIBUTING.md.";
CM_ SG_ 2566547712 Power_Converter_1_Isolation_Inte "Generic 8-byte raw payload. Detail page: https://www.isobus.net/isobus/pGNAndSPN/9868?type=PGN. Signal-level enrichment via PR welcome  see CONTRIBUTING.md.";
CM_ SG_ 2566547968 Power_Converter_2_Limits_Request "Generic 8-byte raw payload. Detail page: https://www.isobus.net/isobus/pGNAndSPN/9874?type=PGN. Signal-level enrichment via PR welcome  see CONTRIBUTING.md.";
CM_ SG_ 2566548224 Power_Converter_2_Limits_Request "Generic 8-byte raw payload. Detail page: https://www.isobus.net/isobus/pGNAndSPN/9880?type=PGN. Signal-level enrichment via PR welcome  see CONTRIBUTING.md.";
CM_ SG_ 2566548480 Power_Converter_2_Limits_Request "Generic 8-byte raw payload. Detail page: https://www.isobus.net/isobus/pGNAndSPN/9886?type=PGN. Signal-level enrichment via PR welcome  see CONTRIBUTING.md.";
CM_ SG_ 2566548736 Power_Converter_1_Limits_Request "Generic 8-byte raw payload. Detail page: https://www.isobus.net/isobus/pGNAndSPN/9892?type=PGN. Signal-level enrichment via PR welcome  see CONTRIBUTING.md.";
CM_ SG_ 2566548992 Power_Converter_1_Limits_Request "Generic 8-byte raw payload. Detail page: https://www.isobus.net/isobus/pGNAndSPN/9898?type=PGN. Signal-level enrichment via PR welcome  see CONTRIBUTING.md.";
CM_ SG_ 2566549248 Power_Converter_1_Limits_Request "Generic 8-byte raw payload. Detail page: https://www.isobus.net/isobus/pGNAndSPN/9904?type=PGN. Signal-level enrichment via PR welcome  see CONTRIBUTING.md.";
CM_ SG_ 2566549504 Inverter_1_Lifetime_Data_RawPayl "Generic 8-byte raw payload. Detail page: https://www.isobus.net/isobus/pGNAndSPN/9908?type=PGN. Signal-level enrichment via PR welcome  see CONTRIBUTING.md.";
CM_ SG_ 2566549760 Inverter_2_Lifetime_Data_RawPayl "Generic 8-byte raw payload. Detail page: https://www.isobus.net/isobus/pGNAndSPN/9912?type=PGN. Signal-level enrichment via PR welcome  see CONTRIBUTING.md.";
CM_ SG_ 2566550016 Power_Converter_2_Active_Power_L "Generic 8-byte raw payload. Detail page: https://www.isobus.net/isobus/pGNAndSPN/9930?type=PGN. Signal-level enrichment via PR welcome  see CONTRIBUTING.md.";
CM_ SG_ 2566550272 Power_Converter_1_Active_Power_L "Generic 8-byte raw payload. Detail page: https://www.isobus.net/isobus/pGNAndSPN/9948?type=PGN. Signal-level enrichment via PR welcome  see CONTRIBUTING.md.";
CM_ SG_ 2566550528 Power_Converter_2_Reference_1_Ra "Generic 8-byte raw payload. Detail page: https://www.isobus.net/isobus/pGNAndSPN/9953?type=PGN. Signal-level enrichment via PR welcome  see CONTRIBUTING.md.";
CM_ SG_ 2566550784 Power_Converter_2_Reference_2_Ra "Generic 8-byte raw payload. Detail page: https://www.isobus.net/isobus/pGNAndSPN/9957?type=PGN. Signal-level enrichment via PR welcome  see CONTRIBUTING.md.";
CM_ SG_ 2566551040 Power_Converter_2_Temperature_Ra "Generic 8-byte raw payload. Detail page: https://www.isobus.net/isobus/pGNAndSPN/9961?type=PGN. Signal-level enrichment via PR welcome  see CONTRIBUTING.md.";
CM_ SG_ 2566551296 Power_Converter_1_Temperature_Ra "Generic 8-byte raw payload. Detail page: https://www.isobus.net/isobus/pGNAndSPN/9965?type=PGN. Signal-level enrichment via PR welcome  see CONTRIBUTING.md.";
CM_ SG_ 2566551552 Power_Converter_1_Reference_2_Ra "Generic 8-byte raw payload. Detail page: https://www.isobus.net/isobus/pGNAndSPN/9969?type=PGN. Signal-level enrichment via PR welcome  see CONTRIBUTING.md.";
CM_ SG_ 2566551808 Power_Converter_1_Reference_1_Ra "Generic 8-byte raw payload. Detail page: https://www.isobus.net/isobus/pGNAndSPN/9974?type=PGN. Signal-level enrichment via PR welcome  see CONTRIBUTING.md.";
CM_ SG_ 2566552064 Power_Converter_1_Phase_Current_ "Generic 8-byte raw payload. Detail page: https://www.isobus.net/isobus/pGNAndSPN/9977?type=PGN. Signal-level enrichment via PR welcome  see CONTRIBUTING.md.";
CM_ SG_ 2566552320 Power_Converter_2_Phase_Current_ "Generic 8-byte raw payload. Detail page: https://www.isobus.net/isobus/pGNAndSPN/9980?type=PGN. Signal-level enrichment via PR welcome  see CONTRIBUTING.md.";
CM_ SG_ 2566552576 Power_Converter_1_Phase_Voltage_ "Generic 8-byte raw payload. Detail page: https://www.isobus.net/isobus/pGNAndSPN/9983?type=PGN. Signal-level enrichment via PR welcome  see CONTRIBUTING.md.";
CM_ SG_ 2566552832 Power_Converter_2_Phase_Voltage_ "Generic 8-byte raw payload. Detail page: https://www.isobus.net/isobus/pGNAndSPN/9986?type=PGN. Signal-level enrichment via PR welcome  see CONTRIBUTING.md.";
CM_ SG_ 2566553088 Power_Converter_Power_Module_Swi "Generic 8-byte raw payload. Detail page: https://www.isobus.net/isobus/pGNAndSPN/9992?type=PGN. Signal-level enrichment via PR welcome  see CONTRIBUTING.md.";
CM_ SG_ 2566553344 Power_Converter_1_Power_Module_S "Generic 8-byte raw payload. Detail page: https://www.isobus.net/isobus/pGNAndSPN/9995?type=PGN. Signal-level enrichment via PR welcome  see CONTRIBUTING.md.";
CM_ SG_ 2566553600 Power_Converter_2_Power_Module_S "Generic 8-byte raw payload. Detail page: https://www.isobus.net/isobus/pGNAndSPN/9998?type=PGN. Signal-level enrichment via PR welcome  see CONTRIBUTING.md.";
CM_ SG_ 2566553856 Power_Converter_Totals_1_RawPayl "Generic 8-byte raw payload. Detail page: https://www.isobus.net/isobus/pGNAndSPN/10002?type=PGN. Signal-level enrichment via PR welcome  see CONTRIBUTING.md.";
CM_ SG_ 2566554112 Transformer_Temperatures_RawPayl "Generic 8-byte raw payload. Detail page: https://www.isobus.net/isobus/pGNAndSPN/10008?type=PGN. Signal-level enrichment via PR welcome  see CONTRIBUTING.md.";
CM_ SG_ 2566554368 Electrified_Accessory_Engine_Coo "Generic 8-byte raw payload. Detail page: https://www.isobus.net/isobus/pGNAndSPN/10016?type=PGN. Signal-level enrichment via PR welcome  see CONTRIBUTING.md.";
CM_ SG_ 2566554624 High_Voltage_Energy_Storage_Pack "Generic 8-byte raw payload. Detail page: https://www.isobus.net/isobus/pGNAndSPN/10022?type=PGN. Signal-level enrichment via PR welcome  see CONTRIBUTING.md.";
CM_ SG_ 2566554880 High_Voltage_Energy_Storage_Pack "Generic 8-byte raw payload. Detail page: https://www.isobus.net/isobus/pGNAndSPN/10032?type=PGN. Signal-level enrichment via PR welcome  see CONTRIBUTING.md.";
CM_ SG_ 2566555136 High_Voltage_Energy_Storage_Pack "Generic 8-byte raw payload. Detail page: https://www.isobus.net/isobus/pGNAndSPN/10038?type=PGN. Signal-level enrichment via PR welcome  see CONTRIBUTING.md.";
CM_ SG_ 2566555392 High_Voltage_Energy_Storage_Pack "Generic 8-byte raw payload. Detail page: https://www.isobus.net/isobus/pGNAndSPN/10048?type=PGN. Signal-level enrichment via PR welcome  see CONTRIBUTING.md.";
CM_ SG_ 2566555648 High_Voltage_Energy_Storage_Pack "Generic 8-byte raw payload. Detail page: https://www.isobus.net/isobus/pGNAndSPN/10054?type=PGN. Signal-level enrichment via PR welcome  see CONTRIBUTING.md.";
CM_ SG_ 2566555904 High_Voltage_Energy_Storage_Pack "Generic 8-byte raw payload. Detail page: https://www.isobus.net/isobus/pGNAndSPN/10064?type=PGN. Signal-level enrichment via PR welcome  see CONTRIBUTING.md.";
CM_ SG_ 2566556160 High_Voltage_Energy_Storage_Pack "Generic 8-byte raw payload. Detail page: https://www.isobus.net/isobus/pGNAndSPN/10070?type=PGN. Signal-level enrichment via PR welcome  see CONTRIBUTING.md.";
CM_ SG_ 2566556416 High_Voltage_Energy_Storage_Pack "Generic 8-byte raw payload. Detail page: https://www.isobus.net/isobus/pGNAndSPN/10080?type=PGN. Signal-level enrichment via PR welcome  see CONTRIBUTING.md.";
CM_ SG_ 2566556672 High_Voltage_Energy_Storage_Pack "Generic 8-byte raw payload. Detail page: https://www.isobus.net/isobus/pGNAndSPN/10086?type=PGN. Signal-level enrichment via PR welcome  see CONTRIBUTING.md.";
CM_ SG_ 2566556928 High_Voltage_Energy_Storage_Pack "Generic 8-byte raw payload. Detail page: https://www.isobus.net/isobus/pGNAndSPN/10096?type=PGN. Signal-level enrichment via PR welcome  see CONTRIBUTING.md.";
CM_ SG_ 2566557184 High_Voltage_Energy_Storage_Pack "Generic 8-byte raw payload. Detail page: https://www.isobus.net/isobus/pGNAndSPN/10102?type=PGN. Signal-level enrichment via PR welcome  see CONTRIBUTING.md.";
CM_ SG_ 2566557440 High_Voltage_Energy_Storage_Pack "Generic 8-byte raw payload. Detail page: https://www.isobus.net/isobus/pGNAndSPN/10112?type=PGN. Signal-level enrichment via PR welcome  see CONTRIBUTING.md.";
CM_ SG_ 2566557696 High_Voltage_Energy_Storage_Pack "Generic 8-byte raw payload. Detail page: https://www.isobus.net/isobus/pGNAndSPN/10118?type=PGN. Signal-level enrichment via PR welcome  see CONTRIBUTING.md.";
CM_ SG_ 2566557952 High_Voltage_Energy_Storage_Pack "Generic 8-byte raw payload. Detail page: https://www.isobus.net/isobus/pGNAndSPN/10128?type=PGN. Signal-level enrichment via PR welcome  see CONTRIBUTING.md.";
CM_ SG_ 2566558208 High_Voltage_Energy_Storage_Pack "Generic 8-byte raw payload. Detail page: https://www.isobus.net/isobus/pGNAndSPN/10134?type=PGN. Signal-level enrichment via PR welcome  see CONTRIBUTING.md.";
CM_ SG_ 2566558464 High_Voltage_Energy_Storage_Pack "Generic 8-byte raw payload. Detail page: https://www.isobus.net/isobus/pGNAndSPN/10144?type=PGN. Signal-level enrichment via PR welcome  see CONTRIBUTING.md.";
CM_ SG_ 2566558720 High_Voltage_Energy_Storage_Pack "Generic 8-byte raw payload. Detail page: https://www.isobus.net/isobus/pGNAndSPN/10150?type=PGN. Signal-level enrichment via PR welcome  see CONTRIBUTING.md.";
CM_ SG_ 2566558976 High_Voltage_Energy_Storage_Pack "Generic 8-byte raw payload. Detail page: https://www.isobus.net/isobus/pGNAndSPN/10160?type=PGN. Signal-level enrichment via PR welcome  see CONTRIBUTING.md.";
CM_ SG_ 2566559232 High_Voltage_Energy_Storage_Pack "Generic 8-byte raw payload. Detail page: https://www.isobus.net/isobus/pGNAndSPN/10166?type=PGN. Signal-level enrichment via PR welcome  see CONTRIBUTING.md.";
CM_ SG_ 2566559488 High_Voltage_Energy_Storage_Pack "Generic 8-byte raw payload. Detail page: https://www.isobus.net/isobus/pGNAndSPN/10176?type=PGN. Signal-level enrichment via PR welcome  see CONTRIBUTING.md.";
CM_ SG_ 2566559744 High_Voltage_Energy_Storage_Pack "Generic 8-byte raw payload. Detail page: https://www.isobus.net/isobus/pGNAndSPN/10182?type=PGN. Signal-level enrichment via PR welcome  see CONTRIBUTING.md.";
CM_ SG_ 2566560000 High_Voltage_Energy_Storage_Pack "Generic 8-byte raw payload. Detail page: https://www.isobus.net/isobus/pGNAndSPN/10192?type=PGN. Signal-level enrichment via PR welcome  see CONTRIBUTING.md.";
CM_ SG_ 2566560256 High_Voltage_Energy_Storage_Pack "Generic 8-byte raw payload. Detail page: https://www.isobus.net/isobus/pGNAndSPN/10198?type=PGN. Signal-level enrichment via PR welcome  see CONTRIBUTING.md.";
CM_ SG_ 2566560512 High_Voltage_Energy_Storage_Pack "Generic 8-byte raw payload. Detail page: https://www.isobus.net/isobus/pGNAndSPN/10208?type=PGN. Signal-level enrichment via PR welcome  see CONTRIBUTING.md.";
CM_ SG_ 2566560768 High_Voltage_Energy_Storage_Pack "Generic 8-byte raw payload. Detail page: https://www.isobus.net/isobus/pGNAndSPN/10214?type=PGN. Signal-level enrichment via PR welcome  see CONTRIBUTING.md.";
CM_ SG_ 2566561024 High_Voltage_Energy_Storage_Pack "Generic 8-byte raw payload. Detail page: https://www.isobus.net/isobus/pGNAndSPN/10224?type=PGN. Signal-level enrichment via PR welcome  see CONTRIBUTING.md.";
CM_ SG_ 2566561280 High_Voltage_Energy_Storage_Pack "Generic 8-byte raw payload. Detail page: https://www.isobus.net/isobus/pGNAndSPN/10230?type=PGN. Signal-level enrichment via PR welcome  see CONTRIBUTING.md.";
CM_ SG_ 2566561536 High_Voltage_Energy_Storage_Pack "Generic 8-byte raw payload. Detail page: https://www.isobus.net/isobus/pGNAndSPN/10240?type=PGN. Signal-level enrichment via PR welcome  see CONTRIBUTING.md.";
CM_ SG_ 2566561792 High_Voltage_Energy_Storage_Pack "Generic 8-byte raw payload. Detail page: https://www.isobus.net/isobus/pGNAndSPN/10246?type=PGN. Signal-level enrichment via PR welcome  see CONTRIBUTING.md.";
CM_ SG_ 2566562048 High_Voltage_Energy_Storage_Pack "Generic 8-byte raw payload. Detail page: https://www.isobus.net/isobus/pGNAndSPN/10256?type=PGN. Signal-level enrichment via PR welcome  see CONTRIBUTING.md.";
CM_ SG_ 2566562304 High_Voltage_Energy_Storage_Pack "Generic 8-byte raw payload. Detail page: https://www.isobus.net/isobus/pGNAndSPN/10262?type=PGN. Signal-level enrichment via PR welcome  see CONTRIBUTING.md.";
CM_ SG_ 2566562560 High_Voltage_Energy_Storage_Pack "Generic 8-byte raw payload. Detail page: https://www.isobus.net/isobus/pGNAndSPN/10272?type=PGN. Signal-level enrichment via PR welcome  see CONTRIBUTING.md.";
CM_ SG_ 2566562816 Automated_Driving_System_Control "Generic 8-byte raw payload. Detail page: https://www.isobus.net/isobus/pGNAndSPN/10277?type=PGN. Signal-level enrichment via PR welcome  see CONTRIBUTING.md.";
CM_ SG_ 2566563072 Dual_Fuel_Mode_3_RawPayload "Generic 8-byte raw payload. Detail page: https://www.isobus.net/isobus/pGNAndSPN/10280?type=PGN. Signal-level enrichment via PR welcome  see CONTRIBUTING.md.";
CM_ SG_ 2566563328 Dual_Fuel_Mode_2_RawPayload "Generic 8-byte raw payload. Detail page: https://www.isobus.net/isobus/pGNAndSPN/10282?type=PGN. Signal-level enrichment via PR welcome  see CONTRIBUTING.md.";
CM_ SG_ 2566563584 Dual_Fuel_Mode_1_RawPayload "Generic 8-byte raw payload. Detail page: https://www.isobus.net/isobus/pGNAndSPN/10287?type=PGN. Signal-level enrichment via PR welcome  see CONTRIBUTING.md.";
CM_ SG_ 2566563840 Transmission_1_History_RawPayloa "Generic 8-byte raw payload. Detail page: https://www.isobus.net/isobus/pGNAndSPN/10290?type=PGN. Signal-level enrichment via PR welcome  see CONTRIBUTING.md.";
CM_ SG_ 2566564096 Transmission_Shaft_Twist_Informa "Generic 8-byte raw payload. Detail page: https://www.isobus.net/isobus/pGNAndSPN/10293?type=PGN. Signal-level enrichment via PR welcome  see CONTRIBUTING.md.";
CM_ SG_ 2566564352 Electronic_Auxiliary_Transmissio "Generic 8-byte raw payload. Detail page: https://www.isobus.net/isobus/pGNAndSPN/10295?type=PGN. Signal-level enrichment via PR welcome  see CONTRIBUTING.md.";
CM_ SG_ 2566564608 High_Voltage_Energy_Storage_Pack "Generic 8-byte raw payload. Detail page: https://www.isobus.net/isobus/pGNAndSPN/10305?type=PGN. Signal-level enrichment via PR welcome  see CONTRIBUTING.md.";
CM_ SG_ 2566564864 High_Voltage_Energy_Storage_Pack "Generic 8-byte raw payload. Detail page: https://www.isobus.net/isobus/pGNAndSPN/10311?type=PGN. Signal-level enrichment via PR welcome  see CONTRIBUTING.md.";
CM_ SG_ 2566565120 High_Voltage_Energy_Storage_Pack "Generic 8-byte raw payload. Detail page: https://www.isobus.net/isobus/pGNAndSPN/10321?type=PGN. Signal-level enrichment via PR welcome  see CONTRIBUTING.md.";

BA_DEF_ BO_ "SystemMessageLongSymbol" STRING;
BA_DEF_ SG_ "SystemSignalLongSymbol" STRING;
BA_ "SystemMessageLongSymbol" BO_ 2566092544 "VDMA_F377_Fuel_Cell_System_Operating_State";
BA_ "SystemMessageLongSymbol" BO_ 2566092800 "VDMA_F378_Fuel_Cell_System_Operations_Requ";
BA_ "SystemMessageLongSymbol" BO_ 2566093056 "VDMA_F379_Fuel_Cell_Stack_Information";
BA_ "SystemMessageLongSymbol" BO_ 2566093312 "VDMA_F37A_Fuel_Cell_System_Coolant_Fan_1_S";
BA_ "SystemMessageLongSymbol" BO_ 2566093568 "VDMA_F37B_Fuel_Cell_System_Coolant_Fan_2_S";
BA_ "SystemMessageLongSymbol" BO_ 2566093824 "VDMA_F37C_Fuel_Cell_System_Coolant_Fan_3_S";
BA_ "SystemMessageLongSymbol" BO_ 2566094080 "VDMA_F37D_Fuel_Cell_System_Coolant_Fan_4_S";
BA_ "SystemMessageLongSymbol" BO_ 2566094336 "VDMA_F37E_HVESS_Coolant_Pump_1_Status_2";
BA_ "SystemMessageLongSymbol" BO_ 2566094592 "VDMA_F37F_HVESS_Coolant_Pump_2_Status_2";
BA_ "SystemMessageLongSymbol" BO_ 2566094848 "VDMA_F380_High_Voltage_Energy_Storage_Syst";
BA_ "SystemMessageLongSymbol" BO_ 2566095360 "VDMA_F382_Fuel_Cell_System_Hydrogen_Pressu";
BA_ "SystemMessageLongSymbol" BO_ 2566095872 "VDMA_F384_Engine_Supercharger_Information";
BA_ "SystemMessageLongSymbol" BO_ 2566096128 "VDMA_F385_Engine_Disconnect_Clutch";
BA_ "SystemMessageLongSymbol" BO_ 2566478336 "VDMA_F95A_Engine_Crankcase_Ventilation_Hea";
BA_ "SystemMessageLongSymbol" BO_ 2566478592 "VDMA_F95B_Engine_Crankcase_Ventilation_Hea";
BA_ "SystemMessageLongSymbol" BO_ 2566478848 "VDMA_F95C_Engine_Crankcase_Ventilation_Hea";
BA_ "SystemMessageLongSymbol" BO_ 2566479360 "VDMA_F95E_OBFCM_Engine_Output_Energy_Stati";
BA_ "SystemMessageLongSymbol" BO_ 2566479616 "VDMA_F95F_OBFCM_Vehicle_Distance_Static_Da";
BA_ "SystemMessageLongSymbol" BO_ 2566479872 "VDMA_F960_OBFCM_Fuel_2_Static_Data";
BA_ "SystemMessageLongSymbol" BO_ 2566480128 "VDMA_F961_OBFCM_Fuel_1_Static_Data";
BA_ "SystemMessageLongSymbol" BO_ 2566481408 "VDMA_F966_Maintenance_Information_2";
BA_ "SystemMessageLongSymbol" BO_ 2566481920 "VDMA_F968_Engine_Catalyst_Diverter_Actuato";
BA_ "SystemMessageLongSymbol" BO_ 2566482176 "VDMA_F969_Electronic_Logging_Device_Hours_";
BA_ "SystemMessageLongSymbol" BO_ 2566482432 "VDMA_F96A_ER_DC_DC_Converter_4_References";
BA_ "SystemMessageLongSymbol" BO_ 2566482688 "VDMA_F96B_ER_DC_DC_Converter_4_Power_Limit";
BA_ "SystemMessageLongSymbol" BO_ 2566482944 "VDMA_F96C_ER_DC_DC_Converter_4_Current_Lim";
BA_ "SystemMessageLongSymbol" BO_ 2566483200 "VDMA_F96D_ER_DC_DC_Converter_4_Voltage_Lim";
BA_ "SystemMessageLongSymbol" BO_ 2566483456 "VDMA_F96E_ER_DC_DC_Converter_4_Temperature";
BA_ "SystemMessageLongSymbol" BO_ 2566483712 "VDMA_F96F_ER_DC_DC_Converter_4_Power_Limit";
BA_ "SystemMessageLongSymbol" BO_ 2566483968 "VDMA_F970_ER_DC_DC_Converter_4_Current_Lim";
BA_ "SystemMessageLongSymbol" BO_ 2566484224 "VDMA_F971_ER_DC_DC_Converter_4_Voltage_Lim";
BA_ "SystemMessageLongSymbol" BO_ 2566484480 "VDMA_F972_ER_DC_DC_Converter_4_Low_Voltage";
BA_ "SystemMessageLongSymbol" BO_ 2566484736 "VDMA_F973_ER_DC_DC_Converter_4_Power_and_C";
BA_ "SystemMessageLongSymbol" BO_ 2566484992 "VDMA_F974_ER_DC_DC_Converter_4_Voltage_and";
BA_ "SystemMessageLongSymbol" BO_ 2566485248 "VDMA_F975_ER_DC_DC_Converter_4_Operating_S";
BA_ "SystemMessageLongSymbol" BO_ 2566485504 "VDMA_F976_ER_DC_DC_Converter_4_Control";
BA_ "SystemMessageLongSymbol" BO_ 2566485760 "VDMA_F977_ER_DC_DC_Converter_3_References";
BA_ "SystemMessageLongSymbol" BO_ 2566486016 "VDMA_F978_ER_DC_DC_Converter_3_Power_Limit";
BA_ "SystemMessageLongSymbol" BO_ 2566486272 "VDMA_F979_ER_DC_DC_Converter_3_Current_Lim";
BA_ "SystemMessageLongSymbol" BO_ 2566486528 "VDMA_F97A_ER_DC_DC_Converter_3_Voltage_Lim";
BA_ "SystemMessageLongSymbol" BO_ 2566486784 "VDMA_F97B_ER_DC_DC_Converter_3_Temperature";
BA_ "SystemMessageLongSymbol" BO_ 2566487040 "VDMA_F97C_ER_DC_DC_Converter_3_Power_Limit";
BA_ "SystemMessageLongSymbol" BO_ 2566487296 "VDMA_F97D_ER_DC_DC_Converter_3_Current_Lim";
BA_ "SystemMessageLongSymbol" BO_ 2566487552 "VDMA_F97E_ER_DC_DC_Converter_3_Voltage_Lim";
BA_ "SystemMessageLongSymbol" BO_ 2566487808 "VDMA_F97F_ER_DC_DC_Converter_3_Low_Voltage";
BA_ "SystemMessageLongSymbol" BO_ 2566488064 "VDMA_F980_ER_DC_DC_Converter_3_Power_and_C";
BA_ "SystemMessageLongSymbol" BO_ 2566488320 "VDMA_F981_ER_DC_DC_Converter_3_Voltage_and";
BA_ "SystemMessageLongSymbol" BO_ 2566488576 "VDMA_F982_ER_DC_DC_Converter_3_Operating_S";
BA_ "SystemMessageLongSymbol" BO_ 2566488832 "VDMA_F983_ER_DC_DC_Converter_3_Control";
BA_ "SystemMessageLongSymbol" BO_ 2566489088 "VDMA_F984_ER_DC_DC_Converter_2_References";
BA_ "SystemMessageLongSymbol" BO_ 2566489344 "VDMA_F985_ER_DC_DC_Converter_2_Power_Limit";
BA_ "SystemMessageLongSymbol" BO_ 2566489600 "VDMA_F986_ER_DC_DC_Converter_2_Current_Lim";
BA_ "SystemMessageLongSymbol" BO_ 2566489856 "VDMA_F987_ER_DC_DC_Converter_2_Voltage_Lim";
BA_ "SystemMessageLongSymbol" BO_ 2566490112 "VDMA_F988_ER_DC_DC_Converter_2_Temperature";
BA_ "SystemMessageLongSymbol" BO_ 2566490368 "VDMA_F989_ER_DC_DC_Converter_2_Power_Limit";
BA_ "SystemMessageLongSymbol" BO_ 2566490624 "VDMA_F98A_ER_DC_DC_Converter_2_Current_Lim";
BA_ "SystemMessageLongSymbol" BO_ 2566490880 "VDMA_F98B_ER_DC_DC_Converter_2_Voltage_Lim";
BA_ "SystemMessageLongSymbol" BO_ 2566491136 "VDMA_F98C_ER_DC_DC_Converter_2_Low_Voltage";
BA_ "SystemMessageLongSymbol" BO_ 2566491392 "VDMA_F98D_ER_DC_DC_Converter_2_Power_and_C";
BA_ "SystemMessageLongSymbol" BO_ 2566491648 "VDMA_F98E_ER_DC_DC_Converter_2_Voltage_and";
BA_ "SystemMessageLongSymbol" BO_ 2566491904 "VDMA_F98F_ER_DC_DC_Converter_2_Operating_S";
BA_ "SystemMessageLongSymbol" BO_ 2566492160 "VDMA_F990_ER_DC_DC_Converter_2_Control";
BA_ "SystemMessageLongSymbol" BO_ 2566492416 "VDMA_F991_ER_DC_DC_Converter_1_References";
BA_ "SystemMessageLongSymbol" BO_ 2566492672 "VDMA_F992_ER_DC_DC_Converter_1_Power_Limit";
BA_ "SystemMessageLongSymbol" BO_ 2566492928 "VDMA_F993_ER_DC_DC_Converter_1_Current_Lim";
BA_ "SystemMessageLongSymbol" BO_ 2566493184 "VDMA_F994_ER_DC_DC_Converter_1_Voltage_Lim";
BA_ "SystemMessageLongSymbol" BO_ 2566493440 "VDMA_F995_ER_DC_DC_Converter_1_Temperature";
BA_ "SystemMessageLongSymbol" BO_ 2566493696 "VDMA_F996_ER_DC_DC_Converter_1_Power_Limit";
BA_ "SystemMessageLongSymbol" BO_ 2566493952 "VDMA_F997_ER_DC_DC_Converter_1_Current_Lim";
BA_ "SystemMessageLongSymbol" BO_ 2566494208 "VDMA_F998_ER_DC_DC_Converter_1_Voltage_Lim";
BA_ "SystemMessageLongSymbol" BO_ 2566494464 "VDMA_F999_ER_DC_DC_Converter_1_Low_Voltage";
BA_ "SystemMessageLongSymbol" BO_ 2566494720 "VDMA_F99A_ER_DC_DC_Converter_1_Power_and_C";
BA_ "SystemMessageLongSymbol" BO_ 2566494976 "VDMA_F99B_ER_DC_DC_Converter_1_Voltage_and";
BA_ "SystemMessageLongSymbol" BO_ 2566495232 "VDMA_F99C_ER_DC_DC_Converter_1_Operating_S";
BA_ "SystemMessageLongSymbol" BO_ 2566495488 "VDMA_F99D_ER_DC_DC_Converter_1_Control";
BA_ "SystemMessageLongSymbol" BO_ 2566495744 "VDMA_F99E_Cab_Air_Quality_System_Informati";
BA_ "SystemMessageLongSymbol" BO_ 2566496000 "VDMA_F99F_Cab_Air_Quality_System_Informati";
BA_ "SystemMessageLongSymbol" BO_ 2566496256 "VDMA_F9A0_Well_Stimulation_Pump_System_6";
BA_ "SystemMessageLongSymbol" BO_ 2566496512 "VDMA_F9A1_Engine_Fuel_Lube_Systems_4";
BA_ "SystemMessageLongSymbol" BO_ 2566497024 "VDMA_F9A3_Engine_Catalyst_Diverter_Actuato";
BA_ "SystemMessageLongSymbol" BO_ 2566497536 "VDMA_F9A5_Engine_Exhaust_Particulate_Contr";
BA_ "SystemMessageLongSymbol" BO_ 2566497792 "VDMA_F9A6_Engine_Exhaust_Particulate_Contr";
BA_ "SystemMessageLongSymbol" BO_ 2566498048 "VDMA_F9A7_Aftertreatment_System_Informatio";
BA_ "SystemMessageLongSymbol" BO_ 2566498304 "VDMA_F9A8_Aftertreatment_System_Informatio";
BA_ "SystemMessageLongSymbol" BO_ 2566498560 "VDMA_F9A9_Aftertreatment_System_Informatio";
BA_ "SystemMessageLongSymbol" BO_ 2566498816 "VDMA_F9AA_Aftertreatment_System_Informatio";
BA_ "SystemMessageLongSymbol" BO_ 2566499072 "VDMA_F9AB_Aftertreatment_System_Informatio";
BA_ "SystemMessageLongSymbol" BO_ 2566499328 "VDMA_F9AC_Aftertreatment_System_Informatio";
BA_ "SystemMessageLongSymbol" BO_ 2566499584 "VDMA_F9AD_Aftertreatment_System_Informatio";
BA_ "SystemMessageLongSymbol" BO_ 2566499840 "VDMA_F9AE_Aftertreatment_System_Informatio";
BA_ "SystemMessageLongSymbol" BO_ 2566500096 "VDMA_F9AF_Aftertreatment_System_Informatio";
BA_ "SystemMessageLongSymbol" BO_ 2566500352 "VDMA_F9B0_Aftertreatment_System_Informatio";
BA_ "SystemMessageLongSymbol" BO_ 2566500608 "VDMA_F9B1_Aftertreatment_System_Informatio";
BA_ "SystemMessageLongSymbol" BO_ 2566500864 "VDMA_F9B2_Aftertreatment_System_Informatio";
BA_ "SystemMessageLongSymbol" BO_ 2566501120 "VDMA_F9B3_Route_Attributes_Profile";
BA_ "SystemMessageLongSymbol" BO_ 2566501376 "VDMA_F9B4_Genset_Supporting_Functions_2";
BA_ "SystemMessageLongSymbol" BO_ 2566501632 "VDMA_F9B5_Alternator_Information_2";
BA_ "SystemMessageLongSymbol" BO_ 2566501888 "VDMA_F9B6_Well_Stimulation_Pump_System_5";
BA_ "SystemMessageLongSymbol" BO_ 2566502144 "VDMA_F9B7_Well_Stimulation_Pump_System_4";
BA_ "SystemMessageLongSymbol" BO_ 2566502912 "VDMA_F9BA_Route_Waypoint_GPS_Coordinates";
BA_ "SystemMessageLongSymbol" BO_ 2566503424 "VDMA_F9BC_Engine_Fluid_Level_Pressure_15";
BA_ "SystemMessageLongSymbol" BO_ 2566503680 "VDMA_F9BD_Fuel_Cell_System_Coolant_Informa";
BA_ "SystemMessageLongSymbol" BO_ 2566503936 "VDMA_F9BE_Transmission_Configuration_3";
BA_ "SystemMessageLongSymbol" BO_ 2566504448 "VDMA_F9C0_Fuel_Cell_System_Voltage_Limit_C";
BA_ "SystemMessageLongSymbol" BO_ 2566504960 "VDMA_F9C2_Hydrogen_System_Information";
BA_ "SystemMessageLongSymbol" BO_ 2566505216 "VDMA_F9C3_Auxiliary_Input_Output_Status_17";
BA_ "SystemMessageLongSymbol" BO_ 2566505472 "VDMA_F9C4_Auxiliary_Input_Output_Status_16";
BA_ "SystemMessageLongSymbol" BO_ 2566505728 "VDMA_F9C5_Auxiliary_Input_Output_Status_15";
BA_ "SystemMessageLongSymbol" BO_ 2566505984 "VDMA_F9C6_Auxiliary_Input_Output_Status_14";
BA_ "SystemMessageLongSymbol" BO_ 2566506240 "VDMA_F9C7_Auxiliary_Input_Output_Status_13";
BA_ "SystemMessageLongSymbol" BO_ 2566506496 "VDMA_F9C8_Auxiliary_Input_Output_Status_12";
BA_ "SystemMessageLongSymbol" BO_ 2566506752 "VDMA_F9C9_Auxiliary_Input_Output_Status_11";
BA_ "SystemMessageLongSymbol" BO_ 2566507008 "VDMA_F9CA_Auxiliary_Input_Output_Status_10";
BA_ "SystemMessageLongSymbol" BO_ 2566507264 "VDMA_F9CB_Auxiliary_Input_Output_Status_9";
BA_ "SystemMessageLongSymbol" BO_ 2566507520 "VDMA_F9CC_Auxiliary_Input_Output_Status_8";
BA_ "SystemMessageLongSymbol" BO_ 2566507776 "VDMA_F9CD_Aftertreatment_System_Informatio";
BA_ "SystemMessageLongSymbol" BO_ 2566509568 "VDMA_F9D4_Wheel_Brake_Lining_Remaining_Inf";
BA_ "SystemMessageLongSymbol" BO_ 2566509824 "VDMA_F9D5_Wheel_Brake_Lining_Remaining_Inf";
BA_ "SystemMessageLongSymbol" BO_ 2566510080 "VDMA_F9D6_High_Voltage_Bus_Contactor_Statu";
BA_ "SystemMessageLongSymbol" BO_ 2566510336 "VDMA_F9D7_High_Voltage_Bus_Contactor_Statu";
BA_ "SystemMessageLongSymbol" BO_ 2566510592 "VDMA_F9D8_High_Voltage_Bus_Connection_Comm";
BA_ "SystemMessageLongSymbol" BO_ 2566511104 "VDMA_F9DA_Service_Needed_DTC_Information";
BA_ "SystemMessageLongSymbol" BO_ 2566511616 "VDMA_F9DC_High_Voltage_Energy_Storage_Syst";
BA_ "SystemMessageLongSymbol" BO_ 2566511872 "VDMA_F9DD_High_Voltage_Energy_Storage_Syst";
BA_ "SystemMessageLongSymbol" BO_ 2566512128 "VDMA_F9DE_High_Voltage_Energy_Storage_Syst";
BA_ "SystemMessageLongSymbol" BO_ 2566512384 "VDMA_F9DF_HVESS_Coolant_Pump_1_Status_1";
BA_ "SystemMessageLongSymbol" BO_ 2566512640 "VDMA_F9E0_HVESS_Coolant_Pump_1_Command";
BA_ "SystemMessageLongSymbol" BO_ 2566512896 "VDMA_F9E1_HVESS_Coolant_Pump_2_Status_1";
BA_ "SystemMessageLongSymbol" BO_ 2566513152 "VDMA_F9E2_HVESS_Coolant_Pump_2_Command";
BA_ "SystemMessageLongSymbol" BO_ 2566513408 "VDMA_F9E3_Hydrogen_Sensor_Information";
BA_ "SystemMessageLongSymbol" BO_ 2566513664 "VDMA_F9E4_Operator_Inducement_Information_";
BA_ "SystemMessageLongSymbol" BO_ 2566513920 "VDMA_F9E5_Operator_Inducement_Vehicle_Spee";
BA_ "SystemMessageLongSymbol" BO_ 2566514176 "VDMA_F9E6_Operator_Inducement_Vehicle_Spee";
BA_ "SystemMessageLongSymbol" BO_ 2566514432 "VDMA_F9E7_Engine_Protection_Speed_Derate_I";
BA_ "SystemMessageLongSymbol" BO_ 2566514688 "VDMA_F9E8_Engine_Protection_Torque_Derate_";
BA_ "SystemMessageLongSymbol" BO_ 2566514944 "VDMA_F9E9_Aftertreatment_System_Informatio";
BA_ "SystemMessageLongSymbol" BO_ 2566515200 "VDMA_F9EA_SAE_J2012_3_Byte_DTC_Display";
BA_ "SystemMessageLongSymbol" BO_ 2566515456 "VDMA_F9EB_High_Voltage_Energy_Storage_Syst";
BA_ "SystemMessageLongSymbol" BO_ 2566515712 "VDMA_F9EC_High_Voltage_Energy_Storage_Syst";
BA_ "SystemMessageLongSymbol" BO_ 2566515968 "VDMA_F9ED_High_Voltage_Energy_Storage_Syst";
BA_ "SystemMessageLongSymbol" BO_ 2566516224 "VDMA_F9EE_Engine_Cylinder_Average_Ignition";
BA_ "SystemMessageLongSymbol" BO_ 2566516480 "VDMA_F9EF_Engine_Cylinder_Average_Ignition";
BA_ "SystemMessageLongSymbol" BO_ 2566516736 "VDMA_F9F0_Engine_Cylinder_Average_Ignition";
BA_ "SystemMessageLongSymbol" BO_ 2566516992 "VDMA_F9F1_Engine_Cylinder_Average_Ignition";
BA_ "SystemMessageLongSymbol" BO_ 2566517248 "VDMA_F9F2_Engine_Cylinder_Average_Ignition";
BA_ "SystemMessageLongSymbol" BO_ 2566517504 "VDMA_F9F3_Engine_Indicated_Mean_Effective_";
BA_ "SystemMessageLongSymbol" BO_ 2566517760 "VDMA_F9F4_Engine_Indicated_Mean_Effective_";
BA_ "SystemMessageLongSymbol" BO_ 2566518016 "VDMA_F9F5_Engine_Indicated_Mean_Effective_";
BA_ "SystemMessageLongSymbol" BO_ 2566518272 "VDMA_F9F6_Fuel_Cell_System_Coolant_Fan_1_C";
BA_ "SystemMessageLongSymbol" BO_ 2566518528 "VDMA_F9F7_Fuel_Cell_System_Coolant_Fan_1_S";
BA_ "SystemMessageLongSymbol" BO_ 2566518784 "VDMA_F9F8_Fuel_Cell_System_Coolant_Fan_2_C";
BA_ "SystemMessageLongSymbol" BO_ 2566519040 "VDMA_F9F9_Fuel_Cell_System_Coolant_Fan_2_S";
BA_ "SystemMessageLongSymbol" BO_ 2566519296 "VDMA_F9FA_Fuel_Cell_System_Coolant_Fan_3_C";
BA_ "SystemMessageLongSymbol" BO_ 2566519552 "VDMA_F9FB_Fuel_Cell_System_Coolant_Fan_3_S";
BA_ "SystemMessageLongSymbol" BO_ 2566519808 "VDMA_F9FC_Fuel_Cell_System_Coolant_Fan_4_C";
BA_ "SystemMessageLongSymbol" BO_ 2566520064 "VDMA_F9FD_Fuel_Cell_System_Coolant_Fan_4_S";
BA_ "SystemMessageLongSymbol" BO_ 2566520576 "VDMA_F9FF_Fuel_Cell_System_Configuration";
BA_ "SystemMessageLongSymbol" BO_ 2566520832 "VDMA_FA00_Fuel_Cell_System_Coolant_Informa";
BA_ "SystemMessageLongSymbol" BO_ 2566521088 "VDMA_FA01_Fuel_Cell_System_Coolant_Informa";
BA_ "SystemMessageLongSymbol" BO_ 2566523392 "VDMA_FA0A_Motor_Generator_1_Thermal_Perfor";
BA_ "SystemMessageLongSymbol" BO_ 2566523648 "VDMA_FA0B_Motor_Generator_2_Thermal_Perfor";
BA_ "SystemMessageLongSymbol" BO_ 2566523904 "VDMA_FA0C_Motor_Generator_3_Thermal_Perfor";
BA_ "SystemMessageLongSymbol" BO_ 2566524160 "VDMA_FA0D_Motor_Generator_4_Thermal_Perfor";
BA_ "SystemMessageLongSymbol" BO_ 2566524416 "VDMA_FA0E_Motor_Generator_5_Thermal_Perfor";
BA_ "SystemMessageLongSymbol" BO_ 2566524672 "VDMA_FA0F_Motor_Generator_6_Thermal_Perfor";
BA_ "SystemMessageLongSymbol" BO_ 2566524928 "VDMA_FA10_On_Board_Programming_Event_Time_";
BA_ "SystemMessageLongSymbol" BO_ 2566525184 "VDMA_FA11_Aftertreatment_1_Light_Off_SCR_S";
BA_ "SystemMessageLongSymbol" BO_ 2566525440 "VDMA_FA12_Motor_Generator_Location_Extende";
BA_ "SystemMessageLongSymbol" BO_ 2566525696 "VDMA_FA13_Cold_Start_Emissions_Reduction_S";
BA_ "SystemMessageLongSymbol" BO_ 2566525952 "VDMA_FA14_Cold_Start_Emissions_Reduction_S";
BA_ "SystemMessageLongSymbol" BO_ 2566526208 "VDMA_FA15_Genset_Supporting_Functions";
BA_ "SystemMessageLongSymbol" BO_ 2566526464 "VDMA_FA16_High_Voltage_Energy_Storage_Syst";
BA_ "SystemMessageLongSymbol" BO_ 2566526720 "VDMA_FA17_High_Voltage_Energy_Storage_Syst";
BA_ "SystemMessageLongSymbol" BO_ 2566526976 "VDMA_FA18_High_Voltage_Energy_Storage_Syst";
BA_ "SystemMessageLongSymbol" BO_ 2566527232 "VDMA_FA19_High_Voltage_Energy_Storage_Syst";
BA_ "SystemMessageLongSymbol" BO_ 2566527488 "VDMA_FA1A_Electronic_Engine_Controller_23";
BA_ "SystemMessageLongSymbol" BO_ 2566527744 "VDMA_FA1B_Electronic_Engine_Controller_24";
BA_ "SystemMessageLongSymbol" BO_ 2566528000 "VDMA_FA1C_Electronic_Engine_Controller_25";
BA_ "SystemMessageLongSymbol" BO_ 2566528256 "VDMA_FA1D_High_Voltage_Bus_Connection_Comm";
BA_ "SystemMessageLongSymbol" BO_ 2566528512 "VDMA_FA1E_High_Voltage_Bus_Contactor_Statu";
BA_ "SystemMessageLongSymbol" BO_ 2566528768 "VDMA_FA1F_Aftertreatment_System_Informatio";
BA_ "SystemMessageLongSymbol" BO_ 2566529024 "VDMA_FA20_EV_Multi_Connection_DC_Charging_";
BA_ "SystemMessageLongSymbol" BO_ 2566529280 "VDMA_FA21_EV_Multi_Connection_Charging_In_";
BA_ "SystemMessageLongSymbol" BO_ 2566529792 "VDMA_FA23_Motor_Generator_Location_obsolet";
BA_ "SystemMessageLongSymbol" BO_ 2566530048 "VDMA_FA24_High_Voltage_Energy_Storage_Syst";
BA_ "SystemMessageLongSymbol" BO_ 2566530304 "VDMA_FA25_High_Voltage_Energy_Storage_Syst";
BA_ "SystemMessageLongSymbol" BO_ 2566530560 "VDMA_FA26_High_Voltage_Energy_Storage_Syst";
BA_ "SystemMessageLongSymbol" BO_ 2566530816 "VDMA_FA27_High_Voltage_Energy_Storage_Pack";
BA_ "SystemMessageLongSymbol" BO_ 2566531072 "VDMA_FA28_High_Voltage_Energy_Storage_Pack";
BA_ "SystemMessageLongSymbol" BO_ 2566531328 "VDMA_FA29_High_Voltage_Energy_Storage_Pack";
BA_ "SystemMessageLongSymbol" BO_ 2566531584 "VDMA_FA2A_High_Voltage_Energy_Storage_Pack";
BA_ "SystemMessageLongSymbol" BO_ 2566531840 "VDMA_FA2B_High_Voltage_Energy_Storage_Pack";
BA_ "SystemMessageLongSymbol" BO_ 2566532096 "VDMA_FA2C_High_Voltage_Energy_Storage_Pack";
BA_ "SystemMessageLongSymbol" BO_ 2566532352 "VDMA_FA2D_High_Voltage_Energy_Storage_Pack";
BA_ "SystemMessageLongSymbol" BO_ 2566532608 "VDMA_FA2E_High_Voltage_Energy_Storage_Pack";
BA_ "SystemMessageLongSymbol" BO_ 2566532864 "VDMA_FA2F_High_Voltage_Energy_Storage_Pack";
BA_ "SystemMessageLongSymbol" BO_ 2566533120 "VDMA_FA30_High_Voltage_Energy_Storage_Pack";
BA_ "SystemMessageLongSymbol" BO_ 2566533376 "VDMA_FA31_High_Voltage_Energy_Storage_Pack";
BA_ "SystemMessageLongSymbol" BO_ 2566533632 "VDMA_FA32_High_Voltage_Energy_Storage_Pack";
BA_ "SystemMessageLongSymbol" BO_ 2566533888 "VDMA_FA33_Multi_Color_Indicator_Lamp_Comma";
BA_ "SystemMessageLongSymbol" BO_ 2566534144 "VDMA_FA34_Multi_Color_Indicator_Lamp_Statu";
BA_ "SystemMessageLongSymbol" BO_ 2566534400 "VDMA_FA35_Refuse_Truck_Body_Information";
BA_ "SystemMessageLongSymbol" BO_ 2566534656 "VDMA_FA36_Engine_Fluid_Level_Pressure_14";
BA_ "SystemMessageLongSymbol" BO_ 2566534912 "VDMA_FA37_Well_Stimulation_Transmission_Co";
BA_ "SystemMessageLongSymbol" BO_ 2566535168 "VDMA_FA38_Well_Stimulation_Pump_Protection";
BA_ "SystemMessageLongSymbol" BO_ 2566535424 "VDMA_FA39_Well_Stimulation_Pump_Protection";
BA_ "SystemMessageLongSymbol" BO_ 2566535680 "VDMA_FA3A_Electric_PTO_Drive_Engagement_1";
BA_ "SystemMessageLongSymbol" BO_ 2566535936 "VDMA_FA3B_Electric_PTO_1_Information";
BA_ "SystemMessageLongSymbol" BO_ 2566536192 "VDMA_FA3C_Engine_Exhaust_O2_Sensor_Informa";
BA_ "SystemMessageLongSymbol" BO_ 2566536448 "VDMA_FA3D_Gaseous_Fuel_Supply_Pressure_3";
BA_ "SystemMessageLongSymbol" BO_ 2566537216 "VDMA_FA40_Electronic_Transmission_Controll";
BA_ "SystemMessageLongSymbol" BO_ 2566537472 "VDMA_FA41_Automated_Driving_System_Network";
BA_ "SystemMessageLongSymbol" BO_ 2566537728 "VDMA_FA42_Automated_Driving_System_Network";
BA_ "SystemMessageLongSymbol" BO_ 2566537984 "VDMA_FA43_Hybrid_or_EV_System_Inputs_2";
BA_ "SystemMessageLongSymbol" BO_ 2566538240 "VDMA_FA44_Engine_Speed_Load_Factor_Informa";
BA_ "SystemMessageLongSymbol" BO_ 2566538496 "VDMA_FA45_Generator_Trip_Energy_2";
BA_ "SystemMessageLongSymbol" BO_ 2566538752 "VDMA_FA46_Security_System_Machine_Operatio";
BA_ "SystemMessageLongSymbol" BO_ 2566539008 "VDMA_FA47_Engine_Fuel_Actuator_Service_Mod";
BA_ "SystemMessageLongSymbol" BO_ 2566539264 "VDMA_FA48_Steering_Wheel_Controls";
BA_ "SystemMessageLongSymbol" BO_ 2566539776 "VDMA_FA4A_Extended_DTC_information";
BA_ "SystemMessageLongSymbol" BO_ 2566540032 "VDMA_FA4B_Aftertreatment_2_SCR_Dosing_Syst";
BA_ "SystemMessageLongSymbol" BO_ 2566540288 "VDMA_FA4C_Aftertreatment_1_SCR_Dosing_Syst";
BA_ "SystemMessageLongSymbol" BO_ 2566540800 "VDMA_FA4E_Automated_Driving_System_Status_";
BA_ "SystemMessageLongSymbol" BO_ 2566541056 "VDMA_FA4F_Automated_Driving_System_Control";
BA_ "SystemMessageLongSymbol" BO_ 2566542080 "VDMA_FA53_Genset_Enclosure_Ventilation";
BA_ "SystemMessageLongSymbol" BO_ 2566543360 "VDMA_FA58_Engine_Exhaust_Gas_Heat_Exchange";
BA_ "SystemMessageLongSymbol" BO_ 2566543616 "VDMA_FA59_Genset_Enclosure_Ventilation_Lou";
BA_ "SystemMessageLongSymbol" BO_ 2566543872 "VDMA_FA5A_Genset_External_Coolant_System";
BA_ "SystemMessageLongSymbol" BO_ 2566544384 "VDMA_FA5C_EVSE_DC_Charging_Limits_3";
BA_ "SystemMessageLongSymbol" BO_ 2566544640 "VDMA_FA5D_EVSE_Power_Max_Schedule";
BA_ "SystemMessageLongSymbol" BO_ 2566545152 "VDMA_FA5F_EV_DC_Charging_Limits_2";
BA_ "SystemMessageLongSymbol" BO_ 2566545408 "VDMA_FA60_EV_DC_Charging_In_Progress";
BA_ "SystemMessageLongSymbol" BO_ 2566546432 "VDMA_FA64_Aftertreatment_System_Informatio";
BA_ "SystemMessageLongSymbol" BO_ 2566546688 "VDMA_FA65_Aftertreatment_System_Informatio";
BA_ "SystemMessageLongSymbol" BO_ 2566546944 "VDMA_FA66_Aftertreatment_System_Informatio";
BA_ "SystemMessageLongSymbol" BO_ 2566547456 "VDMA_FA68_Power_Converter_2_Isolation_Inte";
BA_ "SystemMessageLongSymbol" BO_ 2566547712 "VDMA_FA69_Power_Converter_1_Isolation_Inte";
BA_ "SystemMessageLongSymbol" BO_ 2566547968 "VDMA_FA6A_Power_Converter_2_Limits_Request";
BA_ "SystemMessageLongSymbol" BO_ 2566548224 "VDMA_FA6B_Power_Converter_2_Limits_Request";
BA_ "SystemMessageLongSymbol" BO_ 2566548480 "VDMA_FA6C_Power_Converter_2_Limits_Request";
BA_ "SystemMessageLongSymbol" BO_ 2566548736 "VDMA_FA6D_Power_Converter_1_Limits_Request";
BA_ "SystemMessageLongSymbol" BO_ 2566548992 "VDMA_FA6E_Power_Converter_1_Limits_Request";
BA_ "SystemMessageLongSymbol" BO_ 2566549248 "VDMA_FA6F_Power_Converter_1_Limits_Request";
BA_ "SystemMessageLongSymbol" BO_ 2566549504 "VDMA_FA70_Inverter_1_Lifetime_Data";
BA_ "SystemMessageLongSymbol" BO_ 2566549760 "VDMA_FA71_Inverter_2_Lifetime_Data";
BA_ "SystemMessageLongSymbol" BO_ 2566550016 "VDMA_FA72_Power_Converter_2_Active_Power_L";
BA_ "SystemMessageLongSymbol" BO_ 2566550272 "VDMA_FA73_Power_Converter_1_Active_Power_L";
BA_ "SystemMessageLongSymbol" BO_ 2566550528 "VDMA_FA74_Power_Converter_2_Reference_1";
BA_ "SystemMessageLongSymbol" BO_ 2566550784 "VDMA_FA75_Power_Converter_2_Reference_2";
BA_ "SystemMessageLongSymbol" BO_ 2566551040 "VDMA_FA76_Power_Converter_2_Temperature";
BA_ "SystemMessageLongSymbol" BO_ 2566551296 "VDMA_FA77_Power_Converter_1_Temperature";
BA_ "SystemMessageLongSymbol" BO_ 2566551552 "VDMA_FA78_Power_Converter_1_Reference_2";
BA_ "SystemMessageLongSymbol" BO_ 2566551808 "VDMA_FA79_Power_Converter_1_Reference_1";
BA_ "SystemMessageLongSymbol" BO_ 2566552064 "VDMA_FA7A_Power_Converter_1_Phase_Current";
BA_ "SystemMessageLongSymbol" BO_ 2566552320 "VDMA_FA7B_Power_Converter_2_Phase_Current";
BA_ "SystemMessageLongSymbol" BO_ 2566552576 "VDMA_FA7C_Power_Converter_1_Phase_Voltage";
BA_ "SystemMessageLongSymbol" BO_ 2566552832 "VDMA_FA7D_Power_Converter_2_Phase_Voltage";
BA_ "SystemMessageLongSymbol" BO_ 2566553088 "VDMA_FA7E_Power_Converter_Power_Module_Swi";
BA_ "SystemMessageLongSymbol" BO_ 2566553344 "VDMA_FA7F_Power_Converter_1_Power_Module_S";
BA_ "SystemMessageLongSymbol" BO_ 2566553600 "VDMA_FA80_Power_Converter_2_Power_Module_S";
BA_ "SystemMessageLongSymbol" BO_ 2566553856 "VDMA_FA81_Power_Converter_Totals_1";
BA_ "SystemMessageLongSymbol" BO_ 2566554112 "VDMA_FA82_Transformer_Temperatures";
BA_ "SystemMessageLongSymbol" BO_ 2566554368 "VDMA_FA83_Electrified_Accessory_Engine_Coo";
BA_ "SystemMessageLongSymbol" BO_ 2566554624 "VDMA_FA84_High_Voltage_Energy_Storage_Pack";
BA_ "SystemMessageLongSymbol" BO_ 2566554880 "VDMA_FA85_High_Voltage_Energy_Storage_Pack";
BA_ "SystemMessageLongSymbol" BO_ 2566555136 "VDMA_FA86_High_Voltage_Energy_Storage_Pack";
BA_ "SystemMessageLongSymbol" BO_ 2566555392 "VDMA_FA87_High_Voltage_Energy_Storage_Pack";
BA_ "SystemMessageLongSymbol" BO_ 2566555648 "VDMA_FA88_High_Voltage_Energy_Storage_Pack";
BA_ "SystemMessageLongSymbol" BO_ 2566555904 "VDMA_FA89_High_Voltage_Energy_Storage_Pack";
BA_ "SystemMessageLongSymbol" BO_ 2566556160 "VDMA_FA8A_High_Voltage_Energy_Storage_Pack";
BA_ "SystemMessageLongSymbol" BO_ 2566556416 "VDMA_FA8B_High_Voltage_Energy_Storage_Pack";
BA_ "SystemMessageLongSymbol" BO_ 2566556672 "VDMA_FA8C_High_Voltage_Energy_Storage_Pack";
BA_ "SystemMessageLongSymbol" BO_ 2566556928 "VDMA_FA8D_High_Voltage_Energy_Storage_Pack";
BA_ "SystemMessageLongSymbol" BO_ 2566557184 "VDMA_FA8E_High_Voltage_Energy_Storage_Pack";
BA_ "SystemMessageLongSymbol" BO_ 2566557440 "VDMA_FA8F_High_Voltage_Energy_Storage_Pack";
BA_ "SystemMessageLongSymbol" BO_ 2566557696 "VDMA_FA90_High_Voltage_Energy_Storage_Pack";
BA_ "SystemMessageLongSymbol" BO_ 2566557952 "VDMA_FA91_High_Voltage_Energy_Storage_Pack";
BA_ "SystemMessageLongSymbol" BO_ 2566558208 "VDMA_FA92_High_Voltage_Energy_Storage_Pack";
BA_ "SystemMessageLongSymbol" BO_ 2566558464 "VDMA_FA93_High_Voltage_Energy_Storage_Pack";
BA_ "SystemMessageLongSymbol" BO_ 2566558720 "VDMA_FA94_High_Voltage_Energy_Storage_Pack";
BA_ "SystemMessageLongSymbol" BO_ 2566558976 "VDMA_FA95_High_Voltage_Energy_Storage_Pack";
BA_ "SystemMessageLongSymbol" BO_ 2566559232 "VDMA_FA96_High_Voltage_Energy_Storage_Pack";
BA_ "SystemMessageLongSymbol" BO_ 2566559488 "VDMA_FA97_High_Voltage_Energy_Storage_Pack";
BA_ "SystemMessageLongSymbol" BO_ 2566559744 "VDMA_FA98_High_Voltage_Energy_Storage_Pack";
BA_ "SystemMessageLongSymbol" BO_ 2566560000 "VDMA_FA99_High_Voltage_Energy_Storage_Pack";
BA_ "SystemMessageLongSymbol" BO_ 2566560256 "VDMA_FA9A_High_Voltage_Energy_Storage_Pack";
BA_ "SystemMessageLongSymbol" BO_ 2566560512 "VDMA_FA9B_High_Voltage_Energy_Storage_Pack";
BA_ "SystemMessageLongSymbol" BO_ 2566560768 "VDMA_FA9C_High_Voltage_Energy_Storage_Pack";
BA_ "SystemMessageLongSymbol" BO_ 2566561024 "VDMA_FA9D_High_Voltage_Energy_Storage_Pack";
BA_ "SystemMessageLongSymbol" BO_ 2566561280 "VDMA_FA9E_High_Voltage_Energy_Storage_Pack";
BA_ "SystemMessageLongSymbol" BO_ 2566561536 "VDMA_FA9F_High_Voltage_Energy_Storage_Pack";
BA_ "SystemMessageLongSymbol" BO_ 2566561792 "VDMA_FAA0_High_Voltage_Energy_Storage_Pack";
BA_ "SystemMessageLongSymbol" BO_ 2566562048 "VDMA_FAA1_High_Voltage_Energy_Storage_Pack";
BA_ "SystemMessageLongSymbol" BO_ 2566562304 "VDMA_FAA2_High_Voltage_Energy_Storage_Pack";
BA_ "SystemMessageLongSymbol" BO_ 2566562560 "VDMA_FAA3_High_Voltage_Energy_Storage_Pack";
BA_ "SystemMessageLongSymbol" BO_ 2566562816 "VDMA_FAA4_Automated_Driving_System_Control";
BA_ "SystemMessageLongSymbol" BO_ 2566564096 "VDMA_FAA9_Transmission_Shaft_Twist_Informa";
BA_ "SystemMessageLongSymbol" BO_ 2566564352 "VDMA_FAAA_Electronic_Auxiliary_Transmissio";
BA_ "SystemMessageLongSymbol" BO_ 2566564608 "VDMA_FAAB_High_Voltage_Energy_Storage_Pack";
BA_ "SystemMessageLongSymbol" BO_ 2566564864 "VDMA_FAAC_High_Voltage_Energy_Storage_Pack";
BA_ "SystemMessageLongSymbol" BO_ 2566565120 "VDMA_FAAD_High_Voltage_Energy_Storage_Pack";
