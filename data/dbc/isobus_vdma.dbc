VERSION "created by canmatrix"

NS_ :

BS_:

BU_:

BO_ 2566565376 VDMA_FAAE_High_Voltage_Energy_St: 8 Vector__XXX
 SG_ High_Voltage_Energy_Storage_Pack : 0|64@1+ (1,0) [0|18446744073709551615] "" Vector__XXX

BO_ 2566565632 VDMA_FAAF_High_Voltage_Energy_St: 8 Vector__XXX
 SG_ High_Voltage_Energy_Storage_Pack : 0|64@1+ (1,0) [0|18446744073709551615] "" Vector__XXX

BO_ 2566565888 VDMA_FAB0_High_Voltage_Energy_St: 8 Vector__XXX
 SG_ High_Voltage_Energy_Storage_Pack : 0|64@1+ (1,0) [0|18446744073709551615] "" Vector__XXX

BO_ 2566566144 VDMA_FAB1_High_Voltage_Energy_St: 8 Vector__XXX
 SG_ High_Voltage_Energy_Storage_Pack : 0|64@1+ (1,0) [0|18446744073709551615] "" Vector__XXX

BO_ 2566566400 VDMA_FAB2_High_Voltage_Energy_St: 8 Vector__XXX
 SG_ High_Voltage_Energy_Storage_Pack : 0|64@1+ (1,0) [0|18446744073709551615] "" Vector__XXX

BO_ 2566566656 VDMA_FAB3_AUTOSAR_Time_Synchroni: 8 Vector__XXX
 SG_ AUTOSAR_Time_Synchronization_Raw : 0|64@1+ (1,0) [0|18446744073709551615] "" Vector__XXX

BO_ 2566566912 VDMA_FAB4_EV_DC_Charging_Limits_: 8 Vector__XXX
 SG_ EV_DC_Charging_Limits_1_RawPaylo : 0|64@1+ (1,0) [0|18446744073709551615] "" Vector__XXX

BO_ 2566567168 VDMA_FAB5_EVSE_DC_Charging_Limit: 8 Vector__XXX
 SG_ EVSE_DC_Charging_Limits_1_RawPay : 0|64@1+ (1,0) [0|18446744073709551615] "" Vector__XXX

BO_ 2566567424 VDMA_FAB6_EVSE_DC_Charging_Limit: 8 Vector__XXX
 SG_ EVSE_DC_Charging_Limits_2_RawPay : 0|64@1+ (1,0) [0|18446744073709551615] "" Vector__XXX

BO_ 2566567680 VDMA_FAB7_EV_DC_Charging_Target: 8 Vector__XXX
 SG_ EV_DC_Charging_Target_RawPayload : 0|64@1+ (1,0) [0|18446744073709551615] "" Vector__XXX

BO_ 2566567936 VDMA_FAB8_EVSE_DC_Status_1: 8 Vector__XXX
 SG_ EVSE_DC_Status_1_RawPayload : 0|64@1+ (1,0) [0|18446744073709551615] "" Vector__XXX

BO_ 2566568192 VDMA_FAB9_EVSE_1_Contactor_Cmd_1: 8 Vector__XXX
 SG_ EVSE_1_Contactor_Cmd_1_RawPayloa : 0|64@1+ (1,0) [0|18446744073709551615] "" Vector__XXX

BO_ 2566568448 VDMA_FABA_EVSE_1_Contactor_Statu: 8 Vector__XXX
 SG_ EVSE_1_Contactor_Status_1_RawPay : 0|64@1+ (1,0) [0|18446744073709551615] "" Vector__XXX

BO_ 2566568704 VDMA_FABB_Direct_Lamp_Control_Co: 8 Vector__XXX
 SG_ Direct_Lamp_Control_Command_3_Ra : 0|64@1+ (1,0) [0|18446744073709551615] "" Vector__XXX

BO_ 2566568960 VDMA_FABC_Direct_Lamp_Control_Da: 8 Vector__XXX
 SG_ Direct_Lamp_Control_Data_3_RawPa : 0|64@1+ (1,0) [0|18446744073709551615] "" Vector__XXX

BO_ 2566569216 VDMA_FABD_Motor_Generator_1_Life: 8 Vector__XXX
 SG_ Motor_Generator_1_Lifetime_Data_ : 0|64@1+ (1,0) [0|18446744073709551615] "" Vector__XXX

BO_ 2566569472 VDMA_FABE_Motor_Generator_2_Life: 8 Vector__XXX
 SG_ Motor_Generator_2_Lifetime_Data_ : 0|64@1+ (1,0) [0|18446744073709551615] "" Vector__XXX

BO_ 2566569728 VDMA_FABF_Motor_Generator_3_Life: 8 Vector__XXX
 SG_ Motor_Generator_3_Lifetime_Data_ : 0|64@1+ (1,0) [0|18446744073709551615] "" Vector__XXX

BO_ 2566569984 VDMA_FAC0_Motor_Generator_4_Life: 8 Vector__XXX
 SG_ Motor_Generator_4_Lifetime_Data_ : 0|64@1+ (1,0) [0|18446744073709551615] "" Vector__XXX

BO_ 2566570240 VDMA_FAC1_Motor_Generator_5_Life: 8 Vector__XXX
 SG_ Motor_Generator_5_Lifetime_Data_ : 0|64@1+ (1,0) [0|18446744073709551615] "" Vector__XXX

BO_ 2566570496 VDMA_FAC2_Motor_Generator_6_Life: 8 Vector__XXX
 SG_ Motor_Generator_6_Lifetime_Data_ : 0|64@1+ (1,0) [0|18446744073709551615] "" Vector__XXX

BO_ 2566570752 VDMA_FAC3_Air_Supply_Pressure_3: 8 Vector__XXX
 SG_ Air_Supply_Pressure_3_RawPayload : 0|64@1+ (1,0) [0|18446744073709551615] "" Vector__XXX

BO_ 2566571008 VDMA_FAC4_EVSE_AC_Supply_Voltage: 8 Vector__XXX
 SG_ EVSE_AC_Supply_Voltage_RawPayloa : 0|64@1+ (1,0) [0|18446744073709551615] "" Vector__XXX

BO_ 2566571264 VDMA_FAC5_EVSE_AC_3_Phase_Load: 8 Vector__XXX
 SG_ EVSE_AC_3_Phase_Load_RawPayload : 0|64@1+ (1,0) [0|18446744073709551615] "" Vector__XXX

BO_ 2566571520 VDMA_FAC6_Electronic_Retarder_Co: 8 Vector__XXX
 SG_ Electronic_Retarder_Controller_3 : 0|64@1+ (1,0) [0|18446744073709551615] "" Vector__XXX

BO_ 2566572032 VDMA_FAC8_Electronic_Transmissio: 8 Vector__XXX
 SG_ Electronic_Transmission_Controll : 0|64@1+ (1,0) [0|18446744073709551615] "" Vector__XXX

BO_ 2566572800 VDMA_FACB_Collision_Avoidance_Sy: 8 Vector__XXX
 SG_ Collision_Avoidance_System_4_Raw : 0|64@1+ (1,0) [0|18446744073709551615] "" Vector__XXX

BO_ 2566573056 VDMA_FACC_Collision_Avoidance_Sy: 8 Vector__XXX
 SG_ Collision_Avoidance_System_3_Raw : 0|64@1+ (1,0) [0|18446744073709551615] "" Vector__XXX

BO_ 2566573312 VDMA_FACD_Aftertreatment_1_SCR_E: 8 Vector__XXX
 SG_ Aftertreatment_1_SCR_Exhaust_Gas : 0|64@1+ (1,0) [0|18446744073709551615] "" Vector__XXX

BO_ 2566573568 VDMA_FACE_PTO_Information_2: 8 Vector__XXX
 SG_ PTO_Information_2_RawPayload : 0|64@1+ (1,0) [0|18446744073709551615] "" Vector__XXX

BO_ 2566573824 VDMA_FACF_EVCC_Diagnostic_Data_1: 8 Vector__XXX
 SG_ EVCC_Diagnostic_Data_1_RawPayloa : 0|64@1+ (1,0) [0|18446744073709551615] "" Vector__XXX

BO_ 2566574080 VDMA_FAD0_Cab_Door_Control_2: 8 Vector__XXX
 SG_ Cab_Door_Control_2_RawPayload : 0|64@1+ (1,0) [0|18446744073709551615] "" Vector__XXX

BO_ 2566574336 VDMA_FAD1_Engine_Average_Informa: 8 Vector__XXX
 SG_ Engine_Average_Information_2_Raw : 0|64@1+ (1,0) [0|18446744073709551615] "" Vector__XXX

BO_ 2566574592 VDMA_FAD2_Turbocharger_Informati: 8 Vector__XXX
 SG_ Turbocharger_Information_9_RawPa : 0|64@1+ (1,0) [0|18446744073709551615] "" Vector__XXX

BO_ 2566574848 VDMA_FAD3_Automated_Driving_Syst: 8 Vector__XXX
 SG_ Automated_Driving_System_Control : 0|64@1+ (1,0) [0|18446744073709551615] "" Vector__XXX

BO_ 2566575104 VDMA_FAD4_EVSE_AC_Status_2: 8 Vector__XXX
 SG_ EVSE_AC_Status_2_RawPayload : 0|64@1+ (1,0) [0|18446744073709551615] "" Vector__XXX

BO_ 2566575360 VDMA_FAD5_EVSE_AC_Status_1: 8 Vector__XXX
 SG_ EVSE_AC_Status_1_RawPayload : 0|64@1+ (1,0) [0|18446744073709551615] "" Vector__XXX

BO_ 2566575616 VDMA_FAD6_EVSE_Status_1: 8 Vector__XXX
 SG_ EVSE_Status_1_RawPayload : 0|64@1+ (1,0) [0|18446744073709551615] "" Vector__XXX

BO_ 2566575872 VDMA_FAD7_Object_Detection_Messa: 8 Vector__XXX
 SG_ Object_Detection_Message_1_1_Raw : 0|64@1+ (1,0) [0|18446744073709551615] "" Vector__XXX

BO_ 2566576128 VDMA_FAD8_Object_Detection_Messa: 8 Vector__XXX
 SG_ Object_Detection_Message_2_1_Raw : 0|64@1+ (1,0) [0|18446744073709551615] "" Vector__XXX

BO_ 2566576384 VDMA_FAD9_Object_Detection_Messa: 8 Vector__XXX
 SG_ Object_Detection_Message_2_2_Raw : 0|64@1+ (1,0) [0|18446744073709551615] "" Vector__XXX

BO_ 2566576640 VDMA_FADA_Object_Detection_Messa: 8 Vector__XXX
 SG_ Object_Detection_Message_2_3_Raw : 0|64@1+ (1,0) [0|18446744073709551615] "" Vector__XXX

BO_ 2566576896 VDMA_FADB_Object_Detection_Messa: 8 Vector__XXX
 SG_ Object_Detection_Message_2_4_Raw : 0|64@1+ (1,0) [0|18446744073709551615] "" Vector__XXX

BO_ 2566577152 VDMA_FADC_Object_Detection_Messa: 8 Vector__XXX
 SG_ Object_Detection_Message_2_5_Raw : 0|64@1+ (1,0) [0|18446744073709551615] "" Vector__XXX

BO_ 2566577408 VDMA_FADD_Object_Detection_Messa: 8 Vector__XXX
 SG_ Object_Detection_Message_2_6_Raw : 0|64@1+ (1,0) [0|18446744073709551615] "" Vector__XXX

BO_ 2566577664 VDMA_FADE_Object_Detection_Messa: 8 Vector__XXX
 SG_ Object_Detection_Message_2_7_Raw : 0|64@1+ (1,0) [0|18446744073709551615] "" Vector__XXX

BO_ 2566577920 VDMA_FADF_Object_Detection_Messa: 8 Vector__XXX
 SG_ Object_Detection_Message_2_8_Raw : 0|64@1+ (1,0) [0|18446744073709551615] "" Vector__XXX

BO_ 2566578176 VDMA_FAE0_Object_Detection_Messa: 8 Vector__XXX
 SG_ Object_Detection_Message_2_9_Raw : 0|64@1+ (1,0) [0|18446744073709551615] "" Vector__XXX

BO_ 2566578432 VDMA_FAE1_Object_Detection_Messa: 8 Vector__XXX
 SG_ Object_Detection_Message_2_10_Ra : 0|64@1+ (1,0) [0|18446744073709551615] "" Vector__XXX

BO_ 2566578688 VDMA_FAE2_Object_Detection_Messa: 8 Vector__XXX
 SG_ Object_Detection_Message_2_11_Ra : 0|64@1+ (1,0) [0|18446744073709551615] "" Vector__XXX

BO_ 2566578944 VDMA_FAE3_Object_Detection_Messa: 8 Vector__XXX
 SG_ Object_Detection_Message_2_12_Ra : 0|64@1+ (1,0) [0|18446744073709551615] "" Vector__XXX

BO_ 2566579200 VDMA_FAE4_Object_Detection_Messa: 8 Vector__XXX
 SG_ Object_Detection_Message_2_13_Ra : 0|64@1+ (1,0) [0|18446744073709551615] "" Vector__XXX

BO_ 2566579456 VDMA_FAE5_Object_Detection_Messa: 8 Vector__XXX
 SG_ Object_Detection_Message_2_14_Ra : 0|64@1+ (1,0) [0|18446744073709551615] "" Vector__XXX

BO_ 2566579712 VDMA_FAE6_Object_Detection_Messa: 8 Vector__XXX
 SG_ Object_Detection_Message_2_15_Ra : 0|64@1+ (1,0) [0|18446744073709551615] "" Vector__XXX

BO_ 2566579968 VDMA_FAE7_Object_Detection_Messa: 8 Vector__XXX
 SG_ Object_Detection_Message_2_16_Ra : 0|64@1+ (1,0) [0|18446744073709551615] "" Vector__XXX

BO_ 2566580224 VDMA_FAE8_Object_Detection_Messa: 8 Vector__XXX
 SG_ Object_Detection_Message_2_17_Ra : 0|64@1+ (1,0) [0|18446744073709551615] "" Vector__XXX

BO_ 2566580480 VDMA_FAE9_Object_Detection_Messa: 8 Vector__XXX
 SG_ Object_Detection_Message_2_18_Ra : 0|64@1+ (1,0) [0|18446744073709551615] "" Vector__XXX

BO_ 2566580736 VDMA_FAEA_Object_Detection_Messa: 8 Vector__XXX
 SG_ Object_Detection_Message_2_19_Ra : 0|64@1+ (1,0) [0|18446744073709551615] "" Vector__XXX

BO_ 2566580992 VDMA_FAEB_Object_Detection_Messa: 8 Vector__XXX
 SG_ Object_Detection_Message_2_20_Ra : 0|64@1+ (1,0) [0|18446744073709551615] "" Vector__XXX

BO_ 2566581248 VDMA_FAEC_Object_Detection_Messa: 8 Vector__XXX
 SG_ Object_Detection_Message_2_21_Ra : 0|64@1+ (1,0) [0|18446744073709551615] "" Vector__XXX

BO_ 2566581504 VDMA_FAED_Temperature_Sensing_Mo: 8 Vector__XXX
 SG_ Temperature_Sensing_Module_1_Raw : 0|64@1+ (1,0) [0|18446744073709551615] "" Vector__XXX

BO_ 2566581760 VDMA_FAEE_Temperature_Sensing_Mo: 8 Vector__XXX
 SG_ Temperature_Sensing_Module_2_Raw : 0|64@1+ (1,0) [0|18446744073709551615] "" Vector__XXX

BO_ 2566582016 VDMA_FAEF_Aftertreatment_2_SCR_S: 8 Vector__XXX
 SG_ Aftertreatment_2_SCR_Service_Inf : 0|64@1+ (1,0) [0|18446744073709551615] "" Vector__XXX

BO_ 2566582272 VDMA_FAF0_Aftertreatment_1_SCR_S: 8 Vector__XXX
 SG_ Aftertreatment_1_SCR_Service_Inf : 0|64@1+ (1,0) [0|18446744073709551615] "" Vector__XXX

BO_ 2566582528 VDMA_FAF1_PSA_Times_Lifetime_Hou: 8 Vector__XXX
 SG_ PSA_Times_Lifetime_Hours_RawPayl : 0|64@1+ (1,0) [0|18446744073709551615] "" Vector__XXX

BO_ 2566582784 VDMA_FAF2_PSA_Times_Stored_100_H: 8 Vector__XXX
 SG_ PSA_Times_Stored_100_Hours_RawPa : 0|64@1+ (1,0) [0|18446744073709551615] "" Vector__XXX

BO_ 2566583040 VDMA_FAF3_PSA_Times_Active_100_H: 8 Vector__XXX
 SG_ PSA_Times_Active_100_Hours_RawPa : 0|64@1+ (1,0) [0|18446744073709551615] "" Vector__XXX

BO_ 2566583296 VDMA_FAF4_Hybrid_Charge_Depletin: 8 Vector__XXX
 SG_ Hybrid_Charge_Depleting_or_Incre : 0|64@1+ (1,0) [0|18446744073709551615] "" Vector__XXX

BO_ 2566583552 VDMA_FAF5_Hybrid_Charge_Depletin: 8 Vector__XXX
 SG_ Hybrid_Charge_Depleting_or_Incre : 0|64@1+ (1,0) [0|18446744073709551615] "" Vector__XXX

BO_ 2566583808 VDMA_FAF6_Hybrid_Charge_Depletin: 8 Vector__XXX
 SG_ Hybrid_Charge_Depleting_or_Incre : 0|64@1+ (1,0) [0|18446744073709551615] "" Vector__XXX

BO_ 2566584064 VDMA_FAF7_Aftertreatment_1_Histo: 8 Vector__XXX
 SG_ Aftertreatment_1_Historical_Info : 0|64@1+ (1,0) [0|18446744073709551615] "" Vector__XXX

BO_ 2566584320 VDMA_FAF8_Engine_Maximum_Net_Tor: 8 Vector__XXX
 SG_ Engine_Maximum_Net_Torque_Map_Ra : 0|64@1+ (1,0) [0|18446744073709551615] "" Vector__XXX

BO_ 2566584576 VDMA_FAF9_Aftertreatment_1_SCR_2: 8 Vector__XXX
 SG_ Aftertreatment_1_SCR_2_NOx_Mass_ : 0|64@1+ (1,0) [0|18446744073709551615] "" Vector__XXX

BO_ 2566584832 VDMA_FAFA_Aftertreatment_1_SCR_1: 8 Vector__XXX
 SG_ Aftertreatment_1_SCR_1_NOx_Mass_ : 0|64@1+ (1,0) [0|18446744073709551615] "" Vector__XXX

BO_ 2566585088 VDMA_FAFB_Evaporative_System_Pre: 8 Vector__XXX
 SG_ Evaporative_System_Pressure_and_ : 0|64@1+ (1,0) [0|18446744073709551615] "" Vector__XXX

BO_ 2566585344 VDMA_FAFC_GHG_Tracking_Lifetime_: 8 Vector__XXX
 SG_ GHG_Tracking_Lifetime_Array_Data : 0|64@1+ (1,0) [0|18446744073709551615] "" Vector__XXX

BO_ 2566585600 VDMA_FAFD_GHG_Tracking_Stored_10: 8 Vector__XXX
 SG_ GHG_Tracking_Stored_100_Hour_Arr : 0|64@1+ (1,0) [0|18446744073709551615] "" Vector__XXX

BO_ 2566585856 VDMA_FAFE_GHG_Tracking_Active_10: 8 Vector__XXX
 SG_ GHG_Tracking_Active_100_Hour_Arr : 0|64@1+ (1,0) [0|18446744073709551615] "" Vector__XXX

BO_ 2566586112 VDMA_FAFF_Green_House_Gas_Stored: 8 Vector__XXX
 SG_ Green_House_Gas_Stored_100_Hour_ : 0|64@1+ (1,0) [0|18446744073709551615] "" Vector__XXX

BO_ 2566586368 VDMA_FB00_Green_House_Gas_Active: 8 Vector__XXX
 SG_ Green_House_Gas_Active_100_Hour_ : 0|64@1+ (1,0) [0|18446744073709551615] "" Vector__XXX

BO_ 2566586624 VDMA_FB01_Green_House_Gas_Lifeti: 8 Vector__XXX
 SG_ Green_House_Gas_Lifetime_Active_ : 0|64@1+ (1,0) [0|18446744073709551615] "" Vector__XXX

BO_ 2566586880 VDMA_FB02_NOx_Tracking_Engine_Ac: 8 Vector__XXX
 SG_ NOx_Tracking_Engine_Activity_Lif : 0|64@1+ (1,0) [0|18446744073709551615] "" Vector__XXX

BO_ 2566587136 VDMA_FB03_NOx_Tracking_Engine_Ac: 8 Vector__XXX
 SG_ NOx_Tracking_Engine_Activity_Lif : 0|64@1+ (1,0) [0|18446744073709551615] "" Vector__XXX

BO_ 2566587392 VDMA_FB04_NOx_Tracking_Engine_Ac: 8 Vector__XXX
 SG_ NOx_Tracking_Engine_Activity_Lif : 0|64@1+ (1,0) [0|18446744073709551615] "" Vector__XXX

BO_ 2566587648 VDMA_FB05_NOx_Tracking_Engine_Ac: 8 Vector__XXX
 SG_ NOx_Tracking_Engine_Activity_Lif : 0|64@1+ (1,0) [0|18446744073709551615] "" Vector__XXX

BO_ 2566587904 VDMA_FB06_NOx_Tracking_Valid_NOx: 8 Vector__XXX
 SG_ NOx_Tracking_Valid_NOx_Lifetime_ : 0|64@1+ (1,0) [0|18446744073709551615] "" Vector__XXX

BO_ 2566588160 VDMA_FB07_NOx_Tracking_Valid_NOx: 8 Vector__XXX
 SG_ NOx_Tracking_Valid_NOx_Lifetime_ : 0|64@1+ (1,0) [0|18446744073709551615] "" Vector__XXX

BO_ 2566588416 VDMA_FB08_NOx_Tracking_Valid_NOx: 8 Vector__XXX
 SG_ NOx_Tracking_Valid_NOx_Lifetime_ : 0|64@1+ (1,0) [0|18446744073709551615] "" Vector__XXX

BO_ 2566588672 VDMA_FB09_NOx_Tracking_Valid_NOx: 8 Vector__XXX
 SG_ NOx_Tracking_Valid_NOx_Lifetime_ : 0|64@1+ (1,0) [0|18446744073709551615] "" Vector__XXX

BO_ 2566588928 VDMA_FB0A_NOx_Tracking_Valid_NOx: 8 Vector__XXX
 SG_ NOx_Tracking_Valid_NOx_Lifetime_ : 0|64@1+ (1,0) [0|18446744073709551615] "" Vector__XXX

BO_ 2566589184 VDMA_FB0B_NOx_Tracking_Valid_NOx: 8 Vector__XXX
 SG_ NOx_Tracking_Valid_NOx_Lifetime_ : 0|64@1+ (1,0) [0|18446744073709551615] "" Vector__XXX

BO_ 2566589440 VDMA_FB0C_NOx_Tracking_Stored_10: 8 Vector__XXX
 SG_ NOx_Tracking_Stored_100_Hour_Fue : 0|64@1+ (1,0) [0|18446744073709551615] "" Vector__XXX

BO_ 2566589696 VDMA_FB0D_NOx_Tracking_Stored_10: 8 Vector__XXX
 SG_ NOx_Tracking_Stored_100_Hour_Eng : 0|64@1+ (1,0) [0|18446744073709551615] "" Vector__XXX

BO_ 2566589952 VDMA_FB0E_NOx_Tracking_Stored_10: 8 Vector__XXX
 SG_ NOx_Tracking_Stored_100_Hour_Veh : 0|64@1+ (1,0) [0|18446744073709551615] "" Vector__XXX

BO_ 2566590208 VDMA_FB0F_NOx_Tracking_Stored_10: 8 Vector__XXX
 SG_ NOx_Tracking_Stored_100_Hour_Eng : 0|64@1+ (1,0) [0|18446744073709551615] "" Vector__XXX

BO_ 2566590464 VDMA_FB10_NOx_Tracking_Stored_10: 8 Vector__XXX
 SG_ NOx_Tracking_Stored_100_Hour_Eng : 0|64@1+ (1,0) [0|18446744073709551615] "" Vector__XXX

BO_ 2566590720 VDMA_FB11_NOx_Tracking_Stored_10: 8 Vector__XXX
 SG_ NOx_Tracking_Stored_100_Hour_Sys : 0|64@1+ (1,0) [0|18446744073709551615] "" Vector__XXX

BO_ 2566590976 VDMA_FB12_NOx_Tracking_Active_10: 8 Vector__XXX
 SG_ NOx_Tracking_Active_100_Hour_Fue : 0|64@1+ (1,0) [0|18446744073709551615] "" Vector__XXX

BO_ 2566591232 VDMA_FB13_NOx_Tracking_Active_10: 8 Vector__XXX
 SG_ NOx_Tracking_Active_100_Hour_Eng : 0|64@1+ (1,0) [0|18446744073709551615] "" Vector__XXX

BO_ 2566591488 VDMA_FB14_NOx_Tracking_Active_10: 8 Vector__XXX
 SG_ NOx_Tracking_Active_100_Hour_Veh : 0|64@1+ (1,0) [0|18446744073709551615] "" Vector__XXX

BO_ 2566591744 VDMA_FB15_NOx_Tracking_Active_10: 8 Vector__XXX
 SG_ NOx_Tracking_Active_100_Hour_Eng : 0|64@1+ (1,0) [0|18446744073709551615] "" Vector__XXX

BO_ 2566592000 VDMA_FB16_NOx_Tracking_Active_10: 8 Vector__XXX
 SG_ NOx_Tracking_Active_100_Hour_Eng : 0|64@1+ (1,0) [0|18446744073709551615] "" Vector__XXX

BO_ 2566592256 VDMA_FB17_NOx_Tracking_Active_10: 8 Vector__XXX
 SG_ NOx_Tracking_Active_100_Hour_Sys : 0|64@1+ (1,0) [0|18446744073709551615] "" Vector__XXX

BO_ 2566592512 VDMA_FB18_Motor_Generator_6_Inve: 8 Vector__XXX
 SG_ Motor_Generator_6_Inverter_Contr : 0|64@1+ (1,0) [0|18446744073709551615] "" Vector__XXX

BO_ 2566592768 VDMA_FB19_Motor_Generator_6_Inve: 8 Vector__XXX
 SG_ Motor_Generator_6_Inverter_Limit : 0|64@1+ (1,0) [0|18446744073709551615] "" Vector__XXX

BO_ 2566593024 VDMA_FB1A_Motor_Generator_6_Inve: 8 Vector__XXX
 SG_ Motor_Generator_6_Inverter_Limit : 0|64@1+ (1,0) [0|18446744073709551615] "" Vector__XXX

BO_ 2566593280 VDMA_FB1B_Motor_Generator_6_Inve: 8 Vector__XXX
 SG_ Motor_Generator_6_Inverter_Limit : 0|64@1+ (1,0) [0|18446744073709551615] "" Vector__XXX

BO_ 2566593536 VDMA_FB1C_Motor_Generator_6_Inve: 8 Vector__XXX
 SG_ Motor_Generator_6_Inverter_Isola : 0|64@1+ (1,0) [0|18446744073709551615] "" Vector__XXX

BO_ 2566593792 VDMA_FB1D_Motor_Generator_5_Inve: 8 Vector__XXX
 SG_ Motor_Generator_5_Inverter_Contr : 0|64@1+ (1,0) [0|18446744073709551615] "" Vector__XXX

BO_ 2566594048 VDMA_FB1E_Motor_Generator_5_Inve: 8 Vector__XXX
 SG_ Motor_Generator_5_Inverter_Limit : 0|64@1+ (1,0) [0|18446744073709551615] "" Vector__XXX

BO_ 2566594304 VDMA_FB1F_Motor_Generator_5_Inve: 8 Vector__XXX
 SG_ Motor_Generator_5_Inverter_Limit : 0|64@1+ (1,0) [0|18446744073709551615] "" Vector__XXX

BO_ 2566594560 VDMA_FB20_Motor_Generator_5_Inve: 8 Vector__XXX
 SG_ Motor_Generator_5_Inverter_Limit : 0|64@1+ (1,0) [0|18446744073709551615] "" Vector__XXX

BO_ 2566594816 VDMA_FB21_Motor_Generator_5_Inve: 8 Vector__XXX
 SG_ Motor_Generator_5_Inverter_Isola : 0|64@1+ (1,0) [0|18446744073709551615] "" Vector__XXX

BO_ 2566595072 VDMA_FB22_Motor_Generator_4_Inve: 8 Vector__XXX
 SG_ Motor_Generator_4_Inverter_Contr : 0|64@1+ (1,0) [0|18446744073709551615] "" Vector__XXX

BO_ 2566595328 VDMA_FB23_Motor_Generator_4_Inve: 8 Vector__XXX
 SG_ Motor_Generator_4_Inverter_Limit : 0|64@1+ (1,0) [0|18446744073709551615] "" Vector__XXX

BO_ 2566595584 VDMA_FB24_Motor_Generator_4_Inve: 8 Vector__XXX
 SG_ Motor_Generator_4_Inverter_Limit : 0|64@1+ (1,0) [0|18446744073709551615] "" Vector__XXX

BO_ 2566595840 VDMA_FB25_Motor_Generator_4_Inve: 8 Vector__XXX
 SG_ Motor_Generator_4_Inverter_Limit : 0|64@1+ (1,0) [0|18446744073709551615] "" Vector__XXX

BO_ 2566596096 VDMA_FB26_Motor_Generator_4_Inve: 8 Vector__XXX
 SG_ Motor_Generator_4_Inverter_Isola : 0|64@1+ (1,0) [0|18446744073709551615] "" Vector__XXX

BO_ 2566596352 VDMA_FB27_Motor_Generator_3_Inve: 8 Vector__XXX
 SG_ Motor_Generator_3_Inverter_Contr : 0|64@1+ (1,0) [0|18446744073709551615] "" Vector__XXX

BO_ 2566596608 VDMA_FB28_Motor_Generator_3_Inve: 8 Vector__XXX
 SG_ Motor_Generator_3_Inverter_Limit : 0|64@1+ (1,0) [0|18446744073709551615] "" Vector__XXX

BO_ 2566596864 VDMA_FB29_Motor_Generator_3_Inve: 8 Vector__XXX
 SG_ Motor_Generator_3_Inverter_Limit : 0|64@1+ (1,0) [0|18446744073709551615] "" Vector__XXX

BO_ 2566597120 VDMA_FB2A_Motor_Generator_3_Inve: 8 Vector__XXX
 SG_ Motor_Generator_3_Inverter_Limit : 0|64@1+ (1,0) [0|18446744073709551615] "" Vector__XXX

BO_ 2566597376 VDMA_FB2B_Motor_Generator_3_Inve: 8 Vector__XXX
 SG_ Motor_Generator_3_Inverter_Isola : 0|64@1+ (1,0) [0|18446744073709551615] "" Vector__XXX

BO_ 2566597632 VDMA_FB2C_Diagnostic_Readiness_4: 8 Vector__XXX
 SG_ Diagnostic_Readiness_4_RawPayloa : 0|64@1+ (1,0) [0|18446744073709551615] "" Vector__XXX

BO_ 2566597888 VDMA_FB2D_Turbocharger_Informati: 8 Vector__XXX
 SG_ Turbocharger_Information_8_RawPa : 0|64@1+ (1,0) [0|18446744073709551615] "" Vector__XXX

BO_ 2566598144 VDMA_FB2E_Winch_Information_2: 8 Vector__XXX
 SG_ Winch_Information_2_RawPayload : 0|64@1+ (1,0) [0|18446744073709551615] "" Vector__XXX

BO_ 2566598400 VDMA_FB2F_Motor_Generator_6_Inve: 8 Vector__XXX
 SG_ Motor_Generator_6_Inverter_Refer : 0|64@1+ (1,0) [0|18446744073709551615] "" Vector__XXX

BO_ 2566598656 VDMA_FB30_Motor_Generator_6_Inve: 8 Vector__XXX
 SG_ Motor_Generator_6_Inverter_Statu : 0|64@1+ (1,0) [0|18446744073709551615] "" Vector__XXX

BO_ 2566598912 VDMA_FB31_Motor_Generator_6_Inve: 8 Vector__XXX
 SG_ Motor_Generator_6_Inverter_Refer : 0|64@1+ (1,0) [0|18446744073709551615] "" Vector__XXX

BO_ 2566599168 VDMA_FB32_Motor_Generator_6_Inve: 8 Vector__XXX
 SG_ Motor_Generator_6_Inverter_Tempe : 0|64@1+ (1,0) [0|18446744073709551615] "" Vector__XXX

BO_ 2566599424 VDMA_FB33_Motor_Generator_6_Inve: 8 Vector__XXX
 SG_ Motor_Generator_6_Inverter_Motor : 0|64@1+ (1,0) [0|18446744073709551615] "" Vector__XXX

BO_ 2566599680 VDMA_FB34_Motor_Generator_6_Inve: 8 Vector__XXX
 SG_ Motor_Generator_6_Inverter_Isola : 0|64@1+ (1,0) [0|18446744073709551615] "" Vector__XXX

BO_ 2566599936 VDMA_FB35_Motor_Generator_6_Inve: 8 Vector__XXX
 SG_ Motor_Generator_6_Inverter_Activ : 0|64@1+ (1,0) [0|18446744073709551615] "" Vector__XXX

BO_ 2566600192 VDMA_FB36_Motor_Generator_5_Inve: 8 Vector__XXX
 SG_ Motor_Generator_5_Inverter_Refer : 0|64@1+ (1,0) [0|18446744073709551615] "" Vector__XXX

BO_ 2566600448 VDMA_FB37_Motor_Generator_5_Inve: 8 Vector__XXX
 SG_ Motor_Generator_5_Inverter_Statu : 0|64@1+ (1,0) [0|18446744073709551615] "" Vector__XXX

BO_ 2566600704 VDMA_FB38_Motor_Generator_5_Inve: 8 Vector__XXX
 SG_ Motor_Generator_5_Inverter_Refer : 0|64@1+ (1,0) [0|18446744073709551615] "" Vector__XXX

BO_ 2566600960 VDMA_FB39_Motor_Generator_5_Inve: 8 Vector__XXX
 SG_ Motor_Generator_5_Inverter_Tempe : 0|64@1+ (1,0) [0|18446744073709551615] "" Vector__XXX

BO_ 2566601216 VDMA_FB3A_Motor_Generator_5_Inve: 8 Vector__XXX
 SG_ Motor_Generator_5_Inverter_Motor : 0|64@1+ (1,0) [0|18446744073709551615] "" Vector__XXX

BO_ 2566601472 VDMA_FB3B_Motor_Generator_5_Inve: 8 Vector__XXX
 SG_ Motor_Generator_5_Inverter_Isola : 0|64@1+ (1,0) [0|18446744073709551615] "" Vector__XXX

BO_ 2566601728 VDMA_FB3C_Motor_Generator_5_Inve: 8 Vector__XXX
 SG_ Motor_Generator_5_Inverter_Activ : 0|64@1+ (1,0) [0|18446744073709551615] "" Vector__XXX

BO_ 2566601984 VDMA_FB3D_Motor_Generator_4_Inve: 8 Vector__XXX
 SG_ Motor_Generator_4_Inverter_Refer : 0|64@1+ (1,0) [0|18446744073709551615] "" Vector__XXX

BO_ 2566602240 VDMA_FB3E_Motor_Generator_4_Inve: 8 Vector__XXX
 SG_ Motor_Generator_4_Inverter_Statu : 0|64@1+ (1,0) [0|18446744073709551615] "" Vector__XXX

BO_ 2566602496 VDMA_FB3F_Motor_Generator_4_Inve: 8 Vector__XXX
 SG_ Motor_Generator_4_Inverter_Refer : 0|64@1+ (1,0) [0|18446744073709551615] "" Vector__XXX

BO_ 2566602752 VDMA_FB40_Motor_Generator_4_Inve: 8 Vector__XXX
 SG_ Motor_Generator_4_Inverter_Tempe : 0|64@1+ (1,0) [0|18446744073709551615] "" Vector__XXX

BO_ 2566603008 VDMA_FB41_Motor_Generator_4_Inve: 8 Vector__XXX
 SG_ Motor_Generator_4_Inverter_Motor : 0|64@1+ (1,0) [0|18446744073709551615] "" Vector__XXX

BO_ 2566603264 VDMA_FB42_Motor_Generator_4_Inve: 8 Vector__XXX
 SG_ Motor_Generator_4_Inverter_Isola : 0|64@1+ (1,0) [0|18446744073709551615] "" Vector__XXX

BO_ 2566603520 VDMA_FB43_Motor_Generator_4_Inve: 8 Vector__XXX
 SG_ Motor_Generator_4_Inverter_Activ : 0|64@1+ (1,0) [0|18446744073709551615] "" Vector__XXX

BO_ 2566603776 VDMA_FB44_Motor_Generator_3_Inve: 8 Vector__XXX
 SG_ Motor_Generator_3_Inverter_Refer : 0|64@1+ (1,0) [0|18446744073709551615] "" Vector__XXX

BO_ 2566604032 VDMA_FB45_Motor_Generator_3_Inve: 8 Vector__XXX
 SG_ Motor_Generator_3_Inverter_Statu : 0|64@1+ (1,0) [0|18446744073709551615] "" Vector__XXX

BO_ 2566604288 VDMA_FB46_Motor_Generator_3_Inve: 8 Vector__XXX
 SG_ Motor_Generator_3_Inverter_Refer : 0|64@1+ (1,0) [0|18446744073709551615] "" Vector__XXX

BO_ 2566604544 VDMA_FB47_Motor_Generator_3_Inve: 8 Vector__XXX
 SG_ Motor_Generator_3_Inverter_Tempe : 0|64@1+ (1,0) [0|18446744073709551615] "" Vector__XXX

BO_ 2566604800 VDMA_FB48_Motor_Generator_3_Inve: 8 Vector__XXX
 SG_ Motor_Generator_3_Inverter_Motor : 0|64@1+ (1,0) [0|18446744073709551615] "" Vector__XXX

BO_ 2566605056 VDMA_FB49_Motor_Generator_3_Inve: 8 Vector__XXX
 SG_ Motor_Generator_3_Inverter_Isola : 0|64@1+ (1,0) [0|18446744073709551615] "" Vector__XXX

BO_ 2566605312 VDMA_FB4A_Motor_Generator_3_Inve: 8 Vector__XXX
 SG_ Motor_Generator_3_Inverter_Activ : 0|64@1+ (1,0) [0|18446744073709551615] "" Vector__XXX

BO_ 2566605568 VDMA_FB4B_Automated_Driving_Syst: 8 Vector__XXX
 SG_ Automated_Driving_System_Status_ : 0|64@1+ (1,0) [0|18446744073709551615] "" Vector__XXX

BO_ 2566605824 VDMA_FB4C_Cab_Climate_System_Inf: 8 Vector__XXX
 SG_ Cab_Climate_System_Information_2 : 0|64@1+ (1,0) [0|18446744073709551615] "" Vector__XXX

BO_ 2566606080 VDMA_FB4D_Maintenance_Informatio: 8 Vector__XXX
 SG_ Maintenance_Information_1_RawPay : 0|64@1+ (1,0) [0|18446744073709551615] "" Vector__XXX

BO_ 2566606336 VDMA_FB4E_Hoist_Control_Informat: 8 Vector__XXX
 SG_ Hoist_Control_Information_RawPay : 0|64@1+ (1,0) [0|18446744073709551615] "" Vector__XXX

BO_ 2566606592 VDMA_FB4F_High_Voltage_Energy_St: 8 Vector__XXX
 SG_ High_Voltage_Energy_Storage_Pack : 0|64@1+ (1,0) [0|18446744073709551615] "" Vector__XXX

BO_ 2566606848 VDMA_FB50_High_Voltage_Energy_St: 8 Vector__XXX
 SG_ High_Voltage_Energy_Storage_Pack : 0|64@1+ (1,0) [0|18446744073709551615] "" Vector__XXX

BO_ 2566607104 VDMA_FB51_High_Voltage_Energy_St: 8 Vector__XXX
 SG_ High_Voltage_Energy_Storage_Pack : 0|64@1+ (1,0) [0|18446744073709551615] "" Vector__XXX

BO_ 2566607360 VDMA_FB52_High_Voltage_Energy_St: 8 Vector__XXX
 SG_ High_Voltage_Energy_Storage_Pack : 0|64@1+ (1,0) [0|18446744073709551615] "" Vector__XXX

BO_ 2566607616 VDMA_FB53_High_Voltage_Energy_St: 8 Vector__XXX
 SG_ High_Voltage_Energy_Storage_Pack : 0|64@1+ (1,0) [0|18446744073709551615] "" Vector__XXX

BO_ 2566607872 VDMA_FB54_High_Voltage_Energy_St: 8 Vector__XXX
 SG_ High_Voltage_Energy_Storage_Pack : 0|64@1+ (1,0) [0|18446744073709551615] "" Vector__XXX

BO_ 2566608128 VDMA_FB55_High_Voltage_Energy_St: 8 Vector__XXX
 SG_ High_Voltage_Energy_Storage_Pack : 0|64@1+ (1,0) [0|18446744073709551615] "" Vector__XXX

BO_ 2566608384 VDMA_FB56_High_Voltage_Energy_St: 8 Vector__XXX
 SG_ High_Voltage_Energy_Storage_Pack : 0|64@1+ (1,0) [0|18446744073709551615] "" Vector__XXX

BO_ 2566608640 VDMA_FB57_High_Voltage_Energy_St: 8 Vector__XXX
 SG_ High_Voltage_Energy_Storage_Pack : 0|64@1+ (1,0) [0|18446744073709551615] "" Vector__XXX

BO_ 2566608896 VDMA_FB58_High_Voltage_Energy_St: 8 Vector__XXX
 SG_ High_Voltage_Energy_Storage_Pack : 0|64@1+ (1,0) [0|18446744073709551615] "" Vector__XXX

BO_ 2566609152 VDMA_FB59_High_Voltage_Energy_St: 8 Vector__XXX
 SG_ High_Voltage_Energy_Storage_Pack : 0|64@1+ (1,0) [0|18446744073709551615] "" Vector__XXX

BO_ 2566609408 VDMA_FB5A_High_Voltage_Energy_St: 8 Vector__XXX
 SG_ High_Voltage_Energy_Storage_Pack : 0|64@1+ (1,0) [0|18446744073709551615] "" Vector__XXX

BO_ 2566609664 VDMA_FB5B_Vehicle_Fire_Suppressi: 8 Vector__XXX
 SG_ Vehicle_Fire_Suppression_System_ : 0|64@1+ (1,0) [0|18446744073709551615] "" Vector__XXX

BO_ 2566609920 VDMA_FB5C_Vehicle_Fire_Suppressi: 8 Vector__XXX
 SG_ Vehicle_Fire_Suppression_System_ : 0|64@1+ (1,0) [0|18446744073709551615] "" Vector__XXX

BO_ 2566610176 VDMA_FB5D_Vehicle_Fire_Suppressi: 8 Vector__XXX
 SG_ Vehicle_Fire_Suppression_System_ : 0|64@1+ (1,0) [0|18446744073709551615] "" Vector__XXX

BO_ 2566610432 VDMA_FB5E_Vehicle_Fire_Suppressi: 8 Vector__XXX
 SG_ Vehicle_Fire_Suppression_System_ : 0|64@1+ (1,0) [0|18446744073709551615] "" Vector__XXX

BO_ 2566610688 VDMA_FB5F_Vehicle_Fire_Suppressi: 8 Vector__XXX
 SG_ Vehicle_Fire_Suppression_System_ : 0|64@1+ (1,0) [0|18446744073709551615] "" Vector__XXX

BO_ 2566610944 VDMA_FB60_Vehicle_Fire_Suppressi: 8 Vector__XXX
 SG_ Vehicle_Fire_Suppression_System_ : 0|64@1+ (1,0) [0|18446744073709551615] "" Vector__XXX

BO_ 2566611200 VDMA_FB61_Vehicle_Fire_Suppressi: 8 Vector__XXX
 SG_ Vehicle_Fire_Suppression_System_ : 0|64@1+ (1,0) [0|18446744073709551615] "" Vector__XXX

BO_ 2566611456 VDMA_FB62_Vehicle_Fire_Suppressi: 8 Vector__XXX
 SG_ Vehicle_Fire_Suppression_System_ : 0|64@1+ (1,0) [0|18446744073709551615] "" Vector__XXX

BO_ 2566611712 VDMA_FB63_Vehicle_Fire_Suppressi: 8 Vector__XXX
 SG_ Vehicle_Fire_Suppression_System_ : 0|64@1+ (1,0) [0|18446744073709551615] "" Vector__XXX

BO_ 2566611968 VDMA_FB64_Vehicle_Fire_Suppressi: 8 Vector__XXX
 SG_ Vehicle_Fire_Suppression_System_ : 0|64@1+ (1,0) [0|18446744073709551615] "" Vector__XXX

BO_ 2566612224 VDMA_FB65_Vehicle_Fire_Suppressi: 8 Vector__XXX
 SG_ Vehicle_Fire_Suppression_System_ : 0|64@1+ (1,0) [0|18446744073709551615] "" Vector__XXX

BO_ 2566612480 VDMA_FB66_Vehicle_Fire_Suppressi: 8 Vector__XXX
 SG_ Vehicle_Fire_Suppression_System_ : 0|64@1+ (1,0) [0|18446744073709551615] "" Vector__XXX

BO_ 2566612736 VDMA_FB67_Motor_Generator_2_Inve: 8 Vector__XXX
 SG_ Motor_Generator_2_Inverter_Activ : 0|64@1+ (1,0) [0|18446744073709551615] "" Vector__XXX

BO_ 2566612992 VDMA_FB68_Motor_Generator_2_Inve: 8 Vector__XXX
 SG_ Motor_Generator_2_Inverter_Isola : 0|64@1+ (1,0) [0|18446744073709551615] "" Vector__XXX

BO_ 2566613248 VDMA_FB69_Motor_Generator_1_Inve: 8 Vector__XXX
 SG_ Motor_Generator_1_Inverter_Activ : 0|64@1+ (1,0) [0|18446744073709551615] "" Vector__XXX

BO_ 2566613504 VDMA_FB6A_Motor_Generator_1_Inve: 8 Vector__XXX
 SG_ Motor_Generator_1_Inverter_Isola : 0|64@1+ (1,0) [0|18446744073709551615] "" Vector__XXX

BO_ 2566613760 VDMA_FB6B_High_Voltage_Bus_Infor: 8 Vector__XXX
 SG_ High_Voltage_Bus_Information_Raw : 0|64@1+ (1,0) [0|18446744073709551615] "" Vector__XXX

BO_ 2566614016 VDMA_FB6C_Motor_Generator_2_Inve: 8 Vector__XXX
 SG_ Motor_Generator_2_Inverter_Refer : 0|64@1+ (1,0) [0|18446744073709551615] "" Vector__XXX

BO_ 2566614272 VDMA_FB6D_Motor_Generator_2_Inve: 8 Vector__XXX
 SG_ Motor_Generator_2_Inverter_Statu : 0|64@1+ (1,0) [0|18446744073709551615] "" Vector__XXX

BO_ 2566614528 VDMA_FB6E_Motor_Generator_2_Inve: 8 Vector__XXX
 SG_ Motor_Generator_2_Inverter_Refer : 0|64@1+ (1,0) [0|18446744073709551615] "" Vector__XXX

BO_ 2566614784 VDMA_FB6F_Motor_Generator_2_Inve: 8 Vector__XXX
 SG_ Motor_Generator_2_Inverter_Tempe : 0|64@1+ (1,0) [0|18446744073709551615] "" Vector__XXX

BO_ 2566615040 VDMA_FB70_Motor_Generator_2_Inve: 8 Vector__XXX
 SG_ Motor_Generator_2_Inverter_Motor : 0|64@1+ (1,0) [0|18446744073709551615] "" Vector__XXX

BO_ 2566615296 VDMA_FB71_Motor_Generator_1_Inve: 8 Vector__XXX
 SG_ Motor_Generator_1_Inverter_Motor : 0|64@1+ (1,0) [0|18446744073709551615] "" Vector__XXX

BO_ 2566615552 VDMA_FB72_Motor_Generator_1_Inve: 8 Vector__XXX
 SG_ Motor_Generator_1_Inverter_Tempe : 0|64@1+ (1,0) [0|18446744073709551615] "" Vector__XXX

BO_ 2566615808 VDMA_FB73_Motor_Generator_1_Inve: 8 Vector__XXX
 SG_ Motor_Generator_1_Inverter_Refer : 0|64@1+ (1,0) [0|18446744073709551615] "" Vector__XXX

BO_ 2566616064 VDMA_FB74_Motor_Generator_1_Inve: 8 Vector__XXX
 SG_ Motor_Generator_1_Inverter_Statu : 0|64@1+ (1,0) [0|18446744073709551615] "" Vector__XXX

BO_ 2566616320 VDMA_FB75_Motor_Generator_1_Inve: 8 Vector__XXX
 SG_ Motor_Generator_1_Inverter_Refer : 0|64@1+ (1,0) [0|18446744073709551615] "" Vector__XXX

BO_ 2566616576 VDMA_FB76_Personnel_Detect_Statu: 8 Vector__XXX
 SG_ Personnel_Detect_Status_RawPaylo : 0|64@1+ (1,0) [0|18446744073709551615] "" Vector__XXX

BO_ 2566616832 VDMA_FB77_Engine_Cylinder_Pressu: 8 Vector__XXX
 SG_ Engine_Cylinder_Pressure_Gamma_1 : 0|64@1+ (1,0) [0|18446744073709551615] "" Vector__XXX

BO_ 2566617088 VDMA_FB78_Engine_Cylinder_Pressu: 8 Vector__XXX
 SG_ Engine_Cylinder_Pressure_Gamma_2 : 0|64@1+ (1,0) [0|18446744073709551615] "" Vector__XXX

BO_ 2566617344 VDMA_FB79_Engine_Cylinder_Pressu: 8 Vector__XXX
 SG_ Engine_Cylinder_Pressure_Gamma_3 : 0|64@1+ (1,0) [0|18446744073709551615] "" Vector__XXX

BO_ 2566617600 VDMA_FB7A_Engine_Cylinder_Pressu: 8 Vector__XXX
 SG_ Engine_Cylinder_Pressure_Gamma_4 : 0|64@1+ (1,0) [0|18446744073709551615] "" Vector__XXX

BO_ 2566617856 VDMA_FB7B_Engine_Cylinder_Pressu: 8 Vector__XXX
 SG_ Engine_Cylinder_Pressure_Gamma_5 : 0|64@1+ (1,0) [0|18446744073709551615] "" Vector__XXX

BO_ 2566618112 VDMA_FB7C_Wake_Up_and_Sleep: 8 Vector__XXX
 SG_ Wake_Up_and_Sleep_RawPayload : 0|64@1+ (1,0) [0|18446744073709551615] "" Vector__XXX

BO_ 2566618368 VDMA_FB7D_Electrified_Accessory_: 8 Vector__XXX
 SG_ Electrified_Accessory_Generator_ : 0|64@1+ (1,0) [0|18446744073709551615] "" Vector__XXX

BO_ 2566618624 VDMA_FB7E_Electrified_Accessory_: 8 Vector__XXX
 SG_ Electrified_Accessory_Generator_ : 0|64@1+ (1,0) [0|18446744073709551615] "" Vector__XXX

BO_ 2566618880 VDMA_FB7F_Well_Stimulation_Pump_: 8 Vector__XXX
 SG_ Well_Stimulation_Pump_System_Fil : 0|64@1+ (1,0) [0|18446744073709551615] "" Vector__XXX

BO_ 2566619136 VDMA_FB80_PTO_Governor_Configura: 8 Vector__XXX
 SG_ PTO_Governor_Configuration_RawPa : 0|64@1+ (1,0) [0|18446744073709551615] "" Vector__XXX

BO_ 2566619392 VDMA_FB81_On_Board_Programming_2: 8 Vector__XXX
 SG_ On_Board_Programming_2_RawPayloa : 0|64@1+ (1,0) [0|18446744073709551615] "" Vector__XXX

BO_ 2566619648 VDMA_FB82_Primary_or_Rear_Hitch_: 8 Vector__XXX
 SG_ Primary_or_Rear_Hitch_Yaw_RawPay : 0|64@1+ (1,0) [0|18446744073709551615] "" Vector__XXX

BO_ 2566619904 VDMA_FB83_Secondary_or_Front_Hit: 8 Vector__XXX
 SG_ Secondary_or_Front_Hitch_Yaw_Raw : 0|64@1+ (1,0) [0|18446744073709551615] "" Vector__XXX

BO_ 2566620160 VDMA_FB84_Operator_Status: 8 Vector__XXX
 SG_ Operator_Status_RawPayload : 0|64@1+ (1,0) [0|18446744073709551615] "" Vector__XXX

BO_ 2566620416 VDMA_FB85_Engine_Idle_Management: 8 Vector__XXX
 SG_ Engine_Idle_Management_Informati : 0|64@1+ (1,0) [0|18446744073709551615] "" Vector__XXX

BO_ 2566620672 VDMA_FB86_Alcohol_Interlock_To_V: 8 Vector__XXX
 SG_ Alcohol_Interlock_To_Vehicle_Raw : 0|64@1+ (1,0) [0|18446744073709551615] "" Vector__XXX

BO_ 2566620928 VDMA_FB87_Vehicle_To_Alcohol_Int: 8 Vector__XXX
 SG_ Vehicle_To_Alcohol_Interlock_Raw : 0|64@1+ (1,0) [0|18446744073709551615] "" Vector__XXX

BO_ 2566621184 VDMA_FB88_Marine_Control_Informa: 8 Vector__XXX
 SG_ Marine_Control_Information_3_Raw : 0|64@1+ (1,0) [0|18446744073709551615] "" Vector__XXX

BO_ 2566621440 VDMA_FB89_Engine_Fluid_Level_Pre: 8 Vector__XXX
 SG_ Engine_Fluid_Level_Pressure_13_R : 0|64@1+ (1,0) [0|18446744073709551615] "" Vector__XXX

BO_ 2566621696 VDMA_FB8A_High_Voltage_Energy_St: 8 Vector__XXX
 SG_ High_Voltage_Energy_Storage_Syst : 0|64@1+ (1,0) [0|18446744073709551615] "" Vector__XXX

BO_ 2566621952 VDMA_FB8B_Economy_Mode_Inactive_: 8 Vector__XXX
 SG_ Economy_Mode_Inactive_Hours_RawP : 0|64@1+ (1,0) [0|18446744073709551615] "" Vector__XXX

BO_ 2566622208 VDMA_FB8C_Economy_Mode_Estimated: 8 Vector__XXX
 SG_ Economy_Mode_Estimated_Instantan : 0|64@1+ (1,0) [0|18446744073709551615] "" Vector__XXX

BO_ 2566622464 VDMA_FB8D_Economy_Mode_Active_Ho: 8 Vector__XXX
 SG_ Economy_Mode_Active_Hours_RawPay : 0|64@1+ (1,0) [0|18446744073709551615] "" Vector__XXX

BO_ 2566622720 VDMA_FB8E_Economy_Mode_Fuel_Used: 8 Vector__XXX
 SG_ Economy_Mode_Fuel_Used_RawPayloa : 0|64@1+ (1,0) [0|18446744073709551615] "" Vector__XXX

BO_ 2566622976 VDMA_FB8F_Economy_Mode_Estimated: 8 Vector__XXX
 SG_ Economy_Mode_Estimated_Fuel_Savi : 0|64@1+ (1,0) [0|18446744073709551615] "" Vector__XXX

BO_ 2566623232 VDMA_FB90_DC_DC_Converter_4_Volt: 8 Vector__XXX
 SG_ DC_DC_Converter_4_Voltage_RawPay : 0|64@1+ (1,0) [0|18446744073709551615] "" Vector__XXX

BO_ 2566623488 VDMA_FB91_DC_DC_Converter_3_Volt: 8 Vector__XXX
 SG_ DC_DC_Converter_3_Voltage_RawPay : 0|64@1+ (1,0) [0|18446744073709551615] "" Vector__XXX

BO_ 2566623744 VDMA_FB92_DC_DC_Converter_2_Volt: 8 Vector__XXX
 SG_ DC_DC_Converter_2_Voltage_RawPay : 0|64@1+ (1,0) [0|18446744073709551615] "" Vector__XXX

BO_ 2566624000 VDMA_FB93_DC_DC_Converter_1_Volt: 8 Vector__XXX
 SG_ DC_DC_Converter_1_Voltage_RawPay : 0|64@1+ (1,0) [0|18446744073709551615] "" Vector__XXX

BO_ 2566624256 VDMA_FB94_Electronic_Engine_Cont: 8 Vector__XXX
 SG_ Electronic_Engine_Controller_22_ : 0|64@1+ (1,0) [0|18446744073709551615] "" Vector__XXX

BO_ 2566624512 VDMA_FB95_Engine_Hours_2: 8 Vector__XXX
 SG_ Engine_Hours_2_RawPayload : 0|64@1+ (1,0) [0|18446744073709551615] "" Vector__XXX

BO_ 2566624768 VDMA_FB96_Engine_Information_3: 8 Vector__XXX
 SG_ Engine_Information_3_RawPayload : 0|64@1+ (1,0) [0|18446744073709551615] "" Vector__XXX

BO_ 2566625024 VDMA_FB97_Vehicle_Electrical_Pow: 8 Vector__XXX
 SG_ Vehicle_Electrical_Power_15_RawP : 0|64@1+ (1,0) [0|18446744073709551615] "" Vector__XXX

BO_ 2566625280 VDMA_FB98_Exhaust_Oxygen_2: 8 Vector__XXX
 SG_ Exhaust_Oxygen_2_RawPayload : 0|64@1+ (1,0) [0|18446744073709551615] "" Vector__XXX

BO_ 2566625536 VDMA_FB99_DC_AC_Accessory_Invert: 8 Vector__XXX
 SG_ DC_AC_Accessory_Inverter_1_Tempe : 0|64@1+ (1,0) [0|18446744073709551615] "" Vector__XXX

BO_ 2566625792 VDMA_FB9A_DC_AC_Accessory_Invert: 8 Vector__XXX
 SG_ DC_AC_Accessory_Inverter_1_DC_Si : 0|64@1+ (1,0) [0|18446744073709551615] "" Vector__XXX

BO_ 2566626048 VDMA_FB9B_DC_AC_Accessory_Invert: 8 Vector__XXX
 SG_ DC_AC_Accessory_Inverter_1_AC_Si : 0|64@1+ (1,0) [0|18446744073709551615] "" Vector__XXX

BO_ 2566626304 VDMA_FB9C_DC_AC_Accessory_Invert: 8 Vector__XXX
 SG_ DC_AC_Accessory_Inverter_1_Confi : 0|64@1+ (1,0) [0|18446744073709551615] "" Vector__XXX

BO_ 2566626560 VDMA_FB9D_DC_AC_Accessory_Invert: 8 Vector__XXX
 SG_ DC_AC_Accessory_Inverter_1_Lifet : 0|64@1+ (1,0) [0|18446744073709551615] "" Vector__XXX

BO_ 2566626816 VDMA_FB9E_DC_AC_Accessory_Invert: 8 Vector__XXX
 SG_ DC_AC_Accessory_Inverter_2_Tempe : 0|64@1+ (1,0) [0|18446744073709551615] "" Vector__XXX

BO_ 2566627072 VDMA_FB9F_DC_AC_Accessory_Invert: 8 Vector__XXX
 SG_ DC_AC_Accessory_Inverter_2_DC_Si : 0|64@1+ (1,0) [0|18446744073709551615] "" Vector__XXX

BO_ 2566627328 VDMA_FBA0_DC_AC_Accessory_Invert: 8 Vector__XXX
 SG_ DC_AC_Accessory_Inverter_2_AC_Si : 0|64@1+ (1,0) [0|18446744073709551615] "" Vector__XXX

BO_ 2566627584 VDMA_FBA1_DC_AC_Accessory_Invert: 8 Vector__XXX
 SG_ DC_AC_Accessory_Inverter_2_Confi : 0|64@1+ (1,0) [0|18446744073709551615] "" Vector__XXX

BO_ 2566627840 VDMA_FBA2_DC_AC_Accessory_Invert: 8 Vector__XXX
 SG_ DC_AC_Accessory_Inverter_2_Lifet : 0|64@1+ (1,0) [0|18446744073709551615] "" Vector__XXX

BO_ 2566628096 VDMA_FBA3_DC_AC_Accessory_Invert: 8 Vector__XXX
 SG_ DC_AC_Accessory_Inverter_3_Tempe : 0|64@1+ (1,0) [0|18446744073709551615] "" Vector__XXX

BO_ 2566628352 VDMA_FBA4_DC_AC_Accessory_Invert: 8 Vector__XXX
 SG_ DC_AC_Accessory_Inverter_3_DC_Si : 0|64@1+ (1,0) [0|18446744073709551615] "" Vector__XXX

BO_ 2566628608 VDMA_FBA5_DC_AC_Accessory_Invert: 8 Vector__XXX
 SG_ DC_AC_Accessory_Inverter_3_AC_Si : 0|64@1+ (1,0) [0|18446744073709551615] "" Vector__XXX

BO_ 2566628864 VDMA_FBA6_DC_AC_Accessory_Invert: 8 Vector__XXX
 SG_ DC_AC_Accessory_Inverter_3_Confi : 0|64@1+ (1,0) [0|18446744073709551615] "" Vector__XXX

BO_ 2566629120 VDMA_FBA7_DC_AC_Accessory_Invert: 8 Vector__XXX
 SG_ DC_AC_Accessory_Inverter_3_Lifet : 0|64@1+ (1,0) [0|18446744073709551615] "" Vector__XXX

BO_ 2566629376 VDMA_FBA8_DC_AC_Accessory_Invert: 8 Vector__XXX
 SG_ DC_AC_Accessory_Inverter_4_Tempe : 0|64@1+ (1,0) [0|18446744073709551615] "" Vector__XXX

BO_ 2566629632 VDMA_FBA9_DC_AC_Accessory_Invert: 8 Vector__XXX
 SG_ DC_AC_Accessory_Inverter_4_DC_Si : 0|64@1+ (1,0) [0|18446744073709551615] "" Vector__XXX

BO_ 2566629888 VDMA_FBAA_DC_AC_Accessory_Invert: 8 Vector__XXX
 SG_ DC_AC_Accessory_Inverter_4_AC_Si : 0|64@1+ (1,0) [0|18446744073709551615] "" Vector__XXX

BO_ 2566630144 VDMA_FBAB_DC_AC_Accessory_Invert: 8 Vector__XXX
 SG_ DC_AC_Accessory_Inverter_4_Confi : 0|64@1+ (1,0) [0|18446744073709551615] "" Vector__XXX

BO_ 2566630400 VDMA_FBAC_DC_AC_Accessory_Invert: 8 Vector__XXX
 SG_ DC_AC_Accessory_Inverter_4_Lifet : 0|64@1+ (1,0) [0|18446744073709551615] "" Vector__XXX

BO_ 2566630656 VDMA_FBAD_DC_AC_Accessory_Invert: 8 Vector__XXX
 SG_ DC_AC_Accessory_Inverter_5_Tempe : 0|64@1+ (1,0) [0|18446744073709551615] "" Vector__XXX

BO_ 2566630912 VDMA_FBAE_DC_AC_Accessory_Invert: 8 Vector__XXX
 SG_ DC_AC_Accessory_Inverter_5_DC_Si : 0|64@1+ (1,0) [0|18446744073709551615] "" Vector__XXX

BO_ 2566631168 VDMA_FBAF_DC_AC_Accessory_Invert: 8 Vector__XXX
 SG_ DC_AC_Accessory_Inverter_5_AC_Si : 0|64@1+ (1,0) [0|18446744073709551615] "" Vector__XXX

BO_ 2566631424 VDMA_FBB0_DC_AC_Accessory_Invert: 8 Vector__XXX
 SG_ DC_AC_Accessory_Inverter_5_Confi : 0|64@1+ (1,0) [0|18446744073709551615] "" Vector__XXX

BO_ 2566631680 VDMA_FBB1_DC_AC_Accessory_Invert: 8 Vector__XXX
 SG_ DC_AC_Accessory_Inverter_5_Lifet : 0|64@1+ (1,0) [0|18446744073709551615] "" Vector__XXX

BO_ 2566631936 VDMA_FBB2_Well_Stimulation_Pump_: 8 Vector__XXX
 SG_ Well_Stimulation_Pump_Sensor_Cal : 0|64@1+ (1,0) [0|18446744073709551615] "" Vector__XXX

BO_ 2566632192 VDMA_FBB3_Well_Stimulation_Pump_: 8 Vector__XXX
 SG_ Well_Stimulation_Pump_Fluid_Volu : 0|64@1+ (1,0) [0|18446744073709551615] "" Vector__XXX

BO_ 2566632448 VDMA_FBB4_Well_Stimulation_Pump_: 8 Vector__XXX
 SG_ Well_Stimulation_Pump_Serial_Num : 0|64@1+ (1,0) [0|18446744073709551615] "" Vector__XXX

BO_ 2566632704 VDMA_FBB5_Well_Stimulation_Pump_: 8 Vector__XXX
 SG_ Well_Stimulation_Pump_Trip_Hours : 0|64@1+ (1,0) [0|18446744073709551615] "" Vector__XXX

BO_ 2566632960 VDMA_FBB6_Aftertreatment_1_Outle: 8 Vector__XXX
 SG_ Aftertreatment_1_Outlet_Gas_4_Ra : 0|64@1+ (1,0) [0|18446744073709551615] "" Vector__XXX

BO_ 2566633216 VDMA_FBB7_Aftertreatment_1_Intak: 8 Vector__XXX
 SG_ Aftertreatment_1_Intake_Gas_4_Ra : 0|64@1+ (1,0) [0|18446744073709551615] "" Vector__XXX

BO_ 2566633472 VDMA_FBB8_DC_DC_Converter_4_Life: 8 Vector__XXX
 SG_ DC_DC_Converter_4_Lifetime_Data_ : 0|64@1+ (1,0) [0|18446744073709551615] "" Vector__XXX

BO_ 2566633728 VDMA_FBB9_DC_DC_Converter_4_Conf: 8 Vector__XXX
 SG_ DC_DC_Converter_4_Configuration_ : 0|64@1+ (1,0) [0|18446744073709551615] "" Vector__XXX

BO_ 2566633984 VDMA_FBBA_DC_DC_Converter_4_SLI_: 8 Vector__XXX
 SG_ DC_DC_Converter_4_SLI_Battery_Li : 0|64@1+ (1,0) [0|18446744073709551615] "" Vector__XXX

BO_ 2566634240 VDMA_FBBB_DC_DC_Converter_4_Temp: 8 Vector__XXX
 SG_ DC_DC_Converter_4_Temperatures_R : 0|64@1+ (1,0) [0|18446744073709551615] "" Vector__XXX

BO_ 2566634496 VDMA_FBBC_DC_DC_Converter_4_Low_: 8 Vector__XXX
 SG_ DC_DC_Converter_4_Low_Side_Limit : 0|64@1+ (1,0) [0|18446744073709551615] "" Vector__XXX

BO_ 2566634752 VDMA_FBBD_DC_DC_Converter_4_High: 8 Vector__XXX
 SG_ DC_DC_Converter_4_High_Side_Limi : 0|64@1+ (1,0) [0|18446744073709551615] "" Vector__XXX

BO_ 2566635008 VDMA_FBBE_DC_DC_Converter_3_Life: 8 Vector__XXX
 SG_ DC_DC_Converter_3_Lifetime_Data_ : 0|64@1+ (1,0) [0|18446744073709551615] "" Vector__XXX

BO_ 2566635264 VDMA_FBBF_DC_DC_Converter_3_Conf: 8 Vector__XXX
 SG_ DC_DC_Converter_3_Configuration_ : 0|64@1+ (1,0) [0|18446744073709551615] "" Vector__XXX

BO_ 2566635520 VDMA_FBC0_DC_DC_Converter_3_SLI_: 8 Vector__XXX
 SG_ DC_DC_Converter_3_SLI_Battery_Li : 0|64@1+ (1,0) [0|18446744073709551615] "" Vector__XXX

BO_ 2566635776 VDMA_FBC1_DC_DC_Converter_3_Temp: 8 Vector__XXX
 SG_ DC_DC_Converter_3_Temperatures_R : 0|64@1+ (1,0) [0|18446744073709551615] "" Vector__XXX

BO_ 2566636032 VDMA_FBC2_DC_DC_Converter_3_Low_: 8 Vector__XXX
 SG_ DC_DC_Converter_3_Low_Side_Limit : 0|64@1+ (1,0) [0|18446744073709551615] "" Vector__XXX

BO_ 2566636288 VDMA_FBC3_DC_DC_Converter_3_High: 8 Vector__XXX
 SG_ DC_DC_Converter_3_High_Side_Limi : 0|64@1+ (1,0) [0|18446744073709551615] "" Vector__XXX

BO_ 2566636544 VDMA_FBC4_DC_DC_Converter_2_Life: 8 Vector__XXX
 SG_ DC_DC_Converter_2_Lifetime_Data_ : 0|64@1+ (1,0) [0|18446744073709551615] "" Vector__XXX

BO_ 2566636800 VDMA_FBC5_DC_DC_Converter_2_Conf: 8 Vector__XXX
 SG_ DC_DC_Converter_2_Configuration_ : 0|64@1+ (1,0) [0|18446744073709551615] "" Vector__XXX

BO_ 2566637056 VDMA_FBC6_DC_DC_Converter_2_SLI_: 8 Vector__XXX
 SG_ DC_DC_Converter_2_SLI_Battery_Li : 0|64@1+ (1,0) [0|18446744073709551615] "" Vector__XXX

BO_ 2566637312 VDMA_FBC7_DC_DC_Converter_2_Temp: 8 Vector__XXX
 SG_ DC_DC_Converter_2_Temperatures_R : 0|64@1+ (1,0) [0|18446744073709551615] "" Vector__XXX

BO_ 2566637568 VDMA_FBC8_DC_DC_Converter_2_Low_: 8 Vector__XXX
 SG_ DC_DC_Converter_2_Low_Side_Limit : 0|64@1+ (1,0) [0|18446744073709551615] "" Vector__XXX

BO_ 2566637824 VDMA_FBC9_DC_DC_Converter_2_High: 8 Vector__XXX
 SG_ DC_DC_Converter_2_High_Side_Limi : 0|64@1+ (1,0) [0|18446744073709551615] "" Vector__XXX

BO_ 2566638080 VDMA_FBCA_CiA_602_2_AUTOSAR_CAN_: 8 Vector__XXX
 SG_ CiA_602_2_AUTOSAR_CAN_NM_Obsolet : 0|64@1+ (1,0) [0|18446744073709551615] "" Vector__XXX

BO_ 2566638336 VDMA_FBCB_Engine_Exhaust_Particu: 8 Vector__XXX
 SG_ Engine_Exhaust_Particulate_Contr : 0|64@1+ (1,0) [0|18446744073709551615] "" Vector__XXX

BO_ 2566638592 VDMA_FBCC_Well_Stimulation_Pump_: 8 Vector__XXX
 SG_ Well_Stimulation_Pump_Hours_RawP : 0|64@1+ (1,0) [0|18446744073709551615] "" Vector__XXX

BO_ 2566638848 VDMA_FBCD_Well_Stimulation_Pump_: 8 Vector__XXX
 SG_ Well_Stimulation_Pump_System_Con : 0|64@1+ (1,0) [0|18446744073709551615] "" Vector__XXX

BO_ 2566639104 VDMA_FBCE_Configurable_Receive_S: 8 Vector__XXX
 SG_ Configurable_Receive_SPNs_Status : 0|64@1+ (1,0) [0|18446744073709551615] "" Vector__XXX

BO_ 2566639360 VDMA_FBCF_DC_DC_Converter_1_Life: 8 Vector__XXX
 SG_ DC_DC_Converter_1_Lifetime_Data_ : 0|64@1+ (1,0) [0|18446744073709551615] "" Vector__XXX

BO_ 2566639616 VDMA_FBD0_DC_DC_Converter_1_Conf: 8 Vector__XXX
 SG_ DC_DC_Converter_1_Configuration_ : 0|64@1+ (1,0) [0|18446744073709551615] "" Vector__XXX

BO_ 2566639872 VDMA_FBD1_DC_DC_Converter_1_SLI_: 8 Vector__XXX
 SG_ DC_DC_Converter_1_SLI_Battery_Li : 0|64@1+ (1,0) [0|18446744073709551615] "" Vector__XXX

BO_ 2566640128 VDMA_FBD2_Pump_Oil_Message: 8 Vector__XXX
 SG_ Pump_Oil_Message_RawPayload : 0|64@1+ (1,0) [0|18446744073709551615] "" Vector__XXX

BO_ 2566640384 VDMA_FBD3_Well_Stimulation_Pump_: 8 Vector__XXX
 SG_ Well_Stimulation_Pump_System_Lif : 0|64@1+ (1,0) [0|18446744073709551615] "" Vector__XXX

BO_ 2566640640 VDMA_FBD4_Well_Stimulation_Pump_: 8 Vector__XXX
 SG_ Well_Stimulation_Pump_System_Con : 0|64@1+ (1,0) [0|18446744073709551615] "" Vector__XXX

BO_ 2566640896 VDMA_FBD5_Aftercooler_and_Oil_Co: 8 Vector__XXX
 SG_ Aftercooler_and_Oil_Cooler_Fluid : 0|64@1+ (1,0) [0|18446744073709551615] "" Vector__XXX

BO_ 2566641152 VDMA_FBD6_Electronic_Engine_Cont: 8 Vector__XXX
 SG_ Electronic_Engine_Controller_21_ : 0|64@1+ (1,0) [0|18446744073709551615] "" Vector__XXX

BO_ 2566641408 VDMA_FBD7_Configurable_Transmit_: 8 Vector__XXX
 SG_ Configurable_Transmit_PGNs_Statu : 0|64@1+ (1,0) [0|18446744073709551615] "" Vector__XXX

BO_ 2566641664 VDMA_FBD8_DC_DC_Converter_1_Temp: 8 Vector__XXX
 SG_ DC_DC_Converter_1_Temperatures_R : 0|64@1+ (1,0) [0|18446744073709551615] "" Vector__XXX

BO_ 2566641920 VDMA_FBD9_DC_DC_Converter_1_Low_: 8 Vector__XXX
 SG_ DC_DC_Converter_1_Low_Side_Limit : 0|64@1+ (1,0) [0|18446744073709551615] "" Vector__XXX

BO_ 2566642176 VDMA_FBDA_DC_DC_Converter_1_High: 8 Vector__XXX
 SG_ DC_DC_Converter_1_High_Side_Limi : 0|64@1+ (1,0) [0|18446744073709551615] "" Vector__XXX

BO_ 2566642688 VDMA_FBDC_Door_Control_4: 8 Vector__XXX
 SG_ Door_Control_4_RawPayload : 0|64@1+ (1,0) [0|18446744073709551615] "" Vector__XXX

BO_ 2566642944 VDMA_FBDD_Door_Control_3: 8 Vector__XXX
 SG_ Door_Control_3_RawPayload : 0|64@1+ (1,0) [0|18446744073709551615] "" Vector__XXX

BO_ 2566643200 VDMA_FBDE_Engine_Temperature_6: 8 Vector__XXX
 SG_ Engine_Temperature_6_RawPayload : 0|64@1+ (1,0) [0|18446744073709551615] "" Vector__XXX

BO_ 2566643456 VDMA_FBDF_Intake_Exhaust_Conditi: 8 Vector__XXX
 SG_ Intake_Exhaust_Conditions_3_RawP : 0|64@1+ (1,0) [0|18446744073709551615] "" Vector__XXX

BO_ 2566643712 VDMA_FBE0_Aftercooler_and_Oil_Co: 8 Vector__XXX
 SG_ Aftercooler_and_Oil_Cooler_Fluid : 0|64@1+ (1,0) [0|18446744073709551615] "" Vector__XXX

BO_ 2566643968 VDMA_FBE1_Diode_Temperature_2: 8 Vector__XXX
 SG_ Diode_Temperature_2_RawPayload : 0|64@1+ (1,0) [0|18446744073709551615] "" Vector__XXX

BO_ 2566644224 VDMA_FBE2_Diode_Temperature_1: 8 Vector__XXX
 SG_ Diode_Temperature_1_RawPayload : 0|64@1+ (1,0) [0|18446744073709551615] "" Vector__XXX

BO_ 2566644480 VDMA_FBE3_Alternator_Temperature: 8 Vector__XXX
 SG_ Alternator_Temperature_2_RawPayl : 0|64@1+ (1,0) [0|18446744073709551615] "" Vector__XXX

BO_ 2566644736 VDMA_FBE4_Fuel_Information_7_Gas: 8 Vector__XXX
 SG_ Fuel_Information_7_Gaseous_RawPa : 0|64@1+ (1,0) [0|18446744073709551615] "" Vector__XXX

BO_ 2566644992 VDMA_FBE5_High_Voltage_Energy_St: 8 Vector__XXX
 SG_ High_Voltage_Energy_Storage_Syst : 0|64@1+ (1,0) [0|18446744073709551615] "" Vector__XXX

BO_ 2566645248 VDMA_FBE6_High_Voltage_Energy_St: 8 Vector__XXX
 SG_ High_Voltage_Energy_Storage_Syst : 0|64@1+ (1,0) [0|18446744073709551615] "" Vector__XXX

BO_ 2566645504 VDMA_FBE7_SCR_Operator_Inducemen: 8 Vector__XXX
 SG_ SCR_Operator_Inducement_Informat : 0|64@1+ (1,0) [0|18446744073709551615] "" Vector__XXX

BO_ 2566645760 VDMA_FBE8_Aftertreatment_System_: 8 Vector__XXX
 SG_ Aftertreatment_System_Informatio : 0|64@1+ (1,0) [0|18446744073709551615] "" Vector__XXX

BO_ 2566646016 VDMA_FBE9_Ethernet_1_Connection_: 8 Vector__XXX
 SG_ Ethernet_1_Connection_Informatio : 0|64@1+ (1,0) [0|18446744073709551615] "" Vector__XXX

BO_ 2566646272 VDMA_FBEA_Ethernet_1_Connection_: 8 Vector__XXX
 SG_ Ethernet_1_Connection_Informatio : 0|64@1+ (1,0) [0|18446744073709551615] "" Vector__XXX

BO_ 2566646528 VDMA_FBEB_Oil_Debris_Monitor_Cou: 8 Vector__XXX
 SG_ Oil_Debris_Monitor_Counts_Ferrou : 0|64@1+ (1,0) [0|18446744073709551615] "" Vector__XXX

BO_ 2566646784 VDMA_FBEC_Oil_Debris_Monitor_Cou: 8 Vector__XXX
 SG_ Oil_Debris_Monitor_Counts_Ferrou : 0|64@1+ (1,0) [0|18446744073709551615] "" Vector__XXX

BO_ 2566647040 VDMA_FBED_Oil_Debris_Monitor_Cou: 8 Vector__XXX
 SG_ Oil_Debris_Monitor_Counts_Ferrou : 0|64@1+ (1,0) [0|18446744073709551615] "" Vector__XXX

BO_ 2566647296 VDMA_FBEE_Oil_Debris_Monitor_Cou: 8 Vector__XXX
 SG_ Oil_Debris_Monitor_Counts_Non_Fe : 0|64@1+ (1,0) [0|18446744073709551615] "" Vector__XXX

BO_ 2566647552 VDMA_FBEF_Oil_Debris_Monitor_Cou: 8 Vector__XXX
 SG_ Oil_Debris_Monitor_Counts_Non_Fe : 0|64@1+ (1,0) [0|18446744073709551615] "" Vector__XXX

BO_ 2566647808 VDMA_FBF0_Oil_Debris_Monitor_Cou: 8 Vector__XXX
 SG_ Oil_Debris_Monitor_Counts_Non_Fe : 0|64@1+ (1,0) [0|18446744073709551615] "" Vector__XXX

BO_ 2566648064 VDMA_FBF1_Oil_Debris_Monitoring_: 8 Vector__XXX
 SG_ Oil_Debris_Monitoring_System_Sta : 0|64@1+ (1,0) [0|18446744073709551615] "" Vector__XXX

BO_ 2566648320 VDMA_FBF2_Engine_Fuel_Lube_Syste: 8 Vector__XXX
 SG_ Engine_Fuel_Lube_Systems_3_RawPa : 0|64@1+ (1,0) [0|18446744073709551615] "" Vector__XXX

BO_ 2566648576 VDMA_FBF3_Cruise_Control_Vehicle: 8 Vector__XXX
 SG_ Cruise_Control_Vehicle_Speed_5_R : 0|64@1+ (1,0) [0|18446744073709551615] "" Vector__XXX

BO_ 2566648832 VDMA_FBF4_Aftertreatment_2_Diese: 8 Vector__XXX
 SG_ Aftertreatment_2_Diesel_Oxidatio : 0|64@1+ (1,0) [0|18446744073709551615] "" Vector__XXX

BO_ 2566649088 VDMA_FBF5_Aftertreatment_1_Diese: 8 Vector__XXX
 SG_ Aftertreatment_1_Diesel_Oxidatio : 0|64@1+ (1,0) [0|18446744073709551615] "" Vector__XXX

BO_ 2566649344 VDMA_FBF6_Vehicle_Position_2: 8 Vector__XXX
 SG_ Vehicle_Position_2_RawPayload : 0|64@1+ (1,0) [0|18446744073709551615] "" Vector__XXX

BO_ 2566649600 VDMA_FBF7_Electrified_Accessory_: 8 Vector__XXX
 SG_ Electrified_Accessory_Propulsion : 0|64@1+ (1,0) [0|18446744073709551615] "" Vector__XXX

BO_ 2566649856 VDMA_FBF8_Electrified_Accessory_: 8 Vector__XXX
 SG_ Electrified_Accessory_Propulsion : 0|64@1+ (1,0) [0|18446744073709551615] "" Vector__XXX

BO_ 2566650112 VDMA_FBF9_Electrified_Accessory_: 8 Vector__XXX
 SG_ Electrified_Accessory_Propulsion : 0|64@1+ (1,0) [0|18446744073709551615] "" Vector__XXX

BO_ 2566650368 VDMA_FBFA_Electrified_Accessory_: 8 Vector__XXX
 SG_ Electrified_Accessory_Power_Elec : 0|64@1+ (1,0) [0|18446744073709551615] "" Vector__XXX

BO_ 2566650624 VDMA_FBFB_Electrified_Accessory_: 8 Vector__XXX
 SG_ Electrified_Accessory_Power_Elec : 0|64@1+ (1,0) [0|18446744073709551615] "" Vector__XXX

BO_ 2566650880 VDMA_FBFC_Electrified_Accessory_: 8 Vector__XXX
 SG_ Electrified_Accessory_Power_Elec : 0|64@1+ (1,0) [0|18446744073709551615] "" Vector__XXX

BO_ 2566651136 VDMA_FBFD_Electrified_Accessory_: 8 Vector__XXX
 SG_ Electrified_Accessory_Propulsion : 0|64@1+ (1,0) [0|18446744073709551615] "" Vector__XXX

BO_ 2566651392 VDMA_FBFE_Electrified_Accessory_: 8 Vector__XXX
 SG_ Electrified_Accessory_Propulsion : 0|64@1+ (1,0) [0|18446744073709551615] "" Vector__XXX

BO_ 2566651648 VDMA_FBFF_Electrified_Accessory_: 8 Vector__XXX
 SG_ Electrified_Accessory_Power_Elec : 0|64@1+ (1,0) [0|18446744073709551615] "" Vector__XXX

BO_ 2566651904 VDMA_FC00_Trailer_Wheel_Brake_We: 8 Vector__XXX
 SG_ Trailer_Wheel_Brake_Wear_Life_Re : 0|64@1+ (1,0) [0|18446744073709551615] "" Vector__XXX

BO_ 2566652160 VDMA_FC01_Electrified_Accessory_: 8 Vector__XXX
 SG_ Electrified_Accessory_Motor_Stat : 0|64@1+ (1,0) [0|18446744073709551615] "" Vector__XXX

BO_ 2566652416 VDMA_FC02_SCR_System_Information: 8 Vector__XXX
 SG_ SCR_System_Information_RawPayloa : 0|64@1+ (1,0) [0|18446744073709551615] "" Vector__XXX

BO_ 2566652672 VDMA_FC03_Vehicle_Electrical_Pow: 8 Vector__XXX
 SG_ Vehicle_Electrical_Power_14_RawP : 0|64@1+ (1,0) [0|18446744073709551615] "" Vector__XXX

BO_ 2566652928 VDMA_FC04_Vehicle_Electrical_Pow: 8 Vector__XXX
 SG_ Vehicle_Electrical_Power_13_RawP : 0|64@1+ (1,0) [0|18446744073709551615] "" Vector__XXX

BO_ 2566653184 VDMA_FC05_Vehicle_Electrical_Pow: 8 Vector__XXX
 SG_ Vehicle_Electrical_Power_12_RawP : 0|64@1+ (1,0) [0|18446744073709551615] "" Vector__XXX

BO_ 2566653440 VDMA_FC06_Vehicle_Electrical_Pow: 8 Vector__XXX
 SG_ Vehicle_Electrical_Power_11_RawP : 0|64@1+ (1,0) [0|18446744073709551615] "" Vector__XXX

BO_ 2566653696 VDMA_FC07_Vehicle_Electrical_Pow: 8 Vector__XXX
 SG_ Vehicle_Electrical_Power_10_RawP : 0|64@1+ (1,0) [0|18446744073709551615] "" Vector__XXX

BO_ 2566653952 VDMA_FC08_Vehicle_Electrical_Pow: 8 Vector__XXX
 SG_ Vehicle_Electrical_Power_9_RawPa : 0|64@1+ (1,0) [0|18446744073709551615] "" Vector__XXX

BO_ 2566654208 VDMA_FC09_Vehicle_Electrical_Pow: 8 Vector__XXX
 SG_ Vehicle_Electrical_Power_8_RawPa : 0|64@1+ (1,0) [0|18446744073709551615] "" Vector__XXX

BO_ 2566654464 VDMA_FC0A_Vehicle_Electrical_Pow: 8 Vector__XXX
 SG_ Vehicle_Electrical_Power_7_RawPa : 0|64@1+ (1,0) [0|18446744073709551615] "" Vector__XXX

CM_ BO_ 2566565376  "Source: isobus.net VDMA Data Dictionary (https://www.isobus.net/isobus/pGNAndSPN/10327?type=PGN)";
CM_ BO_ 2566565632  "Source: isobus.net VDMA Data Dictionary (https://www.isobus.net/isobus/pGNAndSPN/10337?type=PGN)";
CM_ BO_ 2566565888  "Source: isobus.net VDMA Data Dictionary (https://www.isobus.net/isobus/pGNAndSPN/10343?type=PGN)";
CM_ BO_ 2566566144  "Source: isobus.net VDMA Data Dictionary (https://www.isobus.net/isobus/pGNAndSPN/10353?type=PGN)";
CM_ BO_ 2566566400  "Source: isobus.net VDMA Data Dictionary (https://www.isobus.net/isobus/pGNAndSPN/10359?type=PGN)";
CM_ BO_ 2566566656  "Source: isobus.net VDMA Data Dictionary (https://www.isobus.net/isobus/pGNAndSPN/10360?type=PGN)";
CM_ BO_ 2566566912  "Source: isobus.net VDMA Data Dictionary (https://www.isobus.net/isobus/pGNAndSPN/10364?type=PGN)";
CM_ BO_ 2566567168  "Source: isobus.net VDMA Data Dictionary (https://www.isobus.net/isobus/pGNAndSPN/10368?type=PGN)";
CM_ BO_ 2566567424  "Source: isobus.net VDMA Data Dictionary (https://www.isobus.net/isobus/pGNAndSPN/10372?type=PGN)";
CM_ BO_ 2566567680  "Source: isobus.net VDMA Data Dictionary (https://www.isobus.net/isobus/pGNAndSPN/10376?type=PGN)";
CM_ BO_ 2566567936  "Source: isobus.net VDMA Data Dictionary (https://www.isobus.net/isobus/pGNAndSPN/10386?type=PGN)";
CM_ BO_ 2566568192  "Source: isobus.net VDMA Data Dictionary (https://www.isobus.net/isobus/pGNAndSPN/10387?type=PGN)";
CM_ BO_ 2566568448  "Source: isobus.net VDMA Data Dictionary (https://www.isobus.net/isobus/pGNAndSPN/10390?type=PGN)";
CM_ BO_ 2566568704  "Source: isobus.net VDMA Data Dictionary (https://www.isobus.net/isobus/pGNAndSPN/10392?type=PGN)";
CM_ BO_ 2566568960  "Source: isobus.net VDMA Data Dictionary (https://www.isobus.net/isobus/pGNAndSPN/10394?type=PGN)";
CM_ BO_ 2566569216  "Source: isobus.net VDMA Data Dictionary (https://www.isobus.net/isobus/pGNAndSPN/10398?type=PGN)";
CM_ BO_ 2566569472  "Source: isobus.net VDMA Data Dictionary (https://www.isobus.net/isobus/pGNAndSPN/10402?type=PGN)";
CM_ BO_ 2566569728  "Source: isobus.net VDMA Data Dictionary (https://www.isobus.net/isobus/pGNAndSPN/10406?type=PGN)";
CM_ BO_ 2566569984  "Source: isobus.net VDMA Data Dictionary (https://www.isobus.net/isobus/pGNAndSPN/10410?type=PGN)";
CM_ BO_ 2566570240  "Source: isobus.net VDMA Data Dictionary (https://www.isobus.net/isobus/pGNAndSPN/10414?type=PGN)";
CM_ BO_ 2566570496  "Source: isobus.net VDMA Data Dictionary (https://www.isobus.net/isobus/pGNAndSPN/10418?type=PGN)";
CM_ BO_ 2566570752  "Source: isobus.net VDMA Data Dictionary (https://www.isobus.net/isobus/pGNAndSPN/10420?type=PGN)";
CM_ BO_ 2566571008  "Source: isobus.net VDMA Data Dictionary (https://www.isobus.net/isobus/pGNAndSPN/10423?type=PGN)";
CM_ BO_ 2566571264  "Source: isobus.net VDMA Data Dictionary (https://www.isobus.net/isobus/pGNAndSPN/10427?type=PGN)";
CM_ BO_ 2566571520  "Source: isobus.net VDMA Data Dictionary (https://www.isobus.net/isobus/pGNAndSPN/10429?type=PGN)";
CM_ BO_ 2566572032  "Source: isobus.net VDMA Data Dictionary (https://www.isobus.net/isobus/pGNAndSPN/10434?type=PGN)";
CM_ BO_ 2566572800  "Source: isobus.net VDMA Data Dictionary (https://www.isobus.net/isobus/pGNAndSPN/10435?type=PGN)";
CM_ BO_ 2566573056  "Source: isobus.net VDMA Data Dictionary (https://www.isobus.net/isobus/pGNAndSPN/10436?type=PGN)";
CM_ BO_ 2566573312  "Source: isobus.net VDMA Data Dictionary (https://www.isobus.net/isobus/pGNAndSPN/10438?type=PGN)";
CM_ BO_ 2566573568  "Source: isobus.net VDMA Data Dictionary (https://www.isobus.net/isobus/pGNAndSPN/10440?type=PGN)";
CM_ BO_ 2566573824  "Source: isobus.net VDMA Data Dictionary (https://www.isobus.net/isobus/pGNAndSPN/10449?type=PGN)";
CM_ BO_ 2566574080  "Source: isobus.net VDMA Data Dictionary (https://www.isobus.net/isobus/pGNAndSPN/10452?type=PGN)";
CM_ BO_ 2566574336  "Source: isobus.net VDMA Data Dictionary (https://www.isobus.net/isobus/pGNAndSPN/10455?type=PGN)";
CM_ BO_ 2566574592  "Source: isobus.net VDMA Data Dictionary (https://www.isobus.net/isobus/pGNAndSPN/10459?type=PGN)";
CM_ BO_ 2566574848  "Source: isobus.net VDMA Data Dictionary (https://www.isobus.net/isobus/pGNAndSPN/10464?type=PGN)";
CM_ BO_ 2566575104  "Source: isobus.net VDMA Data Dictionary (https://www.isobus.net/isobus/pGNAndSPN/10466?type=PGN)";
CM_ BO_ 2566575360  "Source: isobus.net VDMA Data Dictionary (https://www.isobus.net/isobus/pGNAndSPN/10470?type=PGN)";
CM_ BO_ 2566575616  "Source: isobus.net VDMA Data Dictionary (https://www.isobus.net/isobus/pGNAndSPN/10478?type=PGN)";
CM_ BO_ 2566575872  "Source: isobus.net VDMA Data Dictionary (https://www.isobus.net/isobus/pGNAndSPN/10479?type=PGN)";
CM_ BO_ 2566576128  "Source: isobus.net VDMA Data Dictionary (https://www.isobus.net/isobus/pGNAndSPN/10480?type=PGN)";
CM_ BO_ 2566576384  "Source: isobus.net VDMA Data Dictionary (https://www.isobus.net/isobus/pGNAndSPN/10481?type=PGN)";
CM_ BO_ 2566576640  "Source: isobus.net VDMA Data Dictionary (https://www.isobus.net/isobus/pGNAndSPN/10482?type=PGN)";
CM_ BO_ 2566576896  "Source: isobus.net VDMA Data Dictionary (https://www.isobus.net/isobus/pGNAndSPN/10483?type=PGN)";
CM_ BO_ 2566577152  "Source: isobus.net VDMA Data Dictionary (https://www.isobus.net/isobus/pGNAndSPN/10484?type=PGN)";
CM_ BO_ 2566577408  "Source: isobus.net VDMA Data Dictionary (https://www.isobus.net/isobus/pGNAndSPN/10485?type=PGN)";
CM_ BO_ 2566577664  "Source: isobus.net VDMA Data Dictionary (https://www.isobus.net/isobus/pGNAndSPN/10486?type=PGN)";
CM_ BO_ 2566577920  "Source: isobus.net VDMA Data Dictionary (https://www.isobus.net/isobus/pGNAndSPN/10487?type=PGN)";
CM_ BO_ 2566578176  "Source: isobus.net VDMA Data Dictionary (https://www.isobus.net/isobus/pGNAndSPN/10488?type=PGN)";
CM_ BO_ 2566578432  "Source: isobus.net VDMA Data Dictionary (https://www.isobus.net/isobus/pGNAndSPN/10489?type=PGN)";
CM_ BO_ 2566578688  "Source: isobus.net VDMA Data Dictionary (https://www.isobus.net/isobus/pGNAndSPN/10490?type=PGN)";
CM_ BO_ 2566578944  "Source: isobus.net VDMA Data Dictionary (https://www.isobus.net/isobus/pGNAndSPN/10491?type=PGN)";
CM_ BO_ 2566579200  "Source: isobus.net VDMA Data Dictionary (https://www.isobus.net/isobus/pGNAndSPN/10492?type=PGN)";
CM_ BO_ 2566579456  "Source: isobus.net VDMA Data Dictionary (https://www.isobus.net/isobus/pGNAndSPN/10493?type=PGN)";
CM_ BO_ 2566579712  "Source: isobus.net VDMA Data Dictionary (https://www.isobus.net/isobus/pGNAndSPN/10494?type=PGN)";
CM_ BO_ 2566579968  "Source: isobus.net VDMA Data Dictionary (https://www.isobus.net/isobus/pGNAndSPN/10495?type=PGN)";
CM_ BO_ 2566580224  "Source: isobus.net VDMA Data Dictionary (https://www.isobus.net/isobus/pGNAndSPN/10496?type=PGN)";
CM_ BO_ 2566580480  "Source: isobus.net VDMA Data Dictionary (https://www.isobus.net/isobus/pGNAndSPN/10497?type=PGN)";
CM_ BO_ 2566580736  "Source: isobus.net VDMA Data Dictionary (https://www.isobus.net/isobus/pGNAndSPN/10498?type=PGN)";
CM_ BO_ 2566580992  "Source: isobus.net VDMA Data Dictionary (https://www.isobus.net/isobus/pGNAndSPN/10499?type=PGN)";
CM_ BO_ 2566581248  "Source: isobus.net VDMA Data Dictionary (https://www.isobus.net/isobus/pGNAndSPN/10500?type=PGN)";
CM_ BO_ 2566581504  "Source: isobus.net VDMA Data Dictionary (https://www.isobus.net/isobus/pGNAndSPN/10508?type=PGN)";
CM_ BO_ 2566581760  "Source: isobus.net VDMA Data Dictionary (https://www.isobus.net/isobus/pGNAndSPN/10516?type=PGN)";
CM_ BO_ 2566582016  "Source: isobus.net VDMA Data Dictionary (https://www.isobus.net/isobus/pGNAndSPN/10517?type=PGN)";
CM_ BO_ 2566582272  "Source: isobus.net VDMA Data Dictionary (https://www.isobus.net/isobus/pGNAndSPN/10519?type=PGN)";
CM_ BO_ 2566582528  "Source: isobus.net VDMA Data Dictionary (https://www.isobus.net/isobus/pGNAndSPN/10522?type=PGN)";
CM_ BO_ 2566582784  "Source: isobus.net VDMA Data Dictionary (https://www.isobus.net/isobus/pGNAndSPN/10525?type=PGN)";
CM_ BO_ 2566583040  "Source: isobus.net VDMA Data Dictionary (https://www.isobus.net/isobus/pGNAndSPN/10528?type=PGN)";
CM_ BO_ 2566583296  "Source: isobus.net VDMA Data Dictionary (https://www.isobus.net/isobus/pGNAndSPN/10536?type=PGN)";
CM_ BO_ 2566583552  "Source: isobus.net VDMA Data Dictionary (https://www.isobus.net/isobus/pGNAndSPN/10544?type=PGN)";
CM_ BO_ 2566583808  "Source: isobus.net VDMA Data Dictionary (https://www.isobus.net/isobus/pGNAndSPN/10552?type=PGN)";
CM_ BO_ 2566584064  "Source: isobus.net VDMA Data Dictionary (https://www.isobus.net/isobus/pGNAndSPN/10560?type=PGN)";
CM_ BO_ 2566584320  "Source: isobus.net VDMA Data Dictionary (https://www.isobus.net/isobus/pGNAndSPN/10568?type=PGN)";
CM_ BO_ 2566584576  "Source: isobus.net VDMA Data Dictionary (https://www.isobus.net/isobus/pGNAndSPN/10572?type=PGN)";
CM_ BO_ 2566584832  "Source: isobus.net VDMA Data Dictionary (https://www.isobus.net/isobus/pGNAndSPN/10576?type=PGN)";
CM_ BO_ 2566585088  "Source: isobus.net VDMA Data Dictionary (https://www.isobus.net/isobus/pGNAndSPN/10580?type=PGN)";
CM_ BO_ 2566585344  "Source: isobus.net VDMA Data Dictionary (https://www.isobus.net/isobus/pGNAndSPN/10593?type=PGN)";
CM_ BO_ 2566585600  "Source: isobus.net VDMA Data Dictionary (https://www.isobus.net/isobus/pGNAndSPN/10606?type=PGN)";
CM_ BO_ 2566585856  "Source: isobus.net VDMA Data Dictionary (https://www.isobus.net/isobus/pGNAndSPN/10619?type=PGN)";
CM_ BO_ 2566586112  "Source: isobus.net VDMA Data Dictionary (https://www.isobus.net/isobus/pGNAndSPN/10622?type=PGN)";
CM_ BO_ 2566586368  "Source: isobus.net VDMA Data Dictionary (https://www.isobus.net/isobus/pGNAndSPN/10625?type=PGN)";
CM_ BO_ 2566586624  "Source: isobus.net VDMA Data Dictionary (https://www.isobus.net/isobus/pGNAndSPN/10628?type=PGN)";
CM_ BO_ 2566586880  "Source: isobus.net VDMA Data Dictionary (https://www.isobus.net/isobus/pGNAndSPN/10645?type=PGN)";
CM_ BO_ 2566587136  "Source: isobus.net VDMA Data Dictionary (https://www.isobus.net/isobus/pGNAndSPN/10662?type=PGN)";
CM_ BO_ 2566587392  "Source: isobus.net VDMA Data Dictionary (https://www.isobus.net/isobus/pGNAndSPN/10679?type=PGN)";
CM_ BO_ 2566587648  "Source: isobus.net VDMA Data Dictionary (https://www.isobus.net/isobus/pGNAndSPN/10696?type=PGN)";
CM_ BO_ 2566587904  "Source: isobus.net VDMA Data Dictionary (https://www.isobus.net/isobus/pGNAndSPN/10713?type=PGN)";
CM_ BO_ 2566588160  "Source: isobus.net VDMA Data Dictionary (https://www.isobus.net/isobus/pGNAndSPN/10730?type=PGN)";
CM_ BO_ 2566588416  "Source: isobus.net VDMA Data Dictionary (https://www.isobus.net/isobus/pGNAndSPN/10747?type=PGN)";
CM_ BO_ 2566588672  "Source: isobus.net VDMA Data Dictionary (https://www.isobus.net/isobus/pGNAndSPN/10764?type=PGN)";
CM_ BO_ 2566588928  "Source: isobus.net VDMA Data Dictionary (https://www.isobus.net/isobus/pGNAndSPN/10781?type=PGN)";
CM_ BO_ 2566589184  "Source: isobus.net VDMA Data Dictionary (https://www.isobus.net/isobus/pGNAndSPN/10798?type=PGN)";
CM_ BO_ 2566589440  "Source: isobus.net VDMA Data Dictionary (https://www.isobus.net/isobus/pGNAndSPN/10815?type=PGN)";
CM_ BO_ 2566589696  "Source: isobus.net VDMA Data Dictionary (https://www.isobus.net/isobus/pGNAndSPN/10832?type=PGN)";
CM_ BO_ 2566589952  "Source: isobus.net VDMA Data Dictionary (https://www.isobus.net/isobus/pGNAndSPN/10849?type=PGN)";
CM_ BO_ 2566590208  "Source: isobus.net VDMA Data Dictionary (https://www.isobus.net/isobus/pGNAndSPN/10866?type=PGN)";
CM_ BO_ 2566590464  "Source: isobus.net VDMA Data Dictionary (https://www.isobus.net/isobus/pGNAndSPN/10883?type=PGN)";
CM_ BO_ 2566590720  "Source: isobus.net VDMA Data Dictionary (https://www.isobus.net/isobus/pGNAndSPN/10900?type=PGN)";
CM_ BO_ 2566590976  "Source: isobus.net VDMA Data Dictionary (https://www.isobus.net/isobus/pGNAndSPN/10917?type=PGN)";
CM_ BO_ 2566591232  "Source: isobus.net VDMA Data Dictionary (https://www.isobus.net/isobus/pGNAndSPN/10934?type=PGN)";
CM_ BO_ 2566591488  "Source: isobus.net VDMA Data Dictionary (https://www.isobus.net/isobus/pGNAndSPN/10951?type=PGN)";
CM_ BO_ 2566591744  "Source: isobus.net VDMA Data Dictionary (https://www.isobus.net/isobus/pGNAndSPN/10968?type=PGN)";
CM_ BO_ 2566592000  "Source: isobus.net VDMA Data Dictionary (https://www.isobus.net/isobus/pGNAndSPN/10985?type=PGN)";
CM_ BO_ 2566592256  "Source: isobus.net VDMA Data Dictionary (https://www.isobus.net/isobus/pGNAndSPN/11002?type=PGN)";
CM_ BO_ 2566592512  "Source: isobus.net VDMA Data Dictionary (https://www.isobus.net/isobus/pGNAndSPN/11009?type=PGN)";
CM_ BO_ 2566592768  "Source: isobus.net VDMA Data Dictionary (https://www.isobus.net/isobus/pGNAndSPN/11015?type=PGN)";
CM_ BO_ 2566593024  "Source: isobus.net VDMA Data Dictionary (https://www.isobus.net/isobus/pGNAndSPN/11021?type=PGN)";
CM_ BO_ 2566593280  "Source: isobus.net VDMA Data Dictionary (https://www.isobus.net/isobus/pGNAndSPN/11027?type=PGN)";
CM_ BO_ 2566593536  "Source: isobus.net VDMA Data Dictionary (https://www.isobus.net/isobus/pGNAndSPN/11031?type=PGN)";
CM_ BO_ 2566593792  "Source: isobus.net VDMA Data Dictionary (https://www.isobus.net/isobus/pGNAndSPN/11038?type=PGN)";
CM_ BO_ 2566594048  "Source: isobus.net VDMA Data Dictionary (https://www.isobus.net/isobus/pGNAndSPN/11044?type=PGN)";
CM_ BO_ 2566594304  "Source: isobus.net VDMA Data Dictionary (https://www.isobus.net/isobus/pGNAndSPN/11050?type=PGN)";
CM_ BO_ 2566594560  "Source: isobus.net VDMA Data Dictionary (https://www.isobus.net/isobus/pGNAndSPN/11056?type=PGN)";
CM_ BO_ 2566594816  "Source: isobus.net VDMA Data Dictionary (https://www.isobus.net/isobus/pGNAndSPN/11060?type=PGN)";
CM_ BO_ 2566595072  "Source: isobus.net VDMA Data Dictionary (https://www.isobus.net/isobus/pGNAndSPN/11067?type=PGN)";
CM_ BO_ 2566595328  "Source: isobus.net VDMA Data Dictionary (https://www.isobus.net/isobus/pGNAndSPN/11073?type=PGN)";
CM_ BO_ 2566595584  "Source: isobus.net VDMA Data Dictionary (https://www.isobus.net/isobus/pGNAndSPN/11079?type=PGN)";
CM_ BO_ 2566595840  "Source: isobus.net VDMA Data Dictionary (https://www.isobus.net/isobus/pGNAndSPN/11085?type=PGN)";
CM_ BO_ 2566596096  "Source: isobus.net VDMA Data Dictionary (https://www.isobus.net/isobus/pGNAndSPN/11089?type=PGN)";
CM_ BO_ 2566596352  "Source: isobus.net VDMA Data Dictionary (https://www.isobus.net/isobus/pGNAndSPN/11096?type=PGN)";
CM_ BO_ 2566596608  "Source: isobus.net VDMA Data Dictionary (https://www.isobus.net/isobus/pGNAndSPN/11102?type=PGN)";
CM_ BO_ 2566596864  "Source: isobus.net VDMA Data Dictionary (https://www.isobus.net/isobus/pGNAndSPN/11108?type=PGN)";
CM_ BO_ 2566597120  "Source: isobus.net VDMA Data Dictionary (https://www.isobus.net/isobus/pGNAndSPN/11114?type=PGN)";
CM_ BO_ 2566597376  "Source: isobus.net VDMA Data Dictionary (https://www.isobus.net/isobus/pGNAndSPN/11118?type=PGN)";
CM_ BO_ 2566597632  "Source: isobus.net VDMA Data Dictionary (https://www.isobus.net/isobus/pGNAndSPN/11119?type=PGN)";
CM_ BO_ 2566597888  "Source: isobus.net VDMA Data Dictionary (https://www.isobus.net/isobus/pGNAndSPN/11123?type=PGN)";
CM_ BO_ 2566598144  "Source: isobus.net VDMA Data Dictionary (https://www.isobus.net/isobus/pGNAndSPN/11124?type=PGN)";
CM_ BO_ 2566598400  "Source: isobus.net VDMA Data Dictionary (https://www.isobus.net/isobus/pGNAndSPN/11129?type=PGN)";
CM_ BO_ 2566598656  "Source: isobus.net VDMA Data Dictionary (https://www.isobus.net/isobus/pGNAndSPN/11135?type=PGN)";
CM_ BO_ 2566598912  "Source: isobus.net VDMA Data Dictionary (https://www.isobus.net/isobus/pGNAndSPN/11139?type=PGN)";
CM_ BO_ 2566599168  "Source: isobus.net VDMA Data Dictionary (https://www.isobus.net/isobus/pGNAndSPN/11144?type=PGN)";
CM_ BO_ 2566599424  "Source: isobus.net VDMA Data Dictionary (https://www.isobus.net/isobus/pGNAndSPN/11148?type=PGN)";
CM_ BO_ 2566599680  "Source: isobus.net VDMA Data Dictionary (https://www.isobus.net/isobus/pGNAndSPN/11155?type=PGN)";
CM_ BO_ 2566599936  "Source: isobus.net VDMA Data Dictionary (https://www.isobus.net/isobus/pGNAndSPN/11174?type=PGN)";
CM_ BO_ 2566600192  "Source: isobus.net VDMA Data Dictionary (https://www.isobus.net/isobus/pGNAndSPN/11179?type=PGN)";
CM_ BO_ 2566600448  "Source: isobus.net VDMA Data Dictionary (https://www.isobus.net/isobus/pGNAndSPN/11185?type=PGN)";
CM_ BO_ 2566600704  "Source: isobus.net VDMA Data Dictionary (https://www.isobus.net/isobus/pGNAndSPN/11189?type=PGN)";
CM_ BO_ 2566600960  "Source: isobus.net VDMA Data Dictionary (https://www.isobus.net/isobus/pGNAndSPN/11194?type=PGN)";
CM_ BO_ 2566601216  "Source: isobus.net VDMA Data Dictionary (https://www.isobus.net/isobus/pGNAndSPN/11198?type=PGN)";
CM_ BO_ 2566601472  "Source: isobus.net VDMA Data Dictionary (https://www.isobus.net/isobus/pGNAndSPN/11205?type=PGN)";
CM_ BO_ 2566601728  "Source: isobus.net VDMA Data Dictionary (https://www.isobus.net/isobus/pGNAndSPN/11224?type=PGN)";
CM_ BO_ 2566601984  "Source: isobus.net VDMA Data Dictionary (https://www.isobus.net/isobus/pGNAndSPN/11229?type=PGN)";
CM_ BO_ 2566602240  "Source: isobus.net VDMA Data Dictionary (https://www.isobus.net/isobus/pGNAndSPN/11235?type=PGN)";
CM_ BO_ 2566602496  "Source: isobus.net VDMA Data Dictionary (https://www.isobus.net/isobus/pGNAndSPN/11239?type=PGN)";
CM_ BO_ 2566602752  "Source: isobus.net VDMA Data Dictionary (https://www.isobus.net/isobus/pGNAndSPN/11244?type=PGN)";
CM_ BO_ 2566603008  "Source: isobus.net VDMA Data Dictionary (https://www.isobus.net/isobus/pGNAndSPN/11248?type=PGN)";
CM_ BO_ 2566603264  "Source: isobus.net VDMA Data Dictionary (https://www.isobus.net/isobus/pGNAndSPN/11255?type=PGN)";
CM_ BO_ 2566603520  "Source: isobus.net VDMA Data Dictionary (https://www.isobus.net/isobus/pGNAndSPN/11274?type=PGN)";
CM_ BO_ 2566603776  "Source: isobus.net VDMA Data Dictionary (https://www.isobus.net/isobus/pGNAndSPN/11279?type=PGN)";
CM_ BO_ 2566604032  "Source: isobus.net VDMA Data Dictionary (https://www.isobus.net/isobus/pGNAndSPN/11285?type=PGN)";
CM_ BO_ 2566604288  "Source: isobus.net VDMA Data Dictionary (https://www.isobus.net/isobus/pGNAndSPN/11289?type=PGN)";
CM_ BO_ 2566604544  "Source: isobus.net VDMA Data Dictionary (https://www.isobus.net/isobus/pGNAndSPN/11294?type=PGN)";
CM_ BO_ 2566604800  "Source: isobus.net VDMA Data Dictionary (https://www.isobus.net/isobus/pGNAndSPN/11298?type=PGN)";
CM_ BO_ 2566605056  "Source: isobus.net VDMA Data Dictionary (https://www.isobus.net/isobus/pGNAndSPN/11305?type=PGN)";
CM_ BO_ 2566605312  "Source: isobus.net VDMA Data Dictionary (https://www.isobus.net/isobus/pGNAndSPN/11324?type=PGN)";
CM_ BO_ 2566605568  "Source: isobus.net VDMA Data Dictionary (https://www.isobus.net/isobus/pGNAndSPN/11333?type=PGN)";
CM_ BO_ 2566605824  "Source: isobus.net VDMA Data Dictionary (https://www.isobus.net/isobus/pGNAndSPN/11335?type=PGN)";
CM_ BO_ 2566606080  "Source: isobus.net VDMA Data Dictionary (https://www.isobus.net/isobus/pGNAndSPN/11343?type=PGN)";
CM_ BO_ 2566606336  "Source: isobus.net VDMA Data Dictionary (https://www.isobus.net/isobus/pGNAndSPN/11345?type=PGN)";
CM_ BO_ 2566606592  "Source: isobus.net VDMA Data Dictionary (https://www.isobus.net/isobus/pGNAndSPN/11351?type=PGN)";
CM_ BO_ 2566606848  "Source: isobus.net VDMA Data Dictionary (https://www.isobus.net/isobus/pGNAndSPN/11361?type=PGN)";
CM_ BO_ 2566607104  "Source: isobus.net VDMA Data Dictionary (https://www.isobus.net/isobus/pGNAndSPN/11367?type=PGN)";
CM_ BO_ 2566607360  "Source: isobus.net VDMA Data Dictionary (https://www.isobus.net/isobus/pGNAndSPN/11377?type=PGN)";
CM_ BO_ 2566607616  "Source: isobus.net VDMA Data Dictionary (https://www.isobus.net/isobus/pGNAndSPN/11383?type=PGN)";
CM_ BO_ 2566607872  "Source: isobus.net VDMA Data Dictionary (https://www.isobus.net/isobus/pGNAndSPN/11393?type=PGN)";
CM_ BO_ 2566608128  "Source: isobus.net VDMA Data Dictionary (https://www.isobus.net/isobus/pGNAndSPN/11399?type=PGN)";
CM_ BO_ 2566608384  "Source: isobus.net VDMA Data Dictionary (https://www.isobus.net/isobus/pGNAndSPN/11409?type=PGN)";
CM_ BO_ 2566608640  "Source: isobus.net VDMA Data Dictionary (https://www.isobus.net/isobus/pGNAndSPN/11415?type=PGN)";
CM_ BO_ 2566608896  "Source: isobus.net VDMA Data Dictionary (https://www.isobus.net/isobus/pGNAndSPN/11425?type=PGN)";
CM_ BO_ 2566609152  "Source: isobus.net VDMA Data Dictionary (https://www.isobus.net/isobus/pGNAndSPN/11431?type=PGN)";
CM_ BO_ 2566609408  "Source: isobus.net VDMA Data Dictionary (https://www.isobus.net/isobus/pGNAndSPN/11441?type=PGN)";
CM_ BO_ 2566609664  "Source: isobus.net VDMA Data Dictionary (https://www.isobus.net/isobus/pGNAndSPN/11465?type=PGN)";
CM_ BO_ 2566609920  "Source: isobus.net VDMA Data Dictionary (https://www.isobus.net/isobus/pGNAndSPN/11489?type=PGN)";
CM_ BO_ 2566610176  "Source: isobus.net VDMA Data Dictionary (https://www.isobus.net/isobus/pGNAndSPN/11513?type=PGN)";
CM_ BO_ 2566610432  "Source: isobus.net VDMA Data Dictionary (https://www.isobus.net/isobus/pGNAndSPN/11537?type=PGN)";
CM_ BO_ 2566610688  "Source: isobus.net VDMA Data Dictionary (https://www.isobus.net/isobus/pGNAndSPN/11545?type=PGN)";
CM_ BO_ 2566610944  "Source: isobus.net VDMA Data Dictionary (https://www.isobus.net/isobus/pGNAndSPN/11553?type=PGN)";
CM_ BO_ 2566611200  "Source: isobus.net VDMA Data Dictionary (https://www.isobus.net/isobus/pGNAndSPN/11561?type=PGN)";
CM_ BO_ 2566611456  "Source: isobus.net VDMA Data Dictionary (https://www.isobus.net/isobus/pGNAndSPN/11569?type=PGN)";
CM_ BO_ 2566611712  "Source: isobus.net VDMA Data Dictionary (https://www.isobus.net/isobus/pGNAndSPN/11582?type=PGN)";
CM_ BO_ 2566611968  "Source: isobus.net VDMA Data Dictionary (https://www.isobus.net/isobus/pGNAndSPN/11595?type=PGN)";
CM_ BO_ 2566612224  "Source: isobus.net VDMA Data Dictionary (https://www.isobus.net/isobus/pGNAndSPN/11608?type=PGN)";
CM_ BO_ 2566612480  "Source: isobus.net VDMA Data Dictionary (https://www.isobus.net/isobus/pGNAndSPN/11621?type=PGN)";
CM_ BO_ 2566612736  "Source: isobus.net VDMA Data Dictionary (https://www.isobus.net/isobus/pGNAndSPN/11640?type=PGN)";
CM_ BO_ 2566612992  "Source: isobus.net VDMA Data Dictionary (https://www.isobus.net/isobus/pGNAndSPN/11647?type=PGN)";
CM_ BO_ 2566613248  "Source: isobus.net VDMA Data Dictionary (https://www.isobus.net/isobus/pGNAndSPN/11666?type=PGN)";
CM_ BO_ 2566613504  "Source: isobus.net VDMA Data Dictionary (https://www.isobus.net/isobus/pGNAndSPN/11673?type=PGN)";
CM_ BO_ 2566613760  "Source: isobus.net VDMA Data Dictionary (https://www.isobus.net/isobus/pGNAndSPN/11679?type=PGN)";
CM_ BO_ 2566614016  "Source: isobus.net VDMA Data Dictionary (https://www.isobus.net/isobus/pGNAndSPN/11684?type=PGN)";
CM_ BO_ 2566614272  "Source: isobus.net VDMA Data Dictionary (https://www.isobus.net/isobus/pGNAndSPN/11690?type=PGN)";
CM_ BO_ 2566614528  "Source: isobus.net VDMA Data Dictionary (https://www.isobus.net/isobus/pGNAndSPN/11694?type=PGN)";
CM_ BO_ 2566614784  "Source: isobus.net VDMA Data Dictionary (https://www.isobus.net/isobus/pGNAndSPN/11699?type=PGN)";
CM_ BO_ 2566615040  "Source: isobus.net VDMA Data Dictionary (https://www.isobus.net/isobus/pGNAndSPN/11703?type=PGN)";
CM_ BO_ 2566615296  "Source: isobus.net VDMA Data Dictionary (https://www.isobus.net/isobus/pGNAndSPN/11707?type=PGN)";
CM_ BO_ 2566615552  "Source: isobus.net VDMA Data Dictionary (https://www.isobus.net/isobus/pGNAndSPN/11712?type=PGN)";
CM_ BO_ 2566615808  "Source: isobus.net VDMA Data Dictionary (https://www.isobus.net/isobus/pGNAndSPN/11716?type=PGN)";
CM_ BO_ 2566616064  "Source: isobus.net VDMA Data Dictionary (https://www.isobus.net/isobus/pGNAndSPN/11722?type=PGN)";
CM_ BO_ 2566616320  "Source: isobus.net VDMA Data Dictionary (https://www.isobus.net/isobus/pGNAndSPN/11727?type=PGN)";
CM_ BO_ 2566616576  "Source: isobus.net VDMA Data Dictionary (https://www.isobus.net/isobus/pGNAndSPN/11737?type=PGN)";
CM_ BO_ 2566616832  "Source: isobus.net VDMA Data Dictionary (https://www.isobus.net/isobus/pGNAndSPN/11745?type=PGN)";
CM_ BO_ 2566617088  "Source: isobus.net VDMA Data Dictionary (https://www.isobus.net/isobus/pGNAndSPN/11753?type=PGN)";
CM_ BO_ 2566617344  "Source: isobus.net VDMA Data Dictionary (https://www.isobus.net/isobus/pGNAndSPN/11761?type=PGN)";
CM_ BO_ 2566617600  "Source: isobus.net VDMA Data Dictionary (https://www.isobus.net/isobus/pGNAndSPN/11769?type=PGN)";
CM_ BO_ 2566617856  "Source: isobus.net VDMA Data Dictionary (https://www.isobus.net/isobus/pGNAndSPN/11777?type=PGN)";
CM_ BO_ 2566618112  "Source: isobus.net VDMA Data Dictionary (https://www.isobus.net/isobus/pGNAndSPN/11779?type=PGN)";
CM_ BO_ 2566618368  "Source: isobus.net VDMA Data Dictionary (https://www.isobus.net/isobus/pGNAndSPN/11787?type=PGN)";
CM_ BO_ 2566618624  "Source: isobus.net VDMA Data Dictionary (https://www.isobus.net/isobus/pGNAndSPN/11795?type=PGN)";
CM_ BO_ 2566618880  "Source: isobus.net VDMA Data Dictionary (https://www.isobus.net/isobus/pGNAndSPN/11798?type=PGN)";
CM_ BO_ 2566619136  "Source: isobus.net VDMA Data Dictionary (https://www.isobus.net/isobus/pGNAndSPN/11809?type=PGN)";
CM_ BO_ 2566619392  "Source: isobus.net VDMA Data Dictionary (https://www.isobus.net/isobus/pGNAndSPN/11812?type=PGN)";
CM_ BO_ 2566619648  "Source: isobus.net VDMA Data Dictionary (https://www.isobus.net/isobus/pGNAndSPN/11817?type=PGN)";
CM_ BO_ 2566619904  "Source: isobus.net VDMA Data Dictionary (https://www.isobus.net/isobus/pGNAndSPN/11822?type=PGN)";
CM_ BO_ 2566620160  "Source: isobus.net VDMA Data Dictionary (https://www.isobus.net/isobus/pGNAndSPN/11826?type=PGN)";
CM_ BO_ 2566620416  "Source: isobus.net VDMA Data Dictionary (https://www.isobus.net/isobus/pGNAndSPN/11830?type=PGN)";
CM_ BO_ 2566620672  "Source: isobus.net VDMA Data Dictionary (https://www.isobus.net/isobus/pGNAndSPN/11831?type=PGN)";
CM_ BO_ 2566620928  "Source: isobus.net VDMA Data Dictionary (https://www.isobus.net/isobus/pGNAndSPN/11832?type=PGN)";
CM_ BO_ 2566621184  "Source: isobus.net VDMA Data Dictionary (https://www.isobus.net/isobus/pGNAndSPN/11845?type=PGN)";
CM_ BO_ 2566621440  "Source: isobus.net VDMA Data Dictionary (https://www.isobus.net/isobus/pGNAndSPN/11852?type=PGN)";
CM_ BO_ 2566621696  "Source: isobus.net VDMA Data Dictionary (https://www.isobus.net/isobus/pGNAndSPN/11857?type=PGN)";
CM_ BO_ 2566621952  "Source: isobus.net VDMA Data Dictionary (https://www.isobus.net/isobus/pGNAndSPN/11859?type=PGN)";
CM_ BO_ 2566622208  "Source: isobus.net VDMA Data Dictionary (https://www.isobus.net/isobus/pGNAndSPN/11861?type=PGN)";
CM_ BO_ 2566622464  "Source: isobus.net VDMA Data Dictionary (https://www.isobus.net/isobus/pGNAndSPN/11863?type=PGN)";
CM_ BO_ 2566622720  "Source: isobus.net VDMA Data Dictionary (https://www.isobus.net/isobus/pGNAndSPN/11865?type=PGN)";
CM_ BO_ 2566622976  "Source: isobus.net VDMA Data Dictionary (https://www.isobus.net/isobus/pGNAndSPN/11867?type=PGN)";
CM_ BO_ 2566623232  "Source: isobus.net VDMA Data Dictionary (https://www.isobus.net/isobus/pGNAndSPN/11869?type=PGN)";
CM_ BO_ 2566623488  "Source: isobus.net VDMA Data Dictionary (https://www.isobus.net/isobus/pGNAndSPN/11871?type=PGN)";
CM_ BO_ 2566623744  "Source: isobus.net VDMA Data Dictionary (https://www.isobus.net/isobus/pGNAndSPN/11873?type=PGN)";
CM_ BO_ 2566624000  "Source: isobus.net VDMA Data Dictionary (https://www.isobus.net/isobus/pGNAndSPN/11875?type=PGN)";
CM_ BO_ 2566624256  "Source: isobus.net VDMA Data Dictionary (https://www.isobus.net/isobus/pGNAndSPN/11877?type=PGN)";
CM_ BO_ 2566624512  "Source: isobus.net VDMA Data Dictionary (https://www.isobus.net/isobus/pGNAndSPN/11878?type=PGN)";
CM_ BO_ 2566624768  "Source: isobus.net VDMA Data Dictionary (https://www.isobus.net/isobus/pGNAndSPN/11881?type=PGN)";
CM_ BO_ 2566625024  "Source: isobus.net VDMA Data Dictionary (https://www.isobus.net/isobus/pGNAndSPN/11885?type=PGN)";
CM_ BO_ 2566625280  "Source: isobus.net VDMA Data Dictionary (https://www.isobus.net/isobus/pGNAndSPN/11886?type=PGN)";
CM_ BO_ 2566625536  "Source: isobus.net VDMA Data Dictionary (https://www.isobus.net/isobus/pGNAndSPN/11891?type=PGN)";
CM_ BO_ 2566625792  "Source: isobus.net VDMA Data Dictionary (https://www.isobus.net/isobus/pGNAndSPN/11895?type=PGN)";
CM_ BO_ 2566626048  "Source: isobus.net VDMA Data Dictionary (https://www.isobus.net/isobus/pGNAndSPN/11898?type=PGN)";
CM_ BO_ 2566626304  "Source: isobus.net VDMA Data Dictionary (https://www.isobus.net/isobus/pGNAndSPN/11905?type=PGN)";
CM_ BO_ 2566626560  "Source: isobus.net VDMA Data Dictionary (https://www.isobus.net/isobus/pGNAndSPN/11907?type=PGN)";
CM_ BO_ 2566626816  "Source: isobus.net VDMA Data Dictionary (https://www.isobus.net/isobus/pGNAndSPN/11912?type=PGN)";
CM_ BO_ 2566627072  "Source: isobus.net VDMA Data Dictionary (https://www.isobus.net/isobus/pGNAndSPN/11916?type=PGN)";
CM_ BO_ 2566627328  "Source: isobus.net VDMA Data Dictionary (https://www.isobus.net/isobus/pGNAndSPN/11919?type=PGN)";
CM_ BO_ 2566627584  "Source: isobus.net VDMA Data Dictionary (https://www.isobus.net/isobus/pGNAndSPN/11926?type=PGN)";
CM_ BO_ 2566627840  "Source: isobus.net VDMA Data Dictionary (https://www.isobus.net/isobus/pGNAndSPN/11928?type=PGN)";
CM_ BO_ 2566628096  "Source: isobus.net VDMA Data Dictionary (https://www.isobus.net/isobus/pGNAndSPN/11933?type=PGN)";
CM_ BO_ 2566628352  "Source: isobus.net VDMA Data Dictionary (https://www.isobus.net/isobus/pGNAndSPN/11937?type=PGN)";
CM_ BO_ 2566628608  "Source: isobus.net VDMA Data Dictionary (https://www.isobus.net/isobus/pGNAndSPN/11940?type=PGN)";
CM_ BO_ 2566628864  "Source: isobus.net VDMA Data Dictionary (https://www.isobus.net/isobus/pGNAndSPN/11947?type=PGN)";
CM_ BO_ 2566629120  "Source: isobus.net VDMA Data Dictionary (https://www.isobus.net/isobus/pGNAndSPN/11949?type=PGN)";
CM_ BO_ 2566629376  "Source: isobus.net VDMA Data Dictionary (https://www.isobus.net/isobus/pGNAndSPN/11954?type=PGN)";
CM_ BO_ 2566629632  "Source: isobus.net VDMA Data Dictionary (https://www.isobus.net/isobus/pGNAndSPN/11958?type=PGN)";
CM_ BO_ 2566629888  "Source: isobus.net VDMA Data Dictionary (https://www.isobus.net/isobus/pGNAndSPN/11961?type=PGN)";
CM_ BO_ 2566630144  "Source: isobus.net VDMA Data Dictionary (https://www.isobus.net/isobus/pGNAndSPN/11968?type=PGN)";
CM_ BO_ 2566630400  "Source: isobus.net VDMA Data Dictionary (https://www.isobus.net/isobus/pGNAndSPN/11970?type=PGN)";
CM_ BO_ 2566630656  "Source: isobus.net VDMA Data Dictionary (https://www.isobus.net/isobus/pGNAndSPN/11975?type=PGN)";
CM_ BO_ 2566630912  "Source: isobus.net VDMA Data Dictionary (https://www.isobus.net/isobus/pGNAndSPN/11979?type=PGN)";
CM_ BO_ 2566631168  "Source: isobus.net VDMA Data Dictionary (https://www.isobus.net/isobus/pGNAndSPN/11982?type=PGN)";
CM_ BO_ 2566631424  "Source: isobus.net VDMA Data Dictionary (https://www.isobus.net/isobus/pGNAndSPN/11989?type=PGN)";
CM_ BO_ 2566631680  "Source: isobus.net VDMA Data Dictionary (https://www.isobus.net/isobus/pGNAndSPN/11991?type=PGN)";
CM_ BO_ 2566631936  "Source: isobus.net VDMA Data Dictionary (https://www.isobus.net/isobus/pGNAndSPN/11995?type=PGN)";
CM_ BO_ 2566632192  "Source: isobus.net VDMA Data Dictionary (https://www.isobus.net/isobus/pGNAndSPN/11997?type=PGN)";
CM_ BO_ 2566632448  "Source: isobus.net VDMA Data Dictionary (https://www.isobus.net/isobus/pGNAndSPN/11999?type=PGN)";
CM_ BO_ 2566632704  "Source: isobus.net VDMA Data Dictionary (https://www.isobus.net/isobus/pGNAndSPN/12001?type=PGN)";
CM_ BO_ 2566632960  "Source: isobus.net VDMA Data Dictionary (https://www.isobus.net/isobus/pGNAndSPN/12003?type=PGN)";
CM_ BO_ 2566633216  "Source: isobus.net VDMA Data Dictionary (https://www.isobus.net/isobus/pGNAndSPN/12005?type=PGN)";
CM_ BO_ 2566633472  "Source: isobus.net VDMA Data Dictionary (https://www.isobus.net/isobus/pGNAndSPN/12009?type=PGN)";
CM_ BO_ 2566633728  "Source: isobus.net VDMA Data Dictionary (https://www.isobus.net/isobus/pGNAndSPN/12021?type=PGN)";
CM_ BO_ 2566633984  "Source: isobus.net VDMA Data Dictionary (https://www.isobus.net/isobus/pGNAndSPN/12024?type=PGN)";
CM_ BO_ 2566634240  "Source: isobus.net VDMA Data Dictionary (https://www.isobus.net/isobus/pGNAndSPN/12029?type=PGN)";
CM_ BO_ 2566634496  "Source: isobus.net VDMA Data Dictionary (https://www.isobus.net/isobus/pGNAndSPN/12033?type=PGN)";
CM_ BO_ 2566634752  "Source: isobus.net VDMA Data Dictionary (https://www.isobus.net/isobus/pGNAndSPN/12037?type=PGN)";
CM_ BO_ 2566635008  "Source: isobus.net VDMA Data Dictionary (https://www.isobus.net/isobus/pGNAndSPN/12041?type=PGN)";
CM_ BO_ 2566635264  "Source: isobus.net VDMA Data Dictionary (https://www.isobus.net/isobus/pGNAndSPN/12053?type=PGN)";
CM_ BO_ 2566635520  "Source: isobus.net VDMA Data Dictionary (https://www.isobus.net/isobus/pGNAndSPN/12056?type=PGN)";
CM_ BO_ 2566635776  "Source: isobus.net VDMA Data Dictionary (https://www.isobus.net/isobus/pGNAndSPN/12061?type=PGN)";
CM_ BO_ 2566636032  "Source: isobus.net VDMA Data Dictionary (https://www.isobus.net/isobus/pGNAndSPN/12065?type=PGN)";
CM_ BO_ 2566636288  "Source: isobus.net VDMA Data Dictionary (https://www.isobus.net/isobus/pGNAndSPN/12069?type=PGN)";
CM_ BO_ 2566636544  "Source: isobus.net VDMA Data Dictionary (https://www.isobus.net/isobus/pGNAndSPN/12073?type=PGN)";
CM_ BO_ 2566636800  "Source: isobus.net VDMA Data Dictionary (https://www.isobus.net/isobus/pGNAndSPN/12085?type=PGN)";
CM_ BO_ 2566637056  "Source: isobus.net VDMA Data Dictionary (https://www.isobus.net/isobus/pGNAndSPN/12088?type=PGN)";
CM_ BO_ 2566637312  "Source: isobus.net VDMA Data Dictionary (https://www.isobus.net/isobus/pGNAndSPN/12093?type=PGN)";
CM_ BO_ 2566637568  "Source: isobus.net VDMA Data Dictionary (https://www.isobus.net/isobus/pGNAndSPN/12097?type=PGN)";
CM_ BO_ 2566637824  "Source: isobus.net VDMA Data Dictionary (https://www.isobus.net/isobus/pGNAndSPN/12101?type=PGN)";
CM_ BO_ 2566638080  "Source: isobus.net VDMA Data Dictionary (https://www.isobus.net/isobus/pGNAndSPN/12102?type=PGN)";
CM_ BO_ 2566638336  "Source: isobus.net VDMA Data Dictionary (https://www.isobus.net/isobus/pGNAndSPN/12104?type=PGN)";
CM_ BO_ 2566638592  "Source: isobus.net VDMA Data Dictionary (https://www.isobus.net/isobus/pGNAndSPN/12108?type=PGN)";
CM_ BO_ 2566638848  "Source: isobus.net VDMA Data Dictionary (https://www.isobus.net/isobus/pGNAndSPN/12119?type=PGN)";
CM_ BO_ 2566639104  "Source: isobus.net VDMA Data Dictionary (https://www.isobus.net/isobus/pGNAndSPN/12126?type=PGN)";
CM_ BO_ 2566639360  "Source: isobus.net VDMA Data Dictionary (https://www.isobus.net/isobus/pGNAndSPN/12130?type=PGN)";
CM_ BO_ 2566639616  "Source: isobus.net VDMA Data Dictionary (https://www.isobus.net/isobus/pGNAndSPN/12142?type=PGN)";
CM_ BO_ 2566639872  "Source: isobus.net VDMA Data Dictionary (https://www.isobus.net/isobus/pGNAndSPN/12145?type=PGN)";
CM_ BO_ 2566640128  "Source: isobus.net VDMA Data Dictionary (https://www.isobus.net/isobus/pGNAndSPN/12149?type=PGN)";
CM_ BO_ 2566640384  "Source: isobus.net VDMA Data Dictionary (https://www.isobus.net/isobus/pGNAndSPN/12153?type=PGN)";
CM_ BO_ 2566640640  "Source: isobus.net VDMA Data Dictionary (https://www.isobus.net/isobus/pGNAndSPN/12157?type=PGN)";
CM_ BO_ 2566640896  "Source: isobus.net VDMA Data Dictionary (https://www.isobus.net/isobus/pGNAndSPN/12161?type=PGN)";
CM_ BO_ 2566641152  "Source: isobus.net VDMA Data Dictionary (https://www.isobus.net/isobus/pGNAndSPN/12163?type=PGN)";
CM_ BO_ 2566641408  "Source: isobus.net VDMA Data Dictionary (https://www.isobus.net/isobus/pGNAndSPN/12170?type=PGN)";
CM_ BO_ 2566641664  "Source: isobus.net VDMA Data Dictionary (https://www.isobus.net/isobus/pGNAndSPN/12175?type=PGN)";
CM_ BO_ 2566641920  "Source: isobus.net VDMA Data Dictionary (https://www.isobus.net/isobus/pGNAndSPN/12179?type=PGN)";
CM_ BO_ 2566642176  "Source: isobus.net VDMA Data Dictionary (https://www.isobus.net/isobus/pGNAndSPN/12183?type=PGN)";
CM_ BO_ 2566642688  "Source: isobus.net VDMA Data Dictionary (https://www.isobus.net/isobus/pGNAndSPN/12216?type=PGN)";
CM_ BO_ 2566642944  "Source: isobus.net VDMA Data Dictionary (https://www.isobus.net/isobus/pGNAndSPN/12246?type=PGN)";
CM_ BO_ 2566643200  "Source: isobus.net VDMA Data Dictionary (https://www.isobus.net/isobus/pGNAndSPN/12250?type=PGN)";
CM_ BO_ 2566643456  "Source: isobus.net VDMA Data Dictionary (https://www.isobus.net/isobus/pGNAndSPN/12254?type=PGN)";
CM_ BO_ 2566643712  "Source: isobus.net VDMA Data Dictionary (https://www.isobus.net/isobus/pGNAndSPN/12262?type=PGN)";
CM_ BO_ 2566643968  "Source: isobus.net VDMA Data Dictionary (https://www.isobus.net/isobus/pGNAndSPN/12266?type=PGN)";
CM_ BO_ 2566644224  "Source: isobus.net VDMA Data Dictionary (https://www.isobus.net/isobus/pGNAndSPN/12274?type=PGN)";
CM_ BO_ 2566644480  "Source: isobus.net VDMA Data Dictionary (https://www.isobus.net/isobus/pGNAndSPN/12282?type=PGN)";
CM_ BO_ 2566644736  "Source: isobus.net VDMA Data Dictionary (https://www.isobus.net/isobus/pGNAndSPN/12294?type=PGN)";
CM_ BO_ 2566644992  "Source: isobus.net VDMA Data Dictionary (https://www.isobus.net/isobus/pGNAndSPN/12303?type=PGN)";
CM_ BO_ 2566645248  "Source: isobus.net VDMA Data Dictionary (https://www.isobus.net/isobus/pGNAndSPN/12325?type=PGN)";
CM_ BO_ 2566645504  "Source: isobus.net VDMA Data Dictionary (https://www.isobus.net/isobus/pGNAndSPN/12327?type=PGN)";
CM_ BO_ 2566645760  "Source: isobus.net VDMA Data Dictionary (https://www.isobus.net/isobus/pGNAndSPN/12331?type=PGN)";
CM_ BO_ 2566646016  "Source: isobus.net VDMA Data Dictionary (https://www.isobus.net/isobus/pGNAndSPN/12332?type=PGN)";
CM_ BO_ 2566646272  "Source: isobus.net VDMA Data Dictionary (https://www.isobus.net/isobus/pGNAndSPN/12352?type=PGN)";
CM_ BO_ 2566646528  "Source: isobus.net VDMA Data Dictionary (https://www.isobus.net/isobus/pGNAndSPN/12355?type=PGN)";
CM_ BO_ 2566646784  "Source: isobus.net VDMA Data Dictionary (https://www.isobus.net/isobus/pGNAndSPN/12358?type=PGN)";
CM_ BO_ 2566647040  "Source: isobus.net VDMA Data Dictionary (https://www.isobus.net/isobus/pGNAndSPN/12361?type=PGN)";
CM_ BO_ 2566647296  "Source: isobus.net VDMA Data Dictionary (https://www.isobus.net/isobus/pGNAndSPN/12364?type=PGN)";
CM_ BO_ 2566647552  "Source: isobus.net VDMA Data Dictionary (https://www.isobus.net/isobus/pGNAndSPN/12367?type=PGN)";
CM_ BO_ 2566647808  "Source: isobus.net VDMA Data Dictionary (https://www.isobus.net/isobus/pGNAndSPN/12370?type=PGN)";
CM_ BO_ 2566648064  "Source: isobus.net VDMA Data Dictionary (https://www.isobus.net/isobus/pGNAndSPN/12376?type=PGN)";
CM_ BO_ 2566648320  "Source: isobus.net VDMA Data Dictionary (https://www.isobus.net/isobus/pGNAndSPN/12378?type=PGN)";
CM_ BO_ 2566648576  "Source: isobus.net VDMA Data Dictionary (https://www.isobus.net/isobus/pGNAndSPN/12379?type=PGN)";
CM_ BO_ 2566648832  "Source: isobus.net VDMA Data Dictionary (https://www.isobus.net/isobus/pGNAndSPN/12382?type=PGN)";
CM_ BO_ 2566649088  "Source: isobus.net VDMA Data Dictionary (https://www.isobus.net/isobus/pGNAndSPN/12385?type=PGN)";
CM_ BO_ 2566649344  "Source: isobus.net VDMA Data Dictionary (https://www.isobus.net/isobus/pGNAndSPN/12390?type=PGN)";
CM_ BO_ 2566649600  "Source: isobus.net VDMA Data Dictionary (https://www.isobus.net/isobus/pGNAndSPN/12398?type=PGN)";
CM_ BO_ 2566649856  "Source: isobus.net VDMA Data Dictionary (https://www.isobus.net/isobus/pGNAndSPN/12406?type=PGN)";
CM_ BO_ 2566650112  "Source: isobus.net VDMA Data Dictionary (https://www.isobus.net/isobus/pGNAndSPN/12414?type=PGN)";
CM_ BO_ 2566650368  "Source: isobus.net VDMA Data Dictionary (https://www.isobus.net/isobus/pGNAndSPN/12422?type=PGN)";
CM_ BO_ 2566650624  "Source: isobus.net VDMA Data Dictionary (https://www.isobus.net/isobus/pGNAndSPN/12430?type=PGN)";
CM_ BO_ 2566650880  "Source: isobus.net VDMA Data Dictionary (https://www.isobus.net/isobus/pGNAndSPN/12438?type=PGN)";
CM_ BO_ 2566651136  "Source: isobus.net VDMA Data Dictionary (https://www.isobus.net/isobus/pGNAndSPN/12446?type=PGN)";
CM_ BO_ 2566651392  "Source: isobus.net VDMA Data Dictionary (https://www.isobus.net/isobus/pGNAndSPN/12454?type=PGN)";
CM_ BO_ 2566651648  "Source: isobus.net VDMA Data Dictionary (https://www.isobus.net/isobus/pGNAndSPN/12462?type=PGN)";
CM_ BO_ 2566651904  "Source: isobus.net VDMA Data Dictionary (https://www.isobus.net/isobus/pGNAndSPN/12478?type=PGN)";
CM_ BO_ 2566652160  "Source: isobus.net VDMA Data Dictionary (https://www.isobus.net/isobus/pGNAndSPN/12487?type=PGN)";
CM_ BO_ 2566652416  "Source: isobus.net VDMA Data Dictionary (https://www.isobus.net/isobus/pGNAndSPN/12492?type=PGN)";
CM_ BO_ 2566652672  "Source: isobus.net VDMA Data Dictionary (https://www.isobus.net/isobus/pGNAndSPN/12497?type=PGN)";
CM_ BO_ 2566652928  "Source: isobus.net VDMA Data Dictionary (https://www.isobus.net/isobus/pGNAndSPN/12500?type=PGN)";
CM_ BO_ 2566653184  "Source: isobus.net VDMA Data Dictionary (https://www.isobus.net/isobus/pGNAndSPN/12505?type=PGN)";
CM_ BO_ 2566653440  "Source: isobus.net VDMA Data Dictionary (https://www.isobus.net/isobus/pGNAndSPN/12508?type=PGN)";
CM_ BO_ 2566653696  "Source: isobus.net VDMA Data Dictionary (https://www.isobus.net/isobus/pGNAndSPN/12513?type=PGN)";
CM_ BO_ 2566653952  "Source: isobus.net VDMA Data Dictionary (https://www.isobus.net/isobus/pGNAndSPN/12516?type=PGN)";
CM_ BO_ 2566654208  "Source: isobus.net VDMA Data Dictionary (https://www.isobus.net/isobus/pGNAndSPN/12521?type=PGN)";
CM_ BO_ 2566654464  "Source: isobus.net VDMA Data Dictionary (https://www.isobus.net/isobus/pGNAndSPN/12524?type=PGN)";
CM_ SG_ 2566565376 High_Voltage_Energy_Storage_Pack "Generic 8-byte raw payload. Detail page: https://www.isobus.net/isobus/pGNAndSPN/10327?type=PGN. Signal-level enrichment via PR welcome  see CONTRIBUTING.md.";
CM_ SG_ 2566565632 High_Voltage_Energy_Storage_Pack "Generic 8-byte raw payload. Detail page: https://www.isobus.net/isobus/pGNAndSPN/10337?type=PGN. Signal-level enrichment via PR welcome  see CONTRIBUTING.md.";
CM_ SG_ 2566565888 High_Voltage_Energy_Storage_Pack "Generic 8-byte raw payload. Detail page: https://www.isobus.net/isobus/pGNAndSPN/10343?type=PGN. Signal-level enrichment via PR welcome  see CONTRIBUTING.md.";
CM_ SG_ 2566566144 High_Voltage_Energy_Storage_Pack "Generic 8-byte raw payload. Detail page: https://www.isobus.net/isobus/pGNAndSPN/10353?type=PGN. Signal-level enrichment via PR welcome  see CONTRIBUTING.md.";
CM_ SG_ 2566566400 High_Voltage_Energy_Storage_Pack "Generic 8-byte raw payload. Detail page: https://www.isobus.net/isobus/pGNAndSPN/10359?type=PGN. Signal-level enrichment via PR welcome  see CONTRIBUTING.md.";
CM_ SG_ 2566566656 AUTOSAR_Time_Synchronization_Raw "Generic 8-byte raw payload. Detail page: https://www.isobus.net/isobus/pGNAndSPN/10360?type=PGN. Signal-level enrichment via PR welcome  see CONTRIBUTING.md.";
CM_ SG_ 2566566912 EV_DC_Charging_Limits_1_RawPaylo "Generic 8-byte raw payload. Detail page: https://www.isobus.net/isobus/pGNAndSPN/10364?type=PGN. Signal-level enrichment via PR welcome  see CONTRIBUTING.md.";
CM_ SG_ 2566567168 EVSE_DC_Charging_Limits_1_RawPay "Generic 8-byte raw payload. Detail page: https://www.isobus.net/isobus/pGNAndSPN/10368?type=PGN. Signal-level enrichment via PR welcome  see CONTRIBUTING.md.";
CM_ SG_ 2566567424 EVSE_DC_Charging_Limits_2_RawPay "Generic 8-byte raw payload. Detail page: https://www.isobus.net/isobus/pGNAndSPN/10372?type=PGN. Signal-level enrichment via PR welcome  see CONTRIBUTING.md.";
CM_ SG_ 2566567680 EV_DC_Charging_Target_RawPayload "Generic 8-byte raw payload. Detail page: https://www.isobus.net/isobus/pGNAndSPN/10376?type=PGN. Signal-level enrichment via PR welcome  see CONTRIBUTING.md.";
CM_ SG_ 2566567936 EVSE_DC_Status_1_RawPayload "Generic 8-byte raw payload. Detail page: https://www.isobus.net/isobus/pGNAndSPN/10386?type=PGN. Signal-level enrichment via PR welcome  see CONTRIBUTING.md.";
CM_ SG_ 2566568192 EVSE_1_Contactor_Cmd_1_RawPayloa "Generic 8-byte raw payload. Detail page: https://www.isobus.net/isobus/pGNAndSPN/10387?type=PGN. Signal-level enrichment via PR welcome  see CONTRIBUTING.md.";
CM_ SG_ 2566568448 EVSE_1_Contactor_Status_1_RawPay "Generic 8-byte raw payload. Detail page: https://www.isobus.net/isobus/pGNAndSPN/10390?type=PGN. Signal-level enrichment via PR welcome  see CONTRIBUTING.md.";
CM_ SG_ 2566568704 Direct_Lamp_Control_Command_3_Ra "Generic 8-byte raw payload. Detail page: https://www.isobus.net/isobus/pGNAndSPN/10392?type=PGN. Signal-level enrichment via PR welcome  see CONTRIBUTING.md.";
CM_ SG_ 2566568960 Direct_Lamp_Control_Data_3_RawPa "Generic 8-byte raw payload. Detail page: https://www.isobus.net/isobus/pGNAndSPN/10394?type=PGN. Signal-level enrichment via PR welcome  see CONTRIBUTING.md.";
CM_ SG_ 2566569216 Motor_Generator_1_Lifetime_Data_ "Generic 8-byte raw payload. Detail page: https://www.isobus.net/isobus/pGNAndSPN/10398?type=PGN. Signal-level enrichment via PR welcome  see CONTRIBUTING.md.";
CM_ SG_ 2566569472 Motor_Generator_2_Lifetime_Data_ "Generic 8-byte raw payload. Detail page: https://www.isobus.net/isobus/pGNAndSPN/10402?type=PGN. Signal-level enrichment via PR welcome  see CONTRIBUTING.md.";
CM_ SG_ 2566569728 Motor_Generator_3_Lifetime_Data_ "Generic 8-byte raw payload. Detail page: https://www.isobus.net/isobus/pGNAndSPN/10406?type=PGN. Signal-level enrichment via PR welcome  see CONTRIBUTING.md.";
CM_ SG_ 2566569984 Motor_Generator_4_Lifetime_Data_ "Generic 8-byte raw payload. Detail page: https://www.isobus.net/isobus/pGNAndSPN/10410?type=PGN. Signal-level enrichment via PR welcome  see CONTRIBUTING.md.";
CM_ SG_ 2566570240 Motor_Generator_5_Lifetime_Data_ "Generic 8-byte raw payload. Detail page: https://www.isobus.net/isobus/pGNAndSPN/10414?type=PGN. Signal-level enrichment via PR welcome  see CONTRIBUTING.md.";
CM_ SG_ 2566570496 Motor_Generator_6_Lifetime_Data_ "Generic 8-byte raw payload. Detail page: https://www.isobus.net/isobus/pGNAndSPN/10418?type=PGN. Signal-level enrichment via PR welcome  see CONTRIBUTING.md.";
CM_ SG_ 2566570752 Air_Supply_Pressure_3_RawPayload "Generic 8-byte raw payload. Detail page: https://www.isobus.net/isobus/pGNAndSPN/10420?type=PGN. Signal-level enrichment via PR welcome  see CONTRIBUTING.md.";
CM_ SG_ 2566571008 EVSE_AC_Supply_Voltage_RawPayloa "Generic 8-byte raw payload. Detail page: https://www.isobus.net/isobus/pGNAndSPN/10423?type=PGN. Signal-level enrichment via PR welcome  see CONTRIBUTING.md.";
CM_ SG_ 2566571264 EVSE_AC_3_Phase_Load_RawPayload "Generic 8-byte raw payload. Detail page: https://www.isobus.net/isobus/pGNAndSPN/10427?type=PGN. Signal-level enrichment via PR welcome  see CONTRIBUTING.md.";
CM_ SG_ 2566571520 Electronic_Retarder_Controller_3 "Generic 8-byte raw payload. Detail page: https://www.isobus.net/isobus/pGNAndSPN/10429?type=PGN. Signal-level enrichment via PR welcome  see CONTRIBUTING.md.";
CM_ SG_ 2566572032 Electronic_Transmission_Controll "Generic 8-byte raw payload. Detail page: https://www.isobus.net/isobus/pGNAndSPN/10434?type=PGN. Signal-level enrichment via PR welcome  see CONTRIBUTING.md.";
CM_ SG_ 2566572800 Collision_Avoidance_System_4_Raw "Generic 8-byte raw payload. Detail page: https://www.isobus.net/isobus/pGNAndSPN/10435?type=PGN. Signal-level enrichment via PR welcome  see CONTRIBUTING.md.";
CM_ SG_ 2566573056 Collision_Avoidance_System_3_Raw "Generic 8-byte raw payload. Detail page: https://www.isobus.net/isobus/pGNAndSPN/10436?type=PGN. Signal-level enrichment via PR welcome  see CONTRIBUTING.md.";
CM_ SG_ 2566573312 Aftertreatment_1_SCR_Exhaust_Gas "Generic 8-byte raw payload. Detail page: https://www.isobus.net/isobus/pGNAndSPN/10438?type=PGN. Signal-level enrichment via PR welcome  see CONTRIBUTING.md.";
CM_ SG_ 2566573568 PTO_Information_2_RawPayload "Generic 8-byte raw payload. Detail page: https://www.isobus.net/isobus/pGNAndSPN/10440?type=PGN. Signal-level enrichment via PR welcome  see CONTRIBUTING.md.";
CM_ SG_ 2566573824 EVCC_Diagnostic_Data_1_RawPayloa "Generic 8-byte raw payload. Detail page: https://www.isobus.net/isobus/pGNAndSPN/10449?type=PGN. Signal-level enrichment via PR welcome  see CONTRIBUTING.md.";
CM_ SG_ 2566574080 Cab_Door_Control_2_RawPayload "Generic 8-byte raw payload. Detail page: https://www.isobus.net/isobus/pGNAndSPN/10452?type=PGN. Signal-level enrichment via PR welcome  see CONTRIBUTING.md.";
CM_ SG_ 2566574336 Engine_Average_Information_2_Raw "Generic 8-byte raw payload. Detail page: https://www.isobus.net/isobus/pGNAndSPN/10455?type=PGN. Signal-level enrichment via PR welcome  see CONTRIBUTING.md.";
CM_ SG_ 2566574592 Turbocharger_Information_9_RawPa "Generic 8-byte raw payload. Detail page: https://www.isobus.net/isobus/pGNAndSPN/10459?type=PGN. Signal-level enrichment via PR welcome  see CONTRIBUTING.md.";
CM_ SG_ 2566574848 Automated_Driving_System_Control "Generic 8-byte raw payload. Detail page: https://www.isobus.net/isobus/pGNAndSPN/10464?type=PGN. Signal-level enrichment via PR welcome  see CONTRIBUTING.md.";
CM_ SG_ 2566575104 EVSE_AC_Status_2_RawPayload "Generic 8-byte raw payload. Detail page: https://www.isobus.net/isobus/pGNAndSPN/10466?type=PGN. Signal-level enrichment via PR welcome  see CONTRIBUTING.md.";
CM_ SG_ 2566575360 EVSE_AC_Status_1_RawPayload "Generic 8-byte raw payload. Detail page: https://www.isobus.net/isobus/pGNAndSPN/10470?type=PGN. Signal-level enrichment via PR welcome  see CONTRIBUTING.md.";
CM_ SG_ 2566575616 EVSE_Status_1_RawPayload "Generic 8-byte raw payload. Detail page: https://www.isobus.net/isobus/pGNAndSPN/10478?type=PGN. Signal-level enrichment via PR welcome  see CONTRIBUTING.md.";
CM_ SG_ 2566575872 Object_Detection_Message_1_1_Raw "Generic 8-byte raw payload. Detail page: https://www.isobus.net/isobus/pGNAndSPN/10479?type=PGN. Signal-level enrichment via PR welcome  see CONTRIBUTING.md.";
CM_ SG_ 2566576128 Object_Detection_Message_2_1_Raw "Generic 8-byte raw payload. Detail page: https://www.isobus.net/isobus/pGNAndSPN/10480?type=PGN. Signal-level enrichment via PR welcome  see CONTRIBUTING.md.";
CM_ SG_ 2566576384 Object_Detection_Message_2_2_Raw "Generic 8-byte raw payload. Detail page: https://www.isobus.net/isobus/pGNAndSPN/10481?type=PGN. Signal-level enrichment via PR welcome  see CONTRIBUTING.md.";
CM_ SG_ 2566576640 Object_Detection_Message_2_3_Raw "Generic 8-byte raw payload. Detail page: https://www.isobus.net/isobus/pGNAndSPN/10482?type=PGN. Signal-level enrichment via PR welcome  see CONTRIBUTING.md.";
CM_ SG_ 2566576896 Object_Detection_Message_2_4_Raw "Generic 8-byte raw payload. Detail page: https://www.isobus.net/isobus/pGNAndSPN/10483?type=PGN. Signal-level enrichment via PR welcome  see CONTRIBUTING.md.";
CM_ SG_ 2566577152 Object_Detection_Message_2_5_Raw "Generic 8-byte raw payload. Detail page: https://www.isobus.net/isobus/pGNAndSPN/10484?type=PGN. Signal-level enrichment via PR welcome  see CONTRIBUTING.md.";
CM_ SG_ 2566577408 Object_Detection_Message_2_6_Raw "Generic 8-byte raw payload. Detail page: https://www.isobus.net/isobus/pGNAndSPN/10485?type=PGN. Signal-level enrichment via PR welcome  see CONTRIBUTING.md.";
CM_ SG_ 2566577664 Object_Detection_Message_2_7_Raw "Generic 8-byte raw payload. Detail page: https://www.isobus.net/isobus/pGNAndSPN/10486?type=PGN. Signal-level enrichment via PR welcome  see CONTRIBUTING.md.";
CM_ SG_ 2566577920 Object_Detection_Message_2_8_Raw "Generic 8-byte raw payload. Detail page: https://www.isobus.net/isobus/pGNAndSPN/10487?type=PGN. Signal-level enrichment via PR welcome  see CONTRIBUTING.md.";
CM_ SG_ 2566578176 Object_Detection_Message_2_9_Raw "Generic 8-byte raw payload. Detail page: https://www.isobus.net/isobus/pGNAndSPN/10488?type=PGN. Signal-level enrichment via PR welcome  see CONTRIBUTING.md.";
CM_ SG_ 2566578432 Object_Detection_Message_2_10_Ra "Generic 8-byte raw payload. Detail page: https://www.isobus.net/isobus/pGNAndSPN/10489?type=PGN. Signal-level enrichment via PR welcome  see CONTRIBUTING.md.";
CM_ SG_ 2566578688 Object_Detection_Message_2_11_Ra "Generic 8-byte raw payload. Detail page: https://www.isobus.net/isobus/pGNAndSPN/10490?type=PGN. Signal-level enrichment via PR welcome  see CONTRIBUTING.md.";
CM_ SG_ 2566578944 Object_Detection_Message_2_12_Ra "Generic 8-byte raw payload. Detail page: https://www.isobus.net/isobus/pGNAndSPN/10491?type=PGN. Signal-level enrichment via PR welcome  see CONTRIBUTING.md.";
CM_ SG_ 2566579200 Object_Detection_Message_2_13_Ra "Generic 8-byte raw payload. Detail page: https://www.isobus.net/isobus/pGNAndSPN/10492?type=PGN. Signal-level enrichment via PR welcome  see CONTRIBUTING.md.";
CM_ SG_ 2566579456 Object_Detection_Message_2_14_Ra "Generic 8-byte raw payload. Detail page: https://www.isobus.net/isobus/pGNAndSPN/10493?type=PGN. Signal-level enrichment via PR welcome  see CONTRIBUTING.md.";
CM_ SG_ 2566579712 Object_Detection_Message_2_15_Ra "Generic 8-byte raw payload. Detail page: https://www.isobus.net/isobus/pGNAndSPN/10494?type=PGN. Signal-level enrichment via PR welcome  see CONTRIBUTING.md.";
CM_ SG_ 2566579968 Object_Detection_Message_2_16_Ra "Generic 8-byte raw payload. Detail page: https://www.isobus.net/isobus/pGNAndSPN/10495?type=PGN. Signal-level enrichment via PR welcome  see CONTRIBUTING.md.";
CM_ SG_ 2566580224 Object_Detection_Message_2_17_Ra "Generic 8-byte raw payload. Detail page: https://www.isobus.net/isobus/pGNAndSPN/10496?type=PGN. Signal-level enrichment via PR welcome  see CONTRIBUTING.md.";
CM_ SG_ 2566580480 Object_Detection_Message_2_18_Ra "Generic 8-byte raw payload. Detail page: https://www.isobus.net/isobus/pGNAndSPN/10497?type=PGN. Signal-level enrichment via PR welcome  see CONTRIBUTING.md.";
CM_ SG_ 2566580736 Object_Detection_Message_2_19_Ra "Generic 8-byte raw payload. Detail page: https://www.isobus.net/isobus/pGNAndSPN/10498?type=PGN. Signal-level enrichment via PR welcome  see CONTRIBUTING.md.";
CM_ SG_ 2566580992 Object_Detection_Message_2_20_Ra "Generic 8-byte raw payload. Detail page: https://www.isobus.net/isobus/pGNAndSPN/10499?type=PGN. Signal-level enrichment via PR welcome  see CONTRIBUTING.md.";
CM_ SG_ 2566581248 Object_Detection_Message_2_21_Ra "Generic 8-byte raw payload. Detail page: https://www.isobus.net/isobus/pGNAndSPN/10500?type=PGN. Signal-level enrichment via PR welcome  see CONTRIBUTING.md.";
CM_ SG_ 2566581504 Temperature_Sensing_Module_1_Raw "Generic 8-byte raw payload. Detail page: https://www.isobus.net/isobus/pGNAndSPN/10508?type=PGN. Signal-level enrichment via PR welcome  see CONTRIBUTING.md.";
CM_ SG_ 2566581760 Temperature_Sensing_Module_2_Raw "Generic 8-byte raw payload. Detail page: https://www.isobus.net/isobus/pGNAndSPN/10516?type=PGN. Signal-level enrichment via PR welcome  see CONTRIBUTING.md.";
CM_ SG_ 2566582016 Aftertreatment_2_SCR_Service_Inf "Generic 8-byte raw payload. Detail page: https://www.isobus.net/isobus/pGNAndSPN/10517?type=PGN. Signal-level enrichment via PR welcome  see CONTRIBUTING.md.";
CM_ SG_ 2566582272 Aftertreatment_1_SCR_Service_Inf "Generic 8-byte raw payload. Detail page: https://www.isobus.net/isobus/pGNAndSPN/10519?type=PGN. Signal-level enrichment via PR welcome  see CONTRIBUTING.md.";
CM_ SG_ 2566582528 PSA_Times_Lifetime_Hours_RawPayl "Generic 8-byte raw payload. Detail page: https://www.isobus.net/isobus/pGNAndSPN/10522?type=PGN. Signal-level enrichment via PR welcome  see CONTRIBUTING.md.";
CM_ SG_ 2566582784 PSA_Times_Stored_100_Hours_RawPa "Generic 8-byte raw payload. Detail page: https://www.isobus.net/isobus/pGNAndSPN/10525?type=PGN. Signal-level enrichment via PR welcome  see CONTRIBUTING.md.";
CM_ SG_ 2566583040 PSA_Times_Active_100_Hours_RawPa "Generic 8-byte raw payload. Detail page: https://www.isobus.net/isobus/pGNAndSPN/10528?type=PGN. Signal-level enrichment via PR welcome  see CONTRIBUTING.md.";
CM_ SG_ 2566583296 Hybrid_Charge_Depleting_or_Incre "Generic 8-byte raw payload. Detail page: https://www.isobus.net/isobus/pGNAndSPN/10536?type=PGN. Signal-level enrichment via PR welcome  see CONTRIBUTING.md.";
CM_ SG_ 2566583552 Hybrid_Charge_Depleting_or_Incre "Generic 8-byte raw payload. Detail page: https://www.isobus.net/isobus/pGNAndSPN/10544?type=PGN. Signal-level enrichment via PR welcome  see CONTRIBUTING.md.";
CM_ SG_ 2566583808 Hybrid_Charge_Depleting_or_Incre "Generic 8-byte raw payload. Detail page: https://www.isobus.net/isobus/pGNAndSPN/10552?type=PGN. Signal-level enrichment via PR welcome  see CONTRIBUTING.md.";
CM_ SG_ 2566584064 Aftertreatment_1_Historical_Info "Generic 8-byte raw payload. Detail page: https://www.isobus.net/isobus/pGNAndSPN/10560?type=PGN. Signal-level enrichment via PR welcome  see CONTRIBUTING.md.";
CM_ SG_ 2566584320 Engine_Maximum_Net_Torque_Map_Ra "Generic 8-byte raw payload. Detail page: https://www.isobus.net/isobus/pGNAndSPN/10568?type=PGN. Signal-level enrichment via PR welcome  see CONTRIBUTING.md.";
CM_ SG_ 2566584576 Aftertreatment_1_SCR_2_NOx_Mass_ "Generic 8-byte raw payload. Detail page: https://www.isobus.net/isobus/pGNAndSPN/10572?type=PGN. Signal-level enrichment via PR welcome  see CONTRIBUTING.md.";
CM_ SG_ 2566584832 Aftertreatment_1_SCR_1_NOx_Mass_ "Generic 8-byte raw payload. Detail page: https://www.isobus.net/isobus/pGNAndSPN/10576?type=PGN. Signal-level enrichment via PR welcome  see CONTRIBUTING.md.";
CM_ SG_ 2566585088 Evaporative_System_Pressure_and_ "Generic 8-byte raw payload. Detail page: https://www.isobus.net/isobus/pGNAndSPN/10580?type=PGN. Signal-level enrichment via PR welcome  see CONTRIBUTING.md.";
CM_ SG_ 2566585344 GHG_Tracking_Lifetime_Array_Data "Generic 8-byte raw payload. Detail page: https://www.isobus.net/isobus/pGNAndSPN/10593?type=PGN. Signal-level enrichment via PR welcome  see CONTRIBUTING.md.";
CM_ SG_ 2566585600 GHG_Tracking_Stored_100_Hour_Arr "Generic 8-byte raw payload. Detail page: https://www.isobus.net/isobus/pGNAndSPN/10606?type=PGN. Signal-level enrichment via PR welcome  see CONTRIBUTING.md.";
CM_ SG_ 2566585856 GHG_Tracking_Active_100_Hour_Arr "Generic 8-byte raw payload. Detail page: https://www.isobus.net/isobus/pGNAndSPN/10619?type=PGN. Signal-level enrichment via PR welcome  see CONTRIBUTING.md.";
CM_ SG_ 2566586112 Green_House_Gas_Stored_100_Hour_ "Generic 8-byte raw payload. Detail page: https://www.isobus.net/isobus/pGNAndSPN/10622?type=PGN. Signal-level enrichment via PR welcome  see CONTRIBUTING.md.";
CM_ SG_ 2566586368 Green_House_Gas_Active_100_Hour_ "Generic 8-byte raw payload. Detail page: https://www.isobus.net/isobus/pGNAndSPN/10625?type=PGN. Signal-level enrichment via PR welcome  see CONTRIBUTING.md.";
CM_ SG_ 2566586624 Green_House_Gas_Lifetime_Active_ "Generic 8-byte raw payload. Detail page: https://www.isobus.net/isobus/pGNAndSPN/10628?type=PGN. Signal-level enrichment via PR welcome  see CONTRIBUTING.md.";
CM_ SG_ 2566586880 NOx_Tracking_Engine_Activity_Lif "Generic 8-byte raw payload. Detail page: https://www.isobus.net/isobus/pGNAndSPN/10645?type=PGN. Signal-level enrichment via PR welcome  see CONTRIBUTING.md.";
CM_ SG_ 2566587136 NOx_Tracking_Engine_Activity_Lif "Generic 8-byte raw payload. Detail page: https://www.isobus.net/isobus/pGNAndSPN/10662?type=PGN. Signal-level enrichment via PR welcome  see CONTRIBUTING.md.";
CM_ SG_ 2566587392 NOx_Tracking_Engine_Activity_Lif "Generic 8-byte raw payload. Detail page: https://www.isobus.net/isobus/pGNAndSPN/10679?type=PGN. Signal-level enrichment via PR welcome  see CONTRIBUTING.md.";
CM_ SG_ 2566587648 NOx_Tracking_Engine_Activity_Lif "Generic 8-byte raw payload. Detail page: https://www.isobus.net/isobus/pGNAndSPN/10696?type=PGN. Signal-level enrichment via PR welcome  see CONTRIBUTING.md.";
CM_ SG_ 2566587904 NOx_Tracking_Valid_NOx_Lifetime_ "Generic 8-byte raw payload. Detail page: https://www.isobus.net/isobus/pGNAndSPN/10713?type=PGN. Signal-level enrichment via PR welcome  see CONTRIBUTING.md.";
CM_ SG_ 2566588160 NOx_Tracking_Valid_NOx_Lifetime_ "Generic 8-byte raw payload. Detail page: https://www.isobus.net/isobus/pGNAndSPN/10730?type=PGN. Signal-level enrichment via PR welcome  see CONTRIBUTING.md.";
CM_ SG_ 2566588416 NOx_Tracking_Valid_NOx_Lifetime_ "Generic 8-byte raw payload. Detail page: https://www.isobus.net/isobus/pGNAndSPN/10747?type=PGN. Signal-level enrichment via PR welcome  see CONTRIBUTING.md.";
CM_ SG_ 2566588672 NOx_Tracking_Valid_NOx_Lifetime_ "Generic 8-byte raw payload. Detail page: https://www.isobus.net/isobus/pGNAndSPN/10764?type=PGN. Signal-level enrichment via PR welcome  see CONTRIBUTING.md.";
CM_ SG_ 2566588928 NOx_Tracking_Valid_NOx_Lifetime_ "Generic 8-byte raw payload. Detail page: https://www.isobus.net/isobus/pGNAndSPN/10781?type=PGN. Signal-level enrichment via PR welcome  see CONTRIBUTING.md.";
CM_ SG_ 2566589184 NOx_Tracking_Valid_NOx_Lifetime_ "Generic 8-byte raw payload. Detail page: https://www.isobus.net/isobus/pGNAndSPN/10798?type=PGN. Signal-level enrichment via PR welcome  see CONTRIBUTING.md.";
CM_ SG_ 2566589440 NOx_Tracking_Stored_100_Hour_Fue "Generic 8-byte raw payload. Detail page: https://www.isobus.net/isobus/pGNAndSPN/10815?type=PGN. Signal-level enrichment via PR welcome  see CONTRIBUTING.md.";
CM_ SG_ 2566589696 NOx_Tracking_Stored_100_Hour_Eng "Generic 8-byte raw payload. Detail page: https://www.isobus.net/isobus/pGNAndSPN/10832?type=PGN. Signal-level enrichment via PR welcome  see CONTRIBUTING.md.";
CM_ SG_ 2566589952 NOx_Tracking_Stored_100_Hour_Veh "Generic 8-byte raw payload. Detail page: https://www.isobus.net/isobus/pGNAndSPN/10849?type=PGN. Signal-level enrichment via PR welcome  see CONTRIBUTING.md.";
CM_ SG_ 2566590208 NOx_Tracking_Stored_100_Hour_Eng "Generic 8-byte raw payload. Detail page: https://www.isobus.net/isobus/pGNAndSPN/10866?type=PGN. Signal-level enrichment via PR welcome  see CONTRIBUTING.md.";
CM_ SG_ 2566590464 NOx_Tracking_Stored_100_Hour_Eng "Generic 8-byte raw payload. Detail page: https://www.isobus.net/isobus/pGNAndSPN/10883?type=PGN. Signal-level enrichment via PR welcome  see CONTRIBUTING.md.";
CM_ SG_ 2566590720 NOx_Tracking_Stored_100_Hour_Sys "Generic 8-byte raw payload. Detail page: https://www.isobus.net/isobus/pGNAndSPN/10900?type=PGN. Signal-level enrichment via PR welcome  see CONTRIBUTING.md.";
CM_ SG_ 2566590976 NOx_Tracking_Active_100_Hour_Fue "Generic 8-byte raw payload. Detail page: https://www.isobus.net/isobus/pGNAndSPN/10917?type=PGN. Signal-level enrichment via PR welcome  see CONTRIBUTING.md.";
CM_ SG_ 2566591232 NOx_Tracking_Active_100_Hour_Eng "Generic 8-byte raw payload. Detail page: https://www.isobus.net/isobus/pGNAndSPN/10934?type=PGN. Signal-level enrichment via PR welcome  see CONTRIBUTING.md.";
CM_ SG_ 2566591488 NOx_Tracking_Active_100_Hour_Veh "Generic 8-byte raw payload. Detail page: https://www.isobus.net/isobus/pGNAndSPN/10951?type=PGN. Signal-level enrichment via PR welcome  see CONTRIBUTING.md.";
CM_ SG_ 2566591744 NOx_Tracking_Active_100_Hour_Eng "Generic 8-byte raw payload. Detail page: https://www.isobus.net/isobus/pGNAndSPN/10968?type=PGN. Signal-level enrichment via PR welcome  see CONTRIBUTING.md.";
CM_ SG_ 2566592000 NOx_Tracking_Active_100_Hour_Eng "Generic 8-byte raw payload. Detail page: https://www.isobus.net/isobus/pGNAndSPN/10985?type=PGN. Signal-level enrichment via PR welcome  see CONTRIBUTING.md.";
CM_ SG_ 2566592256 NOx_Tracking_Active_100_Hour_Sys "Generic 8-byte raw payload. Detail page: https://www.isobus.net/isobus/pGNAndSPN/11002?type=PGN. Signal-level enrichment via PR welcome  see CONTRIBUTING.md.";
CM_ SG_ 2566592512 Motor_Generator_6_Inverter_Contr "Generic 8-byte raw payload. Detail page: https://www.isobus.net/isobus/pGNAndSPN/11009?type=PGN. Signal-level enrichment via PR welcome  see CONTRIBUTING.md.";
CM_ SG_ 2566592768 Motor_Generator_6_Inverter_Limit "Generic 8-byte raw payload. Detail page: https://www.isobus.net/isobus/pGNAndSPN/11015?type=PGN. Signal-level enrichment via PR welcome  see CONTRIBUTING.md.";
CM_ SG_ 2566593024 Motor_Generator_6_Inverter_Limit "Generic 8-byte raw payload. Detail page: https://www.isobus.net/isobus/pGNAndSPN/11021?type=PGN. Signal-level enrichment via PR welcome  see CONTRIBUTING.md.";
CM_ SG_ 2566593280 Motor_Generator_6_Inverter_Limit "Generic 8-byte raw payload. Detail page: https://www.isobus.net/isobus/pGNAndSPN/11027?type=PGN. Signal-level enrichment via PR welcome  see CONTRIBUTING.md.";
CM_ SG_ 2566593536 Motor_Generator_6_Inverter_Isola "Generic 8-byte raw payload. Detail page: https://www.isobus.net/isobus/pGNAndSPN/11031?type=PGN. Signal-level enrichment via PR welcome  see CONTRIBUTING.md.";
CM_ SG_ 2566593792 Motor_Generator_5_Inverter_Contr "Generic 8-byte raw payload. Detail page: https://www.isobus.net/isobus/pGNAndSPN/11038?type=PGN. Signal-level enrichment via PR welcome  see CONTRIBUTING.md.";
CM_ SG_ 2566594048 Motor_Generator_5_Inverter_Limit "Generic 8-byte raw payload. Detail page: https://www.isobus.net/isobus/pGNAndSPN/11044?type=PGN. Signal-level enrichment via PR welcome  see CONTRIBUTING.md.";
CM_ SG_ 2566594304 Motor_Generator_5_Inverter_Limit "Generic 8-byte raw payload. Detail page: https://www.isobus.net/isobus/pGNAndSPN/11050?type=PGN. Signal-level enrichment via PR welcome  see CONTRIBUTING.md.";
CM_ SG_ 2566594560 Motor_Generator_5_Inverter_Limit "Generic 8-byte raw payload. Detail page: https://www.isobus.net/isobus/pGNAndSPN/11056?type=PGN. Signal-level enrichment via PR welcome  see CONTRIBUTING.md.";
CM_ SG_ 2566594816 Motor_Generator_5_Inverter_Isola "Generic 8-byte raw payload. Detail page: https://www.isobus.net/isobus/pGNAndSPN/11060?type=PGN. Signal-level enrichment via PR welcome  see CONTRIBUTING.md.";
CM_ SG_ 2566595072 Motor_Generator_4_Inverter_Contr "Generic 8-byte raw payload. Detail page: https://www.isobus.net/isobus/pGNAndSPN/11067?type=PGN. Signal-level enrichment via PR welcome  see CONTRIBUTING.md.";
CM_ SG_ 2566595328 Motor_Generator_4_Inverter_Limit "Generic 8-byte raw payload. Detail page: https://www.isobus.net/isobus/pGNAndSPN/11073?type=PGN. Signal-level enrichment via PR welcome  see CONTRIBUTING.md.";
CM_ SG_ 2566595584 Motor_Generator_4_Inverter_Limit "Generic 8-byte raw payload. Detail page: https://www.isobus.net/isobus/pGNAndSPN/11079?type=PGN. Signal-level enrichment via PR welcome  see CONTRIBUTING.md.";
CM_ SG_ 2566595840 Motor_Generator_4_Inverter_Limit "Generic 8-byte raw payload. Detail page: https://www.isobus.net/isobus/pGNAndSPN/11085?type=PGN. Signal-level enrichment via PR welcome  see CONTRIBUTING.md.";
CM_ SG_ 2566596096 Motor_Generator_4_Inverter_Isola "Generic 8-byte raw payload. Detail page: https://www.isobus.net/isobus/pGNAndSPN/11089?type=PGN. Signal-level enrichment via PR welcome  see CONTRIBUTING.md.";
CM_ SG_ 2566596352 Motor_Generator_3_Inverter_Contr "Generic 8-byte raw payload. Detail page: https://www.isobus.net/isobus/pGNAndSPN/11096?type=PGN. Signal-level enrichment via PR welcome  see CONTRIBUTING.md.";
CM_ SG_ 2566596608 Motor_Generator_3_Inverter_Limit "Generic 8-byte raw payload. Detail page: https://www.isobus.net/isobus/pGNAndSPN/11102?type=PGN. Signal-level enrichment via PR welcome  see CONTRIBUTING.md.";
CM_ SG_ 2566596864 Motor_Generator_3_Inverter_Limit "Generic 8-byte raw payload. Detail page: https://www.isobus.net/isobus/pGNAndSPN/11108?type=PGN. Signal-level enrichment via PR welcome  see CONTRIBUTING.md.";
CM_ SG_ 2566597120 Motor_Generator_3_Inverter_Limit "Generic 8-byte raw payload. Detail page: https://www.isobus.net/isobus/pGNAndSPN/11114?type=PGN. Signal-level enrichment via PR welcome  see CONTRIBUTING.md.";
CM_ SG_ 2566597376 Motor_Generator_3_Inverter_Isola "Generic 8-byte raw payload. Detail page: https://www.isobus.net/isobus/pGNAndSPN/11118?type=PGN. Signal-level enrichment via PR welcome  see CONTRIBUTING.md.";
CM_ SG_ 2566597632 Diagnostic_Readiness_4_RawPayloa "Generic 8-byte raw payload. Detail page: https://www.isobus.net/isobus/pGNAndSPN/11119?type=PGN. Signal-level enrichment via PR welcome  see CONTRIBUTING.md.";
CM_ SG_ 2566597888 Turbocharger_Information_8_RawPa "Generic 8-byte raw payload. Detail page: https://www.isobus.net/isobus/pGNAndSPN/11123?type=PGN. Signal-level enrichment via PR welcome  see CONTRIBUTING.md.";
CM_ SG_ 2566598144 Winch_Information_2_RawPayload "Generic 8-byte raw payload. Detail page: https://www.isobus.net/isobus/pGNAndSPN/11124?type=PGN. Signal-level enrichment via PR welcome  see CONTRIBUTING.md.";
CM_ SG_ 2566598400 Motor_Generator_6_Inverter_Refer "Generic 8-byte raw payload. Detail page: https://www.isobus.net/isobus/pGNAndSPN/11129?type=PGN. Signal-level enrichment via PR welcome  see CONTRIBUTING.md.";
CM_ SG_ 2566598656 Motor_Generator_6_Inverter_Statu "Generic 8-byte raw payload. Detail page: https://www.isobus.net/isobus/pGNAndSPN/11135?type=PGN. Signal-level enrichment via PR welcome  see CONTRIBUTING.md.";
CM_ SG_ 2566598912 Motor_Generator_6_Inverter_Refer "Generic 8-byte raw payload. Detail page: https://www.isobus.net/isobus/pGNAndSPN/11139?type=PGN. Signal-level enrichment via PR welcome  see CONTRIBUTING.md.";
CM_ SG_ 2566599168 Motor_Generator_6_Inverter_Tempe "Generic 8-byte raw payload. Detail page: https://www.isobus.net/isobus/pGNAndSPN/11144?type=PGN. Signal-level enrichment via PR welcome  see CONTRIBUTING.md.";
CM_ SG_ 2566599424 Motor_Generator_6_Inverter_Motor "Generic 8-byte raw payload. Detail page: https://www.isobus.net/isobus/pGNAndSPN/11148?type=PGN. Signal-level enrichment via PR welcome  see CONTRIBUTING.md.";
CM_ SG_ 2566599680 Motor_Generator_6_Inverter_Isola "Generic 8-byte raw payload. Detail page: https://www.isobus.net/isobus/pGNAndSPN/11155?type=PGN. Signal-level enrichment via PR welcome  see CONTRIBUTING.md.";
CM_ SG_ 2566599936 Motor_Generator_6_Inverter_Activ "Generic 8-byte raw payload. Detail page: https://www.isobus.net/isobus/pGNAndSPN/11174?type=PGN. Signal-level enrichment via PR welcome  see CONTRIBUTING.md.";
CM_ SG_ 2566600192 Motor_Generator_5_Inverter_Refer "Generic 8-byte raw payload. Detail page: https://www.isobus.net/isobus/pGNAndSPN/11179?type=PGN. Signal-level enrichment via PR welcome  see CONTRIBUTING.md.";
CM_ SG_ 2566600448 Motor_Generator_5_Inverter_Statu "Generic 8-byte raw payload. Detail page: https://www.isobus.net/isobus/pGNAndSPN/11185?type=PGN. Signal-level enrichment via PR welcome  see CONTRIBUTING.md.";
CM_ SG_ 2566600704 Motor_Generator_5_Inverter_Refer "Generic 8-byte raw payload. Detail page: https://www.isobus.net/isobus/pGNAndSPN/11189?type=PGN. Signal-level enrichment via PR welcome  see CONTRIBUTING.md.";
CM_ SG_ 2566600960 Motor_Generator_5_Inverter_Tempe "Generic 8-byte raw payload. Detail page: https://www.isobus.net/isobus/pGNAndSPN/11194?type=PGN. Signal-level enrichment via PR welcome  see CONTRIBUTING.md.";
CM_ SG_ 2566601216 Motor_Generator_5_Inverter_Motor "Generic 8-byte raw payload. Detail page: https://www.isobus.net/isobus/pGNAndSPN/11198?type=PGN. Signal-level enrichment via PR welcome  see CONTRIBUTING.md.";
CM_ SG_ 2566601472 Motor_Generator_5_Inverter_Isola "Generic 8-byte raw payload. Detail page: https://www.isobus.net/isobus/pGNAndSPN/11205?type=PGN. Signal-level enrichment via PR welcome  see CONTRIBUTING.md.";
CM_ SG_ 2566601728 Motor_Generator_5_Inverter_Activ "Generic 8-byte raw payload. Detail page: https://www.isobus.net/isobus/pGNAndSPN/11224?type=PGN. Signal-level enrichment via PR welcome  see CONTRIBUTING.md.";
CM_ SG_ 2566601984 Motor_Generator_4_Inverter_Refer "Generic 8-byte raw payload. Detail page: https://www.isobus.net/isobus/pGNAndSPN/11229?type=PGN. Signal-level enrichment via PR welcome  see CONTRIBUTING.md.";
CM_ SG_ 2566602240 Motor_Generator_4_Inverter_Statu "Generic 8-byte raw payload. Detail page: https://www.isobus.net/isobus/pGNAndSPN/11235?type=PGN. Signal-level enrichment via PR welcome  see CONTRIBUTING.md.";
CM_ SG_ 2566602496 Motor_Generator_4_Inverter_Refer "Generic 8-byte raw payload. Detail page: https://www.isobus.net/isobus/pGNAndSPN/11239?type=PGN. Signal-level enrichment via PR welcome  see CONTRIBUTING.md.";
CM_ SG_ 2566602752 Motor_Generator_4_Inverter_Tempe "Generic 8-byte raw payload. Detail page: https://www.isobus.net/isobus/pGNAndSPN/11244?type=PGN. Signal-level enrichment via PR welcome  see CONTRIBUTING.md.";
CM_ SG_ 2566603008 Motor_Generator_4_Inverter_Motor "Generic 8-byte raw payload. Detail page: https://www.isobus.net/isobus/pGNAndSPN/11248?type=PGN. Signal-level enrichment via PR welcome  see CONTRIBUTING.md.";
CM_ SG_ 2566603264 Motor_Generator_4_Inverter_Isola "Generic 8-byte raw payload. Detail page: https://www.isobus.net/isobus/pGNAndSPN/11255?type=PGN. Signal-level enrichment via PR welcome  see CONTRIBUTING.md.";
CM_ SG_ 2566603520 Motor_Generator_4_Inverter_Activ "Generic 8-byte raw payload. Detail page: https://www.isobus.net/isobus/pGNAndSPN/11274?type=PGN. Signal-level enrichment via PR welcome  see CONTRIBUTING.md.";
CM_ SG_ 2566603776 Motor_Generator_3_Inverter_Refer "Generic 8-byte raw payload. Detail page: https://www.isobus.net/isobus/pGNAndSPN/11279?type=PGN. Signal-level enrichment via PR welcome  see CONTRIBUTING.md.";
CM_ SG_ 2566604032 Motor_Generator_3_Inverter_Statu "Generic 8-byte raw payload. Detail page: https://www.isobus.net/isobus/pGNAndSPN/11285?type=PGN. Signal-level enrichment via PR welcome  see CONTRIBUTING.md.";
CM_ SG_ 2566604288 Motor_Generator_3_Inverter_Refer "Generic 8-byte raw payload. Detail page: https://www.isobus.net/isobus/pGNAndSPN/11289?type=PGN. Signal-level enrichment via PR welcome  see CONTRIBUTING.md.";
CM_ SG_ 2566604544 Motor_Generator_3_Inverter_Tempe "Generic 8-byte raw payload. Detail page: https://www.isobus.net/isobus/pGNAndSPN/11294?type=PGN. Signal-level enrichment via PR welcome  see CONTRIBUTING.md.";
CM_ SG_ 2566604800 Motor_Generator_3_Inverter_Motor "Generic 8-byte raw payload. Detail page: https://www.isobus.net/isobus/pGNAndSPN/11298?type=PGN. Signal-level enrichment via PR welcome  see CONTRIBUTING.md.";
CM_ SG_ 2566605056 Motor_Generator_3_Inverter_Isola "Generic 8-byte raw payload. Detail page: https://www.isobus.net/isobus/pGNAndSPN/11305?type=PGN. Signal-level enrichment via PR welcome  see CONTRIBUTING.md.";
CM_ SG_ 2566605312 Motor_Generator_3_Inverter_Activ "Generic 8-byte raw payload. Detail page: https://www.isobus.net/isobus/pGNAndSPN/11324?type=PGN. Signal-level enrichment via PR welcome  see CONTRIBUTING.md.";
CM_ SG_ 2566605568 Automated_Driving_System_Status_ "Generic 8-byte raw payload. Detail page: https://www.isobus.net/isobus/pGNAndSPN/11333?type=PGN. Signal-level enrichment via PR welcome  see CONTRIBUTING.md.";
CM_ SG_ 2566605824 Cab_Climate_System_Information_2 "Generic 8-byte raw payload. Detail page: https://www.isobus.net/isobus/pGNAndSPN/11335?type=PGN. Signal-level enrichment via PR welcome  see CONTRIBUTING.md.";
CM_ SG_ 2566606080 Maintenance_Information_1_RawPay "Generic 8-byte raw payload. Detail page: https://www.isobus.net/isobus/pGNAndSPN/11343?type=PGN. Signal-level enrichment via PR welcome  see CONTRIBUTING.md.";
CM_ SG_ 2566606336 Hoist_Control_Information_RawPay "Generic 8-byte raw payload. Detail page: https://www.isobus.net/isobus/pGNAndSPN/11345?type=PGN. Signal-level enrichment via PR welcome  see CONTRIBUTING.md.";
CM_ SG_ 2566606592 High_Voltage_Energy_Storage_Pack "Generic 8-byte raw payload. Detail page: https://www.isobus.net/isobus/pGNAndSPN/11351?type=PGN. Signal-level enrichment via PR welcome  see CONTRIBUTING.md.";
CM_ SG_ 2566606848 High_Voltage_Energy_Storage_Pack "Generic 8-byte raw payload. Detail page: https://www.isobus.net/isobus/pGNAndSPN/11361?type=PGN. Signal-level enrichment via PR welcome  see CONTRIBUTING.md.";
CM_ SG_ 2566607104 High_Voltage_Energy_Storage_Pack "Generic 8-byte raw payload. Detail page: https://www.isobus.net/isobus/pGNAndSPN/11367?type=PGN. Signal-level enrichment via PR welcome  see CONTRIBUTING.md.";
CM_ SG_ 2566607360 High_Voltage_Energy_Storage_Pack "Generic 8-byte raw payload. Detail page: https://www.isobus.net/isobus/pGNAndSPN/11377?type=PGN. Signal-level enrichment via PR welcome  see CONTRIBUTING.md.";
CM_ SG_ 2566607616 High_Voltage_Energy_Storage_Pack "Generic 8-byte raw payload. Detail page: https://www.isobus.net/isobus/pGNAndSPN/11383?type=PGN. Signal-level enrichment via PR welcome  see CONTRIBUTING.md.";
CM_ SG_ 2566607872 High_Voltage_Energy_Storage_Pack "Generic 8-byte raw payload. Detail page: https://www.isobus.net/isobus/pGNAndSPN/11393?type=PGN. Signal-level enrichment via PR welcome  see CONTRIBUTING.md.";
CM_ SG_ 2566608128 High_Voltage_Energy_Storage_Pack "Generic 8-byte raw payload. Detail page: https://www.isobus.net/isobus/pGNAndSPN/11399?type=PGN. Signal-level enrichment via PR welcome  see CONTRIBUTING.md.";
CM_ SG_ 2566608384 High_Voltage_Energy_Storage_Pack "Generic 8-byte raw payload. Detail page: https://www.isobus.net/isobus/pGNAndSPN/11409?type=PGN. Signal-level enrichment via PR welcome  see CONTRIBUTING.md.";
CM_ SG_ 2566608640 High_Voltage_Energy_Storage_Pack "Generic 8-byte raw payload. Detail page: https://www.isobus.net/isobus/pGNAndSPN/11415?type=PGN. Signal-level enrichment via PR welcome  see CONTRIBUTING.md.";
CM_ SG_ 2566608896 High_Voltage_Energy_Storage_Pack "Generic 8-byte raw payload. Detail page: https://www.isobus.net/isobus/pGNAndSPN/11425?type=PGN. Signal-level enrichment via PR welcome  see CONTRIBUTING.md.";
CM_ SG_ 2566609152 High_Voltage_Energy_Storage_Pack "Generic 8-byte raw payload. Detail page: https://www.isobus.net/isobus/pGNAndSPN/11431?type=PGN. Signal-level enrichment via PR welcome  see CONTRIBUTING.md.";
CM_ SG_ 2566609408 High_Voltage_Energy_Storage_Pack "Generic 8-byte raw payload. Detail page: https://www.isobus.net/isobus/pGNAndSPN/11441?type=PGN. Signal-level enrichment via PR welcome  see CONTRIBUTING.md.";
CM_ SG_ 2566609664 Vehicle_Fire_Suppression_System_ "Generic 8-byte raw payload. Detail page: https://www.isobus.net/isobus/pGNAndSPN/11465?type=PGN. Signal-level enrichment via PR welcome  see CONTRIBUTING.md.";
CM_ SG_ 2566609920 Vehicle_Fire_Suppression_System_ "Generic 8-byte raw payload. Detail page: https://www.isobus.net/isobus/pGNAndSPN/11489?type=PGN. Signal-level enrichment via PR welcome  see CONTRIBUTING.md.";
CM_ SG_ 2566610176 Vehicle_Fire_Suppression_System_ "Generic 8-byte raw payload. Detail page: https://www.isobus.net/isobus/pGNAndSPN/11513?type=PGN. Signal-level enrichment via PR welcome  see CONTRIBUTING.md.";
CM_ SG_ 2566610432 Vehicle_Fire_Suppression_System_ "Generic 8-byte raw payload. Detail page: https://www.isobus.net/isobus/pGNAndSPN/11537?type=PGN. Signal-level enrichment via PR welcome  see CONTRIBUTING.md.";
CM_ SG_ 2566610688 Vehicle_Fire_Suppression_System_ "Generic 8-byte raw payload. Detail page: https://www.isobus.net/isobus/pGNAndSPN/11545?type=PGN. Signal-level enrichment via PR welcome  see CONTRIBUTING.md.";
CM_ SG_ 2566610944 Vehicle_Fire_Suppression_System_ "Generic 8-byte raw payload. Detail page: https://www.isobus.net/isobus/pGNAndSPN/11553?type=PGN. Signal-level enrichment via PR welcome  see CONTRIBUTING.md.";
CM_ SG_ 2566611200 Vehicle_Fire_Suppression_System_ "Generic 8-byte raw payload. Detail page: https://www.isobus.net/isobus/pGNAndSPN/11561?type=PGN. Signal-level enrichment via PR welcome  see CONTRIBUTING.md.";
CM_ SG_ 2566611456 Vehicle_Fire_Suppression_System_ "Generic 8-byte raw payload. Detail page: https://www.isobus.net/isobus/pGNAndSPN/11569?type=PGN. Signal-level enrichment via PR welcome  see CONTRIBUTING.md.";
CM_ SG_ 2566611712 Vehicle_Fire_Suppression_System_ "Generic 8-byte raw payload. Detail page: https://www.isobus.net/isobus/pGNAndSPN/11582?type=PGN. Signal-level enrichment via PR welcome  see CONTRIBUTING.md.";
CM_ SG_ 2566611968 Vehicle_Fire_Suppression_System_ "Generic 8-byte raw payload. Detail page: https://www.isobus.net/isobus/pGNAndSPN/11595?type=PGN. Signal-level enrichment via PR welcome  see CONTRIBUTING.md.";
CM_ SG_ 2566612224 Vehicle_Fire_Suppression_System_ "Generic 8-byte raw payload. Detail page: https://www.isobus.net/isobus/pGNAndSPN/11608?type=PGN. Signal-level enrichment via PR welcome  see CONTRIBUTING.md.";
CM_ SG_ 2566612480 Vehicle_Fire_Suppression_System_ "Generic 8-byte raw payload. Detail page: https://www.isobus.net/isobus/pGNAndSPN/11621?type=PGN. Signal-level enrichment via PR welcome  see CONTRIBUTING.md.";
CM_ SG_ 2566612736 Motor_Generator_2_Inverter_Activ "Generic 8-byte raw payload. Detail page: https://www.isobus.net/isobus/pGNAndSPN/11640?type=PGN. Signal-level enrichment via PR welcome  see CONTRIBUTING.md.";
CM_ SG_ 2566612992 Motor_Generator_2_Inverter_Isola "Generic 8-byte raw payload. Detail page: https://www.isobus.net/isobus/pGNAndSPN/11647?type=PGN. Signal-level enrichment via PR welcome  see CONTRIBUTING.md.";
CM_ SG_ 2566613248 Motor_Generator_1_Inverter_Activ "Generic 8-byte raw payload. Detail page: https://www.isobus.net/isobus/pGNAndSPN/11666?type=PGN. Signal-level enrichment via PR welcome  see CONTRIBUTING.md.";
CM_ SG_ 2566613504 Motor_Generator_1_Inverter_Isola "Generic 8-byte raw payload. Detail page: https://www.isobus.net/isobus/pGNAndSPN/11673?type=PGN. Signal-level enrichment via PR welcome  see CONTRIBUTING.md.";
CM_ SG_ 2566613760 High_Voltage_Bus_Information_Raw "Generic 8-byte raw payload. Detail page: https://www.isobus.net/isobus/pGNAndSPN/11679?type=PGN. Signal-level enrichment via PR welcome  see CONTRIBUTING.md.";
CM_ SG_ 2566614016 Motor_Generator_2_Inverter_Refer "Generic 8-byte raw payload. Detail page: https://www.isobus.net/isobus/pGNAndSPN/11684?type=PGN. Signal-level enrichment via PR welcome  see CONTRIBUTING.md.";
CM_ SG_ 2566614272 Motor_Generator_2_Inverter_Statu "Generic 8-byte raw payload. Detail page: https://www.isobus.net/isobus/pGNAndSPN/11690?type=PGN. Signal-level enrichment via PR welcome  see CONTRIBUTING.md.";
CM_ SG_ 2566614528 Motor_Generator_2_Inverter_Refer "Generic 8-byte raw payload. Detail page: https://www.isobus.net/isobus/pGNAndSPN/11694?type=PGN. Signal-level enrichment via PR welcome  see CONTRIBUTING.md.";
CM_ SG_ 2566614784 Motor_Generator_2_Inverter_Tempe "Generic 8-byte raw payload. Detail page: https://www.isobus.net/isobus/pGNAndSPN/11699?type=PGN. Signal-level enrichment via PR welcome  see CONTRIBUTING.md.";
CM_ SG_ 2566615040 Motor_Generator_2_Inverter_Motor "Generic 8-byte raw payload. Detail page: https://www.isobus.net/isobus/pGNAndSPN/11703?type=PGN. Signal-level enrichment via PR welcome  see CONTRIBUTING.md.";
CM_ SG_ 2566615296 Motor_Generator_1_Inverter_Motor "Generic 8-byte raw payload. Detail page: https://www.isobus.net/isobus/pGNAndSPN/11707?type=PGN. Signal-level enrichment via PR welcome  see CONTRIBUTING.md.";
CM_ SG_ 2566615552 Motor_Generator_1_Inverter_Tempe "Generic 8-byte raw payload. Detail page: https://www.isobus.net/isobus/pGNAndSPN/11712?type=PGN. Signal-level enrichment via PR welcome  see CONTRIBUTING.md.";
CM_ SG_ 2566615808 Motor_Generator_1_Inverter_Refer "Generic 8-byte raw payload. Detail page: https://www.isobus.net/isobus/pGNAndSPN/11716?type=PGN. Signal-level enrichment via PR welcome  see CONTRIBUTING.md.";
CM_ SG_ 2566616064 Motor_Generator_1_Inverter_Statu "Generic 8-byte raw payload. Detail page: https://www.isobus.net/isobus/pGNAndSPN/11722?type=PGN. Signal-level enrichment via PR welcome  see CONTRIBUTING.md.";
CM_ SG_ 2566616320 Motor_Generator_1_Inverter_Refer "Generic 8-byte raw payload. Detail page: https://www.isobus.net/isobus/pGNAndSPN/11727?type=PGN. Signal-level enrichment via PR welcome  see CONTRIBUTING.md.";
CM_ SG_ 2566616576 Personnel_Detect_Status_RawPaylo "Generic 8-byte raw payload. Detail page: https://www.isobus.net/isobus/pGNAndSPN/11737?type=PGN. Signal-level enrichment via PR welcome  see CONTRIBUTING.md.";
CM_ SG_ 2566616832 Engine_Cylinder_Pressure_Gamma_1 "Generic 8-byte raw payload. Detail page: https://www.isobus.net/isobus/pGNAndSPN/11745?type=PGN. Signal-level enrichment via PR welcome  see CONTRIBUTING.md.";
CM_ SG_ 2566617088 Engine_Cylinder_Pressure_Gamma_2 "Generic 8-byte raw payload. Detail page: https://www.isobus.net/isobus/pGNAndSPN/11753?type=PGN. Signal-level enrichment via PR welcome  see CONTRIBUTING.md.";
CM_ SG_ 2566617344 Engine_Cylinder_Pressure_Gamma_3 "Generic 8-byte raw payload. Detail page: https://www.isobus.net/isobus/pGNAndSPN/11761?type=PGN. Signal-level enrichment via PR welcome  see CONTRIBUTING.md.";
CM_ SG_ 2566617600 Engine_Cylinder_Pressure_Gamma_4 "Generic 8-byte raw payload. Detail page: https://www.isobus.net/isobus/pGNAndSPN/11769?type=PGN. Signal-level enrichment via PR welcome  see CONTRIBUTING.md.";
CM_ SG_ 2566617856 Engine_Cylinder_Pressure_Gamma_5 "Generic 8-byte raw payload. Detail page: https://www.isobus.net/isobus/pGNAndSPN/11777?type=PGN. Signal-level enrichment via PR welcome  see CONTRIBUTING.md.";
CM_ SG_ 2566618112 Wake_Up_and_Sleep_RawPayload "Generic 8-byte raw payload. Detail page: https://www.isobus.net/isobus/pGNAndSPN/11779?type=PGN. Signal-level enrichment via PR welcome  see CONTRIBUTING.md.";
CM_ SG_ 2566618368 Electrified_Accessory_Generator_ "Generic 8-byte raw payload. Detail page: https://www.isobus.net/isobus/pGNAndSPN/11787?type=PGN. Signal-level enrichment via PR welcome  see CONTRIBUTING.md.";
CM_ SG_ 2566618624 Electrified_Accessory_Generator_ "Generic 8-byte raw payload. Detail page: https://www.isobus.net/isobus/pGNAndSPN/11795?type=PGN. Signal-level enrichment via PR welcome  see CONTRIBUTING.md.";
CM_ SG_ 2566618880 Well_Stimulation_Pump_System_Fil "Generic 8-byte raw payload. Detail page: https://www.isobus.net/isobus/pGNAndSPN/11798?type=PGN. Signal-level enrichment via PR welcome  see CONTRIBUTING.md.";
CM_ SG_ 2566619136 PTO_Governor_Configuration_RawPa "Generic 8-byte raw payload. Detail page: https://www.isobus.net/isobus/pGNAndSPN/11809?type=PGN. Signal-level enrichment via PR welcome  see CONTRIBUTING.md.";
CM_ SG_ 2566619392 On_Board_Programming_2_RawPayloa "Generic 8-byte raw payload. Detail page: https://www.isobus.net/isobus/pGNAndSPN/11812?type=PGN. Signal-level enrichment via PR welcome  see CONTRIBUTING.md.";
CM_ SG_ 2566619648 Primary_or_Rear_Hitch_Yaw_RawPay "Generic 8-byte raw payload. Detail page: https://www.isobus.net/isobus/pGNAndSPN/11817?type=PGN. Signal-level enrichment via PR welcome  see CONTRIBUTING.md.";
CM_ SG_ 2566619904 Secondary_or_Front_Hitch_Yaw_Raw "Generic 8-byte raw payload. Detail page: https://www.isobus.net/isobus/pGNAndSPN/11822?type=PGN. Signal-level enrichment via PR welcome  see CONTRIBUTING.md.";
CM_ SG_ 2566620160 Operator_Status_RawPayload "Generic 8-byte raw payload. Detail page: https://www.isobus.net/isobus/pGNAndSPN/11826?type=PGN. Signal-level enrichment via PR welcome  see CONTRIBUTING.md.";
CM_ SG_ 2566620416 Engine_Idle_Management_Informati "Generic 8-byte raw payload. Detail page: https://www.isobus.net/isobus/pGNAndSPN/11830?type=PGN. Signal-level enrichment via PR welcome  see CONTRIBUTING.md.";
CM_ SG_ 2566620672 Alcohol_Interlock_To_Vehicle_Raw "Generic 8-byte raw payload. Detail page: https://www.isobus.net/isobus/pGNAndSPN/11831?type=PGN. Signal-level enrichment via PR welcome  see CONTRIBUTING.md.";
CM_ SG_ 2566620928 Vehicle_To_Alcohol_Interlock_Raw "Generic 8-byte raw payload. Detail page: https://www.isobus.net/isobus/pGNAndSPN/11832?type=PGN. Signal-level enrichment via PR welcome  see CONTRIBUTING.md.";
CM_ SG_ 2566621184 Marine_Control_Information_3_Raw "Generic 8-byte raw payload. Detail page: https://www.isobus.net/isobus/pGNAndSPN/11845?type=PGN. Signal-level enrichment via PR welcome  see CONTRIBUTING.md.";
CM_ SG_ 2566621440 Engine_Fluid_Level_Pressure_13_R "Generic 8-byte raw payload. Detail page: https://www.isobus.net/isobus/pGNAndSPN/11852?type=PGN. Signal-level enrichment via PR welcome  see CONTRIBUTING.md.";
CM_ SG_ 2566621696 High_Voltage_Energy_Storage_Syst "Generic 8-byte raw payload. Detail page: https://www.isobus.net/isobus/pGNAndSPN/11857?type=PGN. Signal-level enrichment via PR welcome  see CONTRIBUTING.md.";
CM_ SG_ 2566621952 Economy_Mode_Inactive_Hours_RawP "Generic 8-byte raw payload. Detail page: https://www.isobus.net/isobus/pGNAndSPN/11859?type=PGN. Signal-level enrichment via PR welcome  see CONTRIBUTING.md.";
CM_ SG_ 2566622208 Economy_Mode_Estimated_Instantan "Generic 8-byte raw payload. Detail page: https://www.isobus.net/isobus/pGNAndSPN/11861?type=PGN. Signal-level enrichment via PR welcome  see CONTRIBUTING.md.";
CM_ SG_ 2566622464 Economy_Mode_Active_Hours_RawPay "Generic 8-byte raw payload. Detail page: https://www.isobus.net/isobus/pGNAndSPN/11863?type=PGN. Signal-level enrichment via PR welcome  see CONTRIBUTING.md.";
CM_ SG_ 2566622720 Economy_Mode_Fuel_Used_RawPayloa "Generic 8-byte raw payload. Detail page: https://www.isobus.net/isobus/pGNAndSPN/11865?type=PGN. Signal-level enrichment via PR welcome  see CONTRIBUTING.md.";
CM_ SG_ 2566622976 Economy_Mode_Estimated_Fuel_Savi "Generic 8-byte raw payload. Detail page: https://www.isobus.net/isobus/pGNAndSPN/11867?type=PGN. Signal-level enrichment via PR welcome  see CONTRIBUTING.md.";
CM_ SG_ 2566623232 DC_DC_Converter_4_Voltage_RawPay "Generic 8-byte raw payload. Detail page: https://www.isobus.net/isobus/pGNAndSPN/11869?type=PGN. Signal-level enrichment via PR welcome  see CONTRIBUTING.md.";
CM_ SG_ 2566623488 DC_DC_Converter_3_Voltage_RawPay "Generic 8-byte raw payload. Detail page: https://www.isobus.net/isobus/pGNAndSPN/11871?type=PGN. Signal-level enrichment via PR welcome  see CONTRIBUTING.md.";
CM_ SG_ 2566623744 DC_DC_Converter_2_Voltage_RawPay "Generic 8-byte raw payload. Detail page: https://www.isobus.net/isobus/pGNAndSPN/11873?type=PGN. Signal-level enrichment via PR welcome  see CONTRIBUTING.md.";
CM_ SG_ 2566624000 DC_DC_Converter_1_Voltage_RawPay "Generic 8-byte raw payload. Detail page: https://www.isobus.net/isobus/pGNAndSPN/11875?type=PGN. Signal-level enrichment via PR welcome  see CONTRIBUTING.md.";
CM_ SG_ 2566624256 Electronic_Engine_Controller_22_ "Generic 8-byte raw payload. Detail page: https://www.isobus.net/isobus/pGNAndSPN/11877?type=PGN. Signal-level enrichment via PR welcome  see CONTRIBUTING.md.";
CM_ SG_ 2566624512 Engine_Hours_2_RawPayload "Generic 8-byte raw payload. Detail page: https://www.isobus.net/isobus/pGNAndSPN/11878?type=PGN. Signal-level enrichment via PR welcome  see CONTRIBUTING.md.";
CM_ SG_ 2566624768 Engine_Information_3_RawPayload "Generic 8-byte raw payload. Detail page: https://www.isobus.net/isobus/pGNAndSPN/11881?type=PGN. Signal-level enrichment via PR welcome  see CONTRIBUTING.md.";
CM_ SG_ 2566625024 Vehicle_Electrical_Power_15_RawP "Generic 8-byte raw payload. Detail page: https://www.isobus.net/isobus/pGNAndSPN/11885?type=PGN. Signal-level enrichment via PR welcome  see CONTRIBUTING.md.";
CM_ SG_ 2566625280 Exhaust_Oxygen_2_RawPayload "Generic 8-byte raw payload. Detail page: https://www.isobus.net/isobus/pGNAndSPN/11886?type=PGN. Signal-level enrichment via PR welcome  see CONTRIBUTING.md.";
CM_ SG_ 2566625536 DC_AC_Accessory_Inverter_1_Tempe "Generic 8-byte raw payload. Detail page: https://www.isobus.net/isobus/pGNAndSPN/11891?type=PGN. Signal-level enrichment via PR welcome  see CONTRIBUTING.md.";
CM_ SG_ 2566625792 DC_AC_Accessory_Inverter_1_DC_Si "Generic 8-byte raw payload. Detail page: https://www.isobus.net/isobus/pGNAndSPN/11895?type=PGN. Signal-level enrichment via PR welcome  see CONTRIBUTING.md.";
CM_ SG_ 2566626048 DC_AC_Accessory_Inverter_1_AC_Si "Generic 8-byte raw payload. Detail page: https://www.isobus.net/isobus/pGNAndSPN/11898?type=PGN. Signal-level enrichment via PR welcome  see CONTRIBUTING.md.";
CM_ SG_ 2566626304 DC_AC_Accessory_Inverter_1_Confi "Generic 8-byte raw payload. Detail page: https://www.isobus.net/isobus/pGNAndSPN/11905?type=PGN. Signal-level enrichment via PR welcome  see CONTRIBUTING.md.";
CM_ SG_ 2566626560 DC_AC_Accessory_Inverter_1_Lifet "Generic 8-byte raw payload. Detail page: https://www.isobus.net/isobus/pGNAndSPN/11907?type=PGN. Signal-level enrichment via PR welcome  see CONTRIBUTING.md.";
CM_ SG_ 2566626816 DC_AC_Accessory_Inverter_2_Tempe "Generic 8-byte raw payload. Detail page: https://www.isobus.net/isobus/pGNAndSPN/11912?type=PGN. Signal-level enrichment via PR welcome  see CONTRIBUTING.md.";
CM_ SG_ 2566627072 DC_AC_Accessory_Inverter_2_DC_Si "Generic 8-byte raw payload. Detail page: https://www.isobus.net/isobus/pGNAndSPN/11916?type=PGN. Signal-level enrichment via PR welcome  see CONTRIBUTING.md.";
CM_ SG_ 2566627328 DC_AC_Accessory_Inverter_2_AC_Si "Generic 8-byte raw payload. Detail page: https://www.isobus.net/isobus/pGNAndSPN/11919?type=PGN. Signal-level enrichment via PR welcome  see CONTRIBUTING.md.";
CM_ SG_ 2566627584 DC_AC_Accessory_Inverter_2_Confi "Generic 8-byte raw payload. Detail page: https://www.isobus.net/isobus/pGNAndSPN/11926?type=PGN. Signal-level enrichment via PR welcome  see CONTRIBUTING.md.";
CM_ SG_ 2566627840 DC_AC_Accessory_Inverter_2_Lifet "Generic 8-byte raw payload. Detail page: https://www.isobus.net/isobus/pGNAndSPN/11928?type=PGN. Signal-level enrichment via PR welcome  see CONTRIBUTING.md.";
CM_ SG_ 2566628096 DC_AC_Accessory_Inverter_3_Tempe "Generic 8-byte raw payload. Detail page: https://www.isobus.net/isobus/pGNAndSPN/11933?type=PGN. Signal-level enrichment via PR welcome  see CONTRIBUTING.md.";
CM_ SG_ 2566628352 DC_AC_Accessory_Inverter_3_DC_Si "Generic 8-byte raw payload. Detail page: https://www.isobus.net/isobus/pGNAndSPN/11937?type=PGN. Signal-level enrichment via PR welcome  see CONTRIBUTING.md.";
CM_ SG_ 2566628608 DC_AC_Accessory_Inverter_3_AC_Si "Generic 8-byte raw payload. Detail page: https://www.isobus.net/isobus/pGNAndSPN/11940?type=PGN. Signal-level enrichment via PR welcome  see CONTRIBUTING.md.";
CM_ SG_ 2566628864 DC_AC_Accessory_Inverter_3_Confi "Generic 8-byte raw payload. Detail page: https://www.isobus.net/isobus/pGNAndSPN/11947?type=PGN. Signal-level enrichment via PR welcome  see CONTRIBUTING.md.";
CM_ SG_ 2566629120 DC_AC_Accessory_Inverter_3_Lifet "Generic 8-byte raw payload. Detail page: https://www.isobus.net/isobus/pGNAndSPN/11949?type=PGN. Signal-level enrichment via PR welcome  see CONTRIBUTING.md.";
CM_ SG_ 2566629376 DC_AC_Accessory_Inverter_4_Tempe "Generic 8-byte raw payload. Detail page: https://www.isobus.net/isobus/pGNAndSPN/11954?type=PGN. Signal-level enrichment via PR welcome  see CONTRIBUTING.md.";
CM_ SG_ 2566629632 DC_AC_Accessory_Inverter_4_DC_Si "Generic 8-byte raw payload. Detail page: https://www.isobus.net/isobus/pGNAndSPN/11958?type=PGN. Signal-level enrichment via PR welcome  see CONTRIBUTING.md.";
CM_ SG_ 2566629888 DC_AC_Accessory_Inverter_4_AC_Si "Generic 8-byte raw payload. Detail page: https://www.isobus.net/isobus/pGNAndSPN/11961?type=PGN. Signal-level enrichment via PR welcome  see CONTRIBUTING.md.";
CM_ SG_ 2566630144 DC_AC_Accessory_Inverter_4_Confi "Generic 8-byte raw payload. Detail page: https://www.isobus.net/isobus/pGNAndSPN/11968?type=PGN. Signal-level enrichment via PR welcome  see CONTRIBUTING.md.";
CM_ SG_ 2566630400 DC_AC_Accessory_Inverter_4_Lifet "Generic 8-byte raw payload. Detail page: https://www.isobus.net/isobus/pGNAndSPN/11970?type=PGN. Signal-level enrichment via PR welcome  see CONTRIBUTING.md.";
CM_ SG_ 2566630656 DC_AC_Accessory_Inverter_5_Tempe "Generic 8-byte raw payload. Detail page: https://www.isobus.net/isobus/pGNAndSPN/11975?type=PGN. Signal-level enrichment via PR welcome  see CONTRIBUTING.md.";
CM_ SG_ 2566630912 DC_AC_Accessory_Inverter_5_DC_Si "Generic 8-byte raw payload. Detail page: https://www.isobus.net/isobus/pGNAndSPN/11979?type=PGN. Signal-level enrichment via PR welcome  see CONTRIBUTING.md.";
CM_ SG_ 2566631168 DC_AC_Accessory_Inverter_5_AC_Si "Generic 8-byte raw payload. Detail page: https://www.isobus.net/isobus/pGNAndSPN/11982?type=PGN. Signal-level enrichment via PR welcome  see CONTRIBUTING.md.";
CM_ SG_ 2566631424 DC_AC_Accessory_Inverter_5_Confi "Generic 8-byte raw payload. Detail page: https://www.isobus.net/isobus/pGNAndSPN/11989?type=PGN. Signal-level enrichment via PR welcome  see CONTRIBUTING.md.";
CM_ SG_ 2566631680 DC_AC_Accessory_Inverter_5_Lifet "Generic 8-byte raw payload. Detail page: https://www.isobus.net/isobus/pGNAndSPN/11991?type=PGN. Signal-level enrichment via PR welcome  see CONTRIBUTING.md.";
CM_ SG_ 2566631936 Well_Stimulation_Pump_Sensor_Cal "Generic 8-byte raw payload. Detail page: https://www.isobus.net/isobus/pGNAndSPN/11995?type=PGN. Signal-level enrichment via PR welcome  see CONTRIBUTING.md.";
CM_ SG_ 2566632192 Well_Stimulation_Pump_Fluid_Volu "Generic 8-byte raw payload. Detail page: https://www.isobus.net/isobus/pGNAndSPN/11997?type=PGN. Signal-level enrichment via PR welcome  see CONTRIBUTING.md.";
CM_ SG_ 2566632448 Well_Stimulation_Pump_Serial_Num "Generic 8-byte raw payload. Detail page: https://www.isobus.net/isobus/pGNAndSPN/11999?type=PGN. Signal-level enrichment via PR welcome  see CONTRIBUTING.md.";
CM_ SG_ 2566632704 Well_Stimulation_Pump_Trip_Hours "Generic 8-byte raw payload. Detail page: https://www.isobus.net/isobus/pGNAndSPN/12001?type=PGN. Signal-level enrichment via PR welcome  see CONTRIBUTING.md.";
CM_ SG_ 2566632960 Aftertreatment_1_Outlet_Gas_4_Ra "Generic 8-byte raw payload. Detail page: https://www.isobus.net/isobus/pGNAndSPN/12003?type=PGN. Signal-level enrichment via PR welcome  see CONTRIBUTING.md.";
CM_ SG_ 2566633216 Aftertreatment_1_Intake_Gas_4_Ra "Generic 8-byte raw payload. Detail page: https://www.isobus.net/isobus/pGNAndSPN/12005?type=PGN. Signal-level enrichment via PR welcome  see CONTRIBUTING.md.";
CM_ SG_ 2566633472 DC_DC_Converter_4_Lifetime_Data_ "Generic 8-byte raw payload. Detail page: https://www.isobus.net/isobus/pGNAndSPN/12009?type=PGN. Signal-level enrichment via PR welcome  see CONTRIBUTING.md.";
CM_ SG_ 2566633728 DC_DC_Converter_4_Configuration_ "Generic 8-byte raw payload. Detail page: https://www.isobus.net/isobus/pGNAndSPN/12021?type=PGN. Signal-level enrichment via PR welcome  see CONTRIBUTING.md.";
CM_ SG_ 2566633984 DC_DC_Converter_4_SLI_Battery_Li "Generic 8-byte raw payload. Detail page: https://www.isobus.net/isobus/pGNAndSPN/12024?type=PGN. Signal-level enrichment via PR welcome  see CONTRIBUTING.md.";
CM_ SG_ 2566634240 DC_DC_Converter_4_Temperatures_R "Generic 8-byte raw payload. Detail page: https://www.isobus.net/isobus/pGNAndSPN/12029?type=PGN. Signal-level enrichment via PR welcome  see CONTRIBUTING.md.";
CM_ SG_ 2566634496 DC_DC_Converter_4_Low_Side_Limit "Generic 8-byte raw payload. Detail page: https://www.isobus.net/isobus/pGNAndSPN/12033?type=PGN. Signal-level enrichment via PR welcome  see CONTRIBUTING.md.";
CM_ SG_ 2566634752 DC_DC_Converter_4_High_Side_Limi "Generic 8-byte raw payload. Detail page: https://www.isobus.net/isobus/pGNAndSPN/12037?type=PGN. Signal-level enrichment via PR welcome  see CONTRIBUTING.md.";
CM_ SG_ 2566635008 DC_DC_Converter_3_Lifetime_Data_ "Generic 8-byte raw payload. Detail page: https://www.isobus.net/isobus/pGNAndSPN/12041?type=PGN. Signal-level enrichment via PR welcome  see CONTRIBUTING.md.";
CM_ SG_ 2566635264 DC_DC_Converter_3_Configuration_ "Generic 8-byte raw payload. Detail page: https://www.isobus.net/isobus/pGNAndSPN/12053?type=PGN. Signal-level enrichment via PR welcome  see CONTRIBUTING.md.";
CM_ SG_ 2566635520 DC_DC_Converter_3_SLI_Battery_Li "Generic 8-byte raw payload. Detail page: https://www.isobus.net/isobus/pGNAndSPN/12056?type=PGN. Signal-level enrichment via PR welcome  see CONTRIBUTING.md.";
CM_ SG_ 2566635776 DC_DC_Converter_3_Temperatures_R "Generic 8-byte raw payload. Detail page: https://www.isobus.net/isobus/pGNAndSPN/12061?type=PGN. Signal-level enrichment via PR welcome  see CONTRIBUTING.md.";
CM_ SG_ 2566636032 DC_DC_Converter_3_Low_Side_Limit "Generic 8-byte raw payload. Detail page: https://www.isobus.net/isobus/pGNAndSPN/12065?type=PGN. Signal-level enrichment via PR welcome  see CONTRIBUTING.md.";
CM_ SG_ 2566636288 DC_DC_Converter_3_High_Side_Limi "Generic 8-byte raw payload. Detail page: https://www.isobus.net/isobus/pGNAndSPN/12069?type=PGN. Signal-level enrichment via PR welcome  see CONTRIBUTING.md.";
CM_ SG_ 2566636544 DC_DC_Converter_2_Lifetime_Data_ "Generic 8-byte raw payload. Detail page: https://www.isobus.net/isobus/pGNAndSPN/12073?type=PGN. Signal-level enrichment via PR welcome  see CONTRIBUTING.md.";
CM_ SG_ 2566636800 DC_DC_Converter_2_Configuration_ "Generic 8-byte raw payload. Detail page: https://www.isobus.net/isobus/pGNAndSPN/12085?type=PGN. Signal-level enrichment via PR welcome  see CONTRIBUTING.md.";
CM_ SG_ 2566637056 DC_DC_Converter_2_SLI_Battery_Li "Generic 8-byte raw payload. Detail page: https://www.isobus.net/isobus/pGNAndSPN/12088?type=PGN. Signal-level enrichment via PR welcome  see CONTRIBUTING.md.";
CM_ SG_ 2566637312 DC_DC_Converter_2_Temperatures_R "Generic 8-byte raw payload. Detail page: https://www.isobus.net/isobus/pGNAndSPN/12093?type=PGN. Signal-level enrichment via PR welcome  see CONTRIBUTING.md.";
CM_ SG_ 2566637568 DC_DC_Converter_2_Low_Side_Limit "Generic 8-byte raw payload. Detail page: https://www.isobus.net/isobus/pGNAndSPN/12097?type=PGN. Signal-level enrichment via PR welcome  see CONTRIBUTING.md.";
CM_ SG_ 2566637824 DC_DC_Converter_2_High_Side_Limi "Generic 8-byte raw payload. Detail page: https://www.isobus.net/isobus/pGNAndSPN/12101?type=PGN. Signal-level enrichment via PR welcome  see CONTRIBUTING.md.";
CM_ SG_ 2566638080 CiA_602_2_AUTOSAR_CAN_NM_Obsolet "Generic 8-byte raw payload. Detail page: https://www.isobus.net/isobus/pGNAndSPN/12102?type=PGN. Signal-level enrichment via PR welcome  see CONTRIBUTING.md.";
CM_ SG_ 2566638336 Engine_Exhaust_Particulate_Contr "Generic 8-byte raw payload. Detail page: https://www.isobus.net/isobus/pGNAndSPN/12104?type=PGN. Signal-level enrichment via PR welcome  see CONTRIBUTING.md.";
CM_ SG_ 2566638592 Well_Stimulation_Pump_Hours_RawP "Generic 8-byte raw payload. Detail page: https://www.isobus.net/isobus/pGNAndSPN/12108?type=PGN. Signal-level enrichment via PR welcome  see CONTRIBUTING.md.";
CM_ SG_ 2566638848 Well_Stimulation_Pump_System_Con "Generic 8-byte raw payload. Detail page: https://www.isobus.net/isobus/pGNAndSPN/12119?type=PGN. Signal-level enrichment via PR welcome  see CONTRIBUTING.md.";
CM_ SG_ 2566639104 Configurable_Receive_SPNs_Status "Generic 8-byte raw payload. Detail page: https://www.isobus.net/isobus/pGNAndSPN/12126?type=PGN. Signal-level enrichment via PR welcome  see CONTRIBUTING.md.";
CM_ SG_ 2566639360 DC_DC_Converter_1_Lifetime_Data_ "Generic 8-byte raw payload. Detail page: https://www.isobus.net/isobus/pGNAndSPN/12130?type=PGN. Signal-level enrichment via PR welcome  see CONTRIBUTING.md.";
CM_ SG_ 2566639616 DC_DC_Converter_1_Configuration_ "Generic 8-byte raw payload. Detail page: https://www.isobus.net/isobus/pGNAndSPN/12142?type=PGN. Signal-level enrichment via PR welcome  see CONTRIBUTING.md.";
CM_ SG_ 2566639872 DC_DC_Converter_1_SLI_Battery_Li "Generic 8-byte raw payload. Detail page: https://www.isobus.net/isobus/pGNAndSPN/12145?type=PGN. Signal-level enrichment via PR welcome  see CONTRIBUTING.md.";
CM_ SG_ 2566640128 Pump_Oil_Message_RawPayload "Generic 8-byte raw payload. Detail page: https://www.isobus.net/isobus/pGNAndSPN/12149?type=PGN. Signal-level enrichment via PR welcome  see CONTRIBUTING.md.";
CM_ SG_ 2566640384 Well_Stimulation_Pump_System_Lif "Generic 8-byte raw payload. Detail page: https://www.isobus.net/isobus/pGNAndSPN/12153?type=PGN. Signal-level enrichment via PR welcome  see CONTRIBUTING.md.";
CM_ SG_ 2566640640 Well_Stimulation_Pump_System_Con "Generic 8-byte raw payload. Detail page: https://www.isobus.net/isobus/pGNAndSPN/12157?type=PGN. Signal-level enrichment via PR welcome  see CONTRIBUTING.md.";
CM_ SG_ 2566640896 Aftercooler_and_Oil_Cooler_Fluid "Generic 8-byte raw payload. Detail page: https://www.isobus.net/isobus/pGNAndSPN/12161?type=PGN. Signal-level enrichment via PR welcome  see CONTRIBUTING.md.";
CM_ SG_ 2566641152 Electronic_Engine_Controller_21_ "Generic 8-byte raw payload. Detail page: https://www.isobus.net/isobus/pGNAndSPN/12163?type=PGN. Signal-level enrichment via PR welcome  see CONTRIBUTING.md.";
CM_ SG_ 2566641408 Configurable_Transmit_PGNs_Statu "Generic 8-byte raw payload. Detail page: https://www.isobus.net/isobus/pGNAndSPN/12170?type=PGN. Signal-level enrichment via PR welcome  see CONTRIBUTING.md.";
CM_ SG_ 2566641664 DC_DC_Converter_1_Temperatures_R "Generic 8-byte raw payload. Detail page: https://www.isobus.net/isobus/pGNAndSPN/12175?type=PGN. Signal-level enrichment via PR welcome  see CONTRIBUTING.md.";
CM_ SG_ 2566641920 DC_DC_Converter_1_Low_Side_Limit "Generic 8-byte raw payload. Detail page: https://www.isobus.net/isobus/pGNAndSPN/12179?type=PGN. Signal-level enrichment via PR welcome  see CONTRIBUTING.md.";
CM_ SG_ 2566642176 DC_DC_Converter_1_High_Side_Limi "Generic 8-byte raw payload. Detail page: https://www.isobus.net/isobus/pGNAndSPN/12183?type=PGN. Signal-level enrichment via PR welcome  see CONTRIBUTING.md.";
CM_ SG_ 2566642688 Door_Control_4_RawPayload "Generic 8-byte raw payload. Detail page: https://www.isobus.net/isobus/pGNAndSPN/12216?type=PGN. Signal-level enrichment via PR welcome  see CONTRIBUTING.md.";
CM_ SG_ 2566642944 Door_Control_3_RawPayload "Generic 8-byte raw payload. Detail page: https://www.isobus.net/isobus/pGNAndSPN/12246?type=PGN. Signal-level enrichment via PR welcome  see CONTRIBUTING.md.";
CM_ SG_ 2566643200 Engine_Temperature_6_RawPayload "Generic 8-byte raw payload. Detail page: https://www.isobus.net/isobus/pGNAndSPN/12250?type=PGN. Signal-level enrichment via PR welcome  see CONTRIBUTING.md.";
CM_ SG_ 2566643456 Intake_Exhaust_Conditions_3_RawP "Generic 8-byte raw payload. Detail page: https://www.isobus.net/isobus/pGNAndSPN/12254?type=PGN. Signal-level enrichment via PR welcome  see CONTRIBUTING.md.";
CM_ SG_ 2566643712 Aftercooler_and_Oil_Cooler_Fluid "Generic 8-byte raw payload. Detail page: https://www.isobus.net/isobus/pGNAndSPN/12262?type=PGN. Signal-level enrichment via PR welcome  see CONTRIBUTING.md.";
CM_ SG_ 2566643968 Diode_Temperature_2_RawPayload "Generic 8-byte raw payload. Detail page: https://www.isobus.net/isobus/pGNAndSPN/12266?type=PGN. Signal-level enrichment via PR welcome  see CONTRIBUTING.md.";
CM_ SG_ 2566644224 Diode_Temperature_1_RawPayload "Generic 8-byte raw payload. Detail page: https://www.isobus.net/isobus/pGNAndSPN/12274?type=PGN. Signal-level enrichment via PR welcome  see CONTRIBUTING.md.";
CM_ SG_ 2566644480 Alternator_Temperature_2_RawPayl "Generic 8-byte raw payload. Detail page: https://www.isobus.net/isobus/pGNAndSPN/12282?type=PGN. Signal-level enrichment via PR welcome  see CONTRIBUTING.md.";
CM_ SG_ 2566644736 Fuel_Information_7_Gaseous_RawPa "Generic 8-byte raw payload. Detail page: https://www.isobus.net/isobus/pGNAndSPN/12294?type=PGN. Signal-level enrichment via PR welcome  see CONTRIBUTING.md.";
CM_ SG_ 2566644992 High_Voltage_Energy_Storage_Syst "Generic 8-byte raw payload. Detail page: https://www.isobus.net/isobus/pGNAndSPN/12303?type=PGN. Signal-level enrichment via PR welcome  see CONTRIBUTING.md.";
CM_ SG_ 2566645248 High_Voltage_Energy_Storage_Syst "Generic 8-byte raw payload. Detail page: https://www.isobus.net/isobus/pGNAndSPN/12325?type=PGN. Signal-level enrichment via PR welcome  see CONTRIBUTING.md.";
CM_ SG_ 2566645504 SCR_Operator_Inducement_Informat "Generic 8-byte raw payload. Detail page: https://www.isobus.net/isobus/pGNAndSPN/12327?type=PGN. Signal-level enrichment via PR welcome  see CONTRIBUTING.md.";
CM_ SG_ 2566645760 Aftertreatment_System_Informatio "Generic 8-byte raw payload. Detail page: https://www.isobus.net/isobus/pGNAndSPN/12331?type=PGN. Signal-level enrichment via PR welcome  see CONTRIBUTING.md.";
CM_ SG_ 2566646016 Ethernet_1_Connection_Informatio "Generic 8-byte raw payload. Detail page: https://www.isobus.net/isobus/pGNAndSPN/12332?type=PGN. Signal-level enrichment via PR welcome  see CONTRIBUTING.md.";
CM_ SG_ 2566646272 Ethernet_1_Connection_Informatio "Generic 8-byte raw payload. Detail page: https://www.isobus.net/isobus/pGNAndSPN/12352?type=PGN. Signal-level enrichment via PR welcome  see CONTRIBUTING.md.";
CM_ SG_ 2566646528 Oil_Debris_Monitor_Counts_Ferrou "Generic 8-byte raw payload. Detail page: https://www.isobus.net/isobus/pGNAndSPN/12355?type=PGN. Signal-level enrichment via PR welcome  see CONTRIBUTING.md.";
CM_ SG_ 2566646784 Oil_Debris_Monitor_Counts_Ferrou "Generic 8-byte raw payload. Detail page: https://www.isobus.net/isobus/pGNAndSPN/12358?type=PGN. Signal-level enrichment via PR welcome  see CONTRIBUTING.md.";
CM_ SG_ 2566647040 Oil_Debris_Monitor_Counts_Ferrou "Generic 8-byte raw payload. Detail page: https://www.isobus.net/isobus/pGNAndSPN/12361?type=PGN. Signal-level enrichment via PR welcome  see CONTRIBUTING.md.";
CM_ SG_ 2566647296 Oil_Debris_Monitor_Counts_Non_Fe "Generic 8-byte raw payload. Detail page: https://www.isobus.net/isobus/pGNAndSPN/12364?type=PGN. Signal-level enrichment via PR welcome  see CONTRIBUTING.md.";
CM_ SG_ 2566647552 Oil_Debris_Monitor_Counts_Non_Fe "Generic 8-byte raw payload. Detail page: https://www.isobus.net/isobus/pGNAndSPN/12367?type=PGN. Signal-level enrichment via PR welcome  see CONTRIBUTING.md.";
CM_ SG_ 2566647808 Oil_Debris_Monitor_Counts_Non_Fe "Generic 8-byte raw payload. Detail page: https://www.isobus.net/isobus/pGNAndSPN/12370?type=PGN. Signal-level enrichment via PR welcome  see CONTRIBUTING.md.";
CM_ SG_ 2566648064 Oil_Debris_Monitoring_System_Sta "Generic 8-byte raw payload. Detail page: https://www.isobus.net/isobus/pGNAndSPN/12376?type=PGN. Signal-level enrichment via PR welcome  see CONTRIBUTING.md.";
CM_ SG_ 2566648320 Engine_Fuel_Lube_Systems_3_RawPa "Generic 8-byte raw payload. Detail page: https://www.isobus.net/isobus/pGNAndSPN/12378?type=PGN. Signal-level enrichment via PR welcome  see CONTRIBUTING.md.";
CM_ SG_ 2566648576 Cruise_Control_Vehicle_Speed_5_R "Generic 8-byte raw payload. Detail page: https://www.isobus.net/isobus/pGNAndSPN/12379?type=PGN. Signal-level enrichment via PR welcome  see CONTRIBUTING.md.";
CM_ SG_ 2566648832 Aftertreatment_2_Diesel_Oxidatio "Generic 8-byte raw payload. Detail page: https://www.isobus.net/isobus/pGNAndSPN/12382?type=PGN. Signal-level enrichment via PR welcome  see CONTRIBUTING.md.";
CM_ SG_ 2566649088 Aftertreatment_1_Diesel_Oxidatio "Generic 8-byte raw payload. Detail page: https://www.isobus.net/isobus/pGNAndSPN/12385?type=PGN. Signal-level enrichment via PR welcome  see CONTRIBUTING.md.";
CM_ SG_ 2566649344 Vehicle_Position_2_RawPayload "Generic 8-byte raw payload. Detail page: https://www.isobus.net/isobus/pGNAndSPN/12390?type=PGN. Signal-level enrichment via PR welcome  see CONTRIBUTING.md.";
CM_ SG_ 2566649600 Electrified_Accessory_Propulsion "Generic 8-byte raw payload. Detail page: https://www.isobus.net/isobus/pGNAndSPN/12398?type=PGN. Signal-level enrichment via PR welcome  see CONTRIBUTING.md.";
CM_ SG_ 2566649856 Electrified_Accessory_Propulsion "Generic 8-byte raw payload. Detail page: https://www.isobus.net/isobus/pGNAndSPN/12406?type=PGN. Signal-level enrichment via PR welcome  see CONTRIBUTING.md.";
CM_ SG_ 2566650112 Electrified_Accessory_Propulsion "Generic 8-byte raw payload. Detail page: https://www.isobus.net/isobus/pGNAndSPN/12414?type=PGN. Signal-level enrichment via PR welcome  see CONTRIBUTING.md.";
CM_ SG_ 2566650368 Electrified_Accessory_Power_Elec "Generic 8-byte raw payload. Detail page: https://www.isobus.net/isobus/pGNAndSPN/12422?type=PGN. Signal-level enrichment via PR welcome  see CONTRIBUTING.md.";
CM_ SG_ 2566650624 Electrified_Accessory_Power_Elec "Generic 8-byte raw payload. Detail page: https://www.isobus.net/isobus/pGNAndSPN/12430?type=PGN. Signal-level enrichment via PR welcome  see CONTRIBUTING.md.";
CM_ SG_ 2566650880 Electrified_Accessory_Power_Elec "Generic 8-byte raw payload. Detail page: https://www.isobus.net/isobus/pGNAndSPN/12438?type=PGN. Signal-level enrichment via PR welcome  see CONTRIBUTING.md.";
CM_ SG_ 2566651136 Electrified_Accessory_Propulsion "Generic 8-byte raw payload. Detail page: https://www.isobus.net/isobus/pGNAndSPN/12446?type=PGN. Signal-level enrichment via PR welcome  see CONTRIBUTING.md.";
CM_ SG_ 2566651392 Electrified_Accessory_Propulsion "Generic 8-byte raw payload. Detail page: https://www.isobus.net/isobus/pGNAndSPN/12454?type=PGN. Signal-level enrichment via PR welcome  see CONTRIBUTING.md.";
CM_ SG_ 2566651648 Electrified_Accessory_Power_Elec "Generic 8-byte raw payload. Detail page: https://www.isobus.net/isobus/pGNAndSPN/12462?type=PGN. Signal-level enrichment via PR welcome  see CONTRIBUTING.md.";
CM_ SG_ 2566651904 Trailer_Wheel_Brake_Wear_Life_Re "Generic 8-byte raw payload. Detail page: https://www.isobus.net/isobus/pGNAndSPN/12478?type=PGN. Signal-level enrichment via PR welcome  see CONTRIBUTING.md.";
CM_ SG_ 2566652160 Electrified_Accessory_Motor_Stat "Generic 8-byte raw payload. Detail page: https://www.isobus.net/isobus/pGNAndSPN/12487?type=PGN. Signal-level enrichment via PR welcome  see CONTRIBUTING.md.";
CM_ SG_ 2566652416 SCR_System_Information_RawPayloa "Generic 8-byte raw payload. Detail page: https://www.isobus.net/isobus/pGNAndSPN/12492?type=PGN. Signal-level enrichment via PR welcome  see CONTRIBUTING.md.";
CM_ SG_ 2566652672 Vehicle_Electrical_Power_14_RawP "Generic 8-byte raw payload. Detail page: https://www.isobus.net/isobus/pGNAndSPN/12497?type=PGN. Signal-level enrichment via PR welcome  see CONTRIBUTING.md.";
CM_ SG_ 2566652928 Vehicle_Electrical_Power_13_RawP "Generic 8-byte raw payload. Detail page: https://www.isobus.net/isobus/pGNAndSPN/12500?type=PGN. Signal-level enrichment via PR welcome  see CONTRIBUTING.md.";
CM_ SG_ 2566653184 Vehicle_Electrical_Power_12_RawP "Generic 8-byte raw payload. Detail page: https://www.isobus.net/isobus/pGNAndSPN/12505?type=PGN. Signal-level enrichment via PR welcome  see CONTRIBUTING.md.";
CM_ SG_ 2566653440 Vehicle_Electrical_Power_11_RawP "Generic 8-byte raw payload. Detail page: https://www.isobus.net/isobus/pGNAndSPN/12508?type=PGN. Signal-level enrichment via PR welcome  see CONTRIBUTING.md.";
CM_ SG_ 2566653696 Vehicle_Electrical_Power_10_RawP "Generic 8-byte raw payload. Detail page: https://www.isobus.net/isobus/pGNAndSPN/12513?type=PGN. Signal-level enrichment via PR welcome  see CONTRIBUTING.md.";
CM_ SG_ 2566653952 Vehicle_Electrical_Power_9_RawPa "Generic 8-byte raw payload. Detail page: https://www.isobus.net/isobus/pGNAndSPN/12516?type=PGN. Signal-level enrichment via PR welcome  see CONTRIBUTING.md.";
CM_ SG_ 2566654208 Vehicle_Electrical_Power_8_RawPa "Generic 8-byte raw payload. Detail page: https://www.isobus.net/isobus/pGNAndSPN/12521?type=PGN. Signal-level enrichment via PR welcome  see CONTRIBUTING.md.";
CM_ SG_ 2566654464 Vehicle_Electrical_Power_7_RawPa "Generic 8-byte raw payload. Detail page: https://www.isobus.net/isobus/pGNAndSPN/12524?type=PGN. Signal-level enrichment via PR welcome  see CONTRIBUTING.md.";

BA_DEF_ BO_ "SystemMessageLongSymbol" STRING;
BA_DEF_ SG_ "SystemSignalLongSymbol" STRING;
BA_ "SystemMessageLongSymbol" BO_ 2566565376 "VDMA_FAAE_High_Voltage_Energy_Storage_Pack";
BA_ "SystemMessageLongSymbol" BO_ 2566565632 "VDMA_FAAF_High_Voltage_Energy_Storage_Pack";
BA_ "SystemMessageLongSymbol" BO_ 2566565888 "VDMA_FAB0_High_Voltage_Energy_Storage_Pack";
BA_ "SystemMessageLongSymbol" BO_ 2566566144 "VDMA_FAB1_High_Voltage_Energy_Storage_Pack";
BA_ "SystemMessageLongSymbol" BO_ 2566566400 "VDMA_FAB2_High_Voltage_Energy_Storage_Pack";
BA_ "SystemMessageLongSymbol" BO_ 2566566656 "VDMA_FAB3_AUTOSAR_Time_Synchronization";
BA_ "SystemMessageLongSymbol" BO_ 2566566912 "VDMA_FAB4_EV_DC_Charging_Limits_1";
BA_ "SystemMessageLongSymbol" BO_ 2566567168 "VDMA_FAB5_EVSE_DC_Charging_Limits_1";
BA_ "SystemMessageLongSymbol" BO_ 2566567424 "VDMA_FAB6_EVSE_DC_Charging_Limits_2";
BA_ "SystemMessageLongSymbol" BO_ 2566568448 "VDMA_FABA_EVSE_1_Contactor_Status_1";
BA_ "SystemMessageLongSymbol" BO_ 2566568704 "VDMA_FABB_Direct_Lamp_Control_Command_3";
BA_ "SystemMessageLongSymbol" BO_ 2566568960 "VDMA_FABC_Direct_Lamp_Control_Data_3";
BA_ "SystemMessageLongSymbol" BO_ 2566569216 "VDMA_FABD_Motor_Generator_1_Lifetime_Data";
BA_ "SystemMessageLongSymbol" BO_ 2566569472 "VDMA_FABE_Motor_Generator_2_Lifetime_Data";
BA_ "SystemMessageLongSymbol" BO_ 2566569728 "VDMA_FABF_Motor_Generator_3_Lifetime_Data";
BA_ "SystemMessageLongSymbol" BO_ 2566569984 "VDMA_FAC0_Motor_Generator_4_Lifetime_Data";
BA_ "SystemMessageLongSymbol" BO_ 2566570240 "VDMA_FAC1_Motor_Generator_5_Lifetime_Data";
BA_ "SystemMessageLongSymbol" BO_ 2566570496 "VDMA_FAC2_Motor_Generator_6_Lifetime_Data";
BA_ "SystemMessageLongSymbol" BO_ 2566571520 "VDMA_FAC6_Electronic_Retarder_Controller_3";
BA_ "SystemMessageLongSymbol" BO_ 2566572032 "VDMA_FAC8_Electronic_Transmission_Controll";
BA_ "SystemMessageLongSymbol" BO_ 2566572800 "VDMA_FACB_Collision_Avoidance_System_4";
BA_ "SystemMessageLongSymbol" BO_ 2566573056 "VDMA_FACC_Collision_Avoidance_System_3";
BA_ "SystemMessageLongSymbol" BO_ 2566573312 "VDMA_FACD_Aftertreatment_1_SCR_Exhaust_Gas";
BA_ "SystemMessageLongSymbol" BO_ 2566574336 "VDMA_FAD1_Engine_Average_Information_2";
BA_ "SystemMessageLongSymbol" BO_ 2566574592 "VDMA_FAD2_Turbocharger_Information_9";
BA_ "SystemMessageLongSymbol" BO_ 2566574848 "VDMA_FAD3_Automated_Driving_System_Control";
BA_ "SystemMessageLongSymbol" BO_ 2566575872 "VDMA_FAD7_Object_Detection_Message_1_1";
BA_ "SystemMessageLongSymbol" BO_ 2566576128 "VDMA_FAD8_Object_Detection_Message_2_1";
BA_ "SystemMessageLongSymbol" BO_ 2566576384 "VDMA_FAD9_Object_Detection_Message_2_2";
BA_ "SystemMessageLongSymbol" BO_ 2566576640 "VDMA_FADA_Object_Detection_Message_2_3";
BA_ "SystemMessageLongSymbol" BO_ 2566576896 "VDMA_FADB_Object_Detection_Message_2_4";
BA_ "SystemMessageLongSymbol" BO_ 2566577152 "VDMA_FADC_Object_Detection_Message_2_5";
BA_ "SystemMessageLongSymbol" BO_ 2566577408 "VDMA_FADD_Object_Detection_Message_2_6";
BA_ "SystemMessageLongSymbol" BO_ 2566577664 "VDMA_FADE_Object_Detection_Message_2_7";
BA_ "SystemMessageLongSymbol" BO_ 2566577920 "VDMA_FADF_Object_Detection_Message_2_8";
BA_ "SystemMessageLongSymbol" BO_ 2566578176 "VDMA_FAE0_Object_Detection_Message_2_9";
BA_ "SystemMessageLongSymbol" BO_ 2566578432 "VDMA_FAE1_Object_Detection_Message_2_10";
BA_ "SystemMessageLongSymbol" BO_ 2566578688 "VDMA_FAE2_Object_Detection_Message_2_11";
BA_ "SystemMessageLongSymbol" BO_ 2566578944 "VDMA_FAE3_Object_Detection_Message_2_12";
BA_ "SystemMessageLongSymbol" BO_ 2566579200 "VDMA_FAE4_Object_Detection_Message_2_13";
BA_ "SystemMessageLongSymbol" BO_ 2566579456 "VDMA_FAE5_Object_Detection_Message_2_14";
BA_ "SystemMessageLongSymbol" BO_ 2566579712 "VDMA_FAE6_Object_Detection_Message_2_15";
BA_ "SystemMessageLongSymbol" BO_ 2566579968 "VDMA_FAE7_Object_Detection_Message_2_16";
BA_ "SystemMessageLongSymbol" BO_ 2566580224 "VDMA_FAE8_Object_Detection_Message_2_17";
BA_ "SystemMessageLongSymbol" BO_ 2566580480 "VDMA_FAE9_Object_Detection_Message_2_18";
BA_ "SystemMessageLongSymbol" BO_ 2566580736 "VDMA_FAEA_Object_Detection_Message_2_19";
BA_ "SystemMessageLongSymbol" BO_ 2566580992 "VDMA_FAEB_Object_Detection_Message_2_20";
BA_ "SystemMessageLongSymbol" BO_ 2566581248 "VDMA_FAEC_Object_Detection_Message_2_21";
BA_ "SystemMessageLongSymbol" BO_ 2566581504 "VDMA_FAED_Temperature_Sensing_Module_1";
BA_ "SystemMessageLongSymbol" BO_ 2566581760 "VDMA_FAEE_Temperature_Sensing_Module_2";
BA_ "SystemMessageLongSymbol" BO_ 2566582016 "VDMA_FAEF_Aftertreatment_2_SCR_Service_Inf";
BA_ "SystemMessageLongSymbol" BO_ 2566582272 "VDMA_FAF0_Aftertreatment_1_SCR_Service_Inf";
BA_ "SystemMessageLongSymbol" BO_ 2566582528 "VDMA_FAF1_PSA_Times_Lifetime_Hours";
BA_ "SystemMessageLongSymbol" BO_ 2566582784 "VDMA_FAF2_PSA_Times_Stored_100_Hours";
BA_ "SystemMessageLongSymbol" BO_ 2566583040 "VDMA_FAF3_PSA_Times_Active_100_Hours";
BA_ "SystemMessageLongSymbol" BO_ 2566583296 "VDMA_FAF4_Hybrid_Charge_Depleting_or_Incre";
BA_ "SystemMessageLongSymbol" BO_ 2566583552 "VDMA_FAF5_Hybrid_Charge_Depleting_or_Incre";
BA_ "SystemMessageLongSymbol" BO_ 2566583808 "VDMA_FAF6_Hybrid_Charge_Depleting_or_Incre";
BA_ "SystemMessageLongSymbol" BO_ 2566584064 "VDMA_FAF7_Aftertreatment_1_Historical_Info";
BA_ "SystemMessageLongSymbol" BO_ 2566584320 "VDMA_FAF8_Engine_Maximum_Net_Torque_Map";
BA_ "SystemMessageLongSymbol" BO_ 2566584576 "VDMA_FAF9_Aftertreatment_1_SCR_2_NOx_Mass_";
BA_ "SystemMessageLongSymbol" BO_ 2566584832 "VDMA_FAFA_Aftertreatment_1_SCR_1_NOx_Mass_";
BA_ "SystemMessageLongSymbol" BO_ 2566585088 "VDMA_FAFB_Evaporative_System_Pressure_and_";
BA_ "SystemMessageLongSymbol" BO_ 2566585344 "VDMA_FAFC_GHG_Tracking_Lifetime_Array_Data";
BA_ "SystemMessageLongSymbol" BO_ 2566585600 "VDMA_FAFD_GHG_Tracking_Stored_100_Hour_Arr";
BA_ "SystemMessageLongSymbol" BO_ 2566585856 "VDMA_FAFE_GHG_Tracking_Active_100_Hour_Arr";
BA_ "SystemMessageLongSymbol" BO_ 2566586112 "VDMA_FAFF_Green_House_Gas_Stored_100_Hour_";
BA_ "SystemMessageLongSymbol" BO_ 2566586368 "VDMA_FB00_Green_House_Gas_Active_100_Hour_";
BA_ "SystemMessageLongSymbol" BO_ 2566586624 "VDMA_FB01_Green_House_Gas_Lifetime_Active_";
BA_ "SystemMessageLongSymbol" BO_ 2566586880 "VDMA_FB02_NOx_Tracking_Engine_Activity_Lif";
BA_ "SystemMessageLongSymbol" BO_ 2566587136 "VDMA_FB03_NOx_Tracking_Engine_Activity_Lif";
BA_ "SystemMessageLongSymbol" BO_ 2566587392 "VDMA_FB04_NOx_Tracking_Engine_Activity_Lif";
BA_ "SystemMessageLongSymbol" BO_ 2566587648 "VDMA_FB05_NOx_Tracking_Engine_Activity_Lif";
BA_ "SystemMessageLongSymbol" BO_ 2566587904 "VDMA_FB06_NOx_Tracking_Valid_NOx_Lifetime_";
BA_ "SystemMessageLongSymbol" BO_ 2566588160 "VDMA_FB07_NOx_Tracking_Valid_NOx_Lifetime_";
BA_ "SystemMessageLongSymbol" BO_ 2566588416 "VDMA_FB08_NOx_Tracking_Valid_NOx_Lifetime_";
BA_ "SystemMessageLongSymbol" BO_ 2566588672 "VDMA_FB09_NOx_Tracking_Valid_NOx_Lifetime_";
BA_ "SystemMessageLongSymbol" BO_ 2566588928 "VDMA_FB0A_NOx_Tracking_Valid_NOx_Lifetime_";
BA_ "SystemMessageLongSymbol" BO_ 2566589184 "VDMA_FB0B_NOx_Tracking_Valid_NOx_Lifetime_";
BA_ "SystemMessageLongSymbol" BO_ 2566589440 "VDMA_FB0C_NOx_Tracking_Stored_100_Hour_Fue";
BA_ "SystemMessageLongSymbol" BO_ 2566589696 "VDMA_FB0D_NOx_Tracking_Stored_100_Hour_Eng";
BA_ "SystemMessageLongSymbol" BO_ 2566589952 "VDMA_FB0E_NOx_Tracking_Stored_100_Hour_Veh";
BA_ "SystemMessageLongSymbol" BO_ 2566590208 "VDMA_FB0F_NOx_Tracking_Stored_100_Hour_Eng";
BA_ "SystemMessageLongSymbol" BO_ 2566590464 "VDMA_FB10_NOx_Tracking_Stored_100_Hour_Eng";
BA_ "SystemMessageLongSymbol" BO_ 2566590720 "VDMA_FB11_NOx_Tracking_Stored_100_Hour_Sys";
BA_ "SystemMessageLongSymbol" BO_ 2566590976 "VDMA_FB12_NOx_Tracking_Active_100_Hour_Fue";
BA_ "SystemMessageLongSymbol" BO_ 2566591232 "VDMA_FB13_NOx_Tracking_Active_100_Hour_Eng";
BA_ "SystemMessageLongSymbol" BO_ 2566591488 "VDMA_FB14_NOx_Tracking_Active_100_Hour_Veh";
BA_ "SystemMessageLongSymbol" BO_ 2566591744 "VDMA_FB15_NOx_Tracking_Active_100_Hour_Eng";
BA_ "SystemMessageLongSymbol" BO_ 2566592000 "VDMA_FB16_NOx_Tracking_Active_100_Hour_Eng";
BA_ "SystemMessageLongSymbol" BO_ 2566592256 "VDMA_FB17_NOx_Tracking_Active_100_Hour_Sys";
BA_ "SystemMessageLongSymbol" BO_ 2566592512 "VDMA_FB18_Motor_Generator_6_Inverter_Contr";
BA_ "SystemMessageLongSymbol" BO_ 2566592768 "VDMA_FB19_Motor_Generator_6_Inverter_Limit";
BA_ "SystemMessageLongSymbol" BO_ 2566593024 "VDMA_FB1A_Motor_Generator_6_Inverter_Limit";
BA_ "SystemMessageLongSymbol" BO_ 2566593280 "VDMA_FB1B_Motor_Generator_6_Inverter_Limit";
BA_ "SystemMessageLongSymbol" BO_ 2566593536 "VDMA_FB1C_Motor_Generator_6_Inverter_Isola";
BA_ "SystemMessageLongSymbol" BO_ 2566593792 "VDMA_FB1D_Motor_Generator_5_Inverter_Contr";
BA_ "SystemMessageLongSymbol" BO_ 2566594048 "VDMA_FB1E_Motor_Generator_5_Inverter_Limit";
BA_ "SystemMessageLongSymbol" BO_ 2566594304 "VDMA_FB1F_Motor_Generator_5_Inverter_Limit";
BA_ "SystemMessageLongSymbol" BO_ 2566594560 "VDMA_FB20_Motor_Generator_5_Inverter_Limit";
BA_ "SystemMessageLongSymbol" BO_ 2566594816 "VDMA_FB21_Motor_Generator_5_Inverter_Isola";
BA_ "SystemMessageLongSymbol" BO_ 2566595072 "VDMA_FB22_Motor_Generator_4_Inverter_Contr";
BA_ "SystemMessageLongSymbol" BO_ 2566595328 "VDMA_FB23_Motor_Generator_4_Inverter_Limit";
BA_ "SystemMessageLongSymbol" BO_ 2566595584 "VDMA_FB24_Motor_Generator_4_Inverter_Limit";
BA_ "SystemMessageLongSymbol" BO_ 2566595840 "VDMA_FB25_Motor_Generator_4_Inverter_Limit";
BA_ "SystemMessageLongSymbol" BO_ 2566596096 "VDMA_FB26_Motor_Generator_4_Inverter_Isola";
BA_ "SystemMessageLongSymbol" BO_ 2566596352 "VDMA_FB27_Motor_Generator_3_Inverter_Contr";
BA_ "SystemMessageLongSymbol" BO_ 2566596608 "VDMA_FB28_Motor_Generator_3_Inverter_Limit";
BA_ "SystemMessageLongSymbol" BO_ 2566596864 "VDMA_FB29_Motor_Generator_3_Inverter_Limit";
BA_ "SystemMessageLongSymbol" BO_ 2566597120 "VDMA_FB2A_Motor_Generator_3_Inverter_Limit";
BA_ "SystemMessageLongSymbol" BO_ 2566597376 "VDMA_FB2B_Motor_Generator_3_Inverter_Isola";
BA_ "SystemMessageLongSymbol" BO_ 2566597888 "VDMA_FB2D_Turbocharger_Information_8";
BA_ "SystemMessageLongSymbol" BO_ 2566598400 "VDMA_FB2F_Motor_Generator_6_Inverter_Refer";
BA_ "SystemMessageLongSymbol" BO_ 2566598656 "VDMA_FB30_Motor_Generator_6_Inverter_Statu";
BA_ "SystemMessageLongSymbol" BO_ 2566598912 "VDMA_FB31_Motor_Generator_6_Inverter_Refer";
BA_ "SystemMessageLongSymbol" BO_ 2566599168 "VDMA_FB32_Motor_Generator_6_Inverter_Tempe";
BA_ "SystemMessageLongSymbol" BO_ 2566599424 "VDMA_FB33_Motor_Generator_6_Inverter_Motor";
BA_ "SystemMessageLongSymbol" BO_ 2566599680 "VDMA_FB34_Motor_Generator_6_Inverter_Isola";
BA_ "SystemMessageLongSymbol" BO_ 2566599936 "VDMA_FB35_Motor_Generator_6_Inverter_Activ";
BA_ "SystemMessageLongSymbol" BO_ 2566600192 "VDMA_FB36_Motor_Generator_5_Inverter_Refer";
BA_ "SystemMessageLongSymbol" BO_ 2566600448 "VDMA_FB37_Motor_Generator_5_Inverter_Statu";
BA_ "SystemMessageLongSymbol" BO_ 2566600704 "VDMA_FB38_Motor_Generator_5_Inverter_Refer";
BA_ "SystemMessageLongSymbol" BO_ 2566600960 "VDMA_FB39_Motor_Generator_5_Inverter_Tempe";
BA_ "SystemMessageLongSymbol" BO_ 2566601216 "VDMA_FB3A_Motor_Generator_5_Inverter_Motor";
BA_ "SystemMessageLongSymbol" BO_ 2566601472 "VDMA_FB3B_Motor_Generator_5_Inverter_Isola";
BA_ "SystemMessageLongSymbol" BO_ 2566601728 "VDMA_FB3C_Motor_Generator_5_Inverter_Activ";
BA_ "SystemMessageLongSymbol" BO_ 2566601984 "VDMA_FB3D_Motor_Generator_4_Inverter_Refer";
BA_ "SystemMessageLongSymbol" BO_ 2566602240 "VDMA_FB3E_Motor_Generator_4_Inverter_Statu";
BA_ "SystemMessageLongSymbol" BO_ 2566602496 "VDMA_FB3F_Motor_Generator_4_Inverter_Refer";
BA_ "SystemMessageLongSymbol" BO_ 2566602752 "VDMA_FB40_Motor_Generator_4_Inverter_Tempe";
BA_ "SystemMessageLongSymbol" BO_ 2566603008 "VDMA_FB41_Motor_Generator_4_Inverter_Motor";
BA_ "SystemMessageLongSymbol" BO_ 2566603264 "VDMA_FB42_Motor_Generator_4_Inverter_Isola";
BA_ "SystemMessageLongSymbol" BO_ 2566603520 "VDMA_FB43_Motor_Generator_4_Inverter_Activ";
BA_ "SystemMessageLongSymbol" BO_ 2566603776 "VDMA_FB44_Motor_Generator_3_Inverter_Refer";
BA_ "SystemMessageLongSymbol" BO_ 2566604032 "VDMA_FB45_Motor_Generator_3_Inverter_Statu";
BA_ "SystemMessageLongSymbol" BO_ 2566604288 "VDMA_FB46_Motor_Generator_3_Inverter_Refer";
BA_ "SystemMessageLongSymbol" BO_ 2566604544 "VDMA_FB47_Motor_Generator_3_Inverter_Tempe";
BA_ "SystemMessageLongSymbol" BO_ 2566604800 "VDMA_FB48_Motor_Generator_3_Inverter_Motor";
BA_ "SystemMessageLongSymbol" BO_ 2566605056 "VDMA_FB49_Motor_Generator_3_Inverter_Isola";
BA_ "SystemMessageLongSymbol" BO_ 2566605312 "VDMA_FB4A_Motor_Generator_3_Inverter_Activ";
BA_ "SystemMessageLongSymbol" BO_ 2566605568 "VDMA_FB4B_Automated_Driving_System_Status_";
BA_ "SystemMessageLongSymbol" BO_ 2566605824 "VDMA_FB4C_Cab_Climate_System_Information_2";
BA_ "SystemMessageLongSymbol" BO_ 2566606080 "VDMA_FB4D_Maintenance_Information_1";
BA_ "SystemMessageLongSymbol" BO_ 2566606336 "VDMA_FB4E_Hoist_Control_Information";
BA_ "SystemMessageLongSymbol" BO_ 2566606592 "VDMA_FB4F_High_Voltage_Energy_Storage_Pack";
BA_ "SystemMessageLongSymbol" BO_ 2566606848 "VDMA_FB50_High_Voltage_Energy_Storage_Pack";
BA_ "SystemMessageLongSymbol" BO_ 2566607104 "VDMA_FB51_High_Voltage_Energy_Storage_Pack";
BA_ "SystemMessageLongSymbol" BO_ 2566607360 "VDMA_FB52_High_Voltage_Energy_Storage_Pack";
BA_ "SystemMessageLongSymbol" BO_ 2566607616 "VDMA_FB53_High_Voltage_Energy_Storage_Pack";
BA_ "SystemMessageLongSymbol" BO_ 2566607872 "VDMA_FB54_High_Voltage_Energy_Storage_Pack";
BA_ "SystemMessageLongSymbol" BO_ 2566608128 "VDMA_FB55_High_Voltage_Energy_Storage_Pack";
BA_ "SystemMessageLongSymbol" BO_ 2566608384 "VDMA_FB56_High_Voltage_Energy_Storage_Pack";
BA_ "SystemMessageLongSymbol" BO_ 2566608640 "VDMA_FB57_High_Voltage_Energy_Storage_Pack";
BA_ "SystemMessageLongSymbol" BO_ 2566608896 "VDMA_FB58_High_Voltage_Energy_Storage_Pack";
BA_ "SystemMessageLongSymbol" BO_ 2566609152 "VDMA_FB59_High_Voltage_Energy_Storage_Pack";
BA_ "SystemMessageLongSymbol" BO_ 2566609408 "VDMA_FB5A_High_Voltage_Energy_Storage_Pack";
BA_ "SystemMessageLongSymbol" BO_ 2566609664 "VDMA_FB5B_Vehicle_Fire_Suppression_System_";
BA_ "SystemMessageLongSymbol" BO_ 2566609920 "VDMA_FB5C_Vehicle_Fire_Suppression_System_";
BA_ "SystemMessageLongSymbol" BO_ 2566610176 "VDMA_FB5D_Vehicle_Fire_Suppression_System_";
BA_ "SystemMessageLongSymbol" BO_ 2566610432 "VDMA_FB5E_Vehicle_Fire_Suppression_System_";
BA_ "SystemMessageLongSymbol" BO_ 2566610688 "VDMA_FB5F_Vehicle_Fire_Suppression_System_";
BA_ "SystemMessageLongSymbol" BO_ 2566610944 "VDMA_FB60_Vehicle_Fire_Suppression_System_";
BA_ "SystemMessageLongSymbol" BO_ 2566611200 "VDMA_FB61_Vehicle_Fire_Suppression_System_";
BA_ "SystemMessageLongSymbol" BO_ 2566611456 "VDMA_FB62_Vehicle_Fire_Suppression_System_";
BA_ "SystemMessageLongSymbol" BO_ 2566611712 "VDMA_FB63_Vehicle_Fire_Suppression_System_";
BA_ "SystemMessageLongSymbol" BO_ 2566611968 "VDMA_FB64_Vehicle_Fire_Suppression_System_";
BA_ "SystemMessageLongSymbol" BO_ 2566612224 "VDMA_FB65_Vehicle_Fire_Suppression_System_";
BA_ "SystemMessageLongSymbol" BO_ 2566612480 "VDMA_FB66_Vehicle_Fire_Suppression_System_";
BA_ "SystemMessageLongSymbol" BO_ 2566612736 "VDMA_FB67_Motor_Generator_2_Inverter_Activ";
BA_ "SystemMessageLongSymbol" BO_ 2566612992 "VDMA_FB68_Motor_Generator_2_Inverter_Isola";
BA_ "SystemMessageLongSymbol" BO_ 2566613248 "VDMA_FB69_Motor_Generator_1_Inverter_Activ";
BA_ "SystemMessageLongSymbol" BO_ 2566613504 "VDMA_FB6A_Motor_Generator_1_Inverter_Isola";
BA_ "SystemMessageLongSymbol" BO_ 2566613760 "VDMA_FB6B_High_Voltage_Bus_Information";
BA_ "SystemMessageLongSymbol" BO_ 2566614016 "VDMA_FB6C_Motor_Generator_2_Inverter_Refer";
BA_ "SystemMessageLongSymbol" BO_ 2566614272 "VDMA_FB6D_Motor_Generator_2_Inverter_Statu";
BA_ "SystemMessageLongSymbol" BO_ 2566614528 "VDMA_FB6E_Motor_Generator_2_Inverter_Refer";
BA_ "SystemMessageLongSymbol" BO_ 2566614784 "VDMA_FB6F_Motor_Generator_2_Inverter_Tempe";
BA_ "SystemMessageLongSymbol" BO_ 2566615040 "VDMA_FB70_Motor_Generator_2_Inverter_Motor";
BA_ "SystemMessageLongSymbol" BO_ 2566615296 "VDMA_FB71_Motor_Generator_1_Inverter_Motor";
BA_ "SystemMessageLongSymbol" BO_ 2566615552 "VDMA_FB72_Motor_Generator_1_Inverter_Tempe";
BA_ "SystemMessageLongSymbol" BO_ 2566615808 "VDMA_FB73_Motor_Generator_1_Inverter_Refer";
BA_ "SystemMessageLongSymbol" BO_ 2566616064 "VDMA_FB74_Motor_Generator_1_Inverter_Statu";
BA_ "SystemMessageLongSymbol" BO_ 2566616320 "VDMA_FB75_Motor_Generator_1_Inverter_Refer";
BA_ "SystemMessageLongSymbol" BO_ 2566616576 "VDMA_FB76_Personnel_Detect_Status";
BA_ "SystemMessageLongSymbol" BO_ 2566616832 "VDMA_FB77_Engine_Cylinder_Pressure_Gamma_1";
BA_ "SystemMessageLongSymbol" BO_ 2566617088 "VDMA_FB78_Engine_Cylinder_Pressure_Gamma_2";
BA_ "SystemMessageLongSymbol" BO_ 2566617344 "VDMA_FB79_Engine_Cylinder_Pressure_Gamma_3";
BA_ "SystemMessageLongSymbol" BO_ 2566617600 "VDMA_FB7A_Engine_Cylinder_Pressure_Gamma_4";
BA_ "SystemMessageLongSymbol" BO_ 2566617856 "VDMA_FB7B_Engine_Cylinder_Pressure_Gamma_5";
BA_ "SystemMessageLongSymbol" BO_ 2566618368 "VDMA_FB7D_Electrified_Accessory_Generator_";
BA_ "SystemMessageLongSymbol" BO_ 2566618624 "VDMA_FB7E_Electrified_Accessory_Generator_";
BA_ "SystemMessageLongSymbol" BO_ 2566618880 "VDMA_FB7F_Well_Stimulation_Pump_System_Fil";
BA_ "SystemMessageLongSymbol" BO_ 2566619136 "VDMA_FB80_PTO_Governor_Configuration";
BA_ "SystemMessageLongSymbol" BO_ 2566619648 "VDMA_FB82_Primary_or_Rear_Hitch_Yaw";
BA_ "SystemMessageLongSymbol" BO_ 2566619904 "VDMA_FB83_Secondary_or_Front_Hitch_Yaw";
BA_ "SystemMessageLongSymbol" BO_ 2566620416 "VDMA_FB85_Engine_Idle_Management_Informati";
BA_ "SystemMessageLongSymbol" BO_ 2566620672 "VDMA_FB86_Alcohol_Interlock_To_Vehicle";
BA_ "SystemMessageLongSymbol" BO_ 2566620928 "VDMA_FB87_Vehicle_To_Alcohol_Interlock";
BA_ "SystemMessageLongSymbol" BO_ 2566621184 "VDMA_FB88_Marine_Control_Information_3";
BA_ "SystemMessageLongSymbol" BO_ 2566621440 "VDMA_FB89_Engine_Fluid_Level_Pressure_13";
BA_ "SystemMessageLongSymbol" BO_ 2566621696 "VDMA_FB8A_High_Voltage_Energy_Storage_Syst";
BA_ "SystemMessageLongSymbol" BO_ 2566621952 "VDMA_FB8B_Economy_Mode_Inactive_Hours";
BA_ "SystemMessageLongSymbol" BO_ 2566622208 "VDMA_FB8C_Economy_Mode_Estimated_Instantan";
BA_ "SystemMessageLongSymbol" BO_ 2566622464 "VDMA_FB8D_Economy_Mode_Active_Hours";
BA_ "SystemMessageLongSymbol" BO_ 2566622976 "VDMA_FB8F_Economy_Mode_Estimated_Fuel_Savi";
BA_ "SystemMessageLongSymbol" BO_ 2566623232 "VDMA_FB90_DC_DC_Converter_4_Voltage";
BA_ "SystemMessageLongSymbol" BO_ 2566623488 "VDMA_FB91_DC_DC_Converter_3_Voltage";
BA_ "SystemMessageLongSymbol" BO_ 2566623744 "VDMA_FB92_DC_DC_Converter_2_Voltage";
BA_ "SystemMessageLongSymbol" BO_ 2566624000 "VDMA_FB93_DC_DC_Converter_1_Voltage";
BA_ "SystemMessageLongSymbol" BO_ 2566624256 "VDMA_FB94_Electronic_Engine_Controller_22";
BA_ "SystemMessageLongSymbol" BO_ 2566625024 "VDMA_FB97_Vehicle_Electrical_Power_15";
BA_ "SystemMessageLongSymbol" BO_ 2566625536 "VDMA_FB99_DC_AC_Accessory_Inverter_1_Tempe";
BA_ "SystemMessageLongSymbol" BO_ 2566625792 "VDMA_FB9A_DC_AC_Accessory_Inverter_1_DC_Si";
BA_ "SystemMessageLongSymbol" BO_ 2566626048 "VDMA_FB9B_DC_AC_Accessory_Inverter_1_AC_Si";
BA_ "SystemMessageLongSymbol" BO_ 2566626304 "VDMA_FB9C_DC_AC_Accessory_Inverter_1_Confi";
BA_ "SystemMessageLongSymbol" BO_ 2566626560 "VDMA_FB9D_DC_AC_Accessory_Inverter_1_Lifet";
BA_ "SystemMessageLongSymbol" BO_ 2566626816 "VDMA_FB9E_DC_AC_Accessory_Inverter_2_Tempe";
BA_ "SystemMessageLongSymbol" BO_ 2566627072 "VDMA_FB9F_DC_AC_Accessory_Inverter_2_DC_Si";
BA_ "SystemMessageLongSymbol" BO_ 2566627328 "VDMA_FBA0_DC_AC_Accessory_Inverter_2_AC_Si";
BA_ "SystemMessageLongSymbol" BO_ 2566627584 "VDMA_FBA1_DC_AC_Accessory_Inverter_2_Confi";
BA_ "SystemMessageLongSymbol" BO_ 2566627840 "VDMA_FBA2_DC_AC_Accessory_Inverter_2_Lifet";
BA_ "SystemMessageLongSymbol" BO_ 2566628096 "VDMA_FBA3_DC_AC_Accessory_Inverter_3_Tempe";
BA_ "SystemMessageLongSymbol" BO_ 2566628352 "VDMA_FBA4_DC_AC_Accessory_Inverter_3_DC_Si";
BA_ "SystemMessageLongSymbol" BO_ 2566628608 "VDMA_FBA5_DC_AC_Accessory_Inverter_3_AC_Si";
BA_ "SystemMessageLongSymbol" BO_ 2566628864 "VDMA_FBA6_DC_AC_Accessory_Inverter_3_Confi";
BA_ "SystemMessageLongSymbol" BO_ 2566629120 "VDMA_FBA7_DC_AC_Accessory_Inverter_3_Lifet";
BA_ "SystemMessageLongSymbol" BO_ 2566629376 "VDMA_FBA8_DC_AC_Accessory_Inverter_4_Tempe";
BA_ "SystemMessageLongSymbol" BO_ 2566629632 "VDMA_FBA9_DC_AC_Accessory_Inverter_4_DC_Si";
BA_ "SystemMessageLongSymbol" BO_ 2566629888 "VDMA_FBAA_DC_AC_Accessory_Inverter_4_AC_Si";
BA_ "SystemMessageLongSymbol" BO_ 2566630144 "VDMA_FBAB_DC_AC_Accessory_Inverter_4_Confi";
BA_ "SystemMessageLongSymbol" BO_ 2566630400 "VDMA_FBAC_DC_AC_Accessory_Inverter_4_Lifet";
BA_ "SystemMessageLongSymbol" BO_ 2566630656 "VDMA_FBAD_DC_AC_Accessory_Inverter_5_Tempe";
BA_ "SystemMessageLongSymbol" BO_ 2566630912 "VDMA_FBAE_DC_AC_Accessory_Inverter_5_DC_Si";
BA_ "SystemMessageLongSymbol" BO_ 2566631168 "VDMA_FBAF_DC_AC_Accessory_Inverter_5_AC_Si";
BA_ "SystemMessageLongSymbol" BO_ 2566631424 "VDMA_FBB0_DC_AC_Accessory_Inverter_5_Confi";
BA_ "SystemMessageLongSymbol" BO_ 2566631680 "VDMA_FBB1_DC_AC_Accessory_Inverter_5_Lifet";
BA_ "SystemMessageLongSymbol" BO_ 2566631936 "VDMA_FBB2_Well_Stimulation_Pump_Sensor_Cal";
BA_ "SystemMessageLongSymbol" BO_ 2566632192 "VDMA_FBB3_Well_Stimulation_Pump_Fluid_Volu";
BA_ "SystemMessageLongSymbol" BO_ 2566632448 "VDMA_FBB4_Well_Stimulation_Pump_Serial_Num";
BA_ "SystemMessageLongSymbol" BO_ 2566632704 "VDMA_FBB5_Well_Stimulation_Pump_Trip_Hours";
BA_ "SystemMessageLongSymbol" BO_ 2566632960 "VDMA_FBB6_Aftertreatment_1_Outlet_Gas_4";
BA_ "SystemMessageLongSymbol" BO_ 2566633216 "VDMA_FBB7_Aftertreatment_1_Intake_Gas_4";
BA_ "SystemMessageLongSymbol" BO_ 2566633472 "VDMA_FBB8_DC_DC_Converter_4_Lifetime_Data";
BA_ "SystemMessageLongSymbol" BO_ 2566633728 "VDMA_FBB9_DC_DC_Converter_4_Configuration_";
BA_ "SystemMessageLongSymbol" BO_ 2566633984 "VDMA_FBBA_DC_DC_Converter_4_SLI_Battery_Li";
BA_ "SystemMessageLongSymbol" BO_ 2566634240 "VDMA_FBBB_DC_DC_Converter_4_Temperatures";
BA_ "SystemMessageLongSymbol" BO_ 2566634496 "VDMA_FBBC_DC_DC_Converter_4_Low_Side_Limit";
BA_ "SystemMessageLongSymbol" BO_ 2566634752 "VDMA_FBBD_DC_DC_Converter_4_High_Side_Limi";
BA_ "SystemMessageLongSymbol" BO_ 2566635008 "VDMA_FBBE_DC_DC_Converter_3_Lifetime_Data";
BA_ "SystemMessageLongSymbol" BO_ 2566635264 "VDMA_FBBF_DC_DC_Converter_3_Configuration_";
BA_ "SystemMessageLongSymbol" BO_ 2566635520 "VDMA_FBC0_DC_DC_Converter_3_SLI_Battery_Li";
BA_ "SystemMessageLongSymbol" BO_ 2566635776 "VDMA_FBC1_DC_DC_Converter_3_Temperatures";
BA_ "SystemMessageLongSymbol" BO_ 2566636032 "VDMA_FBC2_DC_DC_Converter_3_Low_Side_Limit";
BA_ "SystemMessageLongSymbol" BO_ 2566636288 "VDMA_FBC3_DC_DC_Converter_3_High_Side_Limi";
BA_ "SystemMessageLongSymbol" BO_ 2566636544 "VDMA_FBC4_DC_DC_Converter_2_Lifetime_Data";
BA_ "SystemMessageLongSymbol" BO_ 2566636800 "VDMA_FBC5_DC_DC_Converter_2_Configuration_";
BA_ "SystemMessageLongSymbol" BO_ 2566637056 "VDMA_FBC6_DC_DC_Converter_2_SLI_Battery_Li";
BA_ "SystemMessageLongSymbol" BO_ 2566637312 "VDMA_FBC7_DC_DC_Converter_2_Temperatures";
BA_ "SystemMessageLongSymbol" BO_ 2566637568 "VDMA_FBC8_DC_DC_Converter_2_Low_Side_Limit";
BA_ "SystemMessageLongSymbol" BO_ 2566637824 "VDMA_FBC9_DC_DC_Converter_2_High_Side_Limi";
BA_ "SystemMessageLongSymbol" BO_ 2566638080 "VDMA_FBCA_CiA_602_2_AUTOSAR_CAN_NM_Obsolet";
BA_ "SystemMessageLongSymbol" BO_ 2566638336 "VDMA_FBCB_Engine_Exhaust_Particulate_Contr";
BA_ "SystemMessageLongSymbol" BO_ 2566638592 "VDMA_FBCC_Well_Stimulation_Pump_Hours";
BA_ "SystemMessageLongSymbol" BO_ 2566638848 "VDMA_FBCD_Well_Stimulation_Pump_System_Con";
BA_ "SystemMessageLongSymbol" BO_ 2566639104 "VDMA_FBCE_Configurable_Receive_SPNs_Status";
BA_ "SystemMessageLongSymbol" BO_ 2566639360 "VDMA_FBCF_DC_DC_Converter_1_Lifetime_Data";
BA_ "SystemMessageLongSymbol" BO_ 2566639616 "VDMA_FBD0_DC_DC_Converter_1_Configuration_";
BA_ "SystemMessageLongSymbol" BO_ 2566639872 "VDMA_FBD1_DC_DC_Converter_1_SLI_Battery_Li";
BA_ "SystemMessageLongSymbol" BO_ 2566640384 "VDMA_FBD3_Well_Stimulation_Pump_System_Lif";
BA_ "SystemMessageLongSymbol" BO_ 2566640640 "VDMA_FBD4_Well_Stimulation_Pump_System_Con";
BA_ "SystemMessageLongSymbol" BO_ 2566640896 "VDMA_FBD5_Aftercooler_and_Oil_Cooler_Fluid";
BA_ "SystemMessageLongSymbol" BO_ 2566641152 "VDMA_FBD6_Electronic_Engine_Controller_21";
BA_ "SystemMessageLongSymbol" BO_ 2566641408 "VDMA_FBD7_Configurable_Transmit_PGNs_Statu";
BA_ "SystemMessageLongSymbol" BO_ 2566641664 "VDMA_FBD8_DC_DC_Converter_1_Temperatures";
BA_ "SystemMessageLongSymbol" BO_ 2566641920 "VDMA_FBD9_DC_DC_Converter_1_Low_Side_Limit";
BA_ "SystemMessageLongSymbol" BO_ 2566642176 "VDMA_FBDA_DC_DC_Converter_1_High_Side_Limi";
BA_ "SystemMessageLongSymbol" BO_ 2566643456 "VDMA_FBDF_Intake_Exhaust_Conditions_3";
BA_ "SystemMessageLongSymbol" BO_ 2566643712 "VDMA_FBE0_Aftercooler_and_Oil_Cooler_Fluid";
BA_ "SystemMessageLongSymbol" BO_ 2566644480 "VDMA_FBE3_Alternator_Temperature_2";
BA_ "SystemMessageLongSymbol" BO_ 2566644736 "VDMA_FBE4_Fuel_Information_7_Gaseous";
BA_ "SystemMessageLongSymbol" BO_ 2566644992 "VDMA_FBE5_High_Voltage_Energy_Storage_Syst";
BA_ "SystemMessageLongSymbol" BO_ 2566645248 "VDMA_FBE6_High_Voltage_Energy_Storage_Syst";
BA_ "SystemMessageLongSymbol" BO_ 2566645504 "VDMA_FBE7_SCR_Operator_Inducement_Informat";
BA_ "SystemMessageLongSymbol" BO_ 2566645760 "VDMA_FBE8_Aftertreatment_System_Informatio";
BA_ "SystemMessageLongSymbol" BO_ 2566646016 "VDMA_FBE9_Ethernet_1_Connection_Informatio";
BA_ "SystemMessageLongSymbol" BO_ 2566646272 "VDMA_FBEA_Ethernet_1_Connection_Informatio";
BA_ "SystemMessageLongSymbol" BO_ 2566646528 "VDMA_FBEB_Oil_Debris_Monitor_Counts_Ferrou";
BA_ "SystemMessageLongSymbol" BO_ 2566646784 "VDMA_FBEC_Oil_Debris_Monitor_Counts_Ferrou";
BA_ "SystemMessageLongSymbol" BO_ 2566647040 "VDMA_FBED_Oil_Debris_Monitor_Counts_Ferrou";
BA_ "SystemMessageLongSymbol" BO_ 2566647296 "VDMA_FBEE_Oil_Debris_Monitor_Counts_Non_Fe";
BA_ "SystemMessageLongSymbol" BO_ 2566647552 "VDMA_FBEF_Oil_Debris_Monitor_Counts_Non_Fe";
BA_ "SystemMessageLongSymbol" BO_ 2566647808 "VDMA_FBF0_Oil_Debris_Monitor_Counts_Non_Fe";
BA_ "SystemMessageLongSymbol" BO_ 2566648064 "VDMA_FBF1_Oil_Debris_Monitoring_System_Sta";
BA_ "SystemMessageLongSymbol" BO_ 2566648320 "VDMA_FBF2_Engine_Fuel_Lube_Systems_3";
BA_ "SystemMessageLongSymbol" BO_ 2566648576 "VDMA_FBF3_Cruise_Control_Vehicle_Speed_5";
BA_ "SystemMessageLongSymbol" BO_ 2566648832 "VDMA_FBF4_Aftertreatment_2_Diesel_Oxidatio";
BA_ "SystemMessageLongSymbol" BO_ 2566649088 "VDMA_FBF5_Aftertreatment_1_Diesel_Oxidatio";
BA_ "SystemMessageLongSymbol" BO_ 2566649600 "VDMA_FBF7_Electrified_Accessory_Propulsion";
BA_ "SystemMessageLongSymbol" BO_ 2566649856 "VDMA_FBF8_Electrified_Accessory_Propulsion";
BA_ "SystemMessageLongSymbol" BO_ 2566650112 "VDMA_FBF9_Electrified_Accessory_Propulsion";
BA_ "SystemMessageLongSymbol" BO_ 2566650368 "VDMA_FBFA_Electrified_Accessory_Power_Elec";
BA_ "SystemMessageLongSymbol" BO_ 2566650624 "VDMA_FBFB_Electrified_Accessory_Power_Elec";
BA_ "SystemMessageLongSymbol" BO_ 2566650880 "VDMA_FBFC_Electrified_Accessory_Power_Elec";
BA_ "SystemMessageLongSymbol" BO_ 2566651136 "VDMA_FBFD_Electrified_Accessory_Propulsion";
BA_ "SystemMessageLongSymbol" BO_ 2566651392 "VDMA_FBFE_Electrified_Accessory_Propulsion";
BA_ "SystemMessageLongSymbol" BO_ 2566651648 "VDMA_FBFF_Electrified_Accessory_Power_Elec";
BA_ "SystemMessageLongSymbol" BO_ 2566651904 "VDMA_FC00_Trailer_Wheel_Brake_Wear_Life_Re";
BA_ "SystemMessageLongSymbol" BO_ 2566652160 "VDMA_FC01_Electrified_Accessory_Motor_Stat";
BA_ "SystemMessageLongSymbol" BO_ 2566652672 "VDMA_FC03_Vehicle_Electrical_Power_14";
BA_ "SystemMessageLongSymbol" BO_ 2566652928 "VDMA_FC04_Vehicle_Electrical_Power_13";
BA_ "SystemMessageLongSymbol" BO_ 2566653184 "VDMA_FC05_Vehicle_Electrical_Power_12";
BA_ "SystemMessageLongSymbol" BO_ 2566653440 "VDMA_FC06_Vehicle_Electrical_Power_11";
BA_ "SystemMessageLongSymbol" BO_ 2566653696 "VDMA_FC07_Vehicle_Electrical_Power_10";
BA_ "SystemMessageLongSymbol" BO_ 2566653952 "VDMA_FC08_Vehicle_Electrical_Power_9";
BA_ "SystemMessageLongSymbol" BO_ 2566654208 "VDMA_FC09_Vehicle_Electrical_Power_8";
BA_ "SystemMessageLongSymbol" BO_ 2566654464 "VDMA_FC0A_Vehicle_Electrical_Power_7";
