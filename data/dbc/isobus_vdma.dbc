VERSION "created by canmatrix"

NS_ :

BS_:

BU_:

BO_ 2566654720 VDMA_FC0B_Electronic_Engine_Cont: 8 Vector__XXX
 SG_ Electronic_Engine_Controller_20_ : 0|64@1+ (1,0) [0|18446744073709551615] "" Vector__XXX

BO_ 2566654976 VDMA_FC0C_Evaporative_Systems: 8 Vector__XXX
 SG_ Evaporative_Systems_RawPayload : 0|64@1+ (1,0) [0|18446744073709551615] "" Vector__XXX

BO_ 2566655232 VDMA_FC0D_Fire_Pump_Statistics_1: 8 Vector__XXX
 SG_ Fire_Pump_Statistics_1_RawPayloa : 0|64@1+ (1,0) [0|18446744073709551615] "" Vector__XXX

BO_ 2566655488 VDMA_FC0E_Primary_or_Rear_Hitch_: 8 Vector__XXX
 SG_ Primary_or_Rear_Hitch_Roll_and_P : 0|64@1+ (1,0) [0|18446744073709551615] "" Vector__XXX

BO_ 2566655744 VDMA_FC0F_Secondary_or_Front_Hit: 8 Vector__XXX
 SG_ Secondary_or_Front_Hitch_Roll_an : 0|64@1+ (1,0) [0|18446744073709551615] "" Vector__XXX

BO_ 2566656000 VDMA_FC10_Ambient_Conditions_3: 8 Vector__XXX
 SG_ Ambient_Conditions_3_RawPayload : 0|64@1+ (1,0) [0|18446744073709551615] "" Vector__XXX

BO_ 2566656256 VDMA_FC11_Total_Gaseous_Fuel_Inf: 8 Vector__XXX
 SG_ Total_Gaseous_Fuel_Information_R : 0|64@1+ (1,0) [0|18446744073709551615] "" Vector__XXX

BO_ 2566656512 VDMA_FC12_Cab_Door_Control_1: 8 Vector__XXX
 SG_ Cab_Door_Control_1_RawPayload : 0|64@1+ (1,0) [0|18446744073709551615] "" Vector__XXX

BO_ 2566656768 VDMA_FC13_Door_Latch_Status: 8 Vector__XXX
 SG_ Door_Latch_Status_RawPayload : 0|64@1+ (1,0) [0|18446744073709551615] "" Vector__XXX

BO_ 2566657024 VDMA_FC14_Vehicle_Electrical_Pow: 8 Vector__XXX
 SG_ Vehicle_Electrical_Power_3_obsol : 0|64@1+ (1,0) [0|18446744073709551615] "" Vector__XXX

BO_ 2566657280 VDMA_FC15_Vehicle_Electrical_Pow: 8 Vector__XXX
 SG_ Vehicle_Electrical_Power_6_RawPa : 0|64@1+ (1,0) [0|18446744073709551615] "" Vector__XXX

BO_ 2566657536 VDMA_FC16_Payload_Temperature_2: 8 Vector__XXX
 SG_ Payload_Temperature_2_RawPayload : 0|64@1+ (1,0) [0|18446744073709551615] "" Vector__XXX

BO_ 2566657792 VDMA_FC17_Payload_Temperature_1: 8 Vector__XXX
 SG_ Payload_Temperature_1_RawPayload : 0|64@1+ (1,0) [0|18446744073709551615] "" Vector__XXX

BO_ 2566658048 VDMA_FC18_Payload_System_Totals_: 8 Vector__XXX
 SG_ Payload_System_Totals_2_RawPaylo : 0|64@1+ (1,0) [0|18446744073709551615] "" Vector__XXX

BO_ 2566658304 VDMA_FC19_Payload_System_Totals_: 8 Vector__XXX
 SG_ Payload_System_Totals_1_RawPaylo : 0|64@1+ (1,0) [0|18446744073709551615] "" Vector__XXX

BO_ 2566658560 VDMA_FC1A_HVESS_Thermal_Manageme: 8 Vector__XXX
 SG_ HVESS_Thermal_Management_System_ : 0|64@1+ (1,0) [0|18446744073709551615] "" Vector__XXX

BO_ 2566658816 VDMA_FC1B_HVESS_Thermal_Manageme: 8 Vector__XXX
 SG_ HVESS_Thermal_Management_System_ : 0|64@1+ (1,0) [0|18446744073709551615] "" Vector__XXX

BO_ 2566659072 VDMA_FC1C_Refrigeration_Compartm: 8 Vector__XXX
 SG_ Refrigeration_Compartment_Inform : 0|64@1+ (1,0) [0|18446744073709551615] "" Vector__XXX

BO_ 2566659328 VDMA_FC1D_Refrigeration_Compartm: 8 Vector__XXX
 SG_ Refrigeration_Compartment_Inform : 0|64@1+ (1,0) [0|18446744073709551615] "" Vector__XXX

BO_ 2566659584 VDMA_FC1E_Vehicle_Electrical_Pow: 8 Vector__XXX
 SG_ Vehicle_Electrical_Power_16_RawP : 0|64@1+ (1,0) [0|18446744073709551615] "" Vector__XXX

BO_ 2566659840 VDMA_FC1F_Vehicle_Electrical_Pow: 8 Vector__XXX
 SG_ Vehicle_Electrical_Power_17_RawP : 0|64@1+ (1,0) [0|18446744073709551615] "" Vector__XXX

BO_ 2566660096 VDMA_FC20_High_Voltage_Energy_St: 8 Vector__XXX
 SG_ High_Voltage_Energy_Storage_Syst : 0|64@1+ (1,0) [0|18446744073709551615] "" Vector__XXX

BO_ 2566660352 VDMA_FC21_High_Voltage_Energy_St: 8 Vector__XXX
 SG_ High_Voltage_Energy_Storage_Syst : 0|64@1+ (1,0) [0|18446744073709551615] "" Vector__XXX

BO_ 2566660608 VDMA_FC22_Electronic_Engine_Cont: 8 Vector__XXX
 SG_ Electronic_Engine_Controller_19_ : 0|64@1+ (1,0) [0|18446744073709551615] "" Vector__XXX

BO_ 2566660864 VDMA_FC23_Fuel_Consumption_Liqui: 8 Vector__XXX
 SG_ Fuel_Consumption_Liquid_2_RawPay : 0|64@1+ (1,0) [0|18446744073709551615] "" Vector__XXX

BO_ 2566661120 VDMA_FC24_Aftertreatment_2_Diese: 8 Vector__XXX
 SG_ Aftertreatment_2_Diesel_Exhaust_ : 0|64@1+ (1,0) [0|18446744073709551615] "" Vector__XXX

BO_ 2566661376 VDMA_FC25_Aftertreatment_1_Diese: 8 Vector__XXX
 SG_ Aftertreatment_1_Diesel_Exhaust_ : 0|64@1+ (1,0) [0|18446744073709551615] "" Vector__XXX

BO_ 2566661632 VDMA_FC26_Aftertreatment_2_Diese: 8 Vector__XXX
 SG_ Aftertreatment_2_Diesel_Exhaust_ : 0|64@1+ (1,0) [0|18446744073709551615] "" Vector__XXX

BO_ 2566661888 VDMA_FC27_Aftertreatment_1_Diese: 8 Vector__XXX
 SG_ Aftertreatment_1_Diesel_Exhaust_ : 0|64@1+ (1,0) [0|18446744073709551615] "" Vector__XXX

BO_ 2566662144 VDMA_FC28_Cruise_Control_Vehicle: 8 Vector__XXX
 SG_ Cruise_Control_Vehicle_Speed_6_R : 0|64@1+ (1,0) [0|18446744073709551615] "" Vector__XXX

BO_ 2566662400 VDMA_FC29_Forward_Lane_Image_3: 8 Vector__XXX
 SG_ Forward_Lane_Image_3_RawPayload : 0|64@1+ (1,0) [0|18446744073709551615] "" Vector__XXX

BO_ 2566662656 VDMA_FC2A_Operator_Inducement_In: 8 Vector__XXX
 SG_ Operator_Inducement_Information_ : 0|64@1+ (1,0) [0|18446744073709551615] "" Vector__XXX

BO_ 2566662912 VDMA_FC2B_Cruise_Control_Vehicle: 8 Vector__XXX
 SG_ Cruise_Control_Vehicle_Speed_4_R : 0|64@1+ (1,0) [0|18446744073709551615] "" Vector__XXX

BO_ 2566663168 VDMA_FC2C_Brake_Caliper_Lining_C: 8 Vector__XXX
 SG_ Brake_Caliper_Lining_Clearance_R : 0|64@1+ (1,0) [0|18446744073709551615] "" Vector__XXX

BO_ 2566663424 VDMA_FC2D_Alternate_Fuel_5: 8 Vector__XXX
 SG_ Alternate_Fuel_5_RawPayload : 0|64@1+ (1,0) [0|18446744073709551615] "" Vector__XXX

BO_ 2566663680 VDMA_FC2E_Engine_Turbocharger_Co: 8 Vector__XXX
 SG_ Engine_Turbocharger_Control_3_Ra : 0|64@1+ (1,0) [0|18446744073709551615] "" Vector__XXX

BO_ 2566663936 VDMA_FC2F_Fire_Suppression_Agent: 8 Vector__XXX
 SG_ Fire_Suppression_Agent_Status_Ra : 0|64@1+ (1,0) [0|18446744073709551615] "" Vector__XXX

BO_ 2566664192 VDMA_FC30_SCR_Operator_Inducemen: 8 Vector__XXX
 SG_ SCR_Operator_Inducement_Informat : 0|64@1+ (1,0) [0|18446744073709551615] "" Vector__XXX

BO_ 2566664448 VDMA_FC31_Aftertreatment_System_: 8 Vector__XXX
 SG_ Aftertreatment_System_Informatio : 0|64@1+ (1,0) [0|18446744073709551615] "" Vector__XXX

BO_ 2566664704 VDMA_FC32_Aftertreatment_1_Parti: 8 Vector__XXX
 SG_ Aftertreatment_1_Particulate_Sen : 0|64@1+ (1,0) [0|18446744073709551615] "" Vector__XXX

BO_ 2566664960 VDMA_FC33_Engine_Fuel_Injector_M: 8 Vector__XXX
 SG_ Engine_Fuel_Injector_Metering_Ra : 0|64@1+ (1,0) [0|18446744073709551615] "" Vector__XXX

BO_ 2566665216 VDMA_FC34_Engine_Fuel_Injector_M: 8 Vector__XXX
 SG_ Engine_Fuel_Injector_Metering_Ra : 0|64@1+ (1,0) [0|18446744073709551615] "" Vector__XXX

BO_ 2566665472 VDMA_FC35_Aftertreatment_2_Diese: 8 Vector__XXX
 SG_ Aftertreatment_2_Diesel_Exhaust_ : 0|64@1+ (1,0) [0|18446744073709551615] "" Vector__XXX

BO_ 2566665728 VDMA_FC36_Gaseous_Fuel_Supply_Va: 8 Vector__XXX
 SG_ Gaseous_Fuel_Supply_Valve_Inform : 0|64@1+ (1,0) [0|18446744073709551615] "" Vector__XXX

BO_ 2566665984 VDMA_FC37_Engine_Oil_Mist_Detect: 8 Vector__XXX
 SG_ Engine_Oil_Mist_Detection_Inform : 0|64@1+ (1,0) [0|18446744073709551615] "" Vector__XXX

BO_ 2566666240 VDMA_FC38_Engine_Oil_Mist_Detect: 8 Vector__XXX
 SG_ Engine_Oil_Mist_Detection_Inform : 0|64@1+ (1,0) [0|18446744073709551615] "" Vector__XXX

BO_ 2566666496 VDMA_FC39_Gaseous_Fuel_Supply_Pr: 8 Vector__XXX
 SG_ Gaseous_Fuel_Supply_Pressure_2_R : 0|64@1+ (1,0) [0|18446744073709551615] "" Vector__XXX

BO_ 2566666752 VDMA_FC3A_Gaseous_Fuel_Supply_Pr: 8 Vector__XXX
 SG_ Gaseous_Fuel_Supply_Pressure_1_R : 0|64@1+ (1,0) [0|18446744073709551615] "" Vector__XXX

BO_ 2566667008 VDMA_FC3B_Engine_End_Bearing_Tem: 8 Vector__XXX
 SG_ Engine_End_Bearing_Temperature_3 : 0|64@1+ (1,0) [0|18446744073709551615] "" Vector__XXX

BO_ 2566667264 VDMA_FC3C_Engine_End_Bearing_Tem: 8 Vector__XXX
 SG_ Engine_End_Bearing_Temperature_2 : 0|64@1+ (1,0) [0|18446744073709551615] "" Vector__XXX

BO_ 2566667520 VDMA_FC3D_Engine_End_Bearing_Tem: 8 Vector__XXX
 SG_ Engine_End_Bearing_Temperature_1 : 0|64@1+ (1,0) [0|18446744073709551615] "" Vector__XXX

BO_ 2566667776 VDMA_FC3E_Heat_Exchanger_Debris_: 8 Vector__XXX
 SG_ Heat_Exchanger_Debris_Purge_Info : 0|64@1+ (1,0) [0|18446744073709551615] "" Vector__XXX

BO_ 2566668032 VDMA_FC3F_Engine_Turbocharger_Co: 8 Vector__XXX
 SG_ Engine_Turbocharger_Control_2_Ra : 0|64@1+ (1,0) [0|18446744073709551615] "" Vector__XXX

BO_ 2566668288 VDMA_FC40_Engine_Hydraulic_Fuel_: 8 Vector__XXX
 SG_ Engine_Hydraulic_Fuel_2_Pump_Sta : 0|64@1+ (1,0) [0|18446744073709551615] "" Vector__XXX

BO_ 2566668544 VDMA_FC41_Alternate_Fuel_4: 8 Vector__XXX
 SG_ Alternate_Fuel_4_RawPayload : 0|64@1+ (1,0) [0|18446744073709551615] "" Vector__XXX

BO_ 2566668800 VDMA_FC42_Tire_Condition_Message: 8 Vector__XXX
 SG_ Tire_Condition_Message_2_RawPayl : 0|64@1+ (1,0) [0|18446744073709551615] "" Vector__XXX

BO_ 2566669056 VDMA_FC43_Tire_Configuration_Sta: 8 Vector__XXX
 SG_ Tire_Configuration_Status_Inform : 0|64@1+ (1,0) [0|18446744073709551615] "" Vector__XXX

BO_ 2566669312 VDMA_FC44_High_Voltage_Energy_St: 8 Vector__XXX
 SG_ High_Voltage_Energy_Storage_Syst : 0|64@1+ (1,0) [0|18446744073709551615] "" Vector__XXX

BO_ 2566669568 VDMA_FC45_Tire_Wireless_Signal_S: 8 Vector__XXX
 SG_ Tire_Wireless_Signal_Strength_In : 0|64@1+ (1,0) [0|18446744073709551615] "" Vector__XXX

BO_ 2566669824 VDMA_FC46_Tire_Sensor_Identifica: 8 Vector__XXX
 SG_ Tire_Sensor_Identification_Statu : 0|64@1+ (1,0) [0|18446744073709551615] "" Vector__XXX

BO_ 2566670080 VDMA_FC47_Monitored_Tire_Informa: 8 Vector__XXX
 SG_ Monitored_Tire_Information_RawPa : 0|64@1+ (1,0) [0|18446744073709551615] "" Vector__XXX

BO_ 2566670336 VDMA_FC48_Aftertreatment_2_Histo: 8 Vector__XXX
 SG_ Aftertreatment_2_Historical_Info : 0|64@1+ (1,0) [0|18446744073709551615] "" Vector__XXX

BO_ 2566670592 VDMA_FC49_Aftertreatment_1_Histo: 8 Vector__XXX
 SG_ Aftertreatment_1_Historical_Info : 0|64@1+ (1,0) [0|18446744073709551615] "" Vector__XXX

BO_ 2566670848 VDMA_FC4A_SCR_System_Cleaning: 8 Vector__XXX
 SG_ SCR_System_Cleaning_RawPayload : 0|64@1+ (1,0) [0|18446744073709551615] "" Vector__XXX

BO_ 2566671104 VDMA_FC4B_Electronic_Engine_Cont: 8 Vector__XXX
 SG_ Electronic_Engine_Controller_17_ : 0|64@1+ (1,0) [0|18446744073709551615] "" Vector__XXX

BO_ 2566671360 VDMA_FC4C_SCR_Operator_Inducemen: 8 Vector__XXX
 SG_ SCR_Operator_Inducement_Informat : 0|64@1+ (1,0) [0|18446744073709551615] "" Vector__XXX

BO_ 2566671616 VDMA_FC4D_Aftertreatment_2_SCR_D: 8 Vector__XXX
 SG_ Aftertreatment_2_SCR_Dosing_Syst : 0|64@1+ (1,0) [0|18446744073709551615] "" Vector__XXX

BO_ 2566671872 VDMA_FC4E_Aftertreatment_1_SCR_D: 8 Vector__XXX
 SG_ Aftertreatment_1_SCR_Dosing_Syst : 0|64@1+ (1,0) [0|18446744073709551615] "" Vector__XXX

BO_ 2566672128 VDMA_FC4F_Payload_Weight_Sensor_: 8 Vector__XXX
 SG_ Payload_Weight_Sensor_Informatio : 0|64@1+ (1,0) [0|18446744073709551615] "" Vector__XXX

BO_ 2566672384 VDMA_FC50_Payload_System_Status: 8 Vector__XXX
 SG_ Payload_System_Status_RawPayload : 0|64@1+ (1,0) [0|18446744073709551615] "" Vector__XXX

BO_ 2566672640 VDMA_FC51_Air_Suspension_Control: 8 Vector__XXX
 SG_ Air_Suspension_Control_7_RawPayl : 0|64@1+ (1,0) [0|18446744073709551615] "" Vector__XXX

BO_ 2566672896 VDMA_FC52_Bin_Weight_and_Lift_Co: 8 Vector__XXX
 SG_ Bin_Weight_and_Lift_Count_RawPay : 0|64@1+ (1,0) [0|18446744073709551615] "" Vector__XXX

BO_ 2566673152 VDMA_FC53_Engine_Gaseous_Leakage: 8 Vector__XXX
 SG_ Engine_Gaseous_Leakage_Informati : 0|64@1+ (1,0) [0|18446744073709551615] "" Vector__XXX

BO_ 2566673408 VDMA_FC54_Driving_and_Rest_Times: 8 Vector__XXX
 SG_ Driving_and_Rest_Times_Driver_2_ : 0|64@1+ (1,0) [0|18446744073709551615] "" Vector__XXX

BO_ 2566673664 VDMA_FC55_Driving_and_Rest_Times: 8 Vector__XXX
 SG_ Driving_and_Rest_Times_Driver_1_ : 0|64@1+ (1,0) [0|18446744073709551615] "" Vector__XXX

BO_ 2566673920 VDMA_FC56_SCR_Operator_Inducemen: 8 Vector__XXX
 SG_ SCR_Operator_Inducement_Informat : 0|64@1+ (1,0) [0|18446744073709551615] "" Vector__XXX

BO_ 2566674176 VDMA_FC57_SCR_Operator_Inducemen: 8 Vector__XXX
 SG_ SCR_Operator_Inducement_Informat : 0|64@1+ (1,0) [0|18446744073709551615] "" Vector__XXX

BO_ 2566674432 VDMA_FC58_Turbocharger_Informati: 8 Vector__XXX
 SG_ Turbocharger_Information_7_RawPa : 0|64@1+ (1,0) [0|18446744073709551615] "" Vector__XXX

BO_ 2566674688 VDMA_FC59_Engine_Load_Sharing_In: 8 Vector__XXX
 SG_ Engine_Load_Sharing_Information_ : 0|64@1+ (1,0) [0|18446744073709551615] "" Vector__XXX

BO_ 2566674944 VDMA_FC5A_Synchronized_Service_D: 8 Vector__XXX
 SG_ Synchronized_Service_Distance_In : 0|64@1+ (1,0) [0|18446744073709551615] "" Vector__XXX

BO_ 2566675200 VDMA_FC5B_Synchronized_Service_D: 8 Vector__XXX
 SG_ Synchronized_Service_Delay_Opera : 0|64@1+ (1,0) [0|18446744073709551615] "" Vector__XXX

BO_ 2566675456 VDMA_FC5C_Synchronized_Service_D: 8 Vector__XXX
 SG_ Synchronized_Service_Delay_Calen : 0|64@1+ (1,0) [0|18446744073709551615] "" Vector__XXX

BO_ 2566675712 VDMA_FC5D_High_Voltage_Energy_St: 8 Vector__XXX
 SG_ High_Voltage_Energy_Storage_Syst : 0|64@1+ (1,0) [0|18446744073709551615] "" Vector__XXX

BO_ 2566675968 VDMA_FC5E_High_Voltage_Energy_St: 8 Vector__XXX
 SG_ High_Voltage_Energy_Storage_Syst : 0|64@1+ (1,0) [0|18446744073709551615] "" Vector__XXX

BO_ 2566676224 VDMA_FC5F_Encoder_Position: 8 Vector__XXX
 SG_ Encoder_Position_RawPayload : 0|64@1+ (1,0) [0|18446744073709551615] "" Vector__XXX

BO_ 2566676480 VDMA_FC60_Encoder_High_Resolutio: 8 Vector__XXX
 SG_ Encoder_High_Resolution_Position : 0|64@1+ (1,0) [0|18446744073709551615] "" Vector__XXX

BO_ 2566676736 VDMA_FC61_Encoder_Speed: 8 Vector__XXX
 SG_ Encoder_Speed_RawPayload : 0|64@1+ (1,0) [0|18446744073709551615] "" Vector__XXX

BO_ 2566676992 VDMA_FC62_Encoder_Acceleration: 8 Vector__XXX
 SG_ Encoder_Acceleration_RawPayload : 0|64@1+ (1,0) [0|18446744073709551615] "" Vector__XXX

BO_ 2566677248 VDMA_FC63_Encoder_Position_with_: 8 Vector__XXX
 SG_ Encoder_Position_with_Speed_and_ : 0|64@1+ (1,0) [0|18446744073709551615] "" Vector__XXX

BO_ 2566677504 VDMA_FC64_Inclinometer_Slope_Lon: 8 Vector__XXX
 SG_ Inclinometer_Slope_Longitudinal_ : 0|64@1+ (1,0) [0|18446744073709551615] "" Vector__XXX

BO_ 2566677760 VDMA_FC65_Inclinometer_Slope_Lon: 8 Vector__XXX
 SG_ Inclinometer_Slope_Longitudinal_ : 0|64@1+ (1,0) [0|18446744073709551615] "" Vector__XXX

BO_ 2566678016 VDMA_FC66_Inclinometer_Slope_Lat: 8 Vector__XXX
 SG_ Inclinometer_Slope_Lateral_16_bi : 0|64@1+ (1,0) [0|18446744073709551615] "" Vector__XXX

BO_ 2566678272 VDMA_FC67_Inclinometer_Slope_Lat: 8 Vector__XXX
 SG_ Inclinometer_Slope_Lateral_32_bi : 0|64@1+ (1,0) [0|18446744073709551615] "" Vector__XXX

BO_ 2566678528 VDMA_FC68_CANopen_Emergency_Mess: 8 Vector__XXX
 SG_ CANopen_Emergency_Message_RawPay : 0|64@1+ (1,0) [0|18446744073709551615] "" Vector__XXX

BO_ 2566678784 VDMA_FC69_EV_Operator_Indicators: 8 Vector__XXX
 SG_ EV_Operator_Indicators_1_RawPayl : 0|64@1+ (1,0) [0|18446744073709551615] "" Vector__XXX

BO_ 2566679040 VDMA_FC6A_System_Identification: 8 Vector__XXX
 SG_ System_Identification_RawPayload : 0|64@1+ (1,0) [0|18446744073709551615] "" Vector__XXX

BO_ 2566679296 VDMA_FC6B_Engine_Maximum_Net_Tor: 8 Vector__XXX
 SG_ Engine_Maximum_Net_Torque_Map_ob : 0|64@1+ (1,0) [0|18446744073709551615] "" Vector__XXX

BO_ 2566679552 VDMA_FC6C_Alarm: 8 Vector__XXX
 SG_ Alarm_RawPayload : 0|64@1+ (1,0) [0|18446744073709551615] "" Vector__XXX

BO_ 2566679808 VDMA_FC6D_Acoustic_Warning_Reque: 8 Vector__XXX
 SG_ Acoustic_Warning_Request_RawPayl : 0|64@1+ (1,0) [0|18446744073709551615] "" Vector__XXX

BO_ 2566680064 VDMA_FC6E_Acoustic_Warning_State: 8 Vector__XXX
 SG_ Acoustic_Warning_State_RawPayloa : 0|64@1+ (1,0) [0|18446744073709551615] "" Vector__XXX

BO_ 2566680320 VDMA_FC6F_Vehicle_Load: 8 Vector__XXX
 SG_ Vehicle_Load_RawPayload : 0|64@1+ (1,0) [0|18446744073709551615] "" Vector__XXX

BO_ 2566680576 VDMA_FC70_Body_Application_Unit_: 8 Vector__XXX
 SG_ Body_Application_Unit_1_RawPaylo : 0|64@1+ (1,0) [0|18446744073709551615] "" Vector__XXX

BO_ 2566680832 VDMA_FC71_Body_Application_Unit_: 8 Vector__XXX
 SG_ Body_Application_Unit_2_RawPaylo : 0|64@1+ (1,0) [0|18446744073709551615] "" Vector__XXX

BO_ 2566681088 VDMA_FC72_Body_Application_Unit_: 8 Vector__XXX
 SG_ Body_Application_Unit_3_RawPaylo : 0|64@1+ (1,0) [0|18446744073709551615] "" Vector__XXX

BO_ 2566681344 VDMA_FC73_Body_Application_Unit_: 8 Vector__XXX
 SG_ Body_Application_Unit_4_RawPaylo : 0|64@1+ (1,0) [0|18446744073709551615] "" Vector__XXX

BO_ 2566681600 VDMA_FC74_Body_Application_Unit_: 8 Vector__XXX
 SG_ Body_Application_Unit_5_RawPaylo : 0|64@1+ (1,0) [0|18446744073709551615] "" Vector__XXX

BO_ 2566681856 VDMA_FC75_Body_Application_Unit_: 8 Vector__XXX
 SG_ Body_Application_Unit_6_RawPaylo : 0|64@1+ (1,0) [0|18446744073709551615] "" Vector__XXX

BO_ 2566682112 VDMA_FC76_Body_Application_Unit_: 8 Vector__XXX
 SG_ Body_Application_Unit_7_RawPaylo : 0|64@1+ (1,0) [0|18446744073709551615] "" Vector__XXX

BO_ 2566682368 VDMA_FC77_Body_Application_Unit_: 8 Vector__XXX
 SG_ Body_Application_Unit_8_RawPaylo : 0|64@1+ (1,0) [0|18446744073709551615] "" Vector__XXX

BO_ 2566682624 VDMA_FC78_Electronic_Control_Uni: 8 Vector__XXX
 SG_ Electronic_Control_Unit_RawPaylo : 0|64@1+ (1,0) [0|18446744073709551615] "" Vector__XXX

BO_ 2566682880 VDMA_FC79_ECU_Power_Supply: 8 Vector__XXX
 SG_ ECU_Power_Supply_RawPayload : 0|64@1+ (1,0) [0|18446744073709551615] "" Vector__XXX

BO_ 2566683136 VDMA_FC7A_ECU_Temperature: 8 Vector__XXX
 SG_ ECU_Temperature_RawPayload : 0|64@1+ (1,0) [0|18446744073709551615] "" Vector__XXX

BO_ 2566683392 VDMA_FC7B_Error: 8 Vector__XXX
 SG_ Error_RawPayload : 0|64@1+ (1,0) [0|18446744073709551615] "" Vector__XXX

BO_ 2566683648 VDMA_FC7C_Heating_And_Refrigerat: 8 Vector__XXX
 SG_ Heating_And_Refrigerating_Unit_1 : 0|64@1+ (1,0) [0|18446744073709551615] "" Vector__XXX

BO_ 2566683904 VDMA_FC7D_Heating_And_Refrigerat: 8 Vector__XXX
 SG_ Heating_And_Refrigerating_Unit_2 : 0|64@1+ (1,0) [0|18446744073709551615] "" Vector__XXX

BO_ 2566684160 VDMA_FC7E_Heating_And_Refrigerat: 8 Vector__XXX
 SG_ Heating_And_Refrigerating_Unit_3 : 0|64@1+ (1,0) [0|18446744073709551615] "" Vector__XXX

BO_ 2566684416 VDMA_FC7F_Heating_And_Refrigerat: 8 Vector__XXX
 SG_ Heating_And_Refrigerating_Unit_4 : 0|64@1+ (1,0) [0|18446744073709551615] "" Vector__XXX

BO_ 2566684672 VDMA_FC80_HRU_Temperature_Setpoi: 8 Vector__XXX
 SG_ HRU_Temperature_Setpoint_RawPayl : 0|64@1+ (1,0) [0|18446744073709551615] "" Vector__XXX

BO_ 2566684928 VDMA_FC81_Lifting_Unit_1: 8 Vector__XXX
 SG_ Lifting_Unit_1_RawPayload : 0|64@1+ (1,0) [0|18446744073709551615] "" Vector__XXX

BO_ 2566685184 VDMA_FC82_Tail_Lift_Unit_1: 8 Vector__XXX
 SG_ Tail_Lift_Unit_1_RawPayload : 0|64@1+ (1,0) [0|18446744073709551615] "" Vector__XXX

BO_ 2566685440 VDMA_FC83_Vehicle_Status: 8 Vector__XXX
 SG_ Vehicle_Status_RawPayload : 0|64@1+ (1,0) [0|18446744073709551615] "" Vector__XXX

BO_ 2566685696 VDMA_FC84_Windshield_Wiper_Reque: 8 Vector__XXX
 SG_ Windshield_Wiper_Request_RawPayl : 0|64@1+ (1,0) [0|18446744073709551615] "" Vector__XXX

BO_ 2566685952 VDMA_FC85_Fuel_Cell_Auxiliary_He: 8 Vector__XXX
 SG_ Fuel_Cell_Auxiliary_Heater_Contr : 0|64@1+ (1,0) [0|18446744073709551615] "" Vector__XXX

BO_ 2566686208 VDMA_FC86_Fuel_Cell_Auxiliary_He: 8 Vector__XXX
 SG_ Fuel_Cell_Auxiliary_Heater_Infor : 0|64@1+ (1,0) [0|18446744073709551615] "" Vector__XXX

BO_ 2566686464 VDMA_FC87_Fuel_Cell_Coolant_Pump: 8 Vector__XXX
 SG_ Fuel_Cell_Coolant_Pump_1_Command : 0|64@1+ (1,0) [0|18446744073709551615] "" Vector__XXX

BO_ 2566686720 VDMA_FC88_Fuel_Cell_Coolant_Pump: 8 Vector__XXX
 SG_ Fuel_Cell_Coolant_Pump_2_Command : 0|64@1+ (1,0) [0|18446744073709551615] "" Vector__XXX

BO_ 2566686976 VDMA_FC89_Fuel_Cell_Coolant_Pump: 8 Vector__XXX
 SG_ Fuel_Cell_Coolant_Pump_1_Status_ : 0|64@1+ (1,0) [0|18446744073709551615] "" Vector__XXX

BO_ 2566687232 VDMA_FC8A_Fuel_Cell_Coolant_Pump: 8 Vector__XXX
 SG_ Fuel_Cell_Coolant_Pump_2_Status_ : 0|64@1+ (1,0) [0|18446744073709551615] "" Vector__XXX

BO_ 2566687488 VDMA_FC8B_Aftertreatment_1_Parti: 8 Vector__XXX
 SG_ Aftertreatment_1_Particulate_Sen : 0|64@1+ (1,0) [0|18446744073709551615] "" Vector__XXX

BO_ 2566687744 VDMA_FC8C_Aftertreatment_1_Parti: 8 Vector__XXX
 SG_ Aftertreatment_1_Particulate_Sen : 0|64@1+ (1,0) [0|18446744073709551615] "" Vector__XXX

BO_ 2566688512 VDMA_FC8F_Alternate_Fuel_3: 8 Vector__XXX
 SG_ Alternate_Fuel_3_RawPayload : 0|64@1+ (1,0) [0|18446744073709551615] "" Vector__XXX

BO_ 2566688768 VDMA_FC90_Engine_Fuel_Injector_M: 8 Vector__XXX
 SG_ Engine_Fuel_Injector_Metering_Ra : 0|64@1+ (1,0) [0|18446744073709551615] "" Vector__XXX

BO_ 2566689024 VDMA_FC91_Engine_Exhaust_NOx: 8 Vector__XXX
 SG_ Engine_Exhaust_NOx_RawPayload : 0|64@1+ (1,0) [0|18446744073709551615] "" Vector__XXX

BO_ 2566689280 VDMA_FC92_Air_Fuel_Ratio_1: 8 Vector__XXX
 SG_ Air_Fuel_Ratio_1_RawPayload : 0|64@1+ (1,0) [0|18446744073709551615] "" Vector__XXX

BO_ 2566689536 VDMA_FC93_Gaseous_Fuel_Pressure_: 8 Vector__XXX
 SG_ Gaseous_Fuel_Pressure_2_RawPaylo : 0|64@1+ (1,0) [0|18446744073709551615] "" Vector__XXX

BO_ 2566689792 VDMA_FC94_Aftertreatment_System_: 8 Vector__XXX
 SG_ Aftertreatment_System_Abuse_Info : 0|64@1+ (1,0) [0|18446744073709551615] "" Vector__XXX

BO_ 2566690048 VDMA_FC95_Engine_Cylinder_Pressu: 8 Vector__XXX
 SG_ Engine_Cylinder_Pressure_Monitor : 0|64@1+ (1,0) [0|18446744073709551615] "" Vector__XXX

BO_ 2566690304 VDMA_FC96_Engine_Information_2: 8 Vector__XXX
 SG_ Engine_Information_2_RawPayload : 0|64@1+ (1,0) [0|18446744073709551615] "" Vector__XXX

BO_ 2566690560 VDMA_FC97_Electronic_Steering_Co: 8 Vector__XXX
 SG_ Electronic_Steering_Control_2_Ra : 0|64@1+ (1,0) [0|18446744073709551615] "" Vector__XXX

BO_ 2566690816 VDMA_FC98_Vehicle_Speed_Limiter: 8 Vector__XXX
 SG_ Vehicle_Speed_Limiter_RawPayload : 0|64@1+ (1,0) [0|18446744073709551615] "" Vector__XXX

BO_ 2566691072 VDMA_FC99_Assembly_Unit_Identifi: 8 Vector__XXX
 SG_ Assembly_Unit_Identification_Raw : 0|64@1+ (1,0) [0|18446744073709551615] "" Vector__XXX

BO_ 2566691328 VDMA_FC9A_Joystick_3_Lamp_Status: 8 Vector__XXX
 SG_ Joystick_3_Lamp_Status_RawPayloa : 0|64@1+ (1,0) [0|18446744073709551615] "" Vector__XXX

BO_ 2566691584 VDMA_FC9B_Joystick_2_Lamp_Status: 8 Vector__XXX
 SG_ Joystick_2_Lamp_Status_RawPayloa : 0|64@1+ (1,0) [0|18446744073709551615] "" Vector__XXX

BO_ 2566691840 VDMA_FC9C_Joystick_1_Lamp_Status: 8 Vector__XXX
 SG_ Joystick_1_Lamp_Status_RawPayloa : 0|64@1+ (1,0) [0|18446744073709551615] "" Vector__XXX

BO_ 2566692096 VDMA_FC9D_Engine_Timing_Actuator: 8 Vector__XXX
 SG_ Engine_Timing_Actuator_Position_ : 0|64@1+ (1,0) [0|18446744073709551615] "" Vector__XXX

BO_ 2566692352 VDMA_FC9E_Engine_Timing_Actuator: 8 Vector__XXX
 SG_ Engine_Timing_Actuator_Position_ : 0|64@1+ (1,0) [0|18446744073709551615] "" Vector__XXX

BO_ 2566692608 VDMA_FC9F_Dash_Display_2: 8 Vector__XXX
 SG_ Dash_Display_2_RawPayload : 0|64@1+ (1,0) [0|18446744073709551615] "" Vector__XXX

BO_ 2566692864 VDMA_FCA0_Multi_fuel_Engine_Hour: 8 Vector__XXX
 SG_ Multi_fuel_Engine_Hours_RawPaylo : 0|64@1+ (1,0) [0|18446744073709551615] "" Vector__XXX

BO_ 2566693120 VDMA_FCA1_Engine_Spark_Misfire_R: 8 Vector__XXX
 SG_ Engine_Spark_Misfire_Rate_3_RawP : 0|64@1+ (1,0) [0|18446744073709551615] "" Vector__XXX

BO_ 2566693376 VDMA_FCA2_Engine_Spark_Misfire_R: 8 Vector__XXX
 SG_ Engine_Spark_Misfire_Rate_2_RawP : 0|64@1+ (1,0) [0|18446744073709551615] "" Vector__XXX

BO_ 2566693632 VDMA_FCA3_Engine_Spark_Misfire_R: 8 Vector__XXX
 SG_ Engine_Spark_Misfire_Rate_1_RawP : 0|64@1+ (1,0) [0|18446744073709551615] "" Vector__XXX

BO_ 2566693888 VDMA_FCA4_Engine_Spark_Maximum_V: 8 Vector__XXX
 SG_ Engine_Spark_Maximum_Voltage_6_R : 0|64@1+ (1,0) [0|18446744073709551615] "" Vector__XXX

BO_ 2566694144 VDMA_FCA5_Engine_Spark_Maximum_V: 8 Vector__XXX
 SG_ Engine_Spark_Maximum_Voltage_5_R : 0|64@1+ (1,0) [0|18446744073709551615] "" Vector__XXX

BO_ 2566694400 VDMA_FCA6_Engine_Spark_Maximum_V: 8 Vector__XXX
 SG_ Engine_Spark_Maximum_Voltage_4_R : 0|64@1+ (1,0) [0|18446744073709551615] "" Vector__XXX

BO_ 2566694656 VDMA_FCA7_Engine_Spark_Maximum_V: 8 Vector__XXX
 SG_ Engine_Spark_Maximum_Voltage_3_R : 0|64@1+ (1,0) [0|18446744073709551615] "" Vector__XXX

BO_ 2566694912 VDMA_FCA8_Engine_Spark_Maximum_V: 8 Vector__XXX
 SG_ Engine_Spark_Maximum_Voltage_2_R : 0|64@1+ (1,0) [0|18446744073709551615] "" Vector__XXX

BO_ 2566695168 VDMA_FCA9_Engine_Spark_Maximum_V: 8 Vector__XXX
 SG_ Engine_Spark_Maximum_Voltage_1_R : 0|64@1+ (1,0) [0|18446744073709551615] "" Vector__XXX

BO_ 2566695424 VDMA_FCAA_Engine_Spark_Minimum_V: 8 Vector__XXX
 SG_ Engine_Spark_Minimum_Voltage_6_R : 0|64@1+ (1,0) [0|18446744073709551615] "" Vector__XXX

BO_ 2566695680 VDMA_FCAB_Engine_Spark_Minimum_V: 8 Vector__XXX
 SG_ Engine_Spark_Minimum_Voltage_5_R : 0|64@1+ (1,0) [0|18446744073709551615] "" Vector__XXX

BO_ 2566695936 VDMA_FCAC_Engine_Spark_Minimum_V: 8 Vector__XXX
 SG_ Engine_Spark_Minimum_Voltage_4_R : 0|64@1+ (1,0) [0|18446744073709551615] "" Vector__XXX

BO_ 2566696192 VDMA_FCAD_Engine_Spark_Minimum_V: 8 Vector__XXX
 SG_ Engine_Spark_Minimum_Voltage_3_R : 0|64@1+ (1,0) [0|18446744073709551615] "" Vector__XXX

BO_ 2566696448 VDMA_FCAE_Engine_Spark_Minimum_V: 8 Vector__XXX
 SG_ Engine_Spark_Minimum_Voltage_2_R : 0|64@1+ (1,0) [0|18446744073709551615] "" Vector__XXX

BO_ 2566696704 VDMA_FCAF_Engine_Spark_Minimum_V: 8 Vector__XXX
 SG_ Engine_Spark_Minimum_Voltage_1_R : 0|64@1+ (1,0) [0|18446744073709551615] "" Vector__XXX

BO_ 2566696960 VDMA_FCB0_Engine_Ignition_Contro: 8 Vector__XXX
 SG_ Engine_Ignition_Controller_Maint : 0|64@1+ (1,0) [0|18446744073709551615] "" Vector__XXX

BO_ 2566697216 VDMA_FCB1_Engine_Ignition_Contro: 8 Vector__XXX
 SG_ Engine_Ignition_Control_Module_S : 0|64@1+ (1,0) [0|18446744073709551615] "" Vector__XXX

BO_ 2566697728 VDMA_FCB3_Fused_Power_Output_Cur: 8 Vector__XXX
 SG_ Fused_Power_Output_Current_RawPa : 0|64@1+ (1,0) [0|18446744073709551615] "" Vector__XXX

BO_ 2566697984 VDMA_FCB4_Switched_Power_Output_: 8 Vector__XXX
 SG_ Switched_Power_Output_Status_Raw : 0|64@1+ (1,0) [0|18446744073709551615] "" Vector__XXX

BO_ 2566698240 VDMA_FCB5_Fused_Power_Output_Sta: 8 Vector__XXX
 SG_ Fused_Power_Output_Status_RawPay : 0|64@1+ (1,0) [0|18446744073709551615] "" Vector__XXX

BO_ 2566698496 VDMA_FCB6_Vehicle_Electrical_Pow: 8 Vector__XXX
 SG_ Vehicle_Electrical_Power_5_RawPa : 0|64@1+ (1,0) [0|18446744073709551615] "" Vector__XXX

BO_ 2566698752 VDMA_FCB7_Hybrid_or_EV_System_St: 8 Vector__XXX
 SG_ Hybrid_or_EV_System_Status_2_Raw : 0|64@1+ (1,0) [0|18446744073709551615] "" Vector__XXX

BO_ 2566699008 VDMA_FCB8_Aftertreatment_2_Servi: 8 Vector__XXX
 SG_ Aftertreatment_2_Service_2_RawPa : 0|64@1+ (1,0) [0|18446744073709551615] "" Vector__XXX

BO_ 2566699264 VDMA_FCB9_Aftertreatment_1_Servi: 8 Vector__XXX
 SG_ Aftertreatment_1_Service_2_RawPa : 0|64@1+ (1,0) [0|18446744073709551615] "" Vector__XXX

BO_ 2566699520 VDMA_FCBA_Aftertreatment_2_SCR_E: 8 Vector__XXX
 SG_ Aftertreatment_2_SCR_Electronic_ : 0|64@1+ (1,0) [0|18446744073709551615] "" Vector__XXX

BO_ 2566699776 VDMA_FCBB_Aftertreatment_1_SCR_E: 8 Vector__XXX
 SG_ Aftertreatment_1_SCR_Electronic_ : 0|64@1+ (1,0) [0|18446744073709551615] "" Vector__XXX

BO_ 2566700032 VDMA_FCBC_Aftertreatment_2_SCR_S: 8 Vector__XXX
 SG_ Aftertreatment_2_SCR_Service_Inf : 0|64@1+ (1,0) [0|18446744073709551615] "" Vector__XXX

BO_ 2566700288 VDMA_FCBD_Aftertreatment_1_SCR_S: 8 Vector__XXX
 SG_ Aftertreatment_1_SCR_Service_Inf : 0|64@1+ (1,0) [0|18446744073709551615] "" Vector__XXX

BO_ 2566700544 VDMA_FCBE_Electronic_Transmissio: 8 Vector__XXX
 SG_ Electronic_Transmission_Controll : 0|64@1+ (1,0) [0|18446744073709551615] "" Vector__XXX

BO_ 2566700800 VDMA_FCBF_Electronic_Transmissio: 8 Vector__XXX
 SG_ Electronic_Transmission_Controll : 0|64@1+ (1,0) [0|18446744073709551615] "" Vector__XXX

BO_ 2566701056 VDMA_FCC0_Electronic_Transmissio: 8 Vector__XXX
 SG_ Electronic_Transmission_Controll : 0|64@1+ (1,0) [0|18446744073709551615] "" Vector__XXX

BO_ 2566701312 VDMA_FCC1_Transmission_Fluids_3: 8 Vector__XXX
 SG_ Transmission_Fluids_3_RawPayload : 0|64@1+ (1,0) [0|18446744073709551615] "" Vector__XXX

BO_ 2566701568 VDMA_FCC2_Hybrid_or_EV_System_St: 8 Vector__XXX
 SG_ Hybrid_or_EV_System_Status_1_Raw : 0|64@1+ (1,0) [0|18446744073709551615] "" Vector__XXX

BO_ 2566701824 VDMA_FCC3_Fuel_Information_4_Gas: 8 Vector__XXX
 SG_ Fuel_Information_4_Gaseous_RawPa : 0|64@1+ (1,0) [0|18446744073709551615] "" Vector__XXX

BO_ 2566702080 VDMA_FCC4_Aftertreatment_2_SCR_E: 8 Vector__XXX
 SG_ Aftertreatment_2_SCR_Exhaust_Gas : 0|64@1+ (1,0) [0|18446744073709551615] "" Vector__XXX

BO_ 2566702336 VDMA_FCC5_Aftertreatment_1_SCR_E: 8 Vector__XXX
 SG_ Aftertreatment_1_SCR_Exhaust_Gas : 0|64@1+ (1,0) [0|18446744073709551615] "" Vector__XXX

BO_ 2566702592 VDMA_FCC6_OBD_Information: 8 Vector__XXX
 SG_ OBD_Information_RawPayload : 0|64@1+ (1,0) [0|18446744073709551615] "" Vector__XXX

BO_ 2566702848 VDMA_FCC7_Model_Year_and_Certifi: 8 Vector__XXX
 SG_ Model_Year_and_Certification_Eng : 0|64@1+ (1,0) [0|18446744073709551615] "" Vector__XXX

BO_ 2566703104 VDMA_FCC8_Electronic_Engine_Cont: 8 Vector__XXX
 SG_ Electronic_Engine_Controller_13_ : 0|64@1+ (1,0) [0|18446744073709551615] "" Vector__XXX

BO_ 2566703360 VDMA_FCC9_Engine_Fuel_Throttle_V: 8 Vector__XXX
 SG_ Engine_Fuel_Throttle_Valve_Infor : 0|64@1+ (1,0) [0|18446744073709551615] "" Vector__XXX

BO_ 2566703616 VDMA_FCCA_Engine_Exhaust_Gas_Rec: 8 Vector__XXX
 SG_ Engine_Exhaust_Gas_Recirculation : 0|64@1+ (1,0) [0|18446744073709551615] "" Vector__XXX

BO_ 2566703872 VDMA_FCCB_Engine_Exhaust_Gas_Rec: 8 Vector__XXX
 SG_ Engine_Exhaust_Gas_Recirculation : 0|64@1+ (1,0) [0|18446744073709551615] "" Vector__XXX

BO_ 2566704128 VDMA_FCCC_Electronic_Engine_Cont: 8 Vector__XXX
 SG_ Electronic_Engine_Controller_12_ : 0|64@1+ (1,0) [0|18446744073709551615] "" Vector__XXX

BO_ 2566704384 VDMA_FCCD_Drive_Strategy_Status: 8 Vector__XXX
 SG_ Drive_Strategy_Status_RawPayload : 0|64@1+ (1,0) [0|18446744073709551615] "" Vector__XXX

BO_ 2566704640 VDMA_FCCE_Drive_Strategy_command: 8 Vector__XXX
 SG_ Drive_Strategy_command_RawPayloa : 0|64@1+ (1,0) [0|18446744073709551615] "" Vector__XXX

BO_ 2566704896 VDMA_FCCF_NOx_Sensor_Self_Diagno: 8 Vector__XXX
 SG_ NOx_Sensor_Self_Diagnosis_Reques : 0|64@1+ (1,0) [0|18446744073709551615] "" Vector__XXX

BO_ 2566705152 VDMA_FCD0_Engine_Particulate_Sen: 8 Vector__XXX
 SG_ Engine_Particulate_Sensor_Inform : 0|64@1+ (1,0) [0|18446744073709551615] "" Vector__XXX

BO_ 2566705408 VDMA_FCD1_Active_Service_Only_DT: 8 Vector__XXX
 SG_ Active_Service_Only_DTCs_RawPayl : 0|64@1+ (1,0) [0|18446744073709551615] "" Vector__XXX

BO_ 2566705664 VDMA_FCD2_Previously_Active_Serv: 8 Vector__XXX
 SG_ Previously_Active_Service_Only_D : 0|64@1+ (1,0) [0|18446744073709551615] "" Vector__XXX

BO_ 2566705920 VDMA_FCD3_Diagnostic_Data_Clear_: 8 Vector__XXX
 SG_ Diagnostic_Data_Clear_Reset_for_ : 0|64@1+ (1,0) [0|18446744073709551615] "" Vector__XXX

BO_ 2566706176 VDMA_FCD4_XCP_Get_Slave_ID: 8 Vector__XXX
 SG_ XCP_Get_Slave_ID_RawPayload : 0|64@1+ (1,0) [0|18446744073709551615] "" Vector__XXX

BO_ 2566706432 VDMA_FCD5_Aftertreatment_1_Diese: 8 Vector__XXX
 SG_ Aftertreatment_1_Diesel_Exhaust_ : 0|64@1+ (1,0) [0|18446744073709551615] "" Vector__XXX

BO_ 2566706688 VDMA_FCD6_Aftertreatment_1_Diese: 8 Vector__XXX
 SG_ Aftertreatment_1_Diesel_Particul : 0|64@1+ (1,0) [0|18446744073709551615] "" Vector__XXX

BO_ 2566706944 VDMA_FCD7_Aftertreatment_1_Diese: 8 Vector__XXX
 SG_ Aftertreatment_1_Diesel_Particul : 0|64@1+ (1,0) [0|18446744073709551615] "" Vector__XXX

BO_ 2566707200 VDMA_FCD8_Aftertreatment_1_Diese: 8 Vector__XXX
 SG_ Aftertreatment_1_Diesel_Particul : 0|64@1+ (1,0) [0|18446744073709551615] "" Vector__XXX

BO_ 2566707456 VDMA_FCD9_Aftertreatment_1_Diese: 8 Vector__XXX
 SG_ Aftertreatment_1_Diesel_Particul : 0|64@1+ (1,0) [0|18446744073709551615] "" Vector__XXX

BO_ 2566707712 VDMA_FCDA_Aftertreatment_1_Diese: 8 Vector__XXX
 SG_ Aftertreatment_1_Diesel_Particul : 0|64@1+ (1,0) [0|18446744073709551615] "" Vector__XXX

BO_ 2566707968 VDMA_FCDB_Aftertreatment_1_Diese: 8 Vector__XXX
 SG_ Aftertreatment_1_Diesel_Particul : 0|64@1+ (1,0) [0|18446744073709551615] "" Vector__XXX

BO_ 2566708224 VDMA_FCDC_Cruise_Control_Vehicle: 8 Vector__XXX
 SG_ Cruise_Control_Vehicle_Speed_3_R : 0|64@1+ (1,0) [0|18446744073709551615] "" Vector__XXX

BO_ 2566708480 VDMA_FCDD_Aftertreatment_2_Air_C: 8 Vector__XXX
 SG_ Aftertreatment_2_Air_Control_3_R : 0|64@1+ (1,0) [0|18446744073709551615] "" Vector__XXX

BO_ 2566708736 VDMA_FCDE_Aftertreatment_1_Air_C: 8 Vector__XXX
 SG_ Aftertreatment_1_Air_Control_3_R : 0|64@1+ (1,0) [0|18446744073709551615] "" Vector__XXX

BO_ 2566708992 VDMA_FCDF_Engine_Fluid_Level_Pre: 8 Vector__XXX
 SG_ Engine_Fluid_Level_Pressure_12_R : 0|64@1+ (1,0) [0|18446744073709551615] "" Vector__XXX

BO_ 2566709248 VDMA_FCE0_Diesel_Particulate_Fil: 8 Vector__XXX
 SG_ Diesel_Particulate_Filter_Contro : 0|64@1+ (1,0) [0|18446744073709551615] "" Vector__XXX

BO_ 2566709504 VDMA_FCE1_Fuel_Economy_2_Liquid: 8 Vector__XXX
 SG_ Fuel_Economy_2_Liquid_RawPayload : 0|64@1+ (1,0) [0|18446744073709551615] "" Vector__XXX

BO_ 2566709760 VDMA_FCE2_Supplemental_Fan_Statu: 8 Vector__XXX
 SG_ Supplemental_Fan_Status_RawPaylo : 0|64@1+ (1,0) [0|18446744073709551615] "" Vector__XXX

BO_ 2566710016 VDMA_FCE3_Engine_Exhaust_Brake_C: 8 Vector__XXX
 SG_ Engine_Exhaust_Brake_Control_Raw : 0|64@1+ (1,0) [0|18446744073709551615] "" Vector__XXX

BO_ 2566710272 VDMA_FCE4_Engine_Fuel_Properties: 8 Vector__XXX
 SG_ Engine_Fuel_Properties_RawPayloa : 0|64@1+ (1,0) [0|18446744073709551615] "" Vector__XXX

BO_ 2566710528 VDMA_FCE5_Hydraulic_Oil_Properti: 8 Vector__XXX
 SG_ Hydraulic_Oil_Properties_RawPayl : 0|64@1+ (1,0) [0|18446744073709551615] "" Vector__XXX

BO_ 2566710784 VDMA_FCE6_Vehicle_Chassis_Lubric: 8 Vector__XXX
 SG_ Vehicle_Chassis_Lubrication_Syst : 0|64@1+ (1,0) [0|18446744073709551615] "" Vector__XXX

BO_ 2566711040 VDMA_FCE7_Engine_Configuration_3: 8 Vector__XXX
 SG_ Engine_Configuration_3_RawPayloa : 0|64@1+ (1,0) [0|18446744073709551615] "" Vector__XXX

BO_ 2566711296 VDMA_FCE8_Intake_Valve_Actuation: 8 Vector__XXX
 SG_ Intake_Valve_Actuation_Control_R : 0|64@1+ (1,0) [0|18446744073709551615] "" Vector__XXX

BO_ 2566711552 VDMA_FCE9_Armrest_Switch_Matrix_: 8 Vector__XXX
 SG_ Armrest_Switch_Matrix_Commands_R : 0|64@1+ (1,0) [0|18446744073709551615] "" Vector__XXX

BO_ 2566711808 VDMA_FCEA_Vehicle_Electrical_Pow: 8 Vector__XXX
 SG_ Vehicle_Electrical_Power_4_obsol : 0|64@1+ (1,0) [0|18446744073709551615] "" Vector__XXX

BO_ 2566712064 VDMA_FCEB_Aftertreatment_2_NOx_A: 8 Vector__XXX
 SG_ Aftertreatment_2_NOx_Adsorber_In : 0|64@1+ (1,0) [0|18446744073709551615] "" Vector__XXX

BO_ 2566712320 VDMA_FCEC_Aftertreatment_1_NOx_A: 8 Vector__XXX
 SG_ Aftertreatment_1_NOx_Adsorber_In : 0|64@1+ (1,0) [0|18446744073709551615] "" Vector__XXX

BO_ 2566712576 VDMA_FCED_Aftertreatment_2_Warm_: 8 Vector__XXX
 SG_ Aftertreatment_2_Warm_Up_Diesel_ : 0|64@1+ (1,0) [0|18446744073709551615] "" Vector__XXX

BO_ 2566712832 VDMA_FCEE_Land_Leveling_System_R: 8 Vector__XXX
 SG_ Land_Leveling_System_Reference_E : 0|64@1+ (1,0) [0|18446744073709551615] "" Vector__XXX

BO_ 2566713088 VDMA_FCEF_Engine_Fluid_Level_Pre: 8 Vector__XXX
 SG_ Engine_Fluid_Level_Pressure_11_R : 0|64@1+ (1,0) [0|18446744073709551615] "" Vector__XXX

BO_ 2566713344 VDMA_FCF0_Engine_Fuel_Lube_x000D: 8 Vector__XXX
 SG_ Engine_Fuel_Lube_x000D_Systems_2 : 0|64@1+ (1,0) [0|18446744073709551615] "" Vector__XXX

BO_ 2566713600 VDMA_FCF1_Engine_Turbocharger_Wa: 8 Vector__XXX
 SG_ Engine_Turbocharger_Wastegate_Ac : 0|64@1+ (1,0) [0|18446744073709551615] "" Vector__XXX

BO_ 2566713856 VDMA_FCF2_Engine_Fuel_Throttle_V: 8 Vector__XXX
 SG_ Engine_Fuel_Throttle_Valve_Infor : 0|64@1+ (1,0) [0|18446744073709551615] "" Vector__XXX

BO_ 2566714112 VDMA_FCF3_Engine_Turbocharger_Co: 8 Vector__XXX
 SG_ Engine_Turbocharger_Compressor_B : 0|64@1+ (1,0) [0|18446744073709551615] "" Vector__XXX

BO_ 2566714368 VDMA_FCF4_Charge_Air_Cooler_2: 8 Vector__XXX
 SG_ Charge_Air_Cooler_2_RawPayload : 0|64@1+ (1,0) [0|18446744073709551615] "" Vector__XXX

BO_ 2566714624 VDMA_FCF5_Charge_Air_Cooler_2_Pr: 8 Vector__XXX
 SG_ Charge_Air_Cooler_2_Precooler_Ra : 0|64@1+ (1,0) [0|18446744073709551615] "" Vector__XXX

BO_ 2566714880 VDMA_FCF6_Charge_Air_Cooler_1: 8 Vector__XXX
 SG_ Charge_Air_Cooler_1_RawPayload : 0|64@1+ (1,0) [0|18446744073709551615] "" Vector__XXX

BO_ 2566715136 VDMA_FCF7_Charge_Air_Cooler_1_Pr: 8 Vector__XXX
 SG_ Charge_Air_Cooler_1_Precooler_Ra : 0|64@1+ (1,0) [0|18446744073709551615] "" Vector__XXX

BO_ 2566715392 VDMA_FCF8_Diesel_Particulate_Fil: 8 Vector__XXX
 SG_ Diesel_Particulate_Filter_2_Soot : 0|64@1+ (1,0) [0|18446744073709551615] "" Vector__XXX

BO_ 2566715648 VDMA_FCF9_Diesel_Particulate_Fil: 8 Vector__XXX
 SG_ Diesel_Particulate_Filter_1_Soot : 0|64@1+ (1,0) [0|18446744073709551615] "" Vector__XXX

BO_ 2566715904 VDMA_FCFA_Electronic_Engine_Cont: 8 Vector__XXX
 SG_ Electronic_Engine_Controller_11_ : 0|64@1+ (1,0) [0|18446744073709551615] "" Vector__XXX

BO_ 2566716160 VDMA_FCFB_Engine_Manifold_Actuat: 8 Vector__XXX
 SG_ Engine_Manifold_Actuator_Positio : 0|64@1+ (1,0) [0|18446744073709551615] "" Vector__XXX

BO_ 2566716416 VDMA_FCFC_Engine_Manifold_Actuat: 8 Vector__XXX
 SG_ Engine_Manifold_Actuator_Control : 0|64@1+ (1,0) [0|18446744073709551615] "" Vector__XXX

BO_ 2566716672 VDMA_FCFD_Electronic_Engine_Cont: 8 Vector__XXX
 SG_ Electronic_Engine_Controller_9_R : 0|64@1+ (1,0) [0|18446744073709551615] "" Vector__XXX

BO_ 2566716928 VDMA_FCFE_Electronic_Engine_Cont: 8 Vector__XXX
 SG_ Electronic_Engine_Controller_10_ : 0|64@1+ (1,0) [0|18446744073709551615] "" Vector__XXX

BO_ 2566717184 VDMA_FCFF_Engine_Temperature_5: 8 Vector__XXX
 SG_ Engine_Temperature_5_RawPayload : 0|64@1+ (1,0) [0|18446744073709551615] "" Vector__XXX

BO_ 2566717440 VDMA_FD00_Engine_Fluid_Level_Pre: 8 Vector__XXX
 SG_ Engine_Fluid_Level_Pressure_10_R : 0|64@1+ (1,0) [0|18446744073709551615] "" Vector__XXX

BO_ 2566717696 VDMA_FD01_Low_Voltage_Disconnect: 8 Vector__XXX
 SG_ Low_Voltage_Disconnect_Status_Ra : 0|64@1+ (1,0) [0|18446744073709551615] "" Vector__XXX

BO_ 2566718208 VDMA_FD03_Implement_Operating_st: 8 Vector__XXX
 SG_ Implement_Operating_state_comman : 0|64@1+ (1,0) [0|18446744073709551615] "" Vector__XXX

BO_ 2566718464 VDMA_FD04_Direct_Lamp_Control_Da: 8 Vector__XXX
 SG_ Direct_Lamp_Control_Data_2_RawPa : 0|64@1+ (1,0) [0|18446744073709551615] "" Vector__XXX

BO_ 2566718720 VDMA_FD05_Direct_Lamp_Control_Da: 8 Vector__XXX
 SG_ Direct_Lamp_Control_Data_1_RawPa : 0|64@1+ (1,0) [0|18446744073709551615] "" Vector__XXX

BO_ 2566718976 VDMA_FD06_Direct_Lamp_Control_Co: 8 Vector__XXX
 SG_ Direct_Lamp_Control_Command_2_Ra : 0|64@1+ (1,0) [0|18446744073709551615] "" Vector__XXX

BO_ 2566719232 VDMA_FD07_Direct_Lamp_Control_Co: 8 Vector__XXX
 SG_ Direct_Lamp_Control_Command_1_Ra : 0|64@1+ (1,0) [0|18446744073709551615] "" Vector__XXX

BO_ 2566719488 VDMA_FD08_Engine_oil_message: 8 Vector__XXX
 SG_ Engine_oil_message_RawPayload : 0|64@1+ (1,0) [0|18446744073709551615] "" Vector__XXX

BO_ 2566720000 VDMA_FD0A_Aftertreatment_2_Outle: 8 Vector__XXX
 SG_ Aftertreatment_2_Outlet_Gas_NOx_ : 0|64@1+ (1,0) [0|18446744073709551615] "" Vector__XXX

BO_ 2566720256 VDMA_FD0B_Aftertreatment_2_Outle: 8 Vector__XXX
 SG_ Aftertreatment_2_Outlet_Gas_NOx_ : 0|64@1+ (1,0) [0|18446744073709551615] "" Vector__XXX

BO_ 2566720512 VDMA_FD0C_Aftertreatment_2_Intak: 8 Vector__XXX
 SG_ Aftertreatment_2_Intake_Gas_NOx_ : 0|64@1+ (1,0) [0|18446744073709551615] "" Vector__XXX

BO_ 2566720768 VDMA_FD0D_Aftertreatment_2_Intak: 8 Vector__XXX
 SG_ Aftertreatment_2_Intake_Gas_NOx_ : 0|64@1+ (1,0) [0|18446744073709551615] "" Vector__XXX

BO_ 2566721024 VDMA_FD0E_Aftertreatment_1_Outle: 8 Vector__XXX
 SG_ Aftertreatment_1_Outlet_Gas_NOx_ : 0|64@1+ (1,0) [0|18446744073709551615] "" Vector__XXX

BO_ 2566721280 VDMA_FD0F_Aftertreatment_1_Outle: 8 Vector__XXX
 SG_ Aftertreatment_1_Outlet_Gas_NOx_ : 0|64@1+ (1,0) [0|18446744073709551615] "" Vector__XXX

BO_ 2566721536 VDMA_FD10_Aftertreatment_1_Intak: 8 Vector__XXX
 SG_ Aftertreatment_1_Intake_Gas_NOx_ : 0|64@1+ (1,0) [0|18446744073709551615] "" Vector__XXX

BO_ 2566721792 VDMA_FD11_Aftertreatment_1_Intak: 8 Vector__XXX
 SG_ Aftertreatment_1_Intake_Gas_NOx_ : 0|64@1+ (1,0) [0|18446744073709551615] "" Vector__XXX

BO_ 2566722048 VDMA_FD12_Magnet_Status_Informat: 8 Vector__XXX
 SG_ Magnet_Status_Information_1_RawP : 0|64@1+ (1,0) [0|18446744073709551615] "" Vector__XXX

BO_ 2566722304 VDMA_FD13_Magnet_System_Configur: 8 Vector__XXX
 SG_ Magnet_System_Configuration_Info : 0|64@1+ (1,0) [0|18446744073709551615] "" Vector__XXX

BO_ 2566722560 VDMA_FD14_Battery_Charger_2: 8 Vector__XXX
 SG_ Battery_Charger_2_RawPayload : 0|64@1+ (1,0) [0|18446744073709551615] "" Vector__XXX

BO_ 2566722816 VDMA_FD15_Battery_Charger_1: 8 Vector__XXX
 SG_ Battery_Charger_1_RawPayload : 0|64@1+ (1,0) [0|18446744073709551615] "" Vector__XXX

BO_ 2566723072 VDMA_FD16_Occupant_Classificatio: 8 Vector__XXX
 SG_ Occupant_Classification_System_I : 0|64@1+ (1,0) [0|18446744073709551615] "" Vector__XXX

BO_ 2566723328 VDMA_FD17_Beltlock_and_Airbag_De: 8 Vector__XXX
 SG_ Beltlock_and_Airbag_Deactivation : 0|64@1+ (1,0) [0|18446744073709551615] "" Vector__XXX

BO_ 2566723584 VDMA_FD18_Collision_Sensor_Infor: 8 Vector__XXX
 SG_ Collision_Sensor_Information_Raw : 0|64@1+ (1,0) [0|18446744073709551615] "" Vector__XXX

BO_ 2566723840 VDMA_FD19_Ignitor_Loop_Informati: 8 Vector__XXX
 SG_ Ignitor_Loop_Information_RawPayl : 0|64@1+ (1,0) [0|18446744073709551615] "" Vector__XXX

BO_ 2566724096 VDMA_FD1A_Aftertreatment_1_Warm_: 8 Vector__XXX
 SG_ Aftertreatment_1_Warm_Up_Diesel_ : 0|64@1+ (1,0) [0|18446744073709551615] "" Vector__XXX

BO_ 2566724352 VDMA_FD1B_Diesel_Particulate_Fil: 8 Vector__XXX
 SG_ Diesel_Particulate_Filter_2_Soot : 0|64@1+ (1,0) [0|18446744073709551615] "" Vector__XXX

BO_ 2566724608 VDMA_FD1C_Diesel_Particulate_Fil: 8 Vector__XXX
 SG_ Diesel_Particulate_Filter_1_Soot : 0|64@1+ (1,0) [0|18446744073709551615] "" Vector__XXX

BO_ 2566724864 VDMA_FD1D_Aftertreatment_Differe: 8 Vector__XXX
 SG_ Aftertreatment_Differential_Temp : 0|64@1+ (1,0) [0|18446744073709551615] "" Vector__XXX

BO_ 2566725120 VDMA_FD1E_Aftertreatment_Differe: 8 Vector__XXX
 SG_ Aftertreatment_Differential_Temp : 0|64@1+ (1,0) [0|18446744073709551615] "" Vector__XXX

BO_ 2566725376 VDMA_FD1F_Aftertreatment_2_Diese: 8 Vector__XXX
 SG_ Aftertreatment_2_Diesel_Oxidatio : 0|64@1+ (1,0) [0|18446744073709551615] "" Vector__XXX

BO_ 2566725632 VDMA_FD20_Aftertreatment_1_Diese: 8 Vector__XXX
 SG_ Aftertreatment_1_Diesel_Oxidatio : 0|64@1+ (1,0) [0|18446744073709551615] "" Vector__XXX

BO_ 2566725888 VDMA_FD21_Aftertreatment_2_Gas_O: 8 Vector__XXX
 SG_ Aftertreatment_2_Gas_Oxidation_C : 0|64@1+ (1,0) [0|18446744073709551615] "" Vector__XXX

BO_ 2566726144 VDMA_FD22_Aftertreatment_1_Gas_O: 8 Vector__XXX
 SG_ Aftertreatment_1_Gas_Oxidation_C : 0|64@1+ (1,0) [0|18446744073709551615] "" Vector__XXX

BO_ 2566726400 VDMA_FD23_Extended_Joystick_Mess: 8 Vector__XXX
 SG_ Extended_Joystick_Message_10_Raw : 0|64@1+ (1,0) [0|18446744073709551615] "" Vector__XXX

BO_ 2566726656 VDMA_FD24_Basic_Joystick_Message: 8 Vector__XXX
 SG_ Basic_Joystick_Message_10_RawPay : 0|64@1+ (1,0) [0|18446744073709551615] "" Vector__XXX

BO_ 2566726912 VDMA_FD25_Extended_Joystick_Mess: 8 Vector__XXX
 SG_ Extended_Joystick_Message_9_RawP : 0|64@1+ (1,0) [0|18446744073709551615] "" Vector__XXX

BO_ 2566727168 VDMA_FD26_Basic_Joystick_Message: 8 Vector__XXX
 SG_ Basic_Joystick_Message_9_RawPayl : 0|64@1+ (1,0) [0|18446744073709551615] "" Vector__XXX

BO_ 2566727424 VDMA_FD27_Extended_Joystick_Mess: 8 Vector__XXX
 SG_ Extended_Joystick_Message_8_RawP : 0|64@1+ (1,0) [0|18446744073709551615] "" Vector__XXX

BO_ 2566727680 VDMA_FD28_Basic_Joystick_Message: 8 Vector__XXX
 SG_ Basic_Joystick_Message_8_RawPayl : 0|64@1+ (1,0) [0|18446744073709551615] "" Vector__XXX

BO_ 2566727936 VDMA_FD29_Extended_Joystick_Mess: 8 Vector__XXX
 SG_ Extended_Joystick_Message_7_RawP : 0|64@1+ (1,0) [0|18446744073709551615] "" Vector__XXX

BO_ 2566728192 VDMA_FD2A_Basic_Joystick_Message: 8 Vector__XXX
 SG_ Basic_Joystick_Message_7_RawPayl : 0|64@1+ (1,0) [0|18446744073709551615] "" Vector__XXX

BO_ 2566728448 VDMA_FD2B_Extended_Joystick_Mess: 8 Vector__XXX
 SG_ Extended_Joystick_Message_6_RawP : 0|64@1+ (1,0) [0|18446744073709551615] "" Vector__XXX

BO_ 2566728704 VDMA_FD2C_Basic_Joystick_Message: 8 Vector__XXX
 SG_ Basic_Joystick_Message_6_RawPayl : 0|64@1+ (1,0) [0|18446744073709551615] "" Vector__XXX

BO_ 2566728960 VDMA_FD2D_Extended_Joystick_Mess: 8 Vector__XXX
 SG_ Extended_Joystick_Message_5_RawP : 0|64@1+ (1,0) [0|18446744073709551615] "" Vector__XXX

BO_ 2566729216 VDMA_FD2E_Basic_Joystick_Message: 8 Vector__XXX
 SG_ Basic_Joystick_Message_5_RawPayl : 0|64@1+ (1,0) [0|18446744073709551615] "" Vector__XXX

BO_ 2566729472 VDMA_FD2F_Extended_Joystick_Mess: 8 Vector__XXX
 SG_ Extended_Joystick_Message_4_RawP : 0|64@1+ (1,0) [0|18446744073709551615] "" Vector__XXX

BO_ 2566729728 VDMA_FD30_Basic_Joystick_Message: 8 Vector__XXX
 SG_ Basic_Joystick_Message_4_RawPayl : 0|64@1+ (1,0) [0|18446744073709551615] "" Vector__XXX

BO_ 2566729984 VDMA_FD31_Fan_Drive_2: 8 Vector__XXX
 SG_ Fan_Drive_2_RawPayload : 0|64@1+ (1,0) [0|18446744073709551615] "" Vector__XXX

BO_ 2566730496 VDMA_FD33_Aftertreatment_2_Diese: 8 Vector__XXX
 SG_ Aftertreatment_2_Diesel_Exhaust_ : 0|64@1+ (1,0) [0|18446744073709551615] "" Vector__XXX

BO_ 2566730752 VDMA_FD34_Aftertreatment_2_SCR_R: 8 Vector__XXX
 SG_ Aftertreatment_2_SCR_Reagant_Tan : 0|64@1+ (1,0) [0|18446744073709551615] "" Vector__XXX

BO_ 2566731008 VDMA_FD35_Aftertreatment_2_Diese: 8 Vector__XXX
 SG_ Aftertreatment_2_Diesel_Exhaust_ : 0|64@1+ (1,0) [0|18446744073709551615] "" Vector__XXX

BO_ 2566731264 VDMA_FD36_Aftertreatment_2_Diese: 8 Vector__XXX
 SG_ Aftertreatment_2_Diesel_Exhaust_ : 0|64@1+ (1,0) [0|18446744073709551615] "" Vector__XXX

BO_ 2566731520 VDMA_FD37_Aftertreatment_2_SCR_S: 8 Vector__XXX
 SG_ Aftertreatment_2_SCR_Service_Inf : 0|64@1+ (1,0) [0|18446744073709551615] "" Vector__XXX

BO_ 2566731776 VDMA_FD38_Aftertreatment_2_SCR_E: 8 Vector__XXX
 SG_ Aftertreatment_2_SCR_Exhaust_Gas : 0|64@1+ (1,0) [0|18446744073709551615] "" Vector__XXX

BO_ 2566732032 VDMA_FD39_Aftertreatment_2_SCR_E: 8 Vector__XXX
 SG_ Aftertreatment_2_SCR_Exhaust_Gas : 0|64@1+ (1,0) [0|18446744073709551615] "" Vector__XXX

BO_ 2566732288 VDMA_FD3A_Aftertreatment_2_SCR_D: 8 Vector__XXX
 SG_ Aftertreatment_2_SCR_Dosing_Syst : 0|64@1+ (1,0) [0|18446744073709551615] "" Vector__XXX

BO_ 2566732544 VDMA_FD3B_Aftertreatment_2_SCR_D: 8 Vector__XXX
 SG_ Aftertreatment_2_SCR_Dosing_Syst : 0|64@1+ (1,0) [0|18446744073709551615] "" Vector__XXX

BO_ 2566732800 VDMA_FD3C_Aftertreatment_1_Diese: 8 Vector__XXX
 SG_ Aftertreatment_1_Diesel_Exhaust_ : 0|64@1+ (1,0) [0|18446744073709551615] "" Vector__XXX

BO_ 2566733056 VDMA_FD3D_Aftertreatment_1_SCR_R: 8 Vector__XXX
 SG_ Aftertreatment_1_SCR_Reagant_Tan : 0|64@1+ (1,0) [0|18446744073709551615] "" Vector__XXX

BO_ 2566733312 VDMA_FD3E_Aftertreatment_1_SCR_E: 8 Vector__XXX
 SG_ Aftertreatment_1_SCR_Exhaust_Gas : 0|64@1+ (1,0) [0|18446744073709551615] "" Vector__XXX

BO_ 2566733568 VDMA_FD3F_Aftertreatment_1_SCR_E: 8 Vector__XXX
 SG_ Aftertreatment_1_SCR_Exhaust_Gas : 0|64@1+ (1,0) [0|18446744073709551615] "" Vector__XXX

BO_ 2566733824 VDMA_FD40_Aftertreatment_1_SCR_D: 8 Vector__XXX
 SG_ Aftertreatment_1_SCR_Dosing_Syst : 0|64@1+ (1,0) [0|18446744073709551615] "" Vector__XXX

BO_ 2566734080 VDMA_FD41_Aftertreatment_1_SCR_D: 8 Vector__XXX
 SG_ Aftertreatment_1_SCR_Dosing_Syst : 0|64@1+ (1,0) [0|18446744073709551615] "" Vector__XXX

BO_ 2566734336 VDMA_FD42_ISOBUS_compliance_cert: 8 Vector__XXX
 SG_ ISOBUS_compliance_certification_ : 0|64@1+ (1,0) [0|18446744073709551615] "" Vector__XXX

BO_ 2566734848 VDMA_FD44_Aftertreatment_2_Fuel_: 8 Vector__XXX
 SG_ Aftertreatment_2_Fuel_Control_2_ : 0|64@1+ (1,0) [0|18446744073709551615] "" Vector__XXX

BO_ 2566735104 VDMA_FD45_Aftertreatment_2_Three: 8 Vector__XXX
 SG_ Aftertreatment_2_Three_Way_Catal : 0|64@1+ (1,0) [0|18446744073709551615] "" Vector__XXX

BO_ 2566735360 VDMA_FD46_Aftertreatment_1_Three: 8 Vector__XXX
 SG_ Aftertreatment_1_Three_Way_Catal : 0|64@1+ (1,0) [0|18446744073709551615] "" Vector__XXX

BO_ 2566735616 VDMA_FD47_Transmission_Mode_Labe: 8 Vector__XXX
 SG_ Transmission_Mode_Labels_RawPayl : 0|64@1+ (1,0) [0|18446744073709551615] "" Vector__XXX

BO_ 2566735872 VDMA_FD48_Engine_Exhaust_Bank_2_: 8 Vector__XXX
 SG_ Engine_Exhaust_Bank_2_O2_Fuel_Tr : 0|64@1+ (1,0) [0|18446744073709551615] "" Vector__XXX

BO_ 2566736128 VDMA_FD49_Engine_Exhaust_Bank_1_: 8 Vector__XXX
 SG_ Engine_Exhaust_Bank_1_O2_Fuel_Tr : 0|64@1+ (1,0) [0|18446744073709551615] "" Vector__XXX

BO_ 2566736384 VDMA_FD4A_General_Purpose_Messag: 8 Vector__XXX
 SG_ General_Purpose_Message_2_11_Raw : 0|64@1+ (1,0) [0|18446744073709551615] "" Vector__XXX

BO_ 2566736640 VDMA_FD4B_General_Purpose_Messag: 8 Vector__XXX
 SG_ General_Purpose_Message_2_10_Raw : 0|64@1+ (1,0) [0|18446744073709551615] "" Vector__XXX

BO_ 2566736896 VDMA_FD4C_General_Purpose_Messag: 8 Vector__XXX
 SG_ General_Purpose_Message_2_9_RawP : 0|64@1+ (1,0) [0|18446744073709551615] "" Vector__XXX

BO_ 2566737152 VDMA_FD4D_General_Purpose_Messag: 8 Vector__XXX
 SG_ General_Purpose_Message_2_8_RawP : 0|64@1+ (1,0) [0|18446744073709551615] "" Vector__XXX

BO_ 2566737408 VDMA_FD4E_General_Purpose_Messag: 8 Vector__XXX
 SG_ General_Purpose_Message_2_7_RawP : 0|64@1+ (1,0) [0|18446744073709551615] "" Vector__XXX

BO_ 2566737664 VDMA_FD4F_General_Purpose_Messag: 8 Vector__XXX
 SG_ General_Purpose_Message_2_6_RawP : 0|64@1+ (1,0) [0|18446744073709551615] "" Vector__XXX

BO_ 2566737920 VDMA_FD50_General_Purpose_Messag: 8 Vector__XXX
 SG_ General_Purpose_Message_1_9_RawP : 0|64@1+ (1,0) [0|18446744073709551615] "" Vector__XXX

BO_ 2566738176 VDMA_FD51_Aftercooler_Coolant_Co: 8 Vector__XXX
 SG_ Aftercooler_Coolant_Control_Valv : 0|64@1+ (1,0) [0|18446744073709551615] "" Vector__XXX

BO_ 2566738432 VDMA_FD52_Engine_Coolant_Control: 8 Vector__XXX
 SG_ Engine_Coolant_Control_Valve_Com : 0|64@1+ (1,0) [0|18446744073709551615] "" Vector__XXX

BO_ 2566738688 VDMA_FD53_Engine_Average_Informa: 8 Vector__XXX
 SG_ Engine_Average_Information_RawPa : 0|64@1+ (1,0) [0|18446744073709551615] "" Vector__XXX

BO_ 2566738944 VDMA_FD54_DTCs_C_Previously_Acti: 8 Vector__XXX
 SG_ DTCs_C_Previously_Active_RawPayl : 0|64@1+ (1,0) [0|18446744073709551615] "" Vector__XXX

BO_ 2566739200 VDMA_FD55_DTCs_C_Confirmed_and_A: 8 Vector__XXX
 SG_ DTCs_C_Confirmed_and_Active_RawP : 0|64@1+ (1,0) [0|18446744073709551615] "" Vector__XXX

BO_ 2566739456 VDMA_FD56_DTCs_C_Pending: 8 Vector__XXX
 SG_ DTCs_C_Pending_RawPayload : 0|64@1+ (1,0) [0|18446744073709551615] "" Vector__XXX

BO_ 2566739712 VDMA_FD57_DTCs_B2_Previously_Act: 8 Vector__XXX
 SG_ DTCs_B2_Previously_Active_RawPay : 0|64@1+ (1,0) [0|18446744073709551615] "" Vector__XXX

BO_ 2566739968 VDMA_FD58_DTCs_B2_Confirmed_and_: 8 Vector__XXX
 SG_ DTCs_B2_Confirmed_and_Active_Raw : 0|64@1+ (1,0) [0|18446744073709551615] "" Vector__XXX

BO_ 2566740224 VDMA_FD59_DTCs_B2_Pending: 8 Vector__XXX
 SG_ DTCs_B2_Pending_RawPayload : 0|64@1+ (1,0) [0|18446744073709551615] "" Vector__XXX

BO_ 2566740480 VDMA_FD5A_DTCs_B1_Previously_Act: 8 Vector__XXX
 SG_ DTCs_B1_Previously_Active_RawPay : 0|64@1+ (1,0) [0|18446744073709551615] "" Vector__XXX

BO_ 2566740736 VDMA_FD5B_DTCs_B1_Confirmed_and_: 8 Vector__XXX
 SG_ DTCs_B1_Confirmed_and_Active_Raw : 0|64@1+ (1,0) [0|18446744073709551615] "" Vector__XXX

BO_ 2566740992 VDMA_FD5C_DTCs_B1_Pending: 8 Vector__XXX
 SG_ DTCs_B1_Pending_RawPayload : 0|64@1+ (1,0) [0|18446744073709551615] "" Vector__XXX

BO_ 2566741248 VDMA_FD5D_DTCs_A_Previously_Acti: 8 Vector__XXX
 SG_ DTCs_A_Previously_Active_RawPayl : 0|64@1+ (1,0) [0|18446744073709551615] "" Vector__XXX

BO_ 2566741504 VDMA_FD5E_DTCs_A_Confirmed_and_A: 8 Vector__XXX
 SG_ DTCs_A_Confirmed_and_Active_RawP : 0|64@1+ (1,0) [0|18446744073709551615] "" Vector__XXX

BO_ 2566741760 VDMA_FD5F_DTCs_A_Pending: 8 Vector__XXX
 SG_ DTCs_A_Pending_RawPayload : 0|64@1+ (1,0) [0|18446744073709551615] "" Vector__XXX

BO_ 2566742016 VDMA_FD60_Harmonized_B1_Failure_: 8 Vector__XXX
 SG_ Harmonized_B1_Failure_Counts_Raw : 0|64@1+ (1,0) [0|18446744073709551615] "" Vector__XXX

BO_ 2566742272 VDMA_FD61_Harmonized_Cumulative_: 8 Vector__XXX
 SG_ Harmonized_Cumulative_Continuous : 0|64@1+ (1,0) [0|18446744073709551615] "" Vector__XXX

BO_ 2566742528 VDMA_FD62_Harmonized_Global_Regu: 8 Vector__XXX
 SG_ Harmonized_Global_Regulation_Des : 0|64@1+ (1,0) [0|18446744073709551615] "" Vector__XXX

BO_ 2566742784 VDMA_FD63_Harmonized_Roadworthin: 8 Vector__XXX
 SG_ Harmonized_Roadworthiness_System : 0|64@1+ (1,0) [0|18446744073709551615] "" Vector__XXX

BO_ 2566743040 VDMA_FD64_Harmonized_Roadworthin: 8 Vector__XXX
 SG_ Harmonized_Roadworthiness_Vehicl : 0|64@1+ (1,0) [0|18446744073709551615] "" Vector__XXX

BO_ 2566743296 VDMA_FD65_Aftertreatment_1_Fuel_: 8 Vector__XXX
 SG_ Aftertreatment_1_Fuel_Control_2_ : 0|64@1+ (1,0) [0|18446744073709551615] "" Vector__XXX

BO_ 2566743552 VDMA_FD66_Engine_Temperature_4: 8 Vector__XXX
 SG_ Engine_Temperature_4_RawPayload : 0|64@1+ (1,0) [0|18446744073709551615] "" Vector__XXX

BO_ 2566743808 VDMA_FD67_Zero_Net_Vehicle_Weigh: 8 Vector__XXX
 SG_ Zero_Net_Vehicle_Weight_Change_R : 0|64@1+ (1,0) [0|18446744073709551615] "" Vector__XXX

BO_ 2566744064 VDMA_FD68_Gross_Combination_Vehi: 8 Vector__XXX
 SG_ Gross_Combination_Vehicle_Weight : 0|64@1+ (1,0) [0|18446744073709551615] "" Vector__XXX

BO_ 2566744320 VDMA_FD69_Axle_Group_Calibration: 8 Vector__XXX
 SG_ Axle_Group_Calibration_Weights_R : 0|64@1+ (1,0) [0|18446744073709551615] "" Vector__XXX

BO_ 2566744576 VDMA_FD6A_Axle_Group_Weight: 8 Vector__XXX
 SG_ Axle_Group_Weight_RawPayload : 0|64@1+ (1,0) [0|18446744073709551615] "" Vector__XXX

BO_ 2566744832 VDMA_FD6B_Available_Axle_Group_W: 8 Vector__XXX
 SG_ Available_Axle_Group_Weights_Raw : 0|64@1+ (1,0) [0|18446744073709551615] "" Vector__XXX

BO_ 2566745088 VDMA_FD6C_Aftertreatment_2_Air_C: 8 Vector__XXX
 SG_ Aftertreatment_2_Air_Control_2_R : 0|64@1+ (1,0) [0|18446744073709551615] "" Vector__XXX

BO_ 2566745344 VDMA_FD6D_Aftertreatment_1_Air_C: 8 Vector__XXX
 SG_ Aftertreatment_1_Air_Control_2_R : 0|64@1+ (1,0) [0|18446744073709551615] "" Vector__XXX

BO_ 2566745600 VDMA_FD6E_Aftertreatment_1_SCR_S: 8 Vector__XXX
 SG_ Aftertreatment_1_SCR_Service_Inf : 0|64@1+ (1,0) [0|18446744073709551615] "" Vector__XXX

BO_ 2566745856 VDMA_FD6F_Electronic_Engine_Cont: 8 Vector__XXX
 SG_ Electronic_Engine_Controller_8_R : 0|64@1+ (1,0) [0|18446744073709551615] "" Vector__XXX

BO_ 2566746112 VDMA_FD70_Door_ramp_control: 8 Vector__XXX
 SG_ Door_ramp_control_RawPayload : 0|64@1+ (1,0) [0|18446744073709551615] "" Vector__XXX

CM_ BO_ 2566654720  "Source: isobus.net VDMA Data Dictionary (https://www.isobus.net/isobus/pGNAndSPN/12528?type=PGN)";
CM_ BO_ 2566654976  "Source: isobus.net VDMA Data Dictionary (https://www.isobus.net/isobus/pGNAndSPN/12531?type=PGN)";
CM_ BO_ 2566655232  "Source: isobus.net VDMA Data Dictionary (https://www.isobus.net/isobus/pGNAndSPN/12533?type=PGN)";
CM_ BO_ 2566655488  "Source: isobus.net VDMA Data Dictionary (https://www.isobus.net/isobus/pGNAndSPN/12535?type=PGN)";
CM_ BO_ 2566655744  "Source: isobus.net VDMA Data Dictionary (https://www.isobus.net/isobus/pGNAndSPN/12537?type=PGN)";
CM_ BO_ 2566656000  "Source: isobus.net VDMA Data Dictionary (https://www.isobus.net/isobus/pGNAndSPN/12540?type=PGN)";
CM_ BO_ 2566656256  "Source: isobus.net VDMA Data Dictionary (https://www.isobus.net/isobus/pGNAndSPN/12542?type=PGN)";
CM_ BO_ 2566656512  "Source: isobus.net VDMA Data Dictionary (https://www.isobus.net/isobus/pGNAndSPN/12562?type=PGN)";
CM_ BO_ 2566656768  "Source: isobus.net VDMA Data Dictionary (https://www.isobus.net/isobus/pGNAndSPN/12566?type=PGN)";
CM_ BO_ 2566657024  "Source: isobus.net VDMA Data Dictionary (https://www.isobus.net/isobus/pGNAndSPN/12567?type=PGN)";
CM_ BO_ 2566657280  "Source: isobus.net VDMA Data Dictionary (https://www.isobus.net/isobus/pGNAndSPN/12571?type=PGN)";
CM_ BO_ 2566657536  "Source: isobus.net VDMA Data Dictionary (https://www.isobus.net/isobus/pGNAndSPN/12572?type=PGN)";
CM_ BO_ 2566657792  "Source: isobus.net VDMA Data Dictionary (https://www.isobus.net/isobus/pGNAndSPN/12576?type=PGN)";
CM_ BO_ 2566658048  "Source: isobus.net VDMA Data Dictionary (https://www.isobus.net/isobus/pGNAndSPN/12577?type=PGN)";
CM_ BO_ 2566658304  "Source: isobus.net VDMA Data Dictionary (https://www.isobus.net/isobus/pGNAndSPN/12579?type=PGN)";
CM_ BO_ 2566658560  "Source: isobus.net VDMA Data Dictionary (https://www.isobus.net/isobus/pGNAndSPN/12585?type=PGN)";
CM_ BO_ 2566658816  "Source: isobus.net VDMA Data Dictionary (https://www.isobus.net/isobus/pGNAndSPN/12589?type=PGN)";
CM_ BO_ 2566659072  "Source: isobus.net VDMA Data Dictionary (https://www.isobus.net/isobus/pGNAndSPN/12593?type=PGN)";
CM_ BO_ 2566659328  "Source: isobus.net VDMA Data Dictionary (https://www.isobus.net/isobus/pGNAndSPN/12595?type=PGN)";
CM_ BO_ 2566659584  "Source: isobus.net VDMA Data Dictionary (https://www.isobus.net/isobus/pGNAndSPN/12599?type=PGN)";
CM_ BO_ 2566659840  "Source: isobus.net VDMA Data Dictionary (https://www.isobus.net/isobus/pGNAndSPN/12603?type=PGN)";
CM_ BO_ 2566660096  "Source: isobus.net VDMA Data Dictionary (https://www.isobus.net/isobus/pGNAndSPN/12635?type=PGN)";
CM_ BO_ 2566660352  "Source: isobus.net VDMA Data Dictionary (https://www.isobus.net/isobus/pGNAndSPN/12667?type=PGN)";
CM_ BO_ 2566660608  "Source: isobus.net VDMA Data Dictionary (https://www.isobus.net/isobus/pGNAndSPN/12669?type=PGN)";
CM_ BO_ 2566660864  "Source: isobus.net VDMA Data Dictionary (https://www.isobus.net/isobus/pGNAndSPN/12670?type=PGN)";
CM_ BO_ 2566661120  "Source: isobus.net VDMA Data Dictionary (https://www.isobus.net/isobus/pGNAndSPN/12673?type=PGN)";
CM_ BO_ 2566661376  "Source: isobus.net VDMA Data Dictionary (https://www.isobus.net/isobus/pGNAndSPN/12676?type=PGN)";
CM_ BO_ 2566661632  "Source: isobus.net VDMA Data Dictionary (https://www.isobus.net/isobus/pGNAndSPN/12678?type=PGN)";
CM_ BO_ 2566661888  "Source: isobus.net VDMA Data Dictionary (https://www.isobus.net/isobus/pGNAndSPN/12680?type=PGN)";
CM_ BO_ 2566662144  "Source: isobus.net VDMA Data Dictionary (https://www.isobus.net/isobus/pGNAndSPN/12685?type=PGN)";
CM_ BO_ 2566662400  "Source: isobus.net VDMA Data Dictionary (https://www.isobus.net/isobus/pGNAndSPN/12694?type=PGN)";
CM_ BO_ 2566662656  "Source: isobus.net VDMA Data Dictionary (https://www.isobus.net/isobus/pGNAndSPN/12699?type=PGN)";
CM_ BO_ 2566662912  "Source: isobus.net VDMA Data Dictionary (https://www.isobus.net/isobus/pGNAndSPN/12703?type=PGN)";
CM_ BO_ 2566663168  "Source: isobus.net VDMA Data Dictionary (https://www.isobus.net/isobus/pGNAndSPN/12723?type=PGN)";
CM_ BO_ 2566663424  "Source: isobus.net VDMA Data Dictionary (https://www.isobus.net/isobus/pGNAndSPN/12727?type=PGN)";
CM_ BO_ 2566663680  "Source: isobus.net VDMA Data Dictionary (https://www.isobus.net/isobus/pGNAndSPN/12734?type=PGN)";
CM_ BO_ 2566663936  "Source: isobus.net VDMA Data Dictionary (https://www.isobus.net/isobus/pGNAndSPN/12738?type=PGN)";
CM_ BO_ 2566664192  "Source: isobus.net VDMA Data Dictionary (https://www.isobus.net/isobus/pGNAndSPN/12742?type=PGN)";
CM_ BO_ 2566664448  "Source: isobus.net VDMA Data Dictionary (https://www.isobus.net/isobus/pGNAndSPN/12755?type=PGN)";
CM_ BO_ 2566664704  "Source: isobus.net VDMA Data Dictionary (https://www.isobus.net/isobus/pGNAndSPN/12765?type=PGN)";
CM_ BO_ 2566664960  "Source: isobus.net VDMA Data Dictionary (https://www.isobus.net/isobus/pGNAndSPN/12767?type=PGN)";
CM_ BO_ 2566665216  "Source: isobus.net VDMA Data Dictionary (https://www.isobus.net/isobus/pGNAndSPN/12771?type=PGN)";
CM_ BO_ 2566665472  "Source: isobus.net VDMA Data Dictionary (https://www.isobus.net/isobus/pGNAndSPN/12773?type=PGN)";
CM_ BO_ 2566665728  "Source: isobus.net VDMA Data Dictionary (https://www.isobus.net/isobus/pGNAndSPN/12779?type=PGN)";
CM_ BO_ 2566665984  "Source: isobus.net VDMA Data Dictionary (https://www.isobus.net/isobus/pGNAndSPN/12781?type=PGN)";
CM_ BO_ 2566666240  "Source: isobus.net VDMA Data Dictionary (https://www.isobus.net/isobus/pGNAndSPN/12789?type=PGN)";
CM_ BO_ 2566666496  "Source: isobus.net VDMA Data Dictionary (https://www.isobus.net/isobus/pGNAndSPN/12791?type=PGN)";
CM_ BO_ 2566666752  "Source: isobus.net VDMA Data Dictionary (https://www.isobus.net/isobus/pGNAndSPN/12795?type=PGN)";
CM_ BO_ 2566667008  "Source: isobus.net VDMA Data Dictionary (https://www.isobus.net/isobus/pGNAndSPN/12799?type=PGN)";
CM_ BO_ 2566667264  "Source: isobus.net VDMA Data Dictionary (https://www.isobus.net/isobus/pGNAndSPN/12807?type=PGN)";
CM_ BO_ 2566667520  "Source: isobus.net VDMA Data Dictionary (https://www.isobus.net/isobus/pGNAndSPN/12815?type=PGN)";
CM_ BO_ 2566667776  "Source: isobus.net VDMA Data Dictionary (https://www.isobus.net/isobus/pGNAndSPN/12817?type=PGN)";
CM_ BO_ 2566668032  "Source: isobus.net VDMA Data Dictionary (https://www.isobus.net/isobus/pGNAndSPN/12819?type=PGN)";
CM_ BO_ 2566668288  "Source: isobus.net VDMA Data Dictionary (https://www.isobus.net/isobus/pGNAndSPN/12823?type=PGN)";
CM_ BO_ 2566668544  "Source: isobus.net VDMA Data Dictionary (https://www.isobus.net/isobus/pGNAndSPN/12828?type=PGN)";
CM_ BO_ 2566668800  "Source: isobus.net VDMA Data Dictionary (https://www.isobus.net/isobus/pGNAndSPN/12831?type=PGN)";
CM_ BO_ 2566669056  "Source: isobus.net VDMA Data Dictionary (https://www.isobus.net/isobus/pGNAndSPN/12837?type=PGN)";
CM_ BO_ 2566669312  "Source: isobus.net VDMA Data Dictionary (https://www.isobus.net/isobus/pGNAndSPN/12839?type=PGN)";
CM_ BO_ 2566669568  "Source: isobus.net VDMA Data Dictionary (https://www.isobus.net/isobus/pGNAndSPN/12845?type=PGN)";
CM_ BO_ 2566669824  "Source: isobus.net VDMA Data Dictionary (https://www.isobus.net/isobus/pGNAndSPN/12849?type=PGN)";
CM_ BO_ 2566670080  "Source: isobus.net VDMA Data Dictionary (https://www.isobus.net/isobus/pGNAndSPN/12863?type=PGN)";
CM_ BO_ 2566670336  "Source: isobus.net VDMA Data Dictionary (https://www.isobus.net/isobus/pGNAndSPN/12869?type=PGN)";
CM_ BO_ 2566670592  "Source: isobus.net VDMA Data Dictionary (https://www.isobus.net/isobus/pGNAndSPN/12876?type=PGN)";
CM_ BO_ 2566670848  "Source: isobus.net VDMA Data Dictionary (https://www.isobus.net/isobus/pGNAndSPN/12897?type=PGN)";
CM_ BO_ 2566671104  "Source: isobus.net VDMA Data Dictionary (https://www.isobus.net/isobus/pGNAndSPN/12901?type=PGN)";
CM_ BO_ 2566671360  "Source: isobus.net VDMA Data Dictionary (https://www.isobus.net/isobus/pGNAndSPN/12905?type=PGN)";
CM_ BO_ 2566671616  "Source: isobus.net VDMA Data Dictionary (https://www.isobus.net/isobus/pGNAndSPN/12910?type=PGN)";
CM_ BO_ 2566671872  "Source: isobus.net VDMA Data Dictionary (https://www.isobus.net/isobus/pGNAndSPN/12915?type=PGN)";
CM_ BO_ 2566672128  "Source: isobus.net VDMA Data Dictionary (https://www.isobus.net/isobus/pGNAndSPN/12923?type=PGN)";
CM_ BO_ 2566672384  "Source: isobus.net VDMA Data Dictionary (https://www.isobus.net/isobus/pGNAndSPN/12928?type=PGN)";
CM_ BO_ 2566672640  "Source: isobus.net VDMA Data Dictionary (https://www.isobus.net/isobus/pGNAndSPN/12932?type=PGN)";
CM_ BO_ 2566672896  "Source: isobus.net VDMA Data Dictionary (https://www.isobus.net/isobus/pGNAndSPN/12936?type=PGN)";
CM_ BO_ 2566673152  "Source: isobus.net VDMA Data Dictionary (https://www.isobus.net/isobus/pGNAndSPN/12942?type=PGN)";
CM_ BO_ 2566673408  "Source: isobus.net VDMA Data Dictionary (https://www.isobus.net/isobus/pGNAndSPN/12943?type=PGN)";
CM_ BO_ 2566673664  "Source: isobus.net VDMA Data Dictionary (https://www.isobus.net/isobus/pGNAndSPN/12944?type=PGN)";
CM_ BO_ 2566673920  "Source: isobus.net VDMA Data Dictionary (https://www.isobus.net/isobus/pGNAndSPN/12946?type=PGN)";
CM_ BO_ 2566674176  "Source: isobus.net VDMA Data Dictionary (https://www.isobus.net/isobus/pGNAndSPN/12948?type=PGN)";
CM_ BO_ 2566674432  "Source: isobus.net VDMA Data Dictionary (https://www.isobus.net/isobus/pGNAndSPN/12953?type=PGN)";
CM_ BO_ 2566674688  "Source: isobus.net VDMA Data Dictionary (https://www.isobus.net/isobus/pGNAndSPN/12956?type=PGN)";
CM_ BO_ 2566674944  "Source: isobus.net VDMA Data Dictionary (https://www.isobus.net/isobus/pGNAndSPN/12958?type=PGN)";
CM_ BO_ 2566675200  "Source: isobus.net VDMA Data Dictionary (https://www.isobus.net/isobus/pGNAndSPN/12960?type=PGN)";
CM_ BO_ 2566675456  "Source: isobus.net VDMA Data Dictionary (https://www.isobus.net/isobus/pGNAndSPN/12962?type=PGN)";
CM_ BO_ 2566675712  "Source: isobus.net VDMA Data Dictionary (https://www.isobus.net/isobus/pGNAndSPN/12973?type=PGN)";
CM_ BO_ 2566675968  "Source: isobus.net VDMA Data Dictionary (https://www.isobus.net/isobus/pGNAndSPN/12979?type=PGN)";
CM_ BO_ 2566676224  "Source: isobus.net VDMA Data Dictionary (https://www.isobus.net/isobus/pGNAndSPN/12980?type=PGN)";
CM_ BO_ 2566676480  "Source: isobus.net VDMA Data Dictionary (https://www.isobus.net/isobus/pGNAndSPN/12981?type=PGN)";
CM_ BO_ 2566676736  "Source: isobus.net VDMA Data Dictionary (https://www.isobus.net/isobus/pGNAndSPN/12982?type=PGN)";
CM_ BO_ 2566676992  "Source: isobus.net VDMA Data Dictionary (https://www.isobus.net/isobus/pGNAndSPN/12983?type=PGN)";
CM_ BO_ 2566677248  "Source: isobus.net VDMA Data Dictionary (https://www.isobus.net/isobus/pGNAndSPN/12984?type=PGN)";
CM_ BO_ 2566677504  "Source: isobus.net VDMA Data Dictionary (https://www.isobus.net/isobus/pGNAndSPN/12985?type=PGN)";
CM_ BO_ 2566677760  "Source: isobus.net VDMA Data Dictionary (https://www.isobus.net/isobus/pGNAndSPN/12986?type=PGN)";
CM_ BO_ 2566678016  "Source: isobus.net VDMA Data Dictionary (https://www.isobus.net/isobus/pGNAndSPN/12987?type=PGN)";
CM_ BO_ 2566678272  "Source: isobus.net VDMA Data Dictionary (https://www.isobus.net/isobus/pGNAndSPN/12988?type=PGN)";
CM_ BO_ 2566678528  "Source: isobus.net VDMA Data Dictionary (https://www.isobus.net/isobus/pGNAndSPN/12989?type=PGN)";
CM_ BO_ 2566678784  "Source: isobus.net VDMA Data Dictionary (https://www.isobus.net/isobus/pGNAndSPN/12990?type=PGN)";
CM_ BO_ 2566679040  "Source: isobus.net VDMA Data Dictionary (https://www.isobus.net/isobus/pGNAndSPN/12994?type=PGN)";
CM_ BO_ 2566679296  "Source: isobus.net VDMA Data Dictionary (https://www.isobus.net/isobus/pGNAndSPN/12995?type=PGN)";
CM_ BO_ 2566679552  "Source: isobus.net VDMA Data Dictionary (https://www.isobus.net/isobus/pGNAndSPN/12996?type=PGN)";
CM_ BO_ 2566679808  "Source: isobus.net VDMA Data Dictionary (https://www.isobus.net/isobus/pGNAndSPN/12997?type=PGN)";
CM_ BO_ 2566680064  "Source: isobus.net VDMA Data Dictionary (https://www.isobus.net/isobus/pGNAndSPN/12998?type=PGN)";
CM_ BO_ 2566680320  "Source: isobus.net VDMA Data Dictionary (https://www.isobus.net/isobus/pGNAndSPN/12999?type=PGN)";
CM_ BO_ 2566680576  "Source: isobus.net VDMA Data Dictionary (https://www.isobus.net/isobus/pGNAndSPN/13000?type=PGN)";
CM_ BO_ 2566680832  "Source: isobus.net VDMA Data Dictionary (https://www.isobus.net/isobus/pGNAndSPN/13001?type=PGN)";
CM_ BO_ 2566681088  "Source: isobus.net VDMA Data Dictionary (https://www.isobus.net/isobus/pGNAndSPN/13002?type=PGN)";
CM_ BO_ 2566681344  "Source: isobus.net VDMA Data Dictionary (https://www.isobus.net/isobus/pGNAndSPN/13003?type=PGN)";
CM_ BO_ 2566681600  "Source: isobus.net VDMA Data Dictionary (https://www.isobus.net/isobus/pGNAndSPN/13004?type=PGN)";
CM_ BO_ 2566681856  "Source: isobus.net VDMA Data Dictionary (https://www.isobus.net/isobus/pGNAndSPN/13005?type=PGN)";
CM_ BO_ 2566682112  "Source: isobus.net VDMA Data Dictionary (https://www.isobus.net/isobus/pGNAndSPN/13006?type=PGN)";
CM_ BO_ 2566682368  "Source: isobus.net VDMA Data Dictionary (https://www.isobus.net/isobus/pGNAndSPN/13007?type=PGN)";
CM_ BO_ 2566682624  "Source: isobus.net VDMA Data Dictionary (https://www.isobus.net/isobus/pGNAndSPN/13008?type=PGN)";
CM_ BO_ 2566682880  "Source: isobus.net VDMA Data Dictionary (https://www.isobus.net/isobus/pGNAndSPN/13009?type=PGN)";
CM_ BO_ 2566683136  "Source: isobus.net VDMA Data Dictionary (https://www.isobus.net/isobus/pGNAndSPN/13010?type=PGN)";
CM_ BO_ 2566683392  "Source: isobus.net VDMA Data Dictionary (https://www.isobus.net/isobus/pGNAndSPN/13011?type=PGN)";
CM_ BO_ 2566683648  "Source: isobus.net VDMA Data Dictionary (https://www.isobus.net/isobus/pGNAndSPN/13012?type=PGN)";
CM_ BO_ 2566683904  "Source: isobus.net VDMA Data Dictionary (https://www.isobus.net/isobus/pGNAndSPN/13013?type=PGN)";
CM_ BO_ 2566684160  "Source: isobus.net VDMA Data Dictionary (https://www.isobus.net/isobus/pGNAndSPN/13014?type=PGN)";
CM_ BO_ 2566684416  "Source: isobus.net VDMA Data Dictionary (https://www.isobus.net/isobus/pGNAndSPN/13015?type=PGN)";
CM_ BO_ 2566684672  "Source: isobus.net VDMA Data Dictionary (https://www.isobus.net/isobus/pGNAndSPN/13016?type=PGN)";
CM_ BO_ 2566684928  "Source: isobus.net VDMA Data Dictionary (https://www.isobus.net/isobus/pGNAndSPN/13017?type=PGN)";
CM_ BO_ 2566685184  "Source: isobus.net VDMA Data Dictionary (https://www.isobus.net/isobus/pGNAndSPN/13018?type=PGN)";
CM_ BO_ 2566685440  "Source: isobus.net VDMA Data Dictionary (https://www.isobus.net/isobus/pGNAndSPN/13019?type=PGN)";
CM_ BO_ 2566685696  "Source: isobus.net VDMA Data Dictionary (https://www.isobus.net/isobus/pGNAndSPN/13020?type=PGN)";
CM_ BO_ 2566685952  "Source: isobus.net VDMA Data Dictionary (https://www.isobus.net/isobus/pGNAndSPN/13023?type=PGN)";
CM_ BO_ 2566686208  "Source: isobus.net VDMA Data Dictionary (https://www.isobus.net/isobus/pGNAndSPN/13028?type=PGN)";
CM_ BO_ 2566686464  "Source: isobus.net VDMA Data Dictionary (https://www.isobus.net/isobus/pGNAndSPN/13031?type=PGN)";
CM_ BO_ 2566686720  "Source: isobus.net VDMA Data Dictionary (https://www.isobus.net/isobus/pGNAndSPN/13034?type=PGN)";
CM_ BO_ 2566686976  "Source: isobus.net VDMA Data Dictionary (https://www.isobus.net/isobus/pGNAndSPN/13038?type=PGN)";
CM_ BO_ 2566687232  "Source: isobus.net VDMA Data Dictionary (https://www.isobus.net/isobus/pGNAndSPN/13042?type=PGN)";
CM_ BO_ 2566687488  "Source: isobus.net VDMA Data Dictionary (https://www.isobus.net/isobus/pGNAndSPN/13048?type=PGN)";
CM_ BO_ 2566687744  "Source: isobus.net VDMA Data Dictionary (https://www.isobus.net/isobus/pGNAndSPN/13054?type=PGN)";
CM_ BO_ 2566688512  "Source: isobus.net VDMA Data Dictionary (https://www.isobus.net/isobus/pGNAndSPN/13067?type=PGN)";
CM_ BO_ 2566688768  "Source: isobus.net VDMA Data Dictionary (https://www.isobus.net/isobus/pGNAndSPN/13071?type=PGN)";
CM_ BO_ 2566689024  "Source: isobus.net VDMA Data Dictionary (https://www.isobus.net/isobus/pGNAndSPN/13074?type=PGN)";
CM_ BO_ 2566689280  "Source: isobus.net VDMA Data Dictionary (https://www.isobus.net/isobus/pGNAndSPN/13078?type=PGN)";
CM_ BO_ 2566689536  "Source: isobus.net VDMA Data Dictionary (https://www.isobus.net/isobus/pGNAndSPN/13082?type=PGN)";
CM_ BO_ 2566689792  "Source: isobus.net VDMA Data Dictionary (https://www.isobus.net/isobus/pGNAndSPN/13089?type=PGN)";
CM_ BO_ 2566690048  "Source: isobus.net VDMA Data Dictionary (https://www.isobus.net/isobus/pGNAndSPN/13091?type=PGN)";
CM_ BO_ 2566690304  "Source: isobus.net VDMA Data Dictionary (https://www.isobus.net/isobus/pGNAndSPN/13096?type=PGN)";
CM_ BO_ 2566690560  "Source: isobus.net VDMA Data Dictionary (https://www.isobus.net/isobus/pGNAndSPN/13108?type=PGN)";
CM_ BO_ 2566690816  "Source: isobus.net VDMA Data Dictionary (https://www.isobus.net/isobus/pGNAndSPN/13113?type=PGN)";
CM_ BO_ 2566691072  "Source: isobus.net VDMA Data Dictionary (https://www.isobus.net/isobus/pGNAndSPN/13115?type=PGN)";
CM_ BO_ 2566691328  "Source: isobus.net VDMA Data Dictionary (https://www.isobus.net/isobus/pGNAndSPN/13125?type=PGN)";
CM_ BO_ 2566691584  "Source: isobus.net VDMA Data Dictionary (https://www.isobus.net/isobus/pGNAndSPN/13135?type=PGN)";
CM_ BO_ 2566691840  "Source: isobus.net VDMA Data Dictionary (https://www.isobus.net/isobus/pGNAndSPN/13145?type=PGN)";
CM_ BO_ 2566692096  "Source: isobus.net VDMA Data Dictionary (https://www.isobus.net/isobus/pGNAndSPN/13147?type=PGN)";
CM_ BO_ 2566692352  "Source: isobus.net VDMA Data Dictionary (https://www.isobus.net/isobus/pGNAndSPN/13151?type=PGN)";
CM_ BO_ 2566692608  "Source: isobus.net VDMA Data Dictionary (https://www.isobus.net/isobus/pGNAndSPN/13158?type=PGN)";
CM_ BO_ 2566692864  "Source: isobus.net VDMA Data Dictionary (https://www.isobus.net/isobus/pGNAndSPN/13160?type=PGN)";
CM_ BO_ 2566693120  "Source: isobus.net VDMA Data Dictionary (https://www.isobus.net/isobus/pGNAndSPN/13168?type=PGN)";
CM_ BO_ 2566693376  "Source: isobus.net VDMA Data Dictionary (https://www.isobus.net/isobus/pGNAndSPN/13176?type=PGN)";
CM_ BO_ 2566693632  "Source: isobus.net VDMA Data Dictionary (https://www.isobus.net/isobus/pGNAndSPN/13184?type=PGN)";
CM_ BO_ 2566693888  "Source: isobus.net VDMA Data Dictionary (https://www.isobus.net/isobus/pGNAndSPN/13188?type=PGN)";
CM_ BO_ 2566694144  "Source: isobus.net VDMA Data Dictionary (https://www.isobus.net/isobus/pGNAndSPN/13192?type=PGN)";
CM_ BO_ 2566694400  "Source: isobus.net VDMA Data Dictionary (https://www.isobus.net/isobus/pGNAndSPN/13196?type=PGN)";
CM_ BO_ 2566694656  "Source: isobus.net VDMA Data Dictionary (https://www.isobus.net/isobus/pGNAndSPN/13200?type=PGN)";
CM_ BO_ 2566694912  "Source: isobus.net VDMA Data Dictionary (https://www.isobus.net/isobus/pGNAndSPN/13204?type=PGN)";
CM_ BO_ 2566695168  "Source: isobus.net VDMA Data Dictionary (https://www.isobus.net/isobus/pGNAndSPN/13208?type=PGN)";
CM_ BO_ 2566695424  "Source: isobus.net VDMA Data Dictionary (https://www.isobus.net/isobus/pGNAndSPN/13212?type=PGN)";
CM_ BO_ 2566695680  "Source: isobus.net VDMA Data Dictionary (https://www.isobus.net/isobus/pGNAndSPN/13216?type=PGN)";
CM_ BO_ 2566695936  "Source: isobus.net VDMA Data Dictionary (https://www.isobus.net/isobus/pGNAndSPN/13220?type=PGN)";
CM_ BO_ 2566696192  "Source: isobus.net VDMA Data Dictionary (https://www.isobus.net/isobus/pGNAndSPN/13224?type=PGN)";
CM_ BO_ 2566696448  "Source: isobus.net VDMA Data Dictionary (https://www.isobus.net/isobus/pGNAndSPN/13228?type=PGN)";
CM_ BO_ 2566696704  "Source: isobus.net VDMA Data Dictionary (https://www.isobus.net/isobus/pGNAndSPN/13232?type=PGN)";
CM_ BO_ 2566696960  "Source: isobus.net VDMA Data Dictionary (https://www.isobus.net/isobus/pGNAndSPN/13234?type=PGN)";
CM_ BO_ 2566697216  "Source: isobus.net VDMA Data Dictionary (https://www.isobus.net/isobus/pGNAndSPN/13238?type=PGN)";
CM_ BO_ 2566697728  "Source: isobus.net VDMA Data Dictionary (https://www.isobus.net/isobus/pGNAndSPN/13302?type=PGN)";
CM_ BO_ 2566697984  "Source: isobus.net VDMA Data Dictionary (https://www.isobus.net/isobus/pGNAndSPN/13334?type=PGN)";
CM_ BO_ 2566698240  "Source: isobus.net VDMA Data Dictionary (https://www.isobus.net/isobus/pGNAndSPN/13366?type=PGN)";
CM_ BO_ 2566698496  "Source: isobus.net VDMA Data Dictionary (https://www.isobus.net/isobus/pGNAndSPN/13370?type=PGN)";
CM_ BO_ 2566698752  "Source: isobus.net VDMA Data Dictionary (https://www.isobus.net/isobus/pGNAndSPN/13376?type=PGN)";
CM_ BO_ 2566699008  "Source: isobus.net VDMA Data Dictionary (https://www.isobus.net/isobus/pGNAndSPN/13378?type=PGN)";
CM_ BO_ 2566699264  "Source: isobus.net VDMA Data Dictionary (https://www.isobus.net/isobus/pGNAndSPN/13380?type=PGN)";
CM_ BO_ 2566699520  "Source: isobus.net VDMA Data Dictionary (https://www.isobus.net/isobus/pGNAndSPN/13387?type=PGN)";
CM_ BO_ 2566699776  "Source: isobus.net VDMA Data Dictionary (https://www.isobus.net/isobus/pGNAndSPN/13394?type=PGN)";
CM_ BO_ 2566700032  "Source: isobus.net VDMA Data Dictionary (https://www.isobus.net/isobus/pGNAndSPN/13395?type=PGN)";
CM_ BO_ 2566700288  "Source: isobus.net VDMA Data Dictionary (https://www.isobus.net/isobus/pGNAndSPN/13397?type=PGN)";
CM_ BO_ 2566700544  "Source: isobus.net VDMA Data Dictionary (https://www.isobus.net/isobus/pGNAndSPN/13401?type=PGN)";
CM_ BO_ 2566700800  "Source: isobus.net VDMA Data Dictionary (https://www.isobus.net/isobus/pGNAndSPN/13415?type=PGN)";
CM_ BO_ 2566701056  "Source: isobus.net VDMA Data Dictionary (https://www.isobus.net/isobus/pGNAndSPN/13421?type=PGN)";
CM_ BO_ 2566701312  "Source: isobus.net VDMA Data Dictionary (https://www.isobus.net/isobus/pGNAndSPN/13425?type=PGN)";
CM_ BO_ 2566701568  "Source: isobus.net VDMA Data Dictionary (https://www.isobus.net/isobus/pGNAndSPN/13446?type=PGN)";
CM_ BO_ 2566701824  "Source: isobus.net VDMA Data Dictionary (https://www.isobus.net/isobus/pGNAndSPN/13448?type=PGN)";
CM_ BO_ 2566702080  "Source: isobus.net VDMA Data Dictionary (https://www.isobus.net/isobus/pGNAndSPN/13450?type=PGN)";
CM_ BO_ 2566702336  "Source: isobus.net VDMA Data Dictionary (https://www.isobus.net/isobus/pGNAndSPN/13452?type=PGN)";
CM_ BO_ 2566702592  "Source: isobus.net VDMA Data Dictionary (https://www.isobus.net/isobus/pGNAndSPN/13453?type=PGN)";
CM_ BO_ 2566702848  "Source: isobus.net VDMA Data Dictionary (https://www.isobus.net/isobus/pGNAndSPN/13455?type=PGN)";
CM_ BO_ 2566703104  "Source: isobus.net VDMA Data Dictionary (https://www.isobus.net/isobus/pGNAndSPN/13468?type=PGN)";
CM_ BO_ 2566703360  "Source: isobus.net VDMA Data Dictionary (https://www.isobus.net/isobus/pGNAndSPN/13475?type=PGN)";
CM_ BO_ 2566703616  "Source: isobus.net VDMA Data Dictionary (https://www.isobus.net/isobus/pGNAndSPN/13485?type=PGN)";
CM_ BO_ 2566703872  "Source: isobus.net VDMA Data Dictionary (https://www.isobus.net/isobus/pGNAndSPN/13495?type=PGN)";
CM_ BO_ 2566704128  "Source: isobus.net VDMA Data Dictionary (https://www.isobus.net/isobus/pGNAndSPN/13501?type=PGN)";
CM_ BO_ 2566704384  "Source: isobus.net VDMA Data Dictionary (https://www.isobus.net/isobus/pGNAndSPN/13507?type=PGN)";
CM_ BO_ 2566704640  "Source: isobus.net VDMA Data Dictionary (https://www.isobus.net/isobus/pGNAndSPN/13512?type=PGN)";
CM_ BO_ 2566704896  "Source: isobus.net VDMA Data Dictionary (https://www.isobus.net/isobus/pGNAndSPN/13516?type=PGN)";
CM_ BO_ 2566705152  "Source: isobus.net VDMA Data Dictionary (https://www.isobus.net/isobus/pGNAndSPN/13519?type=PGN)";
CM_ BO_ 2566705408  "Source: isobus.net VDMA Data Dictionary (https://www.isobus.net/isobus/pGNAndSPN/13531?type=PGN)";
CM_ BO_ 2566705664  "Source: isobus.net VDMA Data Dictionary (https://www.isobus.net/isobus/pGNAndSPN/13543?type=PGN)";
CM_ BO_ 2566705920  "Source: isobus.net VDMA Data Dictionary (https://www.isobus.net/isobus/pGNAndSPN/13544?type=PGN)";
CM_ BO_ 2566706176  "Source: isobus.net VDMA Data Dictionary (https://www.isobus.net/isobus/pGNAndSPN/13545?type=PGN)";
CM_ BO_ 2566706432  "Source: isobus.net VDMA Data Dictionary (https://www.isobus.net/isobus/pGNAndSPN/13552?type=PGN)";
CM_ BO_ 2566706688  "Source: isobus.net VDMA Data Dictionary (https://www.isobus.net/isobus/pGNAndSPN/13556?type=PGN)";
CM_ BO_ 2566706944  "Source: isobus.net VDMA Data Dictionary (https://www.isobus.net/isobus/pGNAndSPN/13560?type=PGN)";
CM_ BO_ 2566707200  "Source: isobus.net VDMA Data Dictionary (https://www.isobus.net/isobus/pGNAndSPN/13564?type=PGN)";
CM_ BO_ 2566707456  "Source: isobus.net VDMA Data Dictionary (https://www.isobus.net/isobus/pGNAndSPN/13568?type=PGN)";
CM_ BO_ 2566707712  "Source: isobus.net VDMA Data Dictionary (https://www.isobus.net/isobus/pGNAndSPN/13572?type=PGN)";
CM_ BO_ 2566707968  "Source: isobus.net VDMA Data Dictionary (https://www.isobus.net/isobus/pGNAndSPN/13576?type=PGN)";
CM_ BO_ 2566708224  "Source: isobus.net VDMA Data Dictionary (https://www.isobus.net/isobus/pGNAndSPN/13587?type=PGN)";
CM_ BO_ 2566708480  "Source: isobus.net VDMA Data Dictionary (https://www.isobus.net/isobus/pGNAndSPN/13588?type=PGN)";
CM_ BO_ 2566708736  "Source: isobus.net VDMA Data Dictionary (https://www.isobus.net/isobus/pGNAndSPN/13590?type=PGN)";
CM_ BO_ 2566708992  "Source: isobus.net VDMA Data Dictionary (https://www.isobus.net/isobus/pGNAndSPN/13597?type=PGN)";
CM_ BO_ 2566709248  "Source: isobus.net VDMA Data Dictionary (https://www.isobus.net/isobus/pGNAndSPN/13601?type=PGN)";
CM_ BO_ 2566709504  "Source: isobus.net VDMA Data Dictionary (https://www.isobus.net/isobus/pGNAndSPN/13603?type=PGN)";
CM_ BO_ 2566709760  "Source: isobus.net VDMA Data Dictionary (https://www.isobus.net/isobus/pGNAndSPN/13612?type=PGN)";
CM_ BO_ 2566710016  "Source: isobus.net VDMA Data Dictionary (https://www.isobus.net/isobus/pGNAndSPN/13617?type=PGN)";
CM_ BO_ 2566710272  "Source: isobus.net VDMA Data Dictionary (https://www.isobus.net/isobus/pGNAndSPN/13621?type=PGN)";
CM_ BO_ 2566710528  "Source: isobus.net VDMA Data Dictionary (https://www.isobus.net/isobus/pGNAndSPN/13625?type=PGN)";
CM_ BO_ 2566710784  "Source: isobus.net VDMA Data Dictionary (https://www.isobus.net/isobus/pGNAndSPN/13631?type=PGN)";
CM_ BO_ 2566711040  "Source: isobus.net VDMA Data Dictionary (https://www.isobus.net/isobus/pGNAndSPN/13638?type=PGN)";
CM_ BO_ 2566711296  "Source: isobus.net VDMA Data Dictionary (https://www.isobus.net/isobus/pGNAndSPN/13640?type=PGN)";
CM_ BO_ 2566711552  "Source: isobus.net VDMA Data Dictionary (https://www.isobus.net/isobus/pGNAndSPN/13644?type=PGN)";
CM_ BO_ 2566711808  "Source: isobus.net VDMA Data Dictionary (https://www.isobus.net/isobus/pGNAndSPN/13645?type=PGN)";
CM_ BO_ 2566712064  "Source: isobus.net VDMA Data Dictionary (https://www.isobus.net/isobus/pGNAndSPN/13647?type=PGN)";
CM_ BO_ 2566712320  "Source: isobus.net VDMA Data Dictionary (https://www.isobus.net/isobus/pGNAndSPN/13649?type=PGN)";
CM_ BO_ 2566712576  "Source: isobus.net VDMA Data Dictionary (https://www.isobus.net/isobus/pGNAndSPN/13651?type=PGN)";
CM_ BO_ 2566712832  "Source: isobus.net VDMA Data Dictionary (https://www.isobus.net/isobus/pGNAndSPN/13655?type=PGN)";
CM_ BO_ 2566713088  "Source: isobus.net VDMA Data Dictionary (https://www.isobus.net/isobus/pGNAndSPN/13659?type=PGN)";
CM_ BO_ 2566713344  "Source: isobus.net VDMA Data Dictionary (https://www.isobus.net/isobus/pGNAndSPN/13664?type=PGN)";
CM_ BO_ 2566713600  "Source: isobus.net VDMA Data Dictionary (https://www.isobus.net/isobus/pGNAndSPN/13676?type=PGN)";
CM_ BO_ 2566713856  "Source: isobus.net VDMA Data Dictionary (https://www.isobus.net/isobus/pGNAndSPN/13690?type=PGN)";
CM_ BO_ 2566714112  "Source: isobus.net VDMA Data Dictionary (https://www.isobus.net/isobus/pGNAndSPN/13698?type=PGN)";
CM_ BO_ 2566714368  "Source: isobus.net VDMA Data Dictionary (https://www.isobus.net/isobus/pGNAndSPN/13702?type=PGN)";
CM_ BO_ 2566714624  "Source: isobus.net VDMA Data Dictionary (https://www.isobus.net/isobus/pGNAndSPN/13705?type=PGN)";
CM_ BO_ 2566714880  "Source: isobus.net VDMA Data Dictionary (https://www.isobus.net/isobus/pGNAndSPN/13709?type=PGN)";
CM_ BO_ 2566715136  "Source: isobus.net VDMA Data Dictionary (https://www.isobus.net/isobus/pGNAndSPN/13712?type=PGN)";
CM_ BO_ 2566715392  "Source: isobus.net VDMA Data Dictionary (https://www.isobus.net/isobus/pGNAndSPN/13715?type=PGN)";
CM_ BO_ 2566715648  "Source: isobus.net VDMA Data Dictionary (https://www.isobus.net/isobus/pGNAndSPN/13718?type=PGN)";
CM_ BO_ 2566715904  "Source: isobus.net VDMA Data Dictionary (https://www.isobus.net/isobus/pGNAndSPN/13722?type=PGN)";
CM_ BO_ 2566716160  "Source: isobus.net VDMA Data Dictionary (https://www.isobus.net/isobus/pGNAndSPN/13724?type=PGN)";
CM_ BO_ 2566716416  "Source: isobus.net VDMA Data Dictionary (https://www.isobus.net/isobus/pGNAndSPN/13726?type=PGN)";
CM_ BO_ 2566716672  "Source: isobus.net VDMA Data Dictionary (https://www.isobus.net/isobus/pGNAndSPN/13730?type=PGN)";
CM_ BO_ 2566716928  "Source: isobus.net VDMA Data Dictionary (https://www.isobus.net/isobus/pGNAndSPN/13735?type=PGN)";
CM_ BO_ 2566717184  "Source: isobus.net VDMA Data Dictionary (https://www.isobus.net/isobus/pGNAndSPN/13738?type=PGN)";
CM_ BO_ 2566717440  "Source: isobus.net VDMA Data Dictionary (https://www.isobus.net/isobus/pGNAndSPN/13743?type=PGN)";
CM_ BO_ 2566717696  "Source: isobus.net VDMA Data Dictionary (https://www.isobus.net/isobus/pGNAndSPN/13751?type=PGN)";
CM_ BO_ 2566718208  "Source: isobus.net VDMA Data Dictionary (https://www.isobus.net/isobus/pGNAndSPN/13754?type=PGN)";
CM_ BO_ 2566718464  "Source: isobus.net VDMA Data Dictionary (https://www.isobus.net/isobus/pGNAndSPN/13769?type=PGN)";
CM_ BO_ 2566718720  "Source: isobus.net VDMA Data Dictionary (https://www.isobus.net/isobus/pGNAndSPN/13796?type=PGN)";
CM_ BO_ 2566718976  "Source: isobus.net VDMA Data Dictionary (https://www.isobus.net/isobus/pGNAndSPN/13811?type=PGN)";
CM_ BO_ 2566719232  "Source: isobus.net VDMA Data Dictionary (https://www.isobus.net/isobus/pGNAndSPN/13838?type=PGN)";
CM_ BO_ 2566719488  "Source: isobus.net VDMA Data Dictionary (https://www.isobus.net/isobus/pGNAndSPN/13842?type=PGN)";
CM_ BO_ 2566720000  "Source: isobus.net VDMA Data Dictionary (https://www.isobus.net/isobus/pGNAndSPN/13850?type=PGN)";
CM_ BO_ 2566720256  "Source: isobus.net VDMA Data Dictionary (https://www.isobus.net/isobus/pGNAndSPN/13854?type=PGN)";
CM_ BO_ 2566720512  "Source: isobus.net VDMA Data Dictionary (https://www.isobus.net/isobus/pGNAndSPN/13860?type=PGN)";
CM_ BO_ 2566720768  "Source: isobus.net VDMA Data Dictionary (https://www.isobus.net/isobus/pGNAndSPN/13864?type=PGN)";
CM_ BO_ 2566721024  "Source: isobus.net VDMA Data Dictionary (https://www.isobus.net/isobus/pGNAndSPN/13870?type=PGN)";
CM_ BO_ 2566721280  "Source: isobus.net VDMA Data Dictionary (https://www.isobus.net/isobus/pGNAndSPN/13874?type=PGN)";
CM_ BO_ 2566721536  "Source: isobus.net VDMA Data Dictionary (https://www.isobus.net/isobus/pGNAndSPN/13880?type=PGN)";
CM_ BO_ 2566721792  "Source: isobus.net VDMA Data Dictionary (https://www.isobus.net/isobus/pGNAndSPN/13884?type=PGN)";
CM_ BO_ 2566722048  "Source: isobus.net VDMA Data Dictionary (https://www.isobus.net/isobus/pGNAndSPN/13892?type=PGN)";
CM_ BO_ 2566722304  "Source: isobus.net VDMA Data Dictionary (https://www.isobus.net/isobus/pGNAndSPN/13894?type=PGN)";
CM_ BO_ 2566722560  "Source: isobus.net VDMA Data Dictionary (https://www.isobus.net/isobus/pGNAndSPN/13901?type=PGN)";
CM_ BO_ 2566722816  "Source: isobus.net VDMA Data Dictionary (https://www.isobus.net/isobus/pGNAndSPN/13908?type=PGN)";
CM_ BO_ 2566723072  "Source: isobus.net VDMA Data Dictionary (https://www.isobus.net/isobus/pGNAndSPN/13918?type=PGN)";
CM_ BO_ 2566723328  "Source: isobus.net VDMA Data Dictionary (https://www.isobus.net/isobus/pGNAndSPN/13930?type=PGN)";
CM_ BO_ 2566723584  "Source: isobus.net VDMA Data Dictionary (https://www.isobus.net/isobus/pGNAndSPN/13964?type=PGN)";
CM_ BO_ 2566723840  "Source: isobus.net VDMA Data Dictionary (https://www.isobus.net/isobus/pGNAndSPN/14064?type=PGN)";
CM_ BO_ 2566724096  "Source: isobus.net VDMA Data Dictionary (https://www.isobus.net/isobus/pGNAndSPN/14066?type=PGN)";
CM_ BO_ 2566724352  "Source: isobus.net VDMA Data Dictionary (https://www.isobus.net/isobus/pGNAndSPN/14072?type=PGN)";
CM_ BO_ 2566724608  "Source: isobus.net VDMA Data Dictionary (https://www.isobus.net/isobus/pGNAndSPN/14078?type=PGN)";
CM_ BO_ 2566724864  "Source: isobus.net VDMA Data Dictionary (https://www.isobus.net/isobus/pGNAndSPN/14080?type=PGN)";
CM_ BO_ 2566725120  "Source: isobus.net VDMA Data Dictionary (https://www.isobus.net/isobus/pGNAndSPN/14082?type=PGN)";
CM_ BO_ 2566725376  "Source: isobus.net VDMA Data Dictionary (https://www.isobus.net/isobus/pGNAndSPN/14088?type=PGN)";
CM_ BO_ 2566725632  "Source: isobus.net VDMA Data Dictionary (https://www.isobus.net/isobus/pGNAndSPN/14094?type=PGN)";
CM_ BO_ 2566725888  "Source: isobus.net VDMA Data Dictionary (https://www.isobus.net/isobus/pGNAndSPN/14100?type=PGN)";
CM_ BO_ 2566726144  "Source: isobus.net VDMA Data Dictionary (https://www.isobus.net/isobus/pGNAndSPN/14106?type=PGN)";
CM_ BO_ 2566726400  "Source: isobus.net VDMA Data Dictionary (https://www.isobus.net/isobus/pGNAndSPN/14125?type=PGN)";
CM_ BO_ 2566726656  "Source: isobus.net VDMA Data Dictionary (https://www.isobus.net/isobus/pGNAndSPN/14147?type=PGN)";
CM_ BO_ 2566726912  "Source: isobus.net VDMA Data Dictionary (https://www.isobus.net/isobus/pGNAndSPN/14166?type=PGN)";
CM_ BO_ 2566727168  "Source: isobus.net VDMA Data Dictionary (https://www.isobus.net/isobus/pGNAndSPN/14188?type=PGN)";
CM_ BO_ 2566727424  "Source: isobus.net VDMA Data Dictionary (https://www.isobus.net/isobus/pGNAndSPN/14207?type=PGN)";
CM_ BO_ 2566727680  "Source: isobus.net VDMA Data Dictionary (https://www.isobus.net/isobus/pGNAndSPN/14229?type=PGN)";
CM_ BO_ 2566727936  "Source: isobus.net VDMA Data Dictionary (https://www.isobus.net/isobus/pGNAndSPN/14248?type=PGN)";
CM_ BO_ 2566728192  "Source: isobus.net VDMA Data Dictionary (https://www.isobus.net/isobus/pGNAndSPN/14270?type=PGN)";
CM_ BO_ 2566728448  "Source: isobus.net VDMA Data Dictionary (https://www.isobus.net/isobus/pGNAndSPN/14289?type=PGN)";
CM_ BO_ 2566728704  "Source: isobus.net VDMA Data Dictionary (https://www.isobus.net/isobus/pGNAndSPN/14311?type=PGN)";
CM_ BO_ 2566728960  "Source: isobus.net VDMA Data Dictionary (https://www.isobus.net/isobus/pGNAndSPN/14330?type=PGN)";
CM_ BO_ 2566729216  "Source: isobus.net VDMA Data Dictionary (https://www.isobus.net/isobus/pGNAndSPN/14352?type=PGN)";
CM_ BO_ 2566729472  "Source: isobus.net VDMA Data Dictionary (https://www.isobus.net/isobus/pGNAndSPN/14371?type=PGN)";
CM_ BO_ 2566729728  "Source: isobus.net VDMA Data Dictionary (https://www.isobus.net/isobus/pGNAndSPN/14393?type=PGN)";
CM_ BO_ 2566729984  "Source: isobus.net VDMA Data Dictionary (https://www.isobus.net/isobus/pGNAndSPN/14398?type=PGN)";
CM_ BO_ 2566730496  "Source: isobus.net VDMA Data Dictionary (https://www.isobus.net/isobus/pGNAndSPN/14408?type=PGN)";
CM_ BO_ 2566730752  "Source: isobus.net VDMA Data Dictionary (https://www.isobus.net/isobus/pGNAndSPN/14415?type=PGN)";
CM_ BO_ 2566731008  "Source: isobus.net VDMA Data Dictionary (https://www.isobus.net/isobus/pGNAndSPN/14422?type=PGN)";
CM_ BO_ 2566731264  "Source: isobus.net VDMA Data Dictionary (https://www.isobus.net/isobus/pGNAndSPN/14428?type=PGN)";
CM_ BO_ 2566731520  "Source: isobus.net VDMA Data Dictionary (https://www.isobus.net/isobus/pGNAndSPN/14433?type=PGN)";
CM_ BO_ 2566731776  "Source: isobus.net VDMA Data Dictionary (https://www.isobus.net/isobus/pGNAndSPN/14437?type=PGN)";
CM_ BO_ 2566732032  "Source: isobus.net VDMA Data Dictionary (https://www.isobus.net/isobus/pGNAndSPN/14441?type=PGN)";
CM_ BO_ 2566732288  "Source: isobus.net VDMA Data Dictionary (https://www.isobus.net/isobus/pGNAndSPN/14458?type=PGN)";
CM_ BO_ 2566732544  "Source: isobus.net VDMA Data Dictionary (https://www.isobus.net/isobus/pGNAndSPN/14471?type=PGN)";
CM_ BO_ 2566732800  "Source: isobus.net VDMA Data Dictionary (https://www.isobus.net/isobus/pGNAndSPN/14480?type=PGN)";
CM_ BO_ 2566733056  "Source: isobus.net VDMA Data Dictionary (https://www.isobus.net/isobus/pGNAndSPN/14487?type=PGN)";
CM_ BO_ 2566733312  "Source: isobus.net VDMA Data Dictionary (https://www.isobus.net/isobus/pGNAndSPN/14491?type=PGN)";
CM_ BO_ 2566733568  "Source: isobus.net VDMA Data Dictionary (https://www.isobus.net/isobus/pGNAndSPN/14495?type=PGN)";
CM_ BO_ 2566733824  "Source: isobus.net VDMA Data Dictionary (https://www.isobus.net/isobus/pGNAndSPN/14513?type=PGN)";
CM_ BO_ 2566734080  "Source: isobus.net VDMA Data Dictionary (https://www.isobus.net/isobus/pGNAndSPN/14526?type=PGN)";
CM_ BO_ 2566734336  "Source: isobus.net VDMA Data Dictionary (https://www.isobus.net/isobus/pGNAndSPN/14545?type=PGN)";
CM_ BO_ 2566734848  "Source: isobus.net VDMA Data Dictionary (https://www.isobus.net/isobus/pGNAndSPN/14552?type=PGN)";
CM_ BO_ 2566735104  "Source: isobus.net VDMA Data Dictionary (https://www.isobus.net/isobus/pGNAndSPN/14558?type=PGN)";
CM_ BO_ 2566735360  "Source: isobus.net VDMA Data Dictionary (https://www.isobus.net/isobus/pGNAndSPN/14564?type=PGN)";
CM_ BO_ 2566735616  "Source: isobus.net VDMA Data Dictionary (https://www.isobus.net/isobus/pGNAndSPN/14565?type=PGN)";
CM_ BO_ 2566735872  "Source: isobus.net VDMA Data Dictionary (https://www.isobus.net/isobus/pGNAndSPN/14568?type=PGN)";
CM_ BO_ 2566736128  "Source: isobus.net VDMA Data Dictionary (https://www.isobus.net/isobus/pGNAndSPN/14571?type=PGN)";
CM_ BO_ 2566736384  "Source: isobus.net VDMA Data Dictionary (https://www.isobus.net/isobus/pGNAndSPN/14572?type=PGN)";
CM_ BO_ 2566736640  "Source: isobus.net VDMA Data Dictionary (https://www.isobus.net/isobus/pGNAndSPN/14573?type=PGN)";
CM_ BO_ 2566736896  "Source: isobus.net VDMA Data Dictionary (https://www.isobus.net/isobus/pGNAndSPN/14574?type=PGN)";
CM_ BO_ 2566737152  "Source: isobus.net VDMA Data Dictionary (https://www.isobus.net/isobus/pGNAndSPN/14575?type=PGN)";
CM_ BO_ 2566737408  "Source: isobus.net VDMA Data Dictionary (https://www.isobus.net/isobus/pGNAndSPN/14576?type=PGN)";
CM_ BO_ 2566737664  "Source: isobus.net VDMA Data Dictionary (https://www.isobus.net/isobus/pGNAndSPN/14577?type=PGN)";
CM_ BO_ 2566737920  "Source: isobus.net VDMA Data Dictionary (https://www.isobus.net/isobus/pGNAndSPN/14578?type=PGN)";
CM_ BO_ 2566738176  "Source: isobus.net VDMA Data Dictionary (https://www.isobus.net/isobus/pGNAndSPN/14584?type=PGN)";
CM_ BO_ 2566738432  "Source: isobus.net VDMA Data Dictionary (https://www.isobus.net/isobus/pGNAndSPN/14592?type=PGN)";
CM_ BO_ 2566738688  "Source: isobus.net VDMA Data Dictionary (https://www.isobus.net/isobus/pGNAndSPN/14595?type=PGN)";
CM_ BO_ 2566738944  "Source: isobus.net VDMA Data Dictionary (https://www.isobus.net/isobus/pGNAndSPN/14607?type=PGN)";
CM_ BO_ 2566739200  "Source: isobus.net VDMA Data Dictionary (https://www.isobus.net/isobus/pGNAndSPN/14619?type=PGN)";
CM_ BO_ 2566739456  "Source: isobus.net VDMA Data Dictionary (https://www.isobus.net/isobus/pGNAndSPN/14631?type=PGN)";
CM_ BO_ 2566739712  "Source: isobus.net VDMA Data Dictionary (https://www.isobus.net/isobus/pGNAndSPN/14643?type=PGN)";
CM_ BO_ 2566739968  "Source: isobus.net VDMA Data Dictionary (https://www.isobus.net/isobus/pGNAndSPN/14655?type=PGN)";
CM_ BO_ 2566740224  "Source: isobus.net VDMA Data Dictionary (https://www.isobus.net/isobus/pGNAndSPN/14667?type=PGN)";
CM_ BO_ 2566740480  "Source: isobus.net VDMA Data Dictionary (https://www.isobus.net/isobus/pGNAndSPN/14679?type=PGN)";
CM_ BO_ 2566740736  "Source: isobus.net VDMA Data Dictionary (https://www.isobus.net/isobus/pGNAndSPN/14691?type=PGN)";
CM_ BO_ 2566740992  "Source: isobus.net VDMA Data Dictionary (https://www.isobus.net/isobus/pGNAndSPN/14703?type=PGN)";
CM_ BO_ 2566741248  "Source: isobus.net VDMA Data Dictionary (https://www.isobus.net/isobus/pGNAndSPN/14715?type=PGN)";
CM_ BO_ 2566741504  "Source: isobus.net VDMA Data Dictionary (https://www.isobus.net/isobus/pGNAndSPN/14727?type=PGN)";
CM_ BO_ 2566741760  "Source: isobus.net VDMA Data Dictionary (https://www.isobus.net/isobus/pGNAndSPN/14739?type=PGN)";
CM_ BO_ 2566742016  "Source: isobus.net VDMA Data Dictionary (https://www.isobus.net/isobus/pGNAndSPN/14742?type=PGN)";
CM_ BO_ 2566742272  "Source: isobus.net VDMA Data Dictionary (https://www.isobus.net/isobus/pGNAndSPN/14744?type=PGN)";
CM_ BO_ 2566742528  "Source: isobus.net VDMA Data Dictionary (https://www.isobus.net/isobus/pGNAndSPN/14745?type=PGN)";
CM_ BO_ 2566742784  "Source: isobus.net VDMA Data Dictionary (https://www.isobus.net/isobus/pGNAndSPN/14750?type=PGN)";
CM_ BO_ 2566743040  "Source: isobus.net VDMA Data Dictionary (https://www.isobus.net/isobus/pGNAndSPN/14751?type=PGN)";
CM_ BO_ 2566743296  "Source: isobus.net VDMA Data Dictionary (https://www.isobus.net/isobus/pGNAndSPN/14756?type=PGN)";
CM_ BO_ 2566743552  "Source: isobus.net VDMA Data Dictionary (https://www.isobus.net/isobus/pGNAndSPN/14762?type=PGN)";
CM_ BO_ 2566743808  "Source: isobus.net VDMA Data Dictionary (https://www.isobus.net/isobus/pGNAndSPN/14763?type=PGN)";
CM_ BO_ 2566744064  "Source: isobus.net VDMA Data Dictionary (https://www.isobus.net/isobus/pGNAndSPN/14765?type=PGN)";
CM_ BO_ 2566744320  "Source: isobus.net VDMA Data Dictionary (https://www.isobus.net/isobus/pGNAndSPN/14769?type=PGN)";
CM_ BO_ 2566744576  "Source: isobus.net VDMA Data Dictionary (https://www.isobus.net/isobus/pGNAndSPN/14772?type=PGN)";
CM_ BO_ 2566744832  "Source: isobus.net VDMA Data Dictionary (https://www.isobus.net/isobus/pGNAndSPN/14788?type=PGN)";
CM_ BO_ 2566745088  "Source: isobus.net VDMA Data Dictionary (https://www.isobus.net/isobus/pGNAndSPN/14792?type=PGN)";
CM_ BO_ 2566745344  "Source: isobus.net VDMA Data Dictionary (https://www.isobus.net/isobus/pGNAndSPN/14796?type=PGN)";
CM_ BO_ 2566745600  "Source: isobus.net VDMA Data Dictionary (https://www.isobus.net/isobus/pGNAndSPN/14801?type=PGN)";
CM_ BO_ 2566745856  "Source: isobus.net VDMA Data Dictionary (https://www.isobus.net/isobus/pGNAndSPN/14806?type=PGN)";
CM_ BO_ 2566746112  "Source: isobus.net VDMA Data Dictionary (https://www.isobus.net/isobus/pGNAndSPN/14821?type=PGN)";
CM_ SG_ 2566654720 Electronic_Engine_Controller_20_ "Generic 8-byte raw payload. Detail page: https://www.isobus.net/isobus/pGNAndSPN/12528?type=PGN. Signal-level enrichment via PR welcome  see CONTRIBUTING.md.";
CM_ SG_ 2566654976 Evaporative_Systems_RawPayload "Generic 8-byte raw payload. Detail page: https://www.isobus.net/isobus/pGNAndSPN/12531?type=PGN. Signal-level enrichment via PR welcome  see CONTRIBUTING.md.";
CM_ SG_ 2566655232 Fire_Pump_Statistics_1_RawPayloa "Generic 8-byte raw payload. Detail page: https://www.isobus.net/isobus/pGNAndSPN/12533?type=PGN. Signal-level enrichment via PR welcome  see CONTRIBUTING.md.";
CM_ SG_ 2566655488 Primary_or_Rear_Hitch_Roll_and_P "Generic 8-byte raw payload. Detail page: https://www.isobus.net/isobus/pGNAndSPN/12535?type=PGN. Signal-level enrichment via PR welcome  see CONTRIBUTING.md.";
CM_ SG_ 2566655744 Secondary_or_Front_Hitch_Roll_an "Generic 8-byte raw payload. Detail page: https://www.isobus.net/isobus/pGNAndSPN/12537?type=PGN. Signal-level enrichment via PR welcome  see CONTRIBUTING.md.";
CM_ SG_ 2566656000 Ambient_Conditions_3_RawPayload "Generic 8-byte raw payload. Detail page: https://www.isobus.net/isobus/pGNAndSPN/12540?type=PGN. Signal-level enrichment via PR welcome  see CONTRIBUTING.md.";
CM_ SG_ 2566656256 Total_Gaseous_Fuel_Information_R "Generic 8-byte raw payload. Detail page: https://www.isobus.net/isobus/pGNAndSPN/12542?type=PGN. Signal-level enrichment via PR welcome  see CONTRIBUTING.md.";
CM_ SG_ 2566656512 Cab_Door_Control_1_RawPayload "Generic 8-byte raw payload. Detail page: https://www.isobus.net/isobus/pGNAndSPN/12562?type=PGN. Signal-level enrichment via PR welcome  see CONTRIBUTING.md.";
CM_ SG_ 2566656768 Door_Latch_Status_RawPayload "Generic 8-byte raw payload. Detail page: https://www.isobus.net/isobus/pGNAndSPN/12566?type=PGN. Signal-level enrichment via PR welcome  see CONTRIBUTING.md.";
CM_ SG_ 2566657024 Vehicle_Electrical_Power_3_obsol "Generic 8-byte raw payload. Detail page: https://www.isobus.net/isobus/pGNAndSPN/12567?type=PGN. Signal-level enrichment via PR welcome  see CONTRIBUTING.md.";
CM_ SG_ 2566657280 Vehicle_Electrical_Power_6_RawPa "Generic 8-byte raw payload. Detail page: https://www.isobus.net/isobus/pGNAndSPN/12571?type=PGN. Signal-level enrichment via PR welcome  see CONTRIBUTING.md.";
CM_ SG_ 2566657536 Payload_Temperature_2_RawPayload "Generic 8-byte raw payload. Detail page: https://www.isobus.net/isobus/pGNAndSPN/12572?type=PGN. Signal-level enrichment via PR welcome  see CONTRIBUTING.md.";
CM_ SG_ 2566657792 Payload_Temperature_1_RawPayload "Generic 8-byte raw payload. Detail page: https://www.isobus.net/isobus/pGNAndSPN/12576?type=PGN. Signal-level enrichment via PR welcome  see CONTRIBUTING.md.";
CM_ SG_ 2566658048 Payload_System_Totals_2_RawPaylo "Generic 8-byte raw payload. Detail page: https://www.isobus.net/isobus/pGNAndSPN/12577?type=PGN. Signal-level enrichment via PR welcome  see CONTRIBUTING.md.";
CM_ SG_ 2566658304 Payload_System_Totals_1_RawPaylo "Generic 8-byte raw payload. Detail page: https://www.isobus.net/isobus/pGNAndSPN/12579?type=PGN. Signal-level enrichment via PR welcome  see CONTRIBUTING.md.";
CM_ SG_ 2566658560 HVESS_Thermal_Management_System_ "Generic 8-byte raw payload. Detail page: https://www.isobus.net/isobus/pGNAndSPN/12585?type=PGN. Signal-level enrichment via PR welcome  see CONTRIBUTING.md.";
CM_ SG_ 2566658816 HVESS_Thermal_Management_System_ "Generic 8-byte raw payload. Detail page: https://www.isobus.net/isobus/pGNAndSPN/12589?type=PGN. Signal-level enrichment via PR welcome  see CONTRIBUTING.md.";
CM_ SG_ 2566659072 Refrigeration_Compartment_Inform "Generic 8-byte raw payload. Detail page: https://www.isobus.net/isobus/pGNAndSPN/12593?type=PGN. Signal-level enrichment via PR welcome  see CONTRIBUTING.md.";
CM_ SG_ 2566659328 Refrigeration_Compartment_Inform "Generic 8-byte raw payload. Detail page: https://www.isobus.net/isobus/pGNAndSPN/12595?type=PGN. Signal-level enrichment via PR welcome  see CONTRIBUTING.md.";
CM_ SG_ 2566659584 Vehicle_Electrical_Power_16_RawP "Generic 8-byte raw payload. Detail page: https://www.isobus.net/isobus/pGNAndSPN/12599?type=PGN. Signal-level enrichment via PR welcome  see CONTRIBUTING.md.";
CM_ SG_ 2566659840 Vehicle_Electrical_Power_17_RawP "Generic 8-byte raw payload. Detail page: https://www.isobus.net/isobus/pGNAndSPN/12603?type=PGN. Signal-level enrichment via PR welcome  see CONTRIBUTING.md.";
CM_ SG_ 2566660096 High_Voltage_Energy_Storage_Syst "Generic 8-byte raw payload. Detail page: https://www.isobus.net/isobus/pGNAndSPN/12635?type=PGN. Signal-level enrichment via PR welcome  see CONTRIBUTING.md.";
CM_ SG_ 2566660352 High_Voltage_Energy_Storage_Syst "Generic 8-byte raw payload. Detail page: https://www.isobus.net/isobus/pGNAndSPN/12667?type=PGN. Signal-level enrichment via PR welcome  see CONTRIBUTING.md.";
CM_ SG_ 2566660608 Electronic_Engine_Controller_19_ "Generic 8-byte raw payload. Detail page: https://www.isobus.net/isobus/pGNAndSPN/12669?type=PGN. Signal-level enrichment via PR welcome  see CONTRIBUTING.md.";
CM_ SG_ 2566660864 Fuel_Consumption_Liquid_2_RawPay "Generic 8-byte raw payload. Detail page: https://www.isobus.net/isobus/pGNAndSPN/12670?type=PGN. Signal-level enrichment via PR welcome  see CONTRIBUTING.md.";
CM_ SG_ 2566661120 Aftertreatment_2_Diesel_Exhaust_ "Generic 8-byte raw payload. Detail page: https://www.isobus.net/isobus/pGNAndSPN/12673?type=PGN. Signal-level enrichment via PR welcome  see CONTRIBUTING.md.";
CM_ SG_ 2566661376 Aftertreatment_1_Diesel_Exhaust_ "Generic 8-byte raw payload. Detail page: https://www.isobus.net/isobus/pGNAndSPN/12676?type=PGN. Signal-level enrichment via PR welcome  see CONTRIBUTING.md.";
CM_ SG_ 2566661632 Aftertreatment_2_Diesel_Exhaust_ "Generic 8-byte raw payload. Detail page: https://www.isobus.net/isobus/pGNAndSPN/12678?type=PGN. Signal-level enrichment via PR welcome  see CONTRIBUTING.md.";
CM_ SG_ 2566661888 Aftertreatment_1_Diesel_Exhaust_ "Generic 8-byte raw payload. Detail page: https://www.isobus.net/isobus/pGNAndSPN/12680?type=PGN. Signal-level enrichment via PR welcome  see CONTRIBUTING.md.";
CM_ SG_ 2566662144 Cruise_Control_Vehicle_Speed_6_R "Generic 8-byte raw payload. Detail page: https://www.isobus.net/isobus/pGNAndSPN/12685?type=PGN. Signal-level enrichment via PR welcome  see CONTRIBUTING.md.";
CM_ SG_ 2566662400 Forward_Lane_Image_3_RawPayload "Generic 8-byte raw payload. Detail page: https://www.isobus.net/isobus/pGNAndSPN/12694?type=PGN. Signal-level enrichment via PR welcome  see CONTRIBUTING.md.";
CM_ SG_ 2566662656 Operator_Inducement_Information_ "Generic 8-byte raw payload. Detail page: https://www.isobus.net/isobus/pGNAndSPN/12699?type=PGN. Signal-level enrichment via PR welcome  see CONTRIBUTING.md.";
CM_ SG_ 2566662912 Cruise_Control_Vehicle_Speed_4_R "Generic 8-byte raw payload. Detail page: https://www.isobus.net/isobus/pGNAndSPN/12703?type=PGN. Signal-level enrichment via PR welcome  see CONTRIBUTING.md.";
CM_ SG_ 2566663168 Brake_Caliper_Lining_Clearance_R "Generic 8-byte raw payload. Detail page: https://www.isobus.net/isobus/pGNAndSPN/12723?type=PGN. Signal-level enrichment via PR welcome  see CONTRIBUTING.md.";
CM_ SG_ 2566663424 Alternate_Fuel_5_RawPayload "Generic 8-byte raw payload. Detail page: https://www.isobus.net/isobus/pGNAndSPN/12727?type=PGN. Signal-level enrichment via PR welcome  see CONTRIBUTING.md.";
CM_ SG_ 2566663680 Engine_Turbocharger_Control_3_Ra "Generic 8-byte raw payload. Detail page: https://www.isobus.net/isobus/pGNAndSPN/12734?type=PGN. Signal-level enrichment via PR welcome  see CONTRIBUTING.md.";
CM_ SG_ 2566663936 Fire_Suppression_Agent_Status_Ra "Generic 8-byte raw payload. Detail page: https://www.isobus.net/isobus/pGNAndSPN/12738?type=PGN. Signal-level enrichment via PR welcome  see CONTRIBUTING.md.";
CM_ SG_ 2566664192 SCR_Operator_Inducement_Informat "Generic 8-byte raw payload. Detail page: https://www.isobus.net/isobus/pGNAndSPN/12742?type=PGN. Signal-level enrichment via PR welcome  see CONTRIBUTING.md.";
CM_ SG_ 2566664448 Aftertreatment_System_Informatio "Generic 8-byte raw payload. Detail page: https://www.isobus.net/isobus/pGNAndSPN/12755?type=PGN. Signal-level enrichment via PR welcome  see CONTRIBUTING.md.";
CM_ SG_ 2566664704 Aftertreatment_1_Particulate_Sen "Generic 8-byte raw payload. Detail page: https://www.isobus.net/isobus/pGNAndSPN/12765?type=PGN. Signal-level enrichment via PR welcome  see CONTRIBUTING.md.";
CM_ SG_ 2566664960 Engine_Fuel_Injector_Metering_Ra "Generic 8-byte raw payload. Detail page: https://www.isobus.net/isobus/pGNAndSPN/12767?type=PGN. Signal-level enrichment via PR welcome  see CONTRIBUTING.md.";
CM_ SG_ 2566665216 Engine_Fuel_Injector_Metering_Ra "Generic 8-byte raw payload. Detail page: https://www.isobus.net/isobus/pGNAndSPN/12771?type=PGN. Signal-level enrichment via PR welcome  see CONTRIBUTING.md.";
CM_ SG_ 2566665472 Aftertreatment_2_Diesel_Exhaust_ "Generic 8-byte raw payload. Detail page: https://www.isobus.net/isobus/pGNAndSPN/12773?type=PGN. Signal-level enrichment via PR welcome  see CONTRIBUTING.md.";
CM_ SG_ 2566665728 Gaseous_Fuel_Supply_Valve_Inform "Generic 8-byte raw payload. Detail page: https://www.isobus.net/isobus/pGNAndSPN/12779?type=PGN. Signal-level enrichment via PR welcome  see CONTRIBUTING.md.";
CM_ SG_ 2566665984 Engine_Oil_Mist_Detection_Inform "Generic 8-byte raw payload. Detail page: https://www.isobus.net/isobus/pGNAndSPN/12781?type=PGN. Signal-level enrichment via PR welcome  see CONTRIBUTING.md.";
CM_ SG_ 2566666240 Engine_Oil_Mist_Detection_Inform "Generic 8-byte raw payload. Detail page: https://www.isobus.net/isobus/pGNAndSPN/12789?type=PGN. Signal-level enrichment via PR welcome  see CONTRIBUTING.md.";
CM_ SG_ 2566666496 Gaseous_Fuel_Supply_Pressure_2_R "Generic 8-byte raw payload. Detail page: https://www.isobus.net/isobus/pGNAndSPN/12791?type=PGN. Signal-level enrichment via PR welcome  see CONTRIBUTING.md.";
CM_ SG_ 2566666752 Gaseous_Fuel_Supply_Pressure_1_R "Generic 8-byte raw payload. Detail page: https://www.isobus.net/isobus/pGNAndSPN/12795?type=PGN. Signal-level enrichment via PR welcome  see CONTRIBUTING.md.";
CM_ SG_ 2566667008 Engine_End_Bearing_Temperature_3 "Generic 8-byte raw payload. Detail page: https://www.isobus.net/isobus/pGNAndSPN/12799?type=PGN. Signal-level enrichment via PR welcome  see CONTRIBUTING.md.";
CM_ SG_ 2566667264 Engine_End_Bearing_Temperature_2 "Generic 8-byte raw payload. Detail page: https://www.isobus.net/isobus/pGNAndSPN/12807?type=PGN. Signal-level enrichment via PR welcome  see CONTRIBUTING.md.";
CM_ SG_ 2566667520 Engine_End_Bearing_Temperature_1 "Generic 8-byte raw payload. Detail page: https://www.isobus.net/isobus/pGNAndSPN/12815?type=PGN. Signal-level enrichment via PR welcome  see CONTRIBUTING.md.";
CM_ SG_ 2566667776 Heat_Exchanger_Debris_Purge_Info "Generic 8-byte raw payload. Detail page: https://www.isobus.net/isobus/pGNAndSPN/12817?type=PGN. Signal-level enrichment via PR welcome  see CONTRIBUTING.md.";
CM_ SG_ 2566668032 Engine_Turbocharger_Control_2_Ra "Generic 8-byte raw payload. Detail page: https://www.isobus.net/isobus/pGNAndSPN/12819?type=PGN. Signal-level enrichment via PR welcome  see CONTRIBUTING.md.";
CM_ SG_ 2566668288 Engine_Hydraulic_Fuel_2_Pump_Sta "Generic 8-byte raw payload. Detail page: https://www.isobus.net/isobus/pGNAndSPN/12823?type=PGN. Signal-level enrichment via PR welcome  see CONTRIBUTING.md.";
CM_ SG_ 2566668544 Alternate_Fuel_4_RawPayload "Generic 8-byte raw payload. Detail page: https://www.isobus.net/isobus/pGNAndSPN/12828?type=PGN. Signal-level enrichment via PR welcome  see CONTRIBUTING.md.";
CM_ SG_ 2566668800 Tire_Condition_Message_2_RawPayl "Generic 8-byte raw payload. Detail page: https://www.isobus.net/isobus/pGNAndSPN/12831?type=PGN. Signal-level enrichment via PR welcome  see CONTRIBUTING.md.";
CM_ SG_ 2566669056 Tire_Configuration_Status_Inform "Generic 8-byte raw payload. Detail page: https://www.isobus.net/isobus/pGNAndSPN/12837?type=PGN. Signal-level enrichment via PR welcome  see CONTRIBUTING.md.";
CM_ SG_ 2566669312 High_Voltage_Energy_Storage_Syst "Generic 8-byte raw payload. Detail page: https://www.isobus.net/isobus/pGNAndSPN/12839?type=PGN. Signal-level enrichment via PR welcome  see CONTRIBUTING.md.";
CM_ SG_ 2566669568 Tire_Wireless_Signal_Strength_In "Generic 8-byte raw payload. Detail page: https://www.isobus.net/isobus/pGNAndSPN/12845?type=PGN. Signal-level enrichment via PR welcome  see CONTRIBUTING.md.";
CM_ SG_ 2566669824 Tire_Sensor_Identification_Statu "Generic 8-byte raw payload. Detail page: https://www.isobus.net/isobus/pGNAndSPN/12849?type=PGN. Signal-level enrichment via PR welcome  see CONTRIBUTING.md.";
CM_ SG_ 2566670080 Monitored_Tire_Information_RawPa "Generic 8-byte raw payload. Detail page: https://www.isobus.net/isobus/pGNAndSPN/12863?type=PGN. Signal-level enrichment via PR welcome  see CONTRIBUTING.md.";
CM_ SG_ 2566670336 Aftertreatment_2_Historical_Info "Generic 8-byte raw payload. Detail page: https://www.isobus.net/isobus/pGNAndSPN/12869?type=PGN. Signal-level enrichment via PR welcome  see CONTRIBUTING.md.";
CM_ SG_ 2566670592 Aftertreatment_1_Historical_Info "Generic 8-byte raw payload. Detail page: https://www.isobus.net/isobus/pGNAndSPN/12876?type=PGN. Signal-level enrichment via PR welcome  see CONTRIBUTING.md.";
CM_ SG_ 2566670848 SCR_System_Cleaning_RawPayload "Generic 8-byte raw payload. Detail page: https://www.isobus.net/isobus/pGNAndSPN/12897?type=PGN. Signal-level enrichment via PR welcome  see CONTRIBUTING.md.";
CM_ SG_ 2566671104 Electronic_Engine_Controller_17_ "Generic 8-byte raw payload. Detail page: https://www.isobus.net/isobus/pGNAndSPN/12901?type=PGN. Signal-level enrichment via PR welcome  see CONTRIBUTING.md.";
CM_ SG_ 2566671360 SCR_Operator_Inducement_Informat "Generic 8-byte raw payload. Detail page: https://www.isobus.net/isobus/pGNAndSPN/12905?type=PGN. Signal-level enrichment via PR welcome  see CONTRIBUTING.md.";
CM_ SG_ 2566671616 Aftertreatment_2_SCR_Dosing_Syst "Generic 8-byte raw payload. Detail page: https://www.isobus.net/isobus/pGNAndSPN/12910?type=PGN. Signal-level enrichment via PR welcome  see CONTRIBUTING.md.";
CM_ SG_ 2566671872 Aftertreatment_1_SCR_Dosing_Syst "Generic 8-byte raw payload. Detail page: https://www.isobus.net/isobus/pGNAndSPN/12915?type=PGN. Signal-level enrichment via PR welcome  see CONTRIBUTING.md.";
CM_ SG_ 2566672128 Payload_Weight_Sensor_Informatio "Generic 8-byte raw payload. Detail page: https://www.isobus.net/isobus/pGNAndSPN/12923?type=PGN. Signal-level enrichment via PR welcome  see CONTRIBUTING.md.";
CM_ SG_ 2566672384 Payload_System_Status_RawPayload "Generic 8-byte raw payload. Detail page: https://www.isobus.net/isobus/pGNAndSPN/12928?type=PGN. Signal-level enrichment via PR welcome  see CONTRIBUTING.md.";
CM_ SG_ 2566672640 Air_Suspension_Control_7_RawPayl "Generic 8-byte raw payload. Detail page: https://www.isobus.net/isobus/pGNAndSPN/12932?type=PGN. Signal-level enrichment via PR welcome  see CONTRIBUTING.md.";
CM_ SG_ 2566672896 Bin_Weight_and_Lift_Count_RawPay "Generic 8-byte raw payload. Detail page: https://www.isobus.net/isobus/pGNAndSPN/12936?type=PGN. Signal-level enrichment via PR welcome  see CONTRIBUTING.md.";
CM_ SG_ 2566673152 Engine_Gaseous_Leakage_Informati "Generic 8-byte raw payload. Detail page: https://www.isobus.net/isobus/pGNAndSPN/12942?type=PGN. Signal-level enrichment via PR welcome  see CONTRIBUTING.md.";
CM_ SG_ 2566673408 Driving_and_Rest_Times_Driver_2_ "Generic 8-byte raw payload. Detail page: https://www.isobus.net/isobus/pGNAndSPN/12943?type=PGN. Signal-level enrichment via PR welcome  see CONTRIBUTING.md.";
CM_ SG_ 2566673664 Driving_and_Rest_Times_Driver_1_ "Generic 8-byte raw payload. Detail page: https://www.isobus.net/isobus/pGNAndSPN/12944?type=PGN. Signal-level enrichment via PR welcome  see CONTRIBUTING.md.";
CM_ SG_ 2566673920 SCR_Operator_Inducement_Informat "Generic 8-byte raw payload. Detail page: https://www.isobus.net/isobus/pGNAndSPN/12946?type=PGN. Signal-level enrichment via PR welcome  see CONTRIBUTING.md.";
CM_ SG_ 2566674176 SCR_Operator_Inducement_Informat "Generic 8-byte raw payload. Detail page: https://www.isobus.net/isobus/pGNAndSPN/12948?type=PGN. Signal-level enrichment via PR welcome  see CONTRIBUTING.md.";
CM_ SG_ 2566674432 Turbocharger_Information_7_RawPa "Generic 8-byte raw payload. Detail page: https://www.isobus.net/isobus/pGNAndSPN/12953?type=PGN. Signal-level enrichment via PR welcome  see CONTRIBUTING.md.";
CM_ SG_ 2566674688 Engine_Load_Sharing_Information_ "Generic 8-byte raw payload. Detail page: https://www.isobus.net/isobus/pGNAndSPN/12956?type=PGN. Signal-level enrichment via PR welcome  see CONTRIBUTING.md.";
CM_ SG_ 2566674944 Synchronized_Service_Distance_In "Generic 8-byte raw payload. Detail page: https://www.isobus.net/isobus/pGNAndSPN/12958?type=PGN. Signal-level enrichment via PR welcome  see CONTRIBUTING.md.";
CM_ SG_ 2566675200 Synchronized_Service_Delay_Opera "Generic 8-byte raw payload. Detail page: https://www.isobus.net/isobus/pGNAndSPN/12960?type=PGN. Signal-level enrichment via PR welcome  see CONTRIBUTING.md.";
CM_ SG_ 2566675456 Synchronized_Service_Delay_Calen "Generic 8-byte raw payload. Detail page: https://www.isobus.net/isobus/pGNAndSPN/12962?type=PGN. Signal-level enrichment via PR welcome  see CONTRIBUTING.md.";
CM_ SG_ 2566675712 High_Voltage_Energy_Storage_Syst "Generic 8-byte raw payload. Detail page: https://www.isobus.net/isobus/pGNAndSPN/12973?type=PGN. Signal-level enrichment via PR welcome  see CONTRIBUTING.md.";
CM_ SG_ 2566675968 High_Voltage_Energy_Storage_Syst "Generic 8-byte raw payload. Detail page: https://www.isobus.net/isobus/pGNAndSPN/12979?type=PGN. Signal-level enrichment via PR welcome  see CONTRIBUTING.md.";
CM_ SG_ 2566676224 Encoder_Position_RawPayload "Generic 8-byte raw payload. Detail page: https://www.isobus.net/isobus/pGNAndSPN/12980?type=PGN. Signal-level enrichment via PR welcome  see CONTRIBUTING.md.";
CM_ SG_ 2566676480 Encoder_High_Resolution_Position "Generic 8-byte raw payload. Detail page: https://www.isobus.net/isobus/pGNAndSPN/12981?type=PGN. Signal-level enrichment via PR welcome  see CONTRIBUTING.md.";
CM_ SG_ 2566676736 Encoder_Speed_RawPayload "Generic 8-byte raw payload. Detail page: https://www.isobus.net/isobus/pGNAndSPN/12982?type=PGN. Signal-level enrichment via PR welcome  see CONTRIBUTING.md.";
CM_ SG_ 2566676992 Encoder_Acceleration_RawPayload "Generic 8-byte raw payload. Detail page: https://www.isobus.net/isobus/pGNAndSPN/12983?type=PGN. Signal-level enrichment via PR welcome  see CONTRIBUTING.md.";
CM_ SG_ 2566677248 Encoder_Position_with_Speed_and_ "Generic 8-byte raw payload. Detail page: https://www.isobus.net/isobus/pGNAndSPN/12984?type=PGN. Signal-level enrichment via PR welcome  see CONTRIBUTING.md.";
CM_ SG_ 2566677504 Inclinometer_Slope_Longitudinal_ "Generic 8-byte raw payload. Detail page: https://www.isobus.net/isobus/pGNAndSPN/12985?type=PGN. Signal-level enrichment via PR welcome  see CONTRIBUTING.md.";
CM_ SG_ 2566677760 Inclinometer_Slope_Longitudinal_ "Generic 8-byte raw payload. Detail page: https://www.isobus.net/isobus/pGNAndSPN/12986?type=PGN. Signal-level enrichment via PR welcome  see CONTRIBUTING.md.";
CM_ SG_ 2566678016 Inclinometer_Slope_Lateral_16_bi "Generic 8-byte raw payload. Detail page: https://www.isobus.net/isobus/pGNAndSPN/12987?type=PGN. Signal-level enrichment via PR welcome  see CONTRIBUTING.md.";
CM_ SG_ 2566678272 Inclinometer_Slope_Lateral_32_bi "Generic 8-byte raw payload. Detail page: https://www.isobus.net/isobus/pGNAndSPN/12988?type=PGN. Signal-level enrichment via PR welcome  see CONTRIBUTING.md.";
CM_ SG_ 2566678528 CANopen_Emergency_Message_RawPay "Generic 8-byte raw payload. Detail page: https://www.isobus.net/isobus/pGNAndSPN/12989?type=PGN. Signal-level enrichment via PR welcome  see CONTRIBUTING.md.";
CM_ SG_ 2566678784 EV_Operator_Indicators_1_RawPayl "Generic 8-byte raw payload. Detail page: https://www.isobus.net/isobus/pGNAndSPN/12990?type=PGN. Signal-level enrichment via PR welcome  see CONTRIBUTING.md.";
CM_ SG_ 2566679040 System_Identification_RawPayload "Generic 8-byte raw payload. Detail page: https://www.isobus.net/isobus/pGNAndSPN/12994?type=PGN. Signal-level enrichment via PR welcome  see CONTRIBUTING.md.";
CM_ SG_ 2566679296 Engine_Maximum_Net_Torque_Map_ob "Generic 8-byte raw payload. Detail page: https://www.isobus.net/isobus/pGNAndSPN/12995?type=PGN. Signal-level enrichment via PR welcome  see CONTRIBUTING.md.";
CM_ SG_ 2566679552 Alarm_RawPayload "Generic 8-byte raw payload. Detail page: https://www.isobus.net/isobus/pGNAndSPN/12996?type=PGN. Signal-level enrichment via PR welcome  see CONTRIBUTING.md.";
CM_ SG_ 2566679808 Acoustic_Warning_Request_RawPayl "Generic 8-byte raw payload. Detail page: https://www.isobus.net/isobus/pGNAndSPN/12997?type=PGN. Signal-level enrichment via PR welcome  see CONTRIBUTING.md.";
CM_ SG_ 2566680064 Acoustic_Warning_State_RawPayloa "Generic 8-byte raw payload. Detail page: https://www.isobus.net/isobus/pGNAndSPN/12998?type=PGN. Signal-level enrichment via PR welcome  see CONTRIBUTING.md.";
CM_ SG_ 2566680320 Vehicle_Load_RawPayload "Generic 8-byte raw payload. Detail page: https://www.isobus.net/isobus/pGNAndSPN/12999?type=PGN. Signal-level enrichment via PR welcome  see CONTRIBUTING.md.";
CM_ SG_ 2566680576 Body_Application_Unit_1_RawPaylo "Generic 8-byte raw payload. Detail page: https://www.isobus.net/isobus/pGNAndSPN/13000?type=PGN. Signal-level enrichment via PR welcome  see CONTRIBUTING.md.";
CM_ SG_ 2566680832 Body_Application_Unit_2_RawPaylo "Generic 8-byte raw payload. Detail page: https://www.isobus.net/isobus/pGNAndSPN/13001?type=PGN. Signal-level enrichment via PR welcome  see CONTRIBUTING.md.";
CM_ SG_ 2566681088 Body_Application_Unit_3_RawPaylo "Generic 8-byte raw payload. Detail page: https://www.isobus.net/isobus/pGNAndSPN/13002?type=PGN. Signal-level enrichment via PR welcome  see CONTRIBUTING.md.";
CM_ SG_ 2566681344 Body_Application_Unit_4_RawPaylo "Generic 8-byte raw payload. Detail page: https://www.isobus.net/isobus/pGNAndSPN/13003?type=PGN. Signal-level enrichment via PR welcome  see CONTRIBUTING.md.";
CM_ SG_ 2566681600 Body_Application_Unit_5_RawPaylo "Generic 8-byte raw payload. Detail page: https://www.isobus.net/isobus/pGNAndSPN/13004?type=PGN. Signal-level enrichment via PR welcome  see CONTRIBUTING.md.";
CM_ SG_ 2566681856 Body_Application_Unit_6_RawPaylo "Generic 8-byte raw payload. Detail page: https://www.isobus.net/isobus/pGNAndSPN/13005?type=PGN. Signal-level enrichment via PR welcome  see CONTRIBUTING.md.";
CM_ SG_ 2566682112 Body_Application_Unit_7_RawPaylo "Generic 8-byte raw payload. Detail page: https://www.isobus.net/isobus/pGNAndSPN/13006?type=PGN. Signal-level enrichment via PR welcome  see CONTRIBUTING.md.";
CM_ SG_ 2566682368 Body_Application_Unit_8_RawPaylo "Generic 8-byte raw payload. Detail page: https://www.isobus.net/isobus/pGNAndSPN/13007?type=PGN. Signal-level enrichment via PR welcome  see CONTRIBUTING.md.";
CM_ SG_ 2566682624 Electronic_Control_Unit_RawPaylo "Generic 8-byte raw payload. Detail page: https://www.isobus.net/isobus/pGNAndSPN/13008?type=PGN. Signal-level enrichment via PR welcome  see CONTRIBUTING.md.";
CM_ SG_ 2566682880 ECU_Power_Supply_RawPayload "Generic 8-byte raw payload. Detail page: https://www.isobus.net/isobus/pGNAndSPN/13009?type=PGN. Signal-level enrichment via PR welcome  see CONTRIBUTING.md.";
CM_ SG_ 2566683136 ECU_Temperature_RawPayload "Generic 8-byte raw payload. Detail page: https://www.isobus.net/isobus/pGNAndSPN/13010?type=PGN. Signal-level enrichment via PR welcome  see CONTRIBUTING.md.";
CM_ SG_ 2566683392 Error_RawPayload "Generic 8-byte raw payload. Detail page: https://www.isobus.net/isobus/pGNAndSPN/13011?type=PGN. Signal-level enrichment via PR welcome  see CONTRIBUTING.md.";
CM_ SG_ 2566683648 Heating_And_Refrigerating_Unit_1 "Generic 8-byte raw payload. Detail page: https://www.isobus.net/isobus/pGNAndSPN/13012?type=PGN. Signal-level enrichment via PR welcome  see CONTRIBUTING.md.";
CM_ SG_ 2566683904 Heating_And_Refrigerating_Unit_2 "Generic 8-byte raw payload. Detail page: https://www.isobus.net/isobus/pGNAndSPN/13013?type=PGN. Signal-level enrichment via PR welcome  see CONTRIBUTING.md.";
CM_ SG_ 2566684160 Heating_And_Refrigerating_Unit_3 "Generic 8-byte raw payload. Detail page: https://www.isobus.net/isobus/pGNAndSPN/13014?type=PGN. Signal-level enrichment via PR welcome  see CONTRIBUTING.md.";
CM_ SG_ 2566684416 Heating_And_Refrigerating_Unit_4 "Generic 8-byte raw payload. Detail page: https://www.isobus.net/isobus/pGNAndSPN/13015?type=PGN. Signal-level enrichment via PR welcome  see CONTRIBUTING.md.";
CM_ SG_ 2566684672 HRU_Temperature_Setpoint_RawPayl "Generic 8-byte raw payload. Detail page: https://www.isobus.net/isobus/pGNAndSPN/13016?type=PGN. Signal-level enrichment via PR welcome  see CONTRIBUTING.md.";
CM_ SG_ 2566684928 Lifting_Unit_1_RawPayload "Generic 8-byte raw payload. Detail page: https://www.isobus.net/isobus/pGNAndSPN/13017?type=PGN. Signal-level enrichment via PR welcome  see CONTRIBUTING.md.";
CM_ SG_ 2566685184 Tail_Lift_Unit_1_RawPayload "Generic 8-byte raw payload. Detail page: https://www.isobus.net/isobus/pGNAndSPN/13018?type=PGN. Signal-level enrichment via PR welcome  see CONTRIBUTING.md.";
CM_ SG_ 2566685440 Vehicle_Status_RawPayload "Generic 8-byte raw payload. Detail page: https://www.isobus.net/isobus/pGNAndSPN/13019?type=PGN. Signal-level enrichment via PR welcome  see CONTRIBUTING.md.";
CM_ SG_ 2566685696 Windshield_Wiper_Request_RawPayl "Generic 8-byte raw payload. Detail page: https://www.isobus.net/isobus/pGNAndSPN/13020?type=PGN. Signal-level enrichment via PR welcome  see CONTRIBUTING.md.";
CM_ SG_ 2566685952 Fuel_Cell_Auxiliary_Heater_Contr "Generic 8-byte raw payload. Detail page: https://www.isobus.net/isobus/pGNAndSPN/13023?type=PGN. Signal-level enrichment via PR welcome  see CONTRIBUTING.md.";
CM_ SG_ 2566686208 Fuel_Cell_Auxiliary_Heater_Infor "Generic 8-byte raw payload. Detail page: https://www.isobus.net/isobus/pGNAndSPN/13028?type=PGN. Signal-level enrichment via PR welcome  see CONTRIBUTING.md.";
CM_ SG_ 2566686464 Fuel_Cell_Coolant_Pump_1_Command "Generic 8-byte raw payload. Detail page: https://www.isobus.net/isobus/pGNAndSPN/13031?type=PGN. Signal-level enrichment via PR welcome  see CONTRIBUTING.md.";
CM_ SG_ 2566686720 Fuel_Cell_Coolant_Pump_2_Command "Generic 8-byte raw payload. Detail page: https://www.isobus.net/isobus/pGNAndSPN/13034?type=PGN. Signal-level enrichment via PR welcome  see CONTRIBUTING.md.";
CM_ SG_ 2566686976 Fuel_Cell_Coolant_Pump_1_Status_ "Generic 8-byte raw payload. Detail page: https://www.isobus.net/isobus/pGNAndSPN/13038?type=PGN. Signal-level enrichment via PR welcome  see CONTRIBUTING.md.";
CM_ SG_ 2566687232 Fuel_Cell_Coolant_Pump_2_Status_ "Generic 8-byte raw payload. Detail page: https://www.isobus.net/isobus/pGNAndSPN/13042?type=PGN. Signal-level enrichment via PR welcome  see CONTRIBUTING.md.";
CM_ SG_ 2566687488 Aftertreatment_1_Particulate_Sen "Generic 8-byte raw payload. Detail page: https://www.isobus.net/isobus/pGNAndSPN/13048?type=PGN. Signal-level enrichment via PR welcome  see CONTRIBUTING.md.";
CM_ SG_ 2566687744 Aftertreatment_1_Particulate_Sen "Generic 8-byte raw payload. Detail page: https://www.isobus.net/isobus/pGNAndSPN/13054?type=PGN. Signal-level enrichment via PR welcome  see CONTRIBUTING.md.";
CM_ SG_ 2566688512 Alternate_Fuel_3_RawPayload "Generic 8-byte raw payload. Detail page: https://www.isobus.net/isobus/pGNAndSPN/13067?type=PGN. Signal-level enrichment via PR welcome  see CONTRIBUTING.md.";
CM_ SG_ 2566688768 Engine_Fuel_Injector_Metering_Ra "Generic 8-byte raw payload. Detail page: https://www.isobus.net/isobus/pGNAndSPN/13071?type=PGN. Signal-level enrichment via PR welcome  see CONTRIBUTING.md.";
CM_ SG_ 2566689024 Engine_Exhaust_NOx_RawPayload "Generic 8-byte raw payload. Detail page: https://www.isobus.net/isobus/pGNAndSPN/13074?type=PGN. Signal-level enrichment via PR welcome  see CONTRIBUTING.md.";
CM_ SG_ 2566689280 Air_Fuel_Ratio_1_RawPayload "Generic 8-byte raw payload. Detail page: https://www.isobus.net/isobus/pGNAndSPN/13078?type=PGN. Signal-level enrichment via PR welcome  see CONTRIBUTING.md.";
CM_ SG_ 2566689536 Gaseous_Fuel_Pressure_2_RawPaylo "Generic 8-byte raw payload. Detail page: https://www.isobus.net/isobus/pGNAndSPN/13082?type=PGN. Signal-level enrichment via PR welcome  see CONTRIBUTING.md.";
CM_ SG_ 2566689792 Aftertreatment_System_Abuse_Info "Generic 8-byte raw payload. Detail page: https://www.isobus.net/isobus/pGNAndSPN/13089?type=PGN. Signal-level enrichment via PR welcome  see CONTRIBUTING.md.";
CM_ SG_ 2566690048 Engine_Cylinder_Pressure_Monitor "Generic 8-byte raw payload. Detail page: https://www.isobus.net/isobus/pGNAndSPN/13091?type=PGN. Signal-level enrichment via PR welcome  see CONTRIBUTING.md.";
CM_ SG_ 2566690304 Engine_Information_2_RawPayload "Generic 8-byte raw payload. Detail page: https://www.isobus.net/isobus/pGNAndSPN/13096?type=PGN. Signal-level enrichment via PR welcome  see CONTRIBUTING.md.";
CM_ SG_ 2566690560 Electronic_Steering_Control_2_Ra "Generic 8-byte raw payload. Detail page: https://www.isobus.net/isobus/pGNAndSPN/13108?type=PGN. Signal-level enrichment via PR welcome  see CONTRIBUTING.md.";
CM_ SG_ 2566690816 Vehicle_Speed_Limiter_RawPayload "Generic 8-byte raw payload. Detail page: https://www.isobus.net/isobus/pGNAndSPN/13113?type=PGN. Signal-level enrichment via PR welcome  see CONTRIBUTING.md.";
CM_ SG_ 2566691072 Assembly_Unit_Identification_Raw "Generic 8-byte raw payload. Detail page: https://www.isobus.net/isobus/pGNAndSPN/13115?type=PGN. Signal-level enrichment via PR welcome  see CONTRIBUTING.md.";
CM_ SG_ 2566691328 Joystick_3_Lamp_Status_RawPayloa "Generic 8-byte raw payload. Detail page: https://www.isobus.net/isobus/pGNAndSPN/13125?type=PGN. Signal-level enrichment via PR welcome  see CONTRIBUTING.md.";
CM_ SG_ 2566691584 Joystick_2_Lamp_Status_RawPayloa "Generic 8-byte raw payload. Detail page: https://www.isobus.net/isobus/pGNAndSPN/13135?type=PGN. Signal-level enrichment via PR welcome  see CONTRIBUTING.md.";
CM_ SG_ 2566691840 Joystick_1_Lamp_Status_RawPayloa "Generic 8-byte raw payload. Detail page: https://www.isobus.net/isobus/pGNAndSPN/13145?type=PGN. Signal-level enrichment via PR welcome  see CONTRIBUTING.md.";
CM_ SG_ 2566692096 Engine_Timing_Actuator_Position_ "Generic 8-byte raw payload. Detail page: https://www.isobus.net/isobus/pGNAndSPN/13147?type=PGN. Signal-level enrichment via PR welcome  see CONTRIBUTING.md.";
CM_ SG_ 2566692352 Engine_Timing_Actuator_Position_ "Generic 8-byte raw payload. Detail page: https://www.isobus.net/isobus/pGNAndSPN/13151?type=PGN. Signal-level enrichment via PR welcome  see CONTRIBUTING.md.";
CM_ SG_ 2566692608 Dash_Display_2_RawPayload "Generic 8-byte raw payload. Detail page: https://www.isobus.net/isobus/pGNAndSPN/13158?type=PGN. Signal-level enrichment via PR welcome  see CONTRIBUTING.md.";
CM_ SG_ 2566692864 Multi_fuel_Engine_Hours_RawPaylo "Generic 8-byte raw payload. Detail page: https://www.isobus.net/isobus/pGNAndSPN/13160?type=PGN. Signal-level enrichment via PR welcome  see CONTRIBUTING.md.";
CM_ SG_ 2566693120 Engine_Spark_Misfire_Rate_3_RawP "Generic 8-byte raw payload. Detail page: https://www.isobus.net/isobus/pGNAndSPN/13168?type=PGN. Signal-level enrichment via PR welcome  see CONTRIBUTING.md.";
CM_ SG_ 2566693376 Engine_Spark_Misfire_Rate_2_RawP "Generic 8-byte raw payload. Detail page: https://www.isobus.net/isobus/pGNAndSPN/13176?type=PGN. Signal-level enrichment via PR welcome  see CONTRIBUTING.md.";
CM_ SG_ 2566693632 Engine_Spark_Misfire_Rate_1_RawP "Generic 8-byte raw payload. Detail page: https://www.isobus.net/isobus/pGNAndSPN/13184?type=PGN. Signal-level enrichment via PR welcome  see CONTRIBUTING.md.";
CM_ SG_ 2566693888 Engine_Spark_Maximum_Voltage_6_R "Generic 8-byte raw payload. Detail page: https://www.isobus.net/isobus/pGNAndSPN/13188?type=PGN. Signal-level enrichment via PR welcome  see CONTRIBUTING.md.";
CM_ SG_ 2566694144 Engine_Spark_Maximum_Voltage_5_R "Generic 8-byte raw payload. Detail page: https://www.isobus.net/isobus/pGNAndSPN/13192?type=PGN. Signal-level enrichment via PR welcome  see CONTRIBUTING.md.";
CM_ SG_ 2566694400 Engine_Spark_Maximum_Voltage_4_R "Generic 8-byte raw payload. Detail page: https://www.isobus.net/isobus/pGNAndSPN/13196?type=PGN. Signal-level enrichment via PR welcome  see CONTRIBUTING.md.";
CM_ SG_ 2566694656 Engine_Spark_Maximum_Voltage_3_R "Generic 8-byte raw payload. Detail page: https://www.isobus.net/isobus/pGNAndSPN/13200?type=PGN. Signal-level enrichment via PR welcome  see CONTRIBUTING.md.";
CM_ SG_ 2566694912 Engine_Spark_Maximum_Voltage_2_R "Generic 8-byte raw payload. Detail page: https://www.isobus.net/isobus/pGNAndSPN/13204?type=PGN. Signal-level enrichment via PR welcome  see CONTRIBUTING.md.";
CM_ SG_ 2566695168 Engine_Spark_Maximum_Voltage_1_R "Generic 8-byte raw payload. Detail page: https://www.isobus.net/isobus/pGNAndSPN/13208?type=PGN. Signal-level enrichment via PR welcome  see CONTRIBUTING.md.";
CM_ SG_ 2566695424 Engine_Spark_Minimum_Voltage_6_R "Generic 8-byte raw payload. Detail page: https://www.isobus.net/isobus/pGNAndSPN/13212?type=PGN. Signal-level enrichment via PR welcome  see CONTRIBUTING.md.";
CM_ SG_ 2566695680 Engine_Spark_Minimum_Voltage_5_R "Generic 8-byte raw payload. Detail page: https://www.isobus.net/isobus/pGNAndSPN/13216?type=PGN. Signal-level enrichment via PR welcome  see CONTRIBUTING.md.";
CM_ SG_ 2566695936 Engine_Spark_Minimum_Voltage_4_R "Generic 8-byte raw payload. Detail page: https://www.isobus.net/isobus/pGNAndSPN/13220?type=PGN. Signal-level enrichment via PR welcome  see CONTRIBUTING.md.";
CM_ SG_ 2566696192 Engine_Spark_Minimum_Voltage_3_R "Generic 8-byte raw payload. Detail page: https://www.isobus.net/isobus/pGNAndSPN/13224?type=PGN. Signal-level enrichment via PR welcome  see CONTRIBUTING.md.";
CM_ SG_ 2566696448 Engine_Spark_Minimum_Voltage_2_R "Generic 8-byte raw payload. Detail page: https://www.isobus.net/isobus/pGNAndSPN/13228?type=PGN. Signal-level enrichment via PR welcome  see CONTRIBUTING.md.";
CM_ SG_ 2566696704 Engine_Spark_Minimum_Voltage_1_R "Generic 8-byte raw payload. Detail page: https://www.isobus.net/isobus/pGNAndSPN/13232?type=PGN. Signal-level enrichment via PR welcome  see CONTRIBUTING.md.";
CM_ SG_ 2566696960 Engine_Ignition_Controller_Maint "Generic 8-byte raw payload. Detail page: https://www.isobus.net/isobus/pGNAndSPN/13234?type=PGN. Signal-level enrichment via PR welcome  see CONTRIBUTING.md.";
CM_ SG_ 2566697216 Engine_Ignition_Control_Module_S "Generic 8-byte raw payload. Detail page: https://www.isobus.net/isobus/pGNAndSPN/13238?type=PGN. Signal-level enrichment via PR welcome  see CONTRIBUTING.md.";
CM_ SG_ 2566697728 Fused_Power_Output_Current_RawPa "Generic 8-byte raw payload. Detail page: https://www.isobus.net/isobus/pGNAndSPN/13302?type=PGN. Signal-level enrichment via PR welcome  see CONTRIBUTING.md.";
CM_ SG_ 2566697984 Switched_Power_Output_Status_Raw "Generic 8-byte raw payload. Detail page: https://www.isobus.net/isobus/pGNAndSPN/13334?type=PGN. Signal-level enrichment via PR welcome  see CONTRIBUTING.md.";
CM_ SG_ 2566698240 Fused_Power_Output_Status_RawPay "Generic 8-byte raw payload. Detail page: https://www.isobus.net/isobus/pGNAndSPN/13366?type=PGN. Signal-level enrichment via PR welcome  see CONTRIBUTING.md.";
CM_ SG_ 2566698496 Vehicle_Electrical_Power_5_RawPa "Generic 8-byte raw payload. Detail page: https://www.isobus.net/isobus/pGNAndSPN/13370?type=PGN. Signal-level enrichment via PR welcome  see CONTRIBUTING.md.";
CM_ SG_ 2566698752 Hybrid_or_EV_System_Status_2_Raw "Generic 8-byte raw payload. Detail page: https://www.isobus.net/isobus/pGNAndSPN/13376?type=PGN. Signal-level enrichment via PR welcome  see CONTRIBUTING.md.";
CM_ SG_ 2566699008 Aftertreatment_2_Service_2_RawPa "Generic 8-byte raw payload. Detail page: https://www.isobus.net/isobus/pGNAndSPN/13378?type=PGN. Signal-level enrichment via PR welcome  see CONTRIBUTING.md.";
CM_ SG_ 2566699264 Aftertreatment_1_Service_2_RawPa "Generic 8-byte raw payload. Detail page: https://www.isobus.net/isobus/pGNAndSPN/13380?type=PGN. Signal-level enrichment via PR welcome  see CONTRIBUTING.md.";
CM_ SG_ 2566699520 Aftertreatment_2_SCR_Electronic_ "Generic 8-byte raw payload. Detail page: https://www.isobus.net/isobus/pGNAndSPN/13387?type=PGN. Signal-level enrichment via PR welcome  see CONTRIBUTING.md.";
CM_ SG_ 2566699776 Aftertreatment_1_SCR_Electronic_ "Generic 8-byte raw payload. Detail page: https://www.isobus.net/isobus/pGNAndSPN/13394?type=PGN. Signal-level enrichment via PR welcome  see CONTRIBUTING.md.";
CM_ SG_ 2566700032 Aftertreatment_2_SCR_Service_Inf "Generic 8-byte raw payload. Detail page: https://www.isobus.net/isobus/pGNAndSPN/13395?type=PGN. Signal-level enrichment via PR welcome  see CONTRIBUTING.md.";
CM_ SG_ 2566700288 Aftertreatment_1_SCR_Service_Inf "Generic 8-byte raw payload. Detail page: https://www.isobus.net/isobus/pGNAndSPN/13397?type=PGN. Signal-level enrichment via PR welcome  see CONTRIBUTING.md.";
CM_ SG_ 2566700544 Electronic_Transmission_Controll "Generic 8-byte raw payload. Detail page: https://www.isobus.net/isobus/pGNAndSPN/13401?type=PGN. Signal-level enrichment via PR welcome  see CONTRIBUTING.md.";
CM_ SG_ 2566700800 Electronic_Transmission_Controll "Generic 8-byte raw payload. Detail page: https://www.isobus.net/isobus/pGNAndSPN/13415?type=PGN. Signal-level enrichment via PR welcome  see CONTRIBUTING.md.";
CM_ SG_ 2566701056 Electronic_Transmission_Controll "Generic 8-byte raw payload. Detail page: https://www.isobus.net/isobus/pGNAndSPN/13421?type=PGN. Signal-level enrichment via PR welcome  see CONTRIBUTING.md.";
CM_ SG_ 2566701312 Transmission_Fluids_3_RawPayload "Generic 8-byte raw payload. Detail page: https://www.isobus.net/isobus/pGNAndSPN/13425?type=PGN. Signal-level enrichment via PR welcome  see CONTRIBUTING.md.";
CM_ SG_ 2566701568 Hybrid_or_EV_System_Status_1_Raw "Generic 8-byte raw payload. Detail page: https://www.isobus.net/isobus/pGNAndSPN/13446?type=PGN. Signal-level enrichment via PR welcome  see CONTRIBUTING.md.";
CM_ SG_ 2566701824 Fuel_Information_4_Gaseous_RawPa "Generic 8-byte raw payload. Detail page: https://www.isobus.net/isobus/pGNAndSPN/13448?type=PGN. Signal-level enrichment via PR welcome  see CONTRIBUTING.md.";
CM_ SG_ 2566702080 Aftertreatment_2_SCR_Exhaust_Gas "Generic 8-byte raw payload. Detail page: https://www.isobus.net/isobus/pGNAndSPN/13450?type=PGN. Signal-level enrichment via PR welcome  see CONTRIBUTING.md.";
CM_ SG_ 2566702336 Aftertreatment_1_SCR_Exhaust_Gas "Generic 8-byte raw payload. Detail page: https://www.isobus.net/isobus/pGNAndSPN/13452?type=PGN. Signal-level enrichment via PR welcome  see CONTRIBUTING.md.";
CM_ SG_ 2566702592 OBD_Information_RawPayload "Generic 8-byte raw payload. Detail page: https://www.isobus.net/isobus/pGNAndSPN/13453?type=PGN. Signal-level enrichment via PR welcome  see CONTRIBUTING.md.";
CM_ SG_ 2566702848 Model_Year_and_Certification_Eng "Generic 8-byte raw payload. Detail page: https://www.isobus.net/isobus/pGNAndSPN/13455?type=PGN. Signal-level enrichment via PR welcome  see CONTRIBUTING.md.";
CM_ SG_ 2566703104 Electronic_Engine_Controller_13_ "Generic 8-byte raw payload. Detail page: https://www.isobus.net/isobus/pGNAndSPN/13468?type=PGN. Signal-level enrichment via PR welcome  see CONTRIBUTING.md.";
CM_ SG_ 2566703360 Engine_Fuel_Throttle_Valve_Infor "Generic 8-byte raw payload. Detail page: https://www.isobus.net/isobus/pGNAndSPN/13475?type=PGN. Signal-level enrichment via PR welcome  see CONTRIBUTING.md.";
CM_ SG_ 2566703616 Engine_Exhaust_Gas_Recirculation "Generic 8-byte raw payload. Detail page: https://www.isobus.net/isobus/pGNAndSPN/13485?type=PGN. Signal-level enrichment via PR welcome  see CONTRIBUTING.md.";
CM_ SG_ 2566703872 Engine_Exhaust_Gas_Recirculation "Generic 8-byte raw payload. Detail page: https://www.isobus.net/isobus/pGNAndSPN/13495?type=PGN. Signal-level enrichment via PR welcome  see CONTRIBUTING.md.";
CM_ SG_ 2566704128 Electronic_Engine_Controller_12_ "Generic 8-byte raw payload. Detail page: https://www.isobus.net/isobus/pGNAndSPN/13501?type=PGN. Signal-level enrichment via PR welcome  see CONTRIBUTING.md.";
CM_ SG_ 2566704384 Drive_Strategy_Status_RawPayload "Generic 8-byte raw payload. Detail page: https://www.isobus.net/isobus/pGNAndSPN/13507?type=PGN. Signal-level enrichment via PR welcome  see CONTRIBUTING.md.";
CM_ SG_ 2566704640 Drive_Strategy_command_RawPayloa "Generic 8-byte raw payload. Detail page: https://www.isobus.net/isobus/pGNAndSPN/13512?type=PGN. Signal-level enrichment via PR welcome  see CONTRIBUTING.md.";
CM_ SG_ 2566704896 NOx_Sensor_Self_Diagnosis_Reques "Generic 8-byte raw payload. Detail page: https://www.isobus.net/isobus/pGNAndSPN/13516?type=PGN. Signal-level enrichment via PR welcome  see CONTRIBUTING.md.";
CM_ SG_ 2566705152 Engine_Particulate_Sensor_Inform "Generic 8-byte raw payload. Detail page: https://www.isobus.net/isobus/pGNAndSPN/13519?type=PGN. Signal-level enrichment via PR welcome  see CONTRIBUTING.md.";
CM_ SG_ 2566705408 Active_Service_Only_DTCs_RawPayl "Generic 8-byte raw payload. Detail page: https://www.isobus.net/isobus/pGNAndSPN/13531?type=PGN. Signal-level enrichment via PR welcome  see CONTRIBUTING.md.";
CM_ SG_ 2566705664 Previously_Active_Service_Only_D "Generic 8-byte raw payload. Detail page: https://www.isobus.net/isobus/pGNAndSPN/13543?type=PGN. Signal-level enrichment via PR welcome  see CONTRIBUTING.md.";
CM_ SG_ 2566705920 Diagnostic_Data_Clear_Reset_for_ "Generic 8-byte raw payload. Detail page: https://www.isobus.net/isobus/pGNAndSPN/13544?type=PGN. Signal-level enrichment via PR welcome  see CONTRIBUTING.md.";
CM_ SG_ 2566706176 XCP_Get_Slave_ID_RawPayload "Generic 8-byte raw payload. Detail page: https://www.isobus.net/isobus/pGNAndSPN/13545?type=PGN. Signal-level enrichment via PR welcome  see CONTRIBUTING.md.";
CM_ SG_ 2566706432 Aftertreatment_1_Diesel_Exhaust_ "Generic 8-byte raw payload. Detail page: https://www.isobus.net/isobus/pGNAndSPN/13552?type=PGN. Signal-level enrichment via PR welcome  see CONTRIBUTING.md.";
CM_ SG_ 2566706688 Aftertreatment_1_Diesel_Particul "Generic 8-byte raw payload. Detail page: https://www.isobus.net/isobus/pGNAndSPN/13556?type=PGN. Signal-level enrichment via PR welcome  see CONTRIBUTING.md.";
CM_ SG_ 2566706944 Aftertreatment_1_Diesel_Particul "Generic 8-byte raw payload. Detail page: https://www.isobus.net/isobus/pGNAndSPN/13560?type=PGN. Signal-level enrichment via PR welcome  see CONTRIBUTING.md.";
CM_ SG_ 2566707200 Aftertreatment_1_Diesel_Particul "Generic 8-byte raw payload. Detail page: https://www.isobus.net/isobus/pGNAndSPN/13564?type=PGN. Signal-level enrichment via PR welcome  see CONTRIBUTING.md.";
CM_ SG_ 2566707456 Aftertreatment_1_Diesel_Particul "Generic 8-byte raw payload. Detail page: https://www.isobus.net/isobus/pGNAndSPN/13568?type=PGN. Signal-level enrichment via PR welcome  see CONTRIBUTING.md.";
CM_ SG_ 2566707712 Aftertreatment_1_Diesel_Particul "Generic 8-byte raw payload. Detail page: https://www.isobus.net/isobus/pGNAndSPN/13572?type=PGN. Signal-level enrichment via PR welcome  see CONTRIBUTING.md.";
CM_ SG_ 2566707968 Aftertreatment_1_Diesel_Particul "Generic 8-byte raw payload. Detail page: https://www.isobus.net/isobus/pGNAndSPN/13576?type=PGN. Signal-level enrichment via PR welcome  see CONTRIBUTING.md.";
CM_ SG_ 2566708224 Cruise_Control_Vehicle_Speed_3_R "Generic 8-byte raw payload. Detail page: https://www.isobus.net/isobus/pGNAndSPN/13587?type=PGN. Signal-level enrichment via PR welcome  see CONTRIBUTING.md.";
CM_ SG_ 2566708480 Aftertreatment_2_Air_Control_3_R "Generic 8-byte raw payload. Detail page: https://www.isobus.net/isobus/pGNAndSPN/13588?type=PGN. Signal-level enrichment via PR welcome  see CONTRIBUTING.md.";
CM_ SG_ 2566708736 Aftertreatment_1_Air_Control_3_R "Generic 8-byte raw payload. Detail page: https://www.isobus.net/isobus/pGNAndSPN/13590?type=PGN. Signal-level enrichment via PR welcome  see CONTRIBUTING.md.";
CM_ SG_ 2566708992 Engine_Fluid_Level_Pressure_12_R "Generic 8-byte raw payload. Detail page: https://www.isobus.net/isobus/pGNAndSPN/13597?type=PGN. Signal-level enrichment via PR welcome  see CONTRIBUTING.md.";
CM_ SG_ 2566709248 Diesel_Particulate_Filter_Contro "Generic 8-byte raw payload. Detail page: https://www.isobus.net/isobus/pGNAndSPN/13601?type=PGN. Signal-level enrichment via PR welcome  see CONTRIBUTING.md.";
CM_ SG_ 2566709504 Fuel_Economy_2_Liquid_RawPayload "Generic 8-byte raw payload. Detail page: https://www.isobus.net/isobus/pGNAndSPN/13603?type=PGN. Signal-level enrichment via PR welcome  see CONTRIBUTING.md.";
CM_ SG_ 2566709760 Supplemental_Fan_Status_RawPaylo "Generic 8-byte raw payload. Detail page: https://www.isobus.net/isobus/pGNAndSPN/13612?type=PGN. Signal-level enrichment via PR welcome  see CONTRIBUTING.md.";
CM_ SG_ 2566710016 Engine_Exhaust_Brake_Control_Raw "Generic 8-byte raw payload. Detail page: https://www.isobus.net/isobus/pGNAndSPN/13617?type=PGN. Signal-level enrichment via PR welcome  see CONTRIBUTING.md.";
CM_ SG_ 2566710272 Engine_Fuel_Properties_RawPayloa "Generic 8-byte raw payload. Detail page: https://www.isobus.net/isobus/pGNAndSPN/13621?type=PGN. Signal-level enrichment via PR welcome  see CONTRIBUTING.md.";
CM_ SG_ 2566710528 Hydraulic_Oil_Properties_RawPayl "Generic 8-byte raw payload. Detail page: https://www.isobus.net/isobus/pGNAndSPN/13625?type=PGN. Signal-level enrichment via PR welcome  see CONTRIBUTING.md.";
CM_ SG_ 2566710784 Vehicle_Chassis_Lubrication_Syst "Generic 8-byte raw payload. Detail page: https://www.isobus.net/isobus/pGNAndSPN/13631?type=PGN. Signal-level enrichment via PR welcome  see CONTRIBUTING.md.";
CM_ SG_ 2566711040 Engine_Configuration_3_RawPayloa "Generic 8-byte raw payload. Detail page: https://www.isobus.net/isobus/pGNAndSPN/13638?type=PGN. Signal-level enrichment via PR welcome  see CONTRIBUTING.md.";
CM_ SG_ 2566711296 Intake_Valve_Actuation_Control_R "Generic 8-byte raw payload. Detail page: https://www.isobus.net/isobus/pGNAndSPN/13640?type=PGN. Signal-level enrichment via PR welcome  see CONTRIBUTING.md.";
CM_ SG_ 2566711552 Armrest_Switch_Matrix_Commands_R "Generic 8-byte raw payload. Detail page: https://www.isobus.net/isobus/pGNAndSPN/13644?type=PGN. Signal-level enrichment via PR welcome  see CONTRIBUTING.md.";
CM_ SG_ 2566711808 Vehicle_Electrical_Power_4_obsol "Generic 8-byte raw payload. Detail page: https://www.isobus.net/isobus/pGNAndSPN/13645?type=PGN. Signal-level enrichment via PR welcome  see CONTRIBUTING.md.";
CM_ SG_ 2566712064 Aftertreatment_2_NOx_Adsorber_In "Generic 8-byte raw payload. Detail page: https://www.isobus.net/isobus/pGNAndSPN/13647?type=PGN. Signal-level enrichment via PR welcome  see CONTRIBUTING.md.";
CM_ SG_ 2566712320 Aftertreatment_1_NOx_Adsorber_In "Generic 8-byte raw payload. Detail page: https://www.isobus.net/isobus/pGNAndSPN/13649?type=PGN. Signal-level enrichment via PR welcome  see CONTRIBUTING.md.";
CM_ SG_ 2566712576 Aftertreatment_2_Warm_Up_Diesel_ "Generic 8-byte raw payload. Detail page: https://www.isobus.net/isobus/pGNAndSPN/13651?type=PGN. Signal-level enrichment via PR welcome  see CONTRIBUTING.md.";
CM_ SG_ 2566712832 Land_Leveling_System_Reference_E "Generic 8-byte raw payload. Detail page: https://www.isobus.net/isobus/pGNAndSPN/13655?type=PGN. Signal-level enrichment via PR welcome  see CONTRIBUTING.md.";
CM_ SG_ 2566713088 Engine_Fluid_Level_Pressure_11_R "Generic 8-byte raw payload. Detail page: https://www.isobus.net/isobus/pGNAndSPN/13659?type=PGN. Signal-level enrichment via PR welcome  see CONTRIBUTING.md.";
CM_ SG_ 2566713344 Engine_Fuel_Lube_x000D_Systems_2 "Generic 8-byte raw payload. Detail page: https://www.isobus.net/isobus/pGNAndSPN/13664?type=PGN. Signal-level enrichment via PR welcome  see CONTRIBUTING.md.";
CM_ SG_ 2566713600 Engine_Turbocharger_Wastegate_Ac "Generic 8-byte raw payload. Detail page: https://www.isobus.net/isobus/pGNAndSPN/13676?type=PGN. Signal-level enrichment via PR welcome  see CONTRIBUTING.md.";
CM_ SG_ 2566713856 Engine_Fuel_Throttle_Valve_Infor "Generic 8-byte raw payload. Detail page: https://www.isobus.net/isobus/pGNAndSPN/13690?type=PGN. Signal-level enrichment via PR welcome  see CONTRIBUTING.md.";
CM_ SG_ 2566714112 Engine_Turbocharger_Compressor_B "Generic 8-byte raw payload. Detail page: https://www.isobus.net/isobus/pGNAndSPN/13698?type=PGN. Signal-level enrichment via PR welcome  see CONTRIBUTING.md.";
CM_ SG_ 2566714368 Charge_Air_Cooler_2_RawPayload "Generic 8-byte raw payload. Detail page: https://www.isobus.net/isobus/pGNAndSPN/13702?type=PGN. Signal-level enrichment via PR welcome  see CONTRIBUTING.md.";
CM_ SG_ 2566714624 Charge_Air_Cooler_2_Precooler_Ra "Generic 8-byte raw payload. Detail page: https://www.isobus.net/isobus/pGNAndSPN/13705?type=PGN. Signal-level enrichment via PR welcome  see CONTRIBUTING.md.";
CM_ SG_ 2566714880 Charge_Air_Cooler_1_RawPayload "Generic 8-byte raw payload. Detail page: https://www.isobus.net/isobus/pGNAndSPN/13709?type=PGN. Signal-level enrichment via PR welcome  see CONTRIBUTING.md.";
CM_ SG_ 2566715136 Charge_Air_Cooler_1_Precooler_Ra "Generic 8-byte raw payload. Detail page: https://www.isobus.net/isobus/pGNAndSPN/13712?type=PGN. Signal-level enrichment via PR welcome  see CONTRIBUTING.md.";
CM_ SG_ 2566715392 Diesel_Particulate_Filter_2_Soot "Generic 8-byte raw payload. Detail page: https://www.isobus.net/isobus/pGNAndSPN/13715?type=PGN. Signal-level enrichment via PR welcome  see CONTRIBUTING.md.";
CM_ SG_ 2566715648 Diesel_Particulate_Filter_1_Soot "Generic 8-byte raw payload. Detail page: https://www.isobus.net/isobus/pGNAndSPN/13718?type=PGN. Signal-level enrichment via PR welcome  see CONTRIBUTING.md.";
CM_ SG_ 2566715904 Electronic_Engine_Controller_11_ "Generic 8-byte raw payload. Detail page: https://www.isobus.net/isobus/pGNAndSPN/13722?type=PGN. Signal-level enrichment via PR welcome  see CONTRIBUTING.md.";
CM_ SG_ 2566716160 Engine_Manifold_Actuator_Positio "Generic 8-byte raw payload. Detail page: https://www.isobus.net/isobus/pGNAndSPN/13724?type=PGN. Signal-level enrichment via PR welcome  see CONTRIBUTING.md.";
CM_ SG_ 2566716416 Engine_Manifold_Actuator_Control "Generic 8-byte raw payload. Detail page: https://www.isobus.net/isobus/pGNAndSPN/13726?type=PGN. Signal-level enrichment via PR welcome  see CONTRIBUTING.md.";
CM_ SG_ 2566716672 Electronic_Engine_Controller_9_R "Generic 8-byte raw payload. Detail page: https://www.isobus.net/isobus/pGNAndSPN/13730?type=PGN. Signal-level enrichment via PR welcome  see CONTRIBUTING.md.";
CM_ SG_ 2566716928 Electronic_Engine_Controller_10_ "Generic 8-byte raw payload. Detail page: https://www.isobus.net/isobus/pGNAndSPN/13735?type=PGN. Signal-level enrichment via PR welcome  see CONTRIBUTING.md.";
CM_ SG_ 2566717184 Engine_Temperature_5_RawPayload "Generic 8-byte raw payload. Detail page: https://www.isobus.net/isobus/pGNAndSPN/13738?type=PGN. Signal-level enrichment via PR welcome  see CONTRIBUTING.md.";
CM_ SG_ 2566717440 Engine_Fluid_Level_Pressure_10_R "Generic 8-byte raw payload. Detail page: https://www.isobus.net/isobus/pGNAndSPN/13743?type=PGN. Signal-level enrichment via PR welcome  see CONTRIBUTING.md.";
CM_ SG_ 2566717696 Low_Voltage_Disconnect_Status_Ra "Generic 8-byte raw payload. Detail page: https://www.isobus.net/isobus/pGNAndSPN/13751?type=PGN. Signal-level enrichment via PR welcome  see CONTRIBUTING.md.";
CM_ SG_ 2566718208 Implement_Operating_state_comman "Generic 8-byte raw payload. Detail page: https://www.isobus.net/isobus/pGNAndSPN/13754?type=PGN. Signal-level enrichment via PR welcome  see CONTRIBUTING.md.";
CM_ SG_ 2566718464 Direct_Lamp_Control_Data_2_RawPa "Generic 8-byte raw payload. Detail page: https://www.isobus.net/isobus/pGNAndSPN/13769?type=PGN. Signal-level enrichment via PR welcome  see CONTRIBUTING.md.";
CM_ SG_ 2566718720 Direct_Lamp_Control_Data_1_RawPa "Generic 8-byte raw payload. Detail page: https://www.isobus.net/isobus/pGNAndSPN/13796?type=PGN. Signal-level enrichment via PR welcome  see CONTRIBUTING.md.";
CM_ SG_ 2566718976 Direct_Lamp_Control_Command_2_Ra "Generic 8-byte raw payload. Detail page: https://www.isobus.net/isobus/pGNAndSPN/13811?type=PGN. Signal-level enrichment via PR welcome  see CONTRIBUTING.md.";
CM_ SG_ 2566719232 Direct_Lamp_Control_Command_1_Ra "Generic 8-byte raw payload. Detail page: https://www.isobus.net/isobus/pGNAndSPN/13838?type=PGN. Signal-level enrichment via PR welcome  see CONTRIBUTING.md.";
CM_ SG_ 2566719488 Engine_oil_message_RawPayload "Generic 8-byte raw payload. Detail page: https://www.isobus.net/isobus/pGNAndSPN/13842?type=PGN. Signal-level enrichment via PR welcome  see CONTRIBUTING.md.";
CM_ SG_ 2566720000 Aftertreatment_2_Outlet_Gas_NOx_ "Generic 8-byte raw payload. Detail page: https://www.isobus.net/isobus/pGNAndSPN/13850?type=PGN. Signal-level enrichment via PR welcome  see CONTRIBUTING.md.";
CM_ SG_ 2566720256 Aftertreatment_2_Outlet_Gas_NOx_ "Generic 8-byte raw payload. Detail page: https://www.isobus.net/isobus/pGNAndSPN/13854?type=PGN. Signal-level enrichment via PR welcome  see CONTRIBUTING.md.";
CM_ SG_ 2566720512 Aftertreatment_2_Intake_Gas_NOx_ "Generic 8-byte raw payload. Detail page: https://www.isobus.net/isobus/pGNAndSPN/13860?type=PGN. Signal-level enrichment via PR welcome  see CONTRIBUTING.md.";
CM_ SG_ 2566720768 Aftertreatment_2_Intake_Gas_NOx_ "Generic 8-byte raw payload. Detail page: https://www.isobus.net/isobus/pGNAndSPN/13864?type=PGN. Signal-level enrichment via PR welcome  see CONTRIBUTING.md.";
CM_ SG_ 2566721024 Aftertreatment_1_Outlet_Gas_NOx_ "Generic 8-byte raw payload. Detail page: https://www.isobus.net/isobus/pGNAndSPN/13870?type=PGN. Signal-level enrichment via PR welcome  see CONTRIBUTING.md.";
CM_ SG_ 2566721280 Aftertreatment_1_Outlet_Gas_NOx_ "Generic 8-byte raw payload. Detail page: https://www.isobus.net/isobus/pGNAndSPN/13874?type=PGN. Signal-level enrichment via PR welcome  see CONTRIBUTING.md.";
CM_ SG_ 2566721536 Aftertreatment_1_Intake_Gas_NOx_ "Generic 8-byte raw payload. Detail page: https://www.isobus.net/isobus/pGNAndSPN/13880?type=PGN. Signal-level enrichment via PR welcome  see CONTRIBUTING.md.";
CM_ SG_ 2566721792 Aftertreatment_1_Intake_Gas_NOx_ "Generic 8-byte raw payload. Detail page: https://www.isobus.net/isobus/pGNAndSPN/13884?type=PGN. Signal-level enrichment via PR welcome  see CONTRIBUTING.md.";
CM_ SG_ 2566722048 Magnet_Status_Information_1_RawP "Generic 8-byte raw payload. Detail page: https://www.isobus.net/isobus/pGNAndSPN/13892?type=PGN. Signal-level enrichment via PR welcome  see CONTRIBUTING.md.";
CM_ SG_ 2566722304 Magnet_System_Configuration_Info "Generic 8-byte raw payload. Detail page: https://www.isobus.net/isobus/pGNAndSPN/13894?type=PGN. Signal-level enrichment via PR welcome  see CONTRIBUTING.md.";
CM_ SG_ 2566722560 Battery_Charger_2_RawPayload "Generic 8-byte raw payload. Detail page: https://www.isobus.net/isobus/pGNAndSPN/13901?type=PGN. Signal-level enrichment via PR welcome  see CONTRIBUTING.md.";
CM_ SG_ 2566722816 Battery_Charger_1_RawPayload "Generic 8-byte raw payload. Detail page: https://www.isobus.net/isobus/pGNAndSPN/13908?type=PGN. Signal-level enrichment via PR welcome  see CONTRIBUTING.md.";
CM_ SG_ 2566723072 Occupant_Classification_System_I "Generic 8-byte raw payload. Detail page: https://www.isobus.net/isobus/pGNAndSPN/13918?type=PGN. Signal-level enrichment via PR welcome  see CONTRIBUTING.md.";
CM_ SG_ 2566723328 Beltlock_and_Airbag_Deactivation "Generic 8-byte raw payload. Detail page: https://www.isobus.net/isobus/pGNAndSPN/13930?type=PGN. Signal-level enrichment via PR welcome  see CONTRIBUTING.md.";
CM_ SG_ 2566723584 Collision_Sensor_Information_Raw "Generic 8-byte raw payload. Detail page: https://www.isobus.net/isobus/pGNAndSPN/13964?type=PGN. Signal-level enrichment via PR welcome  see CONTRIBUTING.md.";
CM_ SG_ 2566723840 Ignitor_Loop_Information_RawPayl "Generic 8-byte raw payload. Detail page: https://www.isobus.net/isobus/pGNAndSPN/14064?type=PGN. Signal-level enrichment via PR welcome  see CONTRIBUTING.md.";
CM_ SG_ 2566724096 Aftertreatment_1_Warm_Up_Diesel_ "Generic 8-byte raw payload. Detail page: https://www.isobus.net/isobus/pGNAndSPN/14066?type=PGN. Signal-level enrichment via PR welcome  see CONTRIBUTING.md.";
CM_ SG_ 2566724352 Diesel_Particulate_Filter_2_Soot "Generic 8-byte raw payload. Detail page: https://www.isobus.net/isobus/pGNAndSPN/14072?type=PGN. Signal-level enrichment via PR welcome  see CONTRIBUTING.md.";
CM_ SG_ 2566724608 Diesel_Particulate_Filter_1_Soot "Generic 8-byte raw payload. Detail page: https://www.isobus.net/isobus/pGNAndSPN/14078?type=PGN. Signal-level enrichment via PR welcome  see CONTRIBUTING.md.";
CM_ SG_ 2566724864 Aftertreatment_Differential_Temp "Generic 8-byte raw payload. Detail page: https://www.isobus.net/isobus/pGNAndSPN/14080?type=PGN. Signal-level enrichment via PR welcome  see CONTRIBUTING.md.";
CM_ SG_ 2566725120 Aftertreatment_Differential_Temp "Generic 8-byte raw payload. Detail page: https://www.isobus.net/isobus/pGNAndSPN/14082?type=PGN. Signal-level enrichment via PR welcome  see CONTRIBUTING.md.";
CM_ SG_ 2566725376 Aftertreatment_2_Diesel_Oxidatio "Generic 8-byte raw payload. Detail page: https://www.isobus.net/isobus/pGNAndSPN/14088?type=PGN. Signal-level enrichment via PR welcome  see CONTRIBUTING.md.";
CM_ SG_ 2566725632 Aftertreatment_1_Diesel_Oxidatio "Generic 8-byte raw payload. Detail page: https://www.isobus.net/isobus/pGNAndSPN/14094?type=PGN. Signal-level enrichment via PR welcome  see CONTRIBUTING.md.";
CM_ SG_ 2566725888 Aftertreatment_2_Gas_Oxidation_C "Generic 8-byte raw payload. Detail page: https://www.isobus.net/isobus/pGNAndSPN/14100?type=PGN. Signal-level enrichment via PR welcome  see CONTRIBUTING.md.";
CM_ SG_ 2566726144 Aftertreatment_1_Gas_Oxidation_C "Generic 8-byte raw payload. Detail page: https://www.isobus.net/isobus/pGNAndSPN/14106?type=PGN. Signal-level enrichment via PR welcome  see CONTRIBUTING.md.";
CM_ SG_ 2566726400 Extended_Joystick_Message_10_Raw "Generic 8-byte raw payload. Detail page: https://www.isobus.net/isobus/pGNAndSPN/14125?type=PGN. Signal-level enrichment via PR welcome  see CONTRIBUTING.md.";
CM_ SG_ 2566726656 Basic_Joystick_Message_10_RawPay "Generic 8-byte raw payload. Detail page: https://www.isobus.net/isobus/pGNAndSPN/14147?type=PGN. Signal-level enrichment via PR welcome  see CONTRIBUTING.md.";
CM_ SG_ 2566726912 Extended_Joystick_Message_9_RawP "Generic 8-byte raw payload. Detail page: https://www.isobus.net/isobus/pGNAndSPN/14166?type=PGN. Signal-level enrichment via PR welcome  see CONTRIBUTING.md.";
CM_ SG_ 2566727168 Basic_Joystick_Message_9_RawPayl "Generic 8-byte raw payload. Detail page: https://www.isobus.net/isobus/pGNAndSPN/14188?type=PGN. Signal-level enrichment via PR welcome  see CONTRIBUTING.md.";
CM_ SG_ 2566727424 Extended_Joystick_Message_8_RawP "Generic 8-byte raw payload. Detail page: https://www.isobus.net/isobus/pGNAndSPN/14207?type=PGN. Signal-level enrichment via PR welcome  see CONTRIBUTING.md.";
CM_ SG_ 2566727680 Basic_Joystick_Message_8_RawPayl "Generic 8-byte raw payload. Detail page: https://www.isobus.net/isobus/pGNAndSPN/14229?type=PGN. Signal-level enrichment via PR welcome  see CONTRIBUTING.md.";
CM_ SG_ 2566727936 Extended_Joystick_Message_7_RawP "Generic 8-byte raw payload. Detail page: https://www.isobus.net/isobus/pGNAndSPN/14248?type=PGN. Signal-level enrichment via PR welcome  see CONTRIBUTING.md.";
CM_ SG_ 2566728192 Basic_Joystick_Message_7_RawPayl "Generic 8-byte raw payload. Detail page: https://www.isobus.net/isobus/pGNAndSPN/14270?type=PGN. Signal-level enrichment via PR welcome  see CONTRIBUTING.md.";
CM_ SG_ 2566728448 Extended_Joystick_Message_6_RawP "Generic 8-byte raw payload. Detail page: https://www.isobus.net/isobus/pGNAndSPN/14289?type=PGN. Signal-level enrichment via PR welcome  see CONTRIBUTING.md.";
CM_ SG_ 2566728704 Basic_Joystick_Message_6_RawPayl "Generic 8-byte raw payload. Detail page: https://www.isobus.net/isobus/pGNAndSPN/14311?type=PGN. Signal-level enrichment via PR welcome  see CONTRIBUTING.md.";
CM_ SG_ 2566728960 Extended_Joystick_Message_5_RawP "Generic 8-byte raw payload. Detail page: https://www.isobus.net/isobus/pGNAndSPN/14330?type=PGN. Signal-level enrichment via PR welcome  see CONTRIBUTING.md.";
CM_ SG_ 2566729216 Basic_Joystick_Message_5_RawPayl "Generic 8-byte raw payload. Detail page: https://www.isobus.net/isobus/pGNAndSPN/14352?type=PGN. Signal-level enrichment via PR welcome  see CONTRIBUTING.md.";
CM_ SG_ 2566729472 Extended_Joystick_Message_4_RawP "Generic 8-byte raw payload. Detail page: https://www.isobus.net/isobus/pGNAndSPN/14371?type=PGN. Signal-level enrichment via PR welcome  see CONTRIBUTING.md.";
CM_ SG_ 2566729728 Basic_Joystick_Message_4_RawPayl "Generic 8-byte raw payload. Detail page: https://www.isobus.net/isobus/pGNAndSPN/14393?type=PGN. Signal-level enrichment via PR welcome  see CONTRIBUTING.md.";
CM_ SG_ 2566729984 Fan_Drive_2_RawPayload "Generic 8-byte raw payload. Detail page: https://www.isobus.net/isobus/pGNAndSPN/14398?type=PGN. Signal-level enrichment via PR welcome  see CONTRIBUTING.md.";
CM_ SG_ 2566730496 Aftertreatment_2_Diesel_Exhaust_ "Generic 8-byte raw payload. Detail page: https://www.isobus.net/isobus/pGNAndSPN/14408?type=PGN. Signal-level enrichment via PR welcome  see CONTRIBUTING.md.";
CM_ SG_ 2566730752 Aftertreatment_2_SCR_Reagant_Tan "Generic 8-byte raw payload. Detail page: https://www.isobus.net/isobus/pGNAndSPN/14415?type=PGN. Signal-level enrichment via PR welcome  see CONTRIBUTING.md.";
CM_ SG_ 2566731008 Aftertreatment_2_Diesel_Exhaust_ "Generic 8-byte raw payload. Detail page: https://www.isobus.net/isobus/pGNAndSPN/14422?type=PGN. Signal-level enrichment via PR welcome  see CONTRIBUTING.md.";
CM_ SG_ 2566731264 Aftertreatment_2_Diesel_Exhaust_ "Generic 8-byte raw payload. Detail page: https://www.isobus.net/isobus/pGNAndSPN/14428?type=PGN. Signal-level enrichment via PR welcome  see CONTRIBUTING.md.";
CM_ SG_ 2566731520 Aftertreatment_2_SCR_Service_Inf "Generic 8-byte raw payload. Detail page: https://www.isobus.net/isobus/pGNAndSPN/14433?type=PGN. Signal-level enrichment via PR welcome  see CONTRIBUTING.md.";
CM_ SG_ 2566731776 Aftertreatment_2_SCR_Exhaust_Gas "Generic 8-byte raw payload. Detail page: https://www.isobus.net/isobus/pGNAndSPN/14437?type=PGN. Signal-level enrichment via PR welcome  see CONTRIBUTING.md.";
CM_ SG_ 2566732032 Aftertreatment_2_SCR_Exhaust_Gas "Generic 8-byte raw payload. Detail page: https://www.isobus.net/isobus/pGNAndSPN/14441?type=PGN. Signal-level enrichment via PR welcome  see CONTRIBUTING.md.";
CM_ SG_ 2566732288 Aftertreatment_2_SCR_Dosing_Syst "Generic 8-byte raw payload. Detail page: https://www.isobus.net/isobus/pGNAndSPN/14458?type=PGN. Signal-level enrichment via PR welcome  see CONTRIBUTING.md.";
CM_ SG_ 2566732544 Aftertreatment_2_SCR_Dosing_Syst "Generic 8-byte raw payload. Detail page: https://www.isobus.net/isobus/pGNAndSPN/14471?type=PGN. Signal-level enrichment via PR welcome  see CONTRIBUTING.md.";
CM_ SG_ 2566732800 Aftertreatment_1_Diesel_Exhaust_ "Generic 8-byte raw payload. Detail page: https://www.isobus.net/isobus/pGNAndSPN/14480?type=PGN. Signal-level enrichment via PR welcome  see CONTRIBUTING.md.";
CM_ SG_ 2566733056 Aftertreatment_1_SCR_Reagant_Tan "Generic 8-byte raw payload. Detail page: https://www.isobus.net/isobus/pGNAndSPN/14487?type=PGN. Signal-level enrichment via PR welcome  see CONTRIBUTING.md.";
CM_ SG_ 2566733312 Aftertreatment_1_SCR_Exhaust_Gas "Generic 8-byte raw payload. Detail page: https://www.isobus.net/isobus/pGNAndSPN/14491?type=PGN. Signal-level enrichment via PR welcome  see CONTRIBUTING.md.";
CM_ SG_ 2566733568 Aftertreatment_1_SCR_Exhaust_Gas "Generic 8-byte raw payload. Detail page: https://www.isobus.net/isobus/pGNAndSPN/14495?type=PGN. Signal-level enrichment via PR welcome  see CONTRIBUTING.md.";
CM_ SG_ 2566733824 Aftertreatment_1_SCR_Dosing_Syst "Generic 8-byte raw payload. Detail page: https://www.isobus.net/isobus/pGNAndSPN/14513?type=PGN. Signal-level enrichment via PR welcome  see CONTRIBUTING.md.";
CM_ SG_ 2566734080 Aftertreatment_1_SCR_Dosing_Syst "Generic 8-byte raw payload. Detail page: https://www.isobus.net/isobus/pGNAndSPN/14526?type=PGN. Signal-level enrichment via PR welcome  see CONTRIBUTING.md.";
CM_ SG_ 2566734336 ISOBUS_compliance_certification_ "Generic 8-byte raw payload. Detail page: https://www.isobus.net/isobus/pGNAndSPN/14545?type=PGN. Signal-level enrichment via PR welcome  see CONTRIBUTING.md.";
CM_ SG_ 2566734848 Aftertreatment_2_Fuel_Control_2_ "Generic 8-byte raw payload. Detail page: https://www.isobus.net/isobus/pGNAndSPN/14552?type=PGN. Signal-level enrichment via PR welcome  see CONTRIBUTING.md.";
CM_ SG_ 2566735104 Aftertreatment_2_Three_Way_Catal "Generic 8-byte raw payload. Detail page: https://www.isobus.net/isobus/pGNAndSPN/14558?type=PGN. Signal-level enrichment via PR welcome  see CONTRIBUTING.md.";
CM_ SG_ 2566735360 Aftertreatment_1_Three_Way_Catal "Generic 8-byte raw payload. Detail page: https://www.isobus.net/isobus/pGNAndSPN/14564?type=PGN. Signal-level enrichment via PR welcome  see CONTRIBUTING.md.";
CM_ SG_ 2566735616 Transmission_Mode_Labels_RawPayl "Generic 8-byte raw payload. Detail page: https://www.isobus.net/isobus/pGNAndSPN/14565?type=PGN. Signal-level enrichment via PR welcome  see CONTRIBUTING.md.";
CM_ SG_ 2566735872 Engine_Exhaust_Bank_2_O2_Fuel_Tr "Generic 8-byte raw payload. Detail page: https://www.isobus.net/isobus/pGNAndSPN/14568?type=PGN. Signal-level enrichment via PR welcome  see CONTRIBUTING.md.";
CM_ SG_ 2566736128 Engine_Exhaust_Bank_1_O2_Fuel_Tr "Generic 8-byte raw payload. Detail page: https://www.isobus.net/isobus/pGNAndSPN/14571?type=PGN. Signal-level enrichment via PR welcome  see CONTRIBUTING.md.";
CM_ SG_ 2566736384 General_Purpose_Message_2_11_Raw "Generic 8-byte raw payload. Detail page: https://www.isobus.net/isobus/pGNAndSPN/14572?type=PGN. Signal-level enrichment via PR welcome  see CONTRIBUTING.md.";
CM_ SG_ 2566736640 General_Purpose_Message_2_10_Raw "Generic 8-byte raw payload. Detail page: https://www.isobus.net/isobus/pGNAndSPN/14573?type=PGN. Signal-level enrichment via PR welcome  see CONTRIBUTING.md.";
CM_ SG_ 2566736896 General_Purpose_Message_2_9_RawP "Generic 8-byte raw payload. Detail page: https://www.isobus.net/isobus/pGNAndSPN/14574?type=PGN. Signal-level enrichment via PR welcome  see CONTRIBUTING.md.";
CM_ SG_ 2566737152 General_Purpose_Message_2_8_RawP "Generic 8-byte raw payload. Detail page: https://www.isobus.net/isobus/pGNAndSPN/14575?type=PGN. Signal-level enrichment via PR welcome  see CONTRIBUTING.md.";
CM_ SG_ 2566737408 General_Purpose_Message_2_7_RawP "Generic 8-byte raw payload. Detail page: https://www.isobus.net/isobus/pGNAndSPN/14576?type=PGN. Signal-level enrichment via PR welcome  see CONTRIBUTING.md.";
CM_ SG_ 2566737664 General_Purpose_Message_2_6_RawP "Generic 8-byte raw payload. Detail page: https://www.isobus.net/isobus/pGNAndSPN/14577?type=PGN. Signal-level enrichment via PR welcome  see CONTRIBUTING.md.";
CM_ SG_ 2566737920 General_Purpose_Message_1_9_RawP "Generic 8-byte raw payload. Detail page: https://www.isobus.net/isobus/pGNAndSPN/14578?type=PGN. Signal-level enrichment via PR welcome  see CONTRIBUTING.md.";
CM_ SG_ 2566738176 Aftercooler_Coolant_Control_Valv "Generic 8-byte raw payload. Detail page: https://www.isobus.net/isobus/pGNAndSPN/14584?type=PGN. Signal-level enrichment via PR welcome  see CONTRIBUTING.md.";
CM_ SG_ 2566738432 Engine_Coolant_Control_Valve_Com "Generic 8-byte raw payload. Detail page: https://www.isobus.net/isobus/pGNAndSPN/14592?type=PGN. Signal-level enrichment via PR welcome  see CONTRIBUTING.md.";
CM_ SG_ 2566738688 Engine_Average_Information_RawPa "Generic 8-byte raw payload. Detail page: https://www.isobus.net/isobus/pGNAndSPN/14595?type=PGN. Signal-level enrichment via PR welcome  see CONTRIBUTING.md.";
CM_ SG_ 2566738944 DTCs_C_Previously_Active_RawPayl "Generic 8-byte raw payload. Detail page: https://www.isobus.net/isobus/pGNAndSPN/14607?type=PGN. Signal-level enrichment via PR welcome  see CONTRIBUTING.md.";
CM_ SG_ 2566739200 DTCs_C_Confirmed_and_Active_RawP "Generic 8-byte raw payload. Detail page: https://www.isobus.net/isobus/pGNAndSPN/14619?type=PGN. Signal-level enrichment via PR welcome  see CONTRIBUTING.md.";
CM_ SG_ 2566739456 DTCs_C_Pending_RawPayload "Generic 8-byte raw payload. Detail page: https://www.isobus.net/isobus/pGNAndSPN/14631?type=PGN. Signal-level enrichment via PR welcome  see CONTRIBUTING.md.";
CM_ SG_ 2566739712 DTCs_B2_Previously_Active_RawPay "Generic 8-byte raw payload. Detail page: https://www.isobus.net/isobus/pGNAndSPN/14643?type=PGN. Signal-level enrichment via PR welcome  see CONTRIBUTING.md.";
CM_ SG_ 2566739968 DTCs_B2_Confirmed_and_Active_Raw "Generic 8-byte raw payload. Detail page: https://www.isobus.net/isobus/pGNAndSPN/14655?type=PGN. Signal-level enrichment via PR welcome  see CONTRIBUTING.md.";
CM_ SG_ 2566740224 DTCs_B2_Pending_RawPayload "Generic 8-byte raw payload. Detail page: https://www.isobus.net/isobus/pGNAndSPN/14667?type=PGN. Signal-level enrichment via PR welcome  see CONTRIBUTING.md.";
CM_ SG_ 2566740480 DTCs_B1_Previously_Active_RawPay "Generic 8-byte raw payload. Detail page: https://www.isobus.net/isobus/pGNAndSPN/14679?type=PGN. Signal-level enrichment via PR welcome  see CONTRIBUTING.md.";
CM_ SG_ 2566740736 DTCs_B1_Confirmed_and_Active_Raw "Generic 8-byte raw payload. Detail page: https://www.isobus.net/isobus/pGNAndSPN/14691?type=PGN. Signal-level enrichment via PR welcome  see CONTRIBUTING.md.";
CM_ SG_ 2566740992 DTCs_B1_Pending_RawPayload "Generic 8-byte raw payload. Detail page: https://www.isobus.net/isobus/pGNAndSPN/14703?type=PGN. Signal-level enrichment via PR welcome  see CONTRIBUTING.md.";
CM_ SG_ 2566741248 DTCs_A_Previously_Active_RawPayl "Generic 8-byte raw payload. Detail page: https://www.isobus.net/isobus/pGNAndSPN/14715?type=PGN. Signal-level enrichment via PR welcome  see CONTRIBUTING.md.";
CM_ SG_ 2566741504 DTCs_A_Confirmed_and_Active_RawP "Generic 8-byte raw payload. Detail page: https://www.isobus.net/isobus/pGNAndSPN/14727?type=PGN. Signal-level enrichment via PR welcome  see CONTRIBUTING.md.";
CM_ SG_ 2566741760 DTCs_A_Pending_RawPayload "Generic 8-byte raw payload. Detail page: https://www.isobus.net/isobus/pGNAndSPN/14739?type=PGN. Signal-level enrichment via PR welcome  see CONTRIBUTING.md.";
CM_ SG_ 2566742016 Harmonized_B1_Failure_Counts_Raw "Generic 8-byte raw payload. Detail page: https://www.isobus.net/isobus/pGNAndSPN/14742?type=PGN. Signal-level enrichment via PR welcome  see CONTRIBUTING.md.";
CM_ SG_ 2566742272 Harmonized_Cumulative_Continuous "Generic 8-byte raw payload. Detail page: https://www.isobus.net/isobus/pGNAndSPN/14744?type=PGN. Signal-level enrichment via PR welcome  see CONTRIBUTING.md.";
CM_ SG_ 2566742528 Harmonized_Global_Regulation_Des "Generic 8-byte raw payload. Detail page: https://www.isobus.net/isobus/pGNAndSPN/14745?type=PGN. Signal-level enrichment via PR welcome  see CONTRIBUTING.md.";
CM_ SG_ 2566742784 Harmonized_Roadworthiness_System "Generic 8-byte raw payload. Detail page: https://www.isobus.net/isobus/pGNAndSPN/14750?type=PGN. Signal-level enrichment via PR welcome  see CONTRIBUTING.md.";
CM_ SG_ 2566743040 Harmonized_Roadworthiness_Vehicl "Generic 8-byte raw payload. Detail page: https://www.isobus.net/isobus/pGNAndSPN/14751?type=PGN. Signal-level enrichment via PR welcome  see CONTRIBUTING.md.";
CM_ SG_ 2566743296 Aftertreatment_1_Fuel_Control_2_ "Generic 8-byte raw payload. Detail page: https://www.isobus.net/isobus/pGNAndSPN/14756?type=PGN. Signal-level enrichment via PR welcome  see CONTRIBUTING.md.";
CM_ SG_ 2566743552 Engine_Temperature_4_RawPayload "Generic 8-byte raw payload. Detail page: https://www.isobus.net/isobus/pGNAndSPN/14762?type=PGN. Signal-level enrichment via PR welcome  see CONTRIBUTING.md.";
CM_ SG_ 2566743808 Zero_Net_Vehicle_Weight_Change_R "Generic 8-byte raw payload. Detail page: https://www.isobus.net/isobus/pGNAndSPN/14763?type=PGN. Signal-level enrichment via PR welcome  see CONTRIBUTING.md.";
CM_ SG_ 2566744064 Gross_Combination_Vehicle_Weight "Generic 8-byte raw payload. Detail page: https://www.isobus.net/isobus/pGNAndSPN/14765?type=PGN. Signal-level enrichment via PR welcome  see CONTRIBUTING.md.";
CM_ SG_ 2566744320 Axle_Group_Calibration_Weights_R "Generic 8-byte raw payload. Detail page: https://www.isobus.net/isobus/pGNAndSPN/14769?type=PGN. Signal-level enrichment via PR welcome  see CONTRIBUTING.md.";
CM_ SG_ 2566744576 Axle_Group_Weight_RawPayload "Generic 8-byte raw payload. Detail page: https://www.isobus.net/isobus/pGNAndSPN/14772?type=PGN. Signal-level enrichment via PR welcome  see CONTRIBUTING.md.";
CM_ SG_ 2566744832 Available_Axle_Group_Weights_Raw "Generic 8-byte raw payload. Detail page: https://www.isobus.net/isobus/pGNAndSPN/14788?type=PGN. Signal-level enrichment via PR welcome  see CONTRIBUTING.md.";
CM_ SG_ 2566745088 Aftertreatment_2_Air_Control_2_R "Generic 8-byte raw payload. Detail page: https://www.isobus.net/isobus/pGNAndSPN/14792?type=PGN. Signal-level enrichment via PR welcome  see CONTRIBUTING.md.";
CM_ SG_ 2566745344 Aftertreatment_1_Air_Control_2_R "Generic 8-byte raw payload. Detail page: https://www.isobus.net/isobus/pGNAndSPN/14796?type=PGN. Signal-level enrichment via PR welcome  see CONTRIBUTING.md.";
CM_ SG_ 2566745600 Aftertreatment_1_SCR_Service_Inf "Generic 8-byte raw payload. Detail page: https://www.isobus.net/isobus/pGNAndSPN/14801?type=PGN. Signal-level enrichment via PR welcome  see CONTRIBUTING.md.";
CM_ SG_ 2566745856 Electronic_Engine_Controller_8_R "Generic 8-byte raw payload. Detail page: https://www.isobus.net/isobus/pGNAndSPN/14806?type=PGN. Signal-level enrichment via PR welcome  see CONTRIBUTING.md.";
CM_ SG_ 2566746112 Door_ramp_control_RawPayload "Generic 8-byte raw payload. Detail page: https://www.isobus.net/isobus/pGNAndSPN/14821?type=PGN. Signal-level enrichment via PR welcome  see CONTRIBUTING.md.";

BA_DEF_ BO_ "SystemMessageLongSymbol" STRING;
BA_DEF_ SG_ "SystemSignalLongSymbol" STRING;
BA_ "SystemMessageLongSymbol" BO_ 2566654720 "VDMA_FC0B_Electronic_Engine_Controller_20";
BA_ "SystemMessageLongSymbol" BO_ 2566655488 "VDMA_FC0E_Primary_or_Rear_Hitch_Roll_and_P";
BA_ "SystemMessageLongSymbol" BO_ 2566655744 "VDMA_FC0F_Secondary_or_Front_Hitch_Roll_an";
BA_ "SystemMessageLongSymbol" BO_ 2566656256 "VDMA_FC11_Total_Gaseous_Fuel_Information";
BA_ "SystemMessageLongSymbol" BO_ 2566657024 "VDMA_FC14_Vehicle_Electrical_Power_3_obsol";
BA_ "SystemMessageLongSymbol" BO_ 2566657280 "VDMA_FC15_Vehicle_Electrical_Power_6";
BA_ "SystemMessageLongSymbol" BO_ 2566658048 "VDMA_FC18_Payload_System_Totals_2";
BA_ "SystemMessageLongSymbol" BO_ 2566658304 "VDMA_FC19_Payload_System_Totals_1";
BA_ "SystemMessageLongSymbol" BO_ 2566658560 "VDMA_FC1A_HVESS_Thermal_Management_System_";
BA_ "SystemMessageLongSymbol" BO_ 2566658816 "VDMA_FC1B_HVESS_Thermal_Management_System_";
BA_ "SystemMessageLongSymbol" BO_ 2566659072 "VDMA_FC1C_Refrigeration_Compartment_Inform";
BA_ "SystemMessageLongSymbol" BO_ 2566659328 "VDMA_FC1D_Refrigeration_Compartment_Inform";
BA_ "SystemMessageLongSymbol" BO_ 2566659584 "VDMA_FC1E_Vehicle_Electrical_Power_16";
BA_ "SystemMessageLongSymbol" BO_ 2566659840 "VDMA_FC1F_Vehicle_Electrical_Power_17";
BA_ "SystemMessageLongSymbol" BO_ 2566660096 "VDMA_FC20_High_Voltage_Energy_Storage_Syst";
BA_ "SystemMessageLongSymbol" BO_ 2566660352 "VDMA_FC21_High_Voltage_Energy_Storage_Syst";
BA_ "SystemMessageLongSymbol" BO_ 2566660608 "VDMA_FC22_Electronic_Engine_Controller_19";
BA_ "SystemMessageLongSymbol" BO_ 2566660864 "VDMA_FC23_Fuel_Consumption_Liquid_2";
BA_ "SystemMessageLongSymbol" BO_ 2566661120 "VDMA_FC24_Aftertreatment_2_Diesel_Exhaust_";
BA_ "SystemMessageLongSymbol" BO_ 2566661376 "VDMA_FC25_Aftertreatment_1_Diesel_Exhaust_";
BA_ "SystemMessageLongSymbol" BO_ 2566661632 "VDMA_FC26_Aftertreatment_2_Diesel_Exhaust_";
BA_ "SystemMessageLongSymbol" BO_ 2566661888 "VDMA_FC27_Aftertreatment_1_Diesel_Exhaust_";
BA_ "SystemMessageLongSymbol" BO_ 2566662144 "VDMA_FC28_Cruise_Control_Vehicle_Speed_6";
BA_ "SystemMessageLongSymbol" BO_ 2566662656 "VDMA_FC2A_Operator_Inducement_Information_";
BA_ "SystemMessageLongSymbol" BO_ 2566662912 "VDMA_FC2B_Cruise_Control_Vehicle_Speed_4";
BA_ "SystemMessageLongSymbol" BO_ 2566663168 "VDMA_FC2C_Brake_Caliper_Lining_Clearance";
BA_ "SystemMessageLongSymbol" BO_ 2566663680 "VDMA_FC2E_Engine_Turbocharger_Control_3";
BA_ "SystemMessageLongSymbol" BO_ 2566663936 "VDMA_FC2F_Fire_Suppression_Agent_Status";
BA_ "SystemMessageLongSymbol" BO_ 2566664192 "VDMA_FC30_SCR_Operator_Inducement_Informat";
BA_ "SystemMessageLongSymbol" BO_ 2566664448 "VDMA_FC31_Aftertreatment_System_Informatio";
BA_ "SystemMessageLongSymbol" BO_ 2566664704 "VDMA_FC32_Aftertreatment_1_Particulate_Sen";
BA_ "SystemMessageLongSymbol" BO_ 2566664960 "VDMA_FC33_Engine_Fuel_Injector_Metering_Ra";
BA_ "SystemMessageLongSymbol" BO_ 2566665216 "VDMA_FC34_Engine_Fuel_Injector_Metering_Ra";
BA_ "SystemMessageLongSymbol" BO_ 2566665472 "VDMA_FC35_Aftertreatment_2_Diesel_Exhaust_";
BA_ "SystemMessageLongSymbol" BO_ 2566665728 "VDMA_FC36_Gaseous_Fuel_Supply_Valve_Inform";
BA_ "SystemMessageLongSymbol" BO_ 2566665984 "VDMA_FC37_Engine_Oil_Mist_Detection_Inform";
BA_ "SystemMessageLongSymbol" BO_ 2566666240 "VDMA_FC38_Engine_Oil_Mist_Detection_Inform";
BA_ "SystemMessageLongSymbol" BO_ 2566666496 "VDMA_FC39_Gaseous_Fuel_Supply_Pressure_2";
BA_ "SystemMessageLongSymbol" BO_ 2566666752 "VDMA_FC3A_Gaseous_Fuel_Supply_Pressure_1";
BA_ "SystemMessageLongSymbol" BO_ 2566667008 "VDMA_FC3B_Engine_End_Bearing_Temperature_3";
BA_ "SystemMessageLongSymbol" BO_ 2566667264 "VDMA_FC3C_Engine_End_Bearing_Temperature_2";
BA_ "SystemMessageLongSymbol" BO_ 2566667520 "VDMA_FC3D_Engine_End_Bearing_Temperature_1";
BA_ "SystemMessageLongSymbol" BO_ 2566667776 "VDMA_FC3E_Heat_Exchanger_Debris_Purge_Info";
BA_ "SystemMessageLongSymbol" BO_ 2566668032 "VDMA_FC3F_Engine_Turbocharger_Control_2";
BA_ "SystemMessageLongSymbol" BO_ 2566668288 "VDMA_FC40_Engine_Hydraulic_Fuel_2_Pump_Sta";
BA_ "SystemMessageLongSymbol" BO_ 2566668800 "VDMA_FC42_Tire_Condition_Message_2";
BA_ "SystemMessageLongSymbol" BO_ 2566669056 "VDMA_FC43_Tire_Configuration_Status_Inform";
BA_ "SystemMessageLongSymbol" BO_ 2566669312 "VDMA_FC44_High_Voltage_Energy_Storage_Syst";
BA_ "SystemMessageLongSymbol" BO_ 2566669568 "VDMA_FC45_Tire_Wireless_Signal_Strength_In";
BA_ "SystemMessageLongSymbol" BO_ 2566669824 "VDMA_FC46_Tire_Sensor_Identification_Statu";
BA_ "SystemMessageLongSymbol" BO_ 2566670080 "VDMA_FC47_Monitored_Tire_Information";
BA_ "SystemMessageLongSymbol" BO_ 2566670336 "VDMA_FC48_Aftertreatment_2_Historical_Info";
BA_ "SystemMessageLongSymbol" BO_ 2566670592 "VDMA_FC49_Aftertreatment_1_Historical_Info";
BA_ "SystemMessageLongSymbol" BO_ 2566671104 "VDMA_FC4B_Electronic_Engine_Controller_17";
BA_ "SystemMessageLongSymbol" BO_ 2566671360 "VDMA_FC4C_SCR_Operator_Inducement_Informat";
BA_ "SystemMessageLongSymbol" BO_ 2566671616 "VDMA_FC4D_Aftertreatment_2_SCR_Dosing_Syst";
BA_ "SystemMessageLongSymbol" BO_ 2566671872 "VDMA_FC4E_Aftertreatment_1_SCR_Dosing_Syst";
BA_ "SystemMessageLongSymbol" BO_ 2566672128 "VDMA_FC4F_Payload_Weight_Sensor_Informatio";
BA_ "SystemMessageLongSymbol" BO_ 2566672640 "VDMA_FC51_Air_Suspension_Control_7";
BA_ "SystemMessageLongSymbol" BO_ 2566672896 "VDMA_FC52_Bin_Weight_and_Lift_Count";
BA_ "SystemMessageLongSymbol" BO_ 2566673152 "VDMA_FC53_Engine_Gaseous_Leakage_Informati";
BA_ "SystemMessageLongSymbol" BO_ 2566673408 "VDMA_FC54_Driving_and_Rest_Times_Driver_2";
BA_ "SystemMessageLongSymbol" BO_ 2566673664 "VDMA_FC55_Driving_and_Rest_Times_Driver_1";
BA_ "SystemMessageLongSymbol" BO_ 2566673920 "VDMA_FC56_SCR_Operator_Inducement_Informat";
BA_ "SystemMessageLongSymbol" BO_ 2566674176 "VDMA_FC57_SCR_Operator_Inducement_Informat";
BA_ "SystemMessageLongSymbol" BO_ 2566674432 "VDMA_FC58_Turbocharger_Information_7";
BA_ "SystemMessageLongSymbol" BO_ 2566674688 "VDMA_FC59_Engine_Load_Sharing_Information";
BA_ "SystemMessageLongSymbol" BO_ 2566674944 "VDMA_FC5A_Synchronized_Service_Distance_In";
BA_ "SystemMessageLongSymbol" BO_ 2566675200 "VDMA_FC5B_Synchronized_Service_Delay_Opera";
BA_ "SystemMessageLongSymbol" BO_ 2566675456 "VDMA_FC5C_Synchronized_Service_Delay_Calen";
BA_ "SystemMessageLongSymbol" BO_ 2566675712 "VDMA_FC5D_High_Voltage_Energy_Storage_Syst";
BA_ "SystemMessageLongSymbol" BO_ 2566675968 "VDMA_FC5E_High_Voltage_Energy_Storage_Syst";
BA_ "SystemMessageLongSymbol" BO_ 2566676480 "VDMA_FC60_Encoder_High_Resolution_Position";
BA_ "SystemMessageLongSymbol" BO_ 2566677248 "VDMA_FC63_Encoder_Position_with_Speed_and_";
BA_ "SystemMessageLongSymbol" BO_ 2566677504 "VDMA_FC64_Inclinometer_Slope_Longitudinal_";
BA_ "SystemMessageLongSymbol" BO_ 2566677760 "VDMA_FC65_Inclinometer_Slope_Longitudinal_";
BA_ "SystemMessageLongSymbol" BO_ 2566678016 "VDMA_FC66_Inclinometer_Slope_Lateral_16_bi";
BA_ "SystemMessageLongSymbol" BO_ 2566678272 "VDMA_FC67_Inclinometer_Slope_Lateral_32_bi";
BA_ "SystemMessageLongSymbol" BO_ 2566678528 "VDMA_FC68_CANopen_Emergency_Message";
BA_ "SystemMessageLongSymbol" BO_ 2566678784 "VDMA_FC69_EV_Operator_Indicators_1";
BA_ "SystemMessageLongSymbol" BO_ 2566679296 "VDMA_FC6B_Engine_Maximum_Net_Torque_Map_ob";
BA_ "SystemMessageLongSymbol" BO_ 2566679808 "VDMA_FC6D_Acoustic_Warning_Request";
BA_ "SystemMessageLongSymbol" BO_ 2566680576 "VDMA_FC70_Body_Application_Unit_1";
BA_ "SystemMessageLongSymbol" BO_ 2566680832 "VDMA_FC71_Body_Application_Unit_2";
BA_ "SystemMessageLongSymbol" BO_ 2566681088 "VDMA_FC72_Body_Application_Unit_3";
BA_ "SystemMessageLongSymbol" BO_ 2566681344 "VDMA_FC73_Body_Application_Unit_4";
BA_ "SystemMessageLongSymbol" BO_ 2566681600 "VDMA_FC74_Body_Application_Unit_5";
BA_ "SystemMessageLongSymbol" BO_ 2566681856 "VDMA_FC75_Body_Application_Unit_6";
BA_ "SystemMessageLongSymbol" BO_ 2566682112 "VDMA_FC76_Body_Application_Unit_7";
BA_ "SystemMessageLongSymbol" BO_ 2566682368 "VDMA_FC77_Body_Application_Unit_8";
BA_ "SystemMessageLongSymbol" BO_ 2566682624 "VDMA_FC78_Electronic_Control_Unit";
BA_ "SystemMessageLongSymbol" BO_ 2566683648 "VDMA_FC7C_Heating_And_Refrigerating_Unit_1";
BA_ "SystemMessageLongSymbol" BO_ 2566683904 "VDMA_FC7D_Heating_And_Refrigerating_Unit_2";
BA_ "SystemMessageLongSymbol" BO_ 2566684160 "VDMA_FC7E_Heating_And_Refrigerating_Unit_3";
BA_ "SystemMessageLongSymbol" BO_ 2566684416 "VDMA_FC7F_Heating_And_Refrigerating_Unit_4";
BA_ "SystemMessageLongSymbol" BO_ 2566684672 "VDMA_FC80_HRU_Temperature_Setpoint";
BA_ "SystemMessageLongSymbol" BO_ 2566685696 "VDMA_FC84_Windshield_Wiper_Request";
BA_ "SystemMessageLongSymbol" BO_ 2566685952 "VDMA_FC85_Fuel_Cell_Auxiliary_Heater_Contr";
BA_ "SystemMessageLongSymbol" BO_ 2566686208 "VDMA_FC86_Fuel_Cell_Auxiliary_Heater_Infor";
BA_ "SystemMessageLongSymbol" BO_ 2566686464 "VDMA_FC87_Fuel_Cell_Coolant_Pump_1_Command";
BA_ "SystemMessageLongSymbol" BO_ 2566686720 "VDMA_FC88_Fuel_Cell_Coolant_Pump_2_Command";
BA_ "SystemMessageLongSymbol" BO_ 2566686976 "VDMA_FC89_Fuel_Cell_Coolant_Pump_1_Status";
BA_ "SystemMessageLongSymbol" BO_ 2566687232 "VDMA_FC8A_Fuel_Cell_Coolant_Pump_2_Status";
BA_ "SystemMessageLongSymbol" BO_ 2566687488 "VDMA_FC8B_Aftertreatment_1_Particulate_Sen";
BA_ "SystemMessageLongSymbol" BO_ 2566687744 "VDMA_FC8C_Aftertreatment_1_Particulate_Sen";
BA_ "SystemMessageLongSymbol" BO_ 2566688768 "VDMA_FC90_Engine_Fuel_Injector_Metering_Ra";
BA_ "SystemMessageLongSymbol" BO_ 2566689536 "VDMA_FC93_Gaseous_Fuel_Pressure_2";
BA_ "SystemMessageLongSymbol" BO_ 2566689792 "VDMA_FC94_Aftertreatment_System_Abuse_Info";
BA_ "SystemMessageLongSymbol" BO_ 2566690048 "VDMA_FC95_Engine_Cylinder_Pressure_Monitor";
BA_ "SystemMessageLongSymbol" BO_ 2566690560 "VDMA_FC97_Electronic_Steering_Control_2";
BA_ "SystemMessageLongSymbol" BO_ 2566691072 "VDMA_FC99_Assembly_Unit_Identification";
BA_ "SystemMessageLongSymbol" BO_ 2566692096 "VDMA_FC9D_Engine_Timing_Actuator_Position_";
BA_ "SystemMessageLongSymbol" BO_ 2566692352 "VDMA_FC9E_Engine_Timing_Actuator_Position";
BA_ "SystemMessageLongSymbol" BO_ 2566692864 "VDMA_FCA0_Multi_fuel_Engine_Hours";
BA_ "SystemMessageLongSymbol" BO_ 2566693120 "VDMA_FCA1_Engine_Spark_Misfire_Rate_3";
BA_ "SystemMessageLongSymbol" BO_ 2566693376 "VDMA_FCA2_Engine_Spark_Misfire_Rate_2";
BA_ "SystemMessageLongSymbol" BO_ 2566693632 "VDMA_FCA3_Engine_Spark_Misfire_Rate_1";
BA_ "SystemMessageLongSymbol" BO_ 2566693888 "VDMA_FCA4_Engine_Spark_Maximum_Voltage_6";
BA_ "SystemMessageLongSymbol" BO_ 2566694144 "VDMA_FCA5_Engine_Spark_Maximum_Voltage_5";
BA_ "SystemMessageLongSymbol" BO_ 2566694400 "VDMA_FCA6_Engine_Spark_Maximum_Voltage_4";
BA_ "SystemMessageLongSymbol" BO_ 2566694656 "VDMA_FCA7_Engine_Spark_Maximum_Voltage_3";
BA_ "SystemMessageLongSymbol" BO_ 2566694912 "VDMA_FCA8_Engine_Spark_Maximum_Voltage_2";
BA_ "SystemMessageLongSymbol" BO_ 2566695168 "VDMA_FCA9_Engine_Spark_Maximum_Voltage_1";
BA_ "SystemMessageLongSymbol" BO_ 2566695424 "VDMA_FCAA_Engine_Spark_Minimum_Voltage_6";
BA_ "SystemMessageLongSymbol" BO_ 2566695680 "VDMA_FCAB_Engine_Spark_Minimum_Voltage_5";
BA_ "SystemMessageLongSymbol" BO_ 2566695936 "VDMA_FCAC_Engine_Spark_Minimum_Voltage_4";
BA_ "SystemMessageLongSymbol" BO_ 2566696192 "VDMA_FCAD_Engine_Spark_Minimum_Voltage_3";
BA_ "SystemMessageLongSymbol" BO_ 2566696448 "VDMA_FCAE_Engine_Spark_Minimum_Voltage_2";
BA_ "SystemMessageLongSymbol" BO_ 2566696704 "VDMA_FCAF_Engine_Spark_Minimum_Voltage_1";
BA_ "SystemMessageLongSymbol" BO_ 2566696960 "VDMA_FCB0_Engine_Ignition_Controller_Maint";
BA_ "SystemMessageLongSymbol" BO_ 2566697216 "VDMA_FCB1_Engine_Ignition_Control_Module_S";
BA_ "SystemMessageLongSymbol" BO_ 2566697728 "VDMA_FCB3_Fused_Power_Output_Current";
BA_ "SystemMessageLongSymbol" BO_ 2566697984 "VDMA_FCB4_Switched_Power_Output_Status";
BA_ "SystemMessageLongSymbol" BO_ 2566698240 "VDMA_FCB5_Fused_Power_Output_Status";
BA_ "SystemMessageLongSymbol" BO_ 2566698496 "VDMA_FCB6_Vehicle_Electrical_Power_5";
BA_ "SystemMessageLongSymbol" BO_ 2566698752 "VDMA_FCB7_Hybrid_or_EV_System_Status_2";
BA_ "SystemMessageLongSymbol" BO_ 2566699008 "VDMA_FCB8_Aftertreatment_2_Service_2";
BA_ "SystemMessageLongSymbol" BO_ 2566699264 "VDMA_FCB9_Aftertreatment_1_Service_2";
BA_ "SystemMessageLongSymbol" BO_ 2566699520 "VDMA_FCBA_Aftertreatment_2_SCR_Electronic_";
BA_ "SystemMessageLongSymbol" BO_ 2566699776 "VDMA_FCBB_Aftertreatment_1_SCR_Electronic_";
BA_ "SystemMessageLongSymbol" BO_ 2566700032 "VDMA_FCBC_Aftertreatment_2_SCR_Service_Inf";
BA_ "SystemMessageLongSymbol" BO_ 2566700288 "VDMA_FCBD_Aftertreatment_1_SCR_Service_Inf";
BA_ "SystemMessageLongSymbol" BO_ 2566700544 "VDMA_FCBE_Electronic_Transmission_Controll";
BA_ "SystemMessageLongSymbol" BO_ 2566700800 "VDMA_FCBF_Electronic_Transmission_Controll";
BA_ "SystemMessageLongSymbol" BO_ 2566701056 "VDMA_FCC0_Electronic_Transmission_Controll";
BA_ "SystemMessageLongSymbol" BO_ 2566701568 "VDMA_FCC2_Hybrid_or_EV_System_Status_1";
BA_ "SystemMessageLongSymbol" BO_ 2566701824 "VDMA_FCC3_Fuel_Information_4_Gaseous";
BA_ "SystemMessageLongSymbol" BO_ 2566702080 "VDMA_FCC4_Aftertreatment_2_SCR_Exhaust_Gas";
BA_ "SystemMessageLongSymbol" BO_ 2566702336 "VDMA_FCC5_Aftertreatment_1_SCR_Exhaust_Gas";
BA_ "SystemMessageLongSymbol" BO_ 2566702848 "VDMA_FCC7_Model_Year_and_Certification_Eng";
BA_ "SystemMessageLongSymbol" BO_ 2566703104 "VDMA_FCC8_Electronic_Engine_Controller_13";
BA_ "SystemMessageLongSymbol" BO_ 2566703360 "VDMA_FCC9_Engine_Fuel_Throttle_Valve_Infor";
BA_ "SystemMessageLongSymbol" BO_ 2566703616 "VDMA_FCCA_Engine_Exhaust_Gas_Recirculation";
BA_ "SystemMessageLongSymbol" BO_ 2566703872 "VDMA_FCCB_Engine_Exhaust_Gas_Recirculation";
BA_ "SystemMessageLongSymbol" BO_ 2566704128 "VDMA_FCCC_Electronic_Engine_Controller_12";
BA_ "SystemMessageLongSymbol" BO_ 2566704896 "VDMA_FCCF_NOx_Sensor_Self_Diagnosis_Reques";
BA_ "SystemMessageLongSymbol" BO_ 2566705152 "VDMA_FCD0_Engine_Particulate_Sensor_Inform";
BA_ "SystemMessageLongSymbol" BO_ 2566705408 "VDMA_FCD1_Active_Service_Only_DTCs";
BA_ "SystemMessageLongSymbol" BO_ 2566705664 "VDMA_FCD2_Previously_Active_Service_Only_D";
BA_ "SystemMessageLongSymbol" BO_ 2566705920 "VDMA_FCD3_Diagnostic_Data_Clear_Reset_for_";
BA_ "SystemMessageLongSymbol" BO_ 2566706432 "VDMA_FCD5_Aftertreatment_1_Diesel_Exhaust_";
BA_ "SystemMessageLongSymbol" BO_ 2566706688 "VDMA_FCD6_Aftertreatment_1_Diesel_Particul";
BA_ "SystemMessageLongSymbol" BO_ 2566706944 "VDMA_FCD7_Aftertreatment_1_Diesel_Particul";
BA_ "SystemMessageLongSymbol" BO_ 2566707200 "VDMA_FCD8_Aftertreatment_1_Diesel_Particul";
BA_ "SystemMessageLongSymbol" BO_ 2566707456 "VDMA_FCD9_Aftertreatment_1_Diesel_Particul";
BA_ "SystemMessageLongSymbol" BO_ 2566707712 "VDMA_FCDA_Aftertreatment_1_Diesel_Particul";
BA_ "SystemMessageLongSymbol" BO_ 2566707968 "VDMA_FCDB_Aftertreatment_1_Diesel_Particul";
BA_ "SystemMessageLongSymbol" BO_ 2566708224 "VDMA_FCDC_Cruise_Control_Vehicle_Speed_3";
BA_ "SystemMessageLongSymbol" BO_ 2566708480 "VDMA_FCDD_Aftertreatment_2_Air_Control_3";
BA_ "SystemMessageLongSymbol" BO_ 2566708736 "VDMA_FCDE_Aftertreatment_1_Air_Control_3";
BA_ "SystemMessageLongSymbol" BO_ 2566708992 "VDMA_FCDF_Engine_Fluid_Level_Pressure_12";
BA_ "SystemMessageLongSymbol" BO_ 2566709248 "VDMA_FCE0_Diesel_Particulate_Filter_Contro";
BA_ "SystemMessageLongSymbol" BO_ 2566709760 "VDMA_FCE2_Supplemental_Fan_Status";
BA_ "SystemMessageLongSymbol" BO_ 2566710016 "VDMA_FCE3_Engine_Exhaust_Brake_Control";
BA_ "SystemMessageLongSymbol" BO_ 2566710528 "VDMA_FCE5_Hydraulic_Oil_Properties";
BA_ "SystemMessageLongSymbol" BO_ 2566710784 "VDMA_FCE6_Vehicle_Chassis_Lubrication_Syst";
BA_ "SystemMessageLongSymbol" BO_ 2566711296 "VDMA_FCE8_Intake_Valve_Actuation_Control";
BA_ "SystemMessageLongSymbol" BO_ 2566711552 "VDMA_FCE9_Armrest_Switch_Matrix_Commands";
BA_ "SystemMessageLongSymbol" BO_ 2566711808 "VDMA_FCEA_Vehicle_Electrical_Power_4_obsol";
BA_ "SystemMessageLongSymbol" BO_ 2566712064 "VDMA_FCEB_Aftertreatment_2_NOx_Adsorber_In";
BA_ "SystemMessageLongSymbol" BO_ 2566712320 "VDMA_FCEC_Aftertreatment_1_NOx_Adsorber_In";
BA_ "SystemMessageLongSymbol" BO_ 2566712576 "VDMA_FCED_Aftertreatment_2_Warm_Up_Diesel_";
BA_ "SystemMessageLongSymbol" BO_ 2566712832 "VDMA_FCEE_Land_Leveling_System_Reference_E";
BA_ "SystemMessageLongSymbol" BO_ 2566713088 "VDMA_FCEF_Engine_Fluid_Level_Pressure_11";
BA_ "SystemMessageLongSymbol" BO_ 2566713344 "VDMA_FCF0_Engine_Fuel_Lube_x000D_Systems_2";
BA_ "SystemMessageLongSymbol" BO_ 2566713600 "VDMA_FCF1_Engine_Turbocharger_Wastegate_Ac";
BA_ "SystemMessageLongSymbol" BO_ 2566713856 "VDMA_FCF2_Engine_Fuel_Throttle_Valve_Infor";
BA_ "SystemMessageLongSymbol" BO_ 2566714112 "VDMA_FCF3_Engine_Turbocharger_Compressor_B";
BA_ "SystemMessageLongSymbol" BO_ 2566714624 "VDMA_FCF5_Charge_Air_Cooler_2_Precooler";
BA_ "SystemMessageLongSymbol" BO_ 2566715136 "VDMA_FCF7_Charge_Air_Cooler_1_Precooler";
BA_ "SystemMessageLongSymbol" BO_ 2566715392 "VDMA_FCF8_Diesel_Particulate_Filter_2_Soot";
BA_ "SystemMessageLongSymbol" BO_ 2566715648 "VDMA_FCF9_Diesel_Particulate_Filter_1_Soot";
BA_ "SystemMessageLongSymbol" BO_ 2566715904 "VDMA_FCFA_Electronic_Engine_Controller_11";
BA_ "SystemMessageLongSymbol" BO_ 2566716160 "VDMA_FCFB_Engine_Manifold_Actuator_Positio";
BA_ "SystemMessageLongSymbol" BO_ 2566716416 "VDMA_FCFC_Engine_Manifold_Actuator_Control";
BA_ "SystemMessageLongSymbol" BO_ 2566716672 "VDMA_FCFD_Electronic_Engine_Controller_9";
BA_ "SystemMessageLongSymbol" BO_ 2566716928 "VDMA_FCFE_Electronic_Engine_Controller_10";
BA_ "SystemMessageLongSymbol" BO_ 2566717440 "VDMA_FD00_Engine_Fluid_Level_Pressure_10";
BA_ "SystemMessageLongSymbol" BO_ 2566717696 "VDMA_FD01_Low_Voltage_Disconnect_Status";
BA_ "SystemMessageLongSymbol" BO_ 2566718208 "VDMA_FD03_Implement_Operating_state_comman";
BA_ "SystemMessageLongSymbol" BO_ 2566718464 "VDMA_FD04_Direct_Lamp_Control_Data_2";
BA_ "SystemMessageLongSymbol" BO_ 2566718720 "VDMA_FD05_Direct_Lamp_Control_Data_1";
BA_ "SystemMessageLongSymbol" BO_ 2566718976 "VDMA_FD06_Direct_Lamp_Control_Command_2";
BA_ "SystemMessageLongSymbol" BO_ 2566719232 "VDMA_FD07_Direct_Lamp_Control_Command_1";
BA_ "SystemMessageLongSymbol" BO_ 2566720000 "VDMA_FD0A_Aftertreatment_2_Outlet_Gas_NOx_";
BA_ "SystemMessageLongSymbol" BO_ 2566720256 "VDMA_FD0B_Aftertreatment_2_Outlet_Gas_NOx_";
BA_ "SystemMessageLongSymbol" BO_ 2566720512 "VDMA_FD0C_Aftertreatment_2_Intake_Gas_NOx_";
BA_ "SystemMessageLongSymbol" BO_ 2566720768 "VDMA_FD0D_Aftertreatment_2_Intake_Gas_NOx_";
BA_ "SystemMessageLongSymbol" BO_ 2566721024 "VDMA_FD0E_Aftertreatment_1_Outlet_Gas_NOx_";
BA_ "SystemMessageLongSymbol" BO_ 2566721280 "VDMA_FD0F_Aftertreatment_1_Outlet_Gas_NOx_";
BA_ "SystemMessageLongSymbol" BO_ 2566721536 "VDMA_FD10_Aftertreatment_1_Intake_Gas_NOx_";
BA_ "SystemMessageLongSymbol" BO_ 2566721792 "VDMA_FD11_Aftertreatment_1_Intake_Gas_NOx_";
BA_ "SystemMessageLongSymbol" BO_ 2566722048 "VDMA_FD12_Magnet_Status_Information_1";
BA_ "SystemMessageLongSymbol" BO_ 2566722304 "VDMA_FD13_Magnet_System_Configuration_Info";
BA_ "SystemMessageLongSymbol" BO_ 2566723072 "VDMA_FD16_Occupant_Classification_System_I";
BA_ "SystemMessageLongSymbol" BO_ 2566723328 "VDMA_FD17_Beltlock_and_Airbag_Deactivation";
BA_ "SystemMessageLongSymbol" BO_ 2566723584 "VDMA_FD18_Collision_Sensor_Information";
BA_ "SystemMessageLongSymbol" BO_ 2566723840 "VDMA_FD19_Ignitor_Loop_Information";
BA_ "SystemMessageLongSymbol" BO_ 2566724096 "VDMA_FD1A_Aftertreatment_1_Warm_Up_Diesel_";
BA_ "SystemMessageLongSymbol" BO_ 2566724352 "VDMA_FD1B_Diesel_Particulate_Filter_2_Soot";
BA_ "SystemMessageLongSymbol" BO_ 2566724608 "VDMA_FD1C_Diesel_Particulate_Filter_1_Soot";
BA_ "SystemMessageLongSymbol" BO_ 2566724864 "VDMA_FD1D_Aftertreatment_Differential_Temp";
BA_ "SystemMessageLongSymbol" BO_ 2566725120 "VDMA_FD1E_Aftertreatment_Differential_Temp";
BA_ "SystemMessageLongSymbol" BO_ 2566725376 "VDMA_FD1F_Aftertreatment_2_Diesel_Oxidatio";
BA_ "SystemMessageLongSymbol" BO_ 2566725632 "VDMA_FD20_Aftertreatment_1_Diesel_Oxidatio";
BA_ "SystemMessageLongSymbol" BO_ 2566725888 "VDMA_FD21_Aftertreatment_2_Gas_Oxidation_C";
BA_ "SystemMessageLongSymbol" BO_ 2566726144 "VDMA_FD22_Aftertreatment_1_Gas_Oxidation_C";
BA_ "SystemMessageLongSymbol" BO_ 2566726400 "VDMA_FD23_Extended_Joystick_Message_10";
BA_ "SystemMessageLongSymbol" BO_ 2566726656 "VDMA_FD24_Basic_Joystick_Message_10";
BA_ "SystemMessageLongSymbol" BO_ 2566726912 "VDMA_FD25_Extended_Joystick_Message_9";
BA_ "SystemMessageLongSymbol" BO_ 2566727168 "VDMA_FD26_Basic_Joystick_Message_9";
BA_ "SystemMessageLongSymbol" BO_ 2566727424 "VDMA_FD27_Extended_Joystick_Message_8";
BA_ "SystemMessageLongSymbol" BO_ 2566727680 "VDMA_FD28_Basic_Joystick_Message_8";
BA_ "SystemMessageLongSymbol" BO_ 2566727936 "VDMA_FD29_Extended_Joystick_Message_7";
BA_ "SystemMessageLongSymbol" BO_ 2566728192 "VDMA_FD2A_Basic_Joystick_Message_7";
BA_ "SystemMessageLongSymbol" BO_ 2566728448 "VDMA_FD2B_Extended_Joystick_Message_6";
BA_ "SystemMessageLongSymbol" BO_ 2566728704 "VDMA_FD2C_Basic_Joystick_Message_6";
BA_ "SystemMessageLongSymbol" BO_ 2566728960 "VDMA_FD2D_Extended_Joystick_Message_5";
BA_ "SystemMessageLongSymbol" BO_ 2566729216 "VDMA_FD2E_Basic_Joystick_Message_5";
BA_ "SystemMessageLongSymbol" BO_ 2566729472 "VDMA_FD2F_Extended_Joystick_Message_4";
BA_ "SystemMessageLongSymbol" BO_ 2566729728 "VDMA_FD30_Basic_Joystick_Message_4";
BA_ "SystemMessageLongSymbol" BO_ 2566730496 "VDMA_FD33_Aftertreatment_2_Diesel_Exhaust_";
BA_ "SystemMessageLongSymbol" BO_ 2566730752 "VDMA_FD34_Aftertreatment_2_SCR_Reagant_Tan";
BA_ "SystemMessageLongSymbol" BO_ 2566731008 "VDMA_FD35_Aftertreatment_2_Diesel_Exhaust_";
BA_ "SystemMessageLongSymbol" BO_ 2566731264 "VDMA_FD36_Aftertreatment_2_Diesel_Exhaust_";
BA_ "SystemMessageLongSymbol" BO_ 2566731520 "VDMA_FD37_Aftertreatment_2_SCR_Service_Inf";
BA_ "SystemMessageLongSymbol" BO_ 2566731776 "VDMA_FD38_Aftertreatment_2_SCR_Exhaust_Gas";
BA_ "SystemMessageLongSymbol" BO_ 2566732032 "VDMA_FD39_Aftertreatment_2_SCR_Exhaust_Gas";
BA_ "SystemMessageLongSymbol" BO_ 2566732288 "VDMA_FD3A_Aftertreatment_2_SCR_Dosing_Syst";
BA_ "SystemMessageLongSymbol" BO_ 2566732544 "VDMA_FD3B_Aftertreatment_2_SCR_Dosing_Syst";
BA_ "SystemMessageLongSymbol" BO_ 2566732800 "VDMA_FD3C_Aftertreatment_1_Diesel_Exhaust_";
BA_ "SystemMessageLongSymbol" BO_ 2566733056 "VDMA_FD3D_Aftertreatment_1_SCR_Reagant_Tan";
BA_ "SystemMessageLongSymbol" BO_ 2566733312 "VDMA_FD3E_Aftertreatment_1_SCR_Exhaust_Gas";
BA_ "SystemMessageLongSymbol" BO_ 2566733568 "VDMA_FD3F_Aftertreatment_1_SCR_Exhaust_Gas";
BA_ "SystemMessageLongSymbol" BO_ 2566733824 "VDMA_FD40_Aftertreatment_1_SCR_Dosing_Syst";
BA_ "SystemMessageLongSymbol" BO_ 2566734080 "VDMA_FD41_Aftertreatment_1_SCR_Dosing_Syst";
BA_ "SystemMessageLongSymbol" BO_ 2566734336 "VDMA_FD42_ISOBUS_compliance_certification";
BA_ "SystemMessageLongSymbol" BO_ 2566734848 "VDMA_FD44_Aftertreatment_2_Fuel_Control_2";
BA_ "SystemMessageLongSymbol" BO_ 2566735104 "VDMA_FD45_Aftertreatment_2_Three_Way_Catal";
BA_ "SystemMessageLongSymbol" BO_ 2566735360 "VDMA_FD46_Aftertreatment_1_Three_Way_Catal";
BA_ "SystemMessageLongSymbol" BO_ 2566735616 "VDMA_FD47_Transmission_Mode_Labels";
BA_ "SystemMessageLongSymbol" BO_ 2566735872 "VDMA_FD48_Engine_Exhaust_Bank_2_O2_Fuel_Tr";
BA_ "SystemMessageLongSymbol" BO_ 2566736128 "VDMA_FD49_Engine_Exhaust_Bank_1_O2_Fuel_Tr";
BA_ "SystemMessageLongSymbol" BO_ 2566736384 "VDMA_FD4A_General_Purpose_Message_2_11";
BA_ "SystemMessageLongSymbol" BO_ 2566736640 "VDMA_FD4B_General_Purpose_Message_2_10";
BA_ "SystemMessageLongSymbol" BO_ 2566736896 "VDMA_FD4C_General_Purpose_Message_2_9";
BA_ "SystemMessageLongSymbol" BO_ 2566737152 "VDMA_FD4D_General_Purpose_Message_2_8";
BA_ "SystemMessageLongSymbol" BO_ 2566737408 "VDMA_FD4E_General_Purpose_Message_2_7";
BA_ "SystemMessageLongSymbol" BO_ 2566737664 "VDMA_FD4F_General_Purpose_Message_2_6";
BA_ "SystemMessageLongSymbol" BO_ 2566737920 "VDMA_FD50_General_Purpose_Message_1_9";
BA_ "SystemMessageLongSymbol" BO_ 2566738176 "VDMA_FD51_Aftercooler_Coolant_Control_Valv";
BA_ "SystemMessageLongSymbol" BO_ 2566738432 "VDMA_FD52_Engine_Coolant_Control_Valve_Com";
BA_ "SystemMessageLongSymbol" BO_ 2566738688 "VDMA_FD53_Engine_Average_Information";
BA_ "SystemMessageLongSymbol" BO_ 2566738944 "VDMA_FD54_DTCs_C_Previously_Active";
BA_ "SystemMessageLongSymbol" BO_ 2566739200 "VDMA_FD55_DTCs_C_Confirmed_and_Active";
BA_ "SystemMessageLongSymbol" BO_ 2566739712 "VDMA_FD57_DTCs_B2_Previously_Active";
BA_ "SystemMessageLongSymbol" BO_ 2566739968 "VDMA_FD58_DTCs_B2_Confirmed_and_Active";
BA_ "SystemMessageLongSymbol" BO_ 2566740480 "VDMA_FD5A_DTCs_B1_Previously_Active";
BA_ "SystemMessageLongSymbol" BO_ 2566740736 "VDMA_FD5B_DTCs_B1_Confirmed_and_Active";
BA_ "SystemMessageLongSymbol" BO_ 2566741248 "VDMA_FD5D_DTCs_A_Previously_Active";
BA_ "SystemMessageLongSymbol" BO_ 2566741504 "VDMA_FD5E_DTCs_A_Confirmed_and_Active";
BA_ "SystemMessageLongSymbol" BO_ 2566742016 "VDMA_FD60_Harmonized_B1_Failure_Counts";
BA_ "SystemMessageLongSymbol" BO_ 2566742272 "VDMA_FD61_Harmonized_Cumulative_Continuous";
BA_ "SystemMessageLongSymbol" BO_ 2566742528 "VDMA_FD62_Harmonized_Global_Regulation_Des";
BA_ "SystemMessageLongSymbol" BO_ 2566742784 "VDMA_FD63_Harmonized_Roadworthiness_System";
BA_ "SystemMessageLongSymbol" BO_ 2566743040 "VDMA_FD64_Harmonized_Roadworthiness_Vehicl";
BA_ "SystemMessageLongSymbol" BO_ 2566743296 "VDMA_FD65_Aftertreatment_1_Fuel_Control_2";
BA_ "SystemMessageLongSymbol" BO_ 2566743808 "VDMA_FD67_Zero_Net_Vehicle_Weight_Change";
BA_ "SystemMessageLongSymbol" BO_ 2566744064 "VDMA_FD68_Gross_Combination_Vehicle_Weight";
BA_ "SystemMessageLongSymbol" BO_ 2566744320 "VDMA_FD69_Axle_Group_Calibration_Weights";
BA_ "SystemMessageLongSymbol" BO_ 2566744832 "VDMA_FD6B_Available_Axle_Group_Weights";
BA_ "SystemMessageLongSymbol" BO_ 2566745088 "VDMA_FD6C_Aftertreatment_2_Air_Control_2";
BA_ "SystemMessageLongSymbol" BO_ 2566745344 "VDMA_FD6D_Aftertreatment_1_Air_Control_2";
BA_ "SystemMessageLongSymbol" BO_ 2566745600 "VDMA_FD6E_Aftertreatment_1_SCR_Service_Inf";
BA_ "SystemMessageLongSymbol" BO_ 2566745856 "VDMA_FD6F_Electronic_Engine_Controller_8";
