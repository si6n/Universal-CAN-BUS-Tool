VERSION "created by canmatrix"

NS_ :

BS_:

BU_:

BO_ 2566746368 VDMA_FD71_Brake_actuator_stroke_: 8 Vector__XXX
 SG_ Brake_actuator_stroke_status_Raw : 0|64@1+ (1,0) [0|18446744073709551615] "" Vector__XXX

BO_ 2566746624 VDMA_FD72_Engine_Spark_Voltage_6: 8 Vector__XXX
 SG_ Engine_Spark_Voltage_6_RawPayloa : 0|64@1+ (1,0) [0|18446744073709551615] "" Vector__XXX

BO_ 2566746880 VDMA_FD73_Engine_Spark_Voltage_5: 8 Vector__XXX
 SG_ Engine_Spark_Voltage_5_RawPayloa : 0|64@1+ (1,0) [0|18446744073709551615] "" Vector__XXX

BO_ 2566747136 VDMA_FD74_Engine_Spark_Voltage_4: 8 Vector__XXX
 SG_ Engine_Spark_Voltage_4_RawPayloa : 0|64@1+ (1,0) [0|18446744073709551615] "" Vector__XXX

BO_ 2566747392 VDMA_FD75_Engine_Spark_Voltage_3: 8 Vector__XXX
 SG_ Engine_Spark_Voltage_3_RawPayloa : 0|64@1+ (1,0) [0|18446744073709551615] "" Vector__XXX

BO_ 2566747648 VDMA_FD76_Engine_Spark_Voltage_2: 8 Vector__XXX
 SG_ Engine_Spark_Voltage_2_RawPayloa : 0|64@1+ (1,0) [0|18446744073709551615] "" Vector__XXX

BO_ 2566747904 VDMA_FD77_Engine_Spark_Voltage_1: 8 Vector__XXX
 SG_ Engine_Spark_Voltage_1_RawPayloa : 0|64@1+ (1,0) [0|18446744073709551615] "" Vector__XXX

BO_ 2566748160 VDMA_FD78_Aftertreatment_2_Trip_: 8 Vector__XXX
 SG_ Aftertreatment_2_Trip_Informatio : 0|64@1+ (1,0) [0|18446744073709551615] "" Vector__XXX

BO_ 2566748416 VDMA_FD79_Aftertreatment_1_Trip_: 8 Vector__XXX
 SG_ Aftertreatment_1_Trip_Informatio : 0|64@1+ (1,0) [0|18446744073709551615] "" Vector__XXX

BO_ 2566748672 VDMA_FD7A_Aftertreatment_2_Servi: 8 Vector__XXX
 SG_ Aftertreatment_2_Service_1_RawPa : 0|64@1+ (1,0) [0|18446744073709551615] "" Vector__XXX

BO_ 2566748928 VDMA_FD7B_Aftertreatment_1_Servi: 8 Vector__XXX
 SG_ Aftertreatment_1_Service_1_RawPa : 0|64@1+ (1,0) [0|18446744073709551615] "" Vector__XXX

BO_ 2566749696 VDMA_FD7E_Adaptive_Front_Lightin: 8 Vector__XXX
 SG_ Adaptive_Front_Lighting_System_S : 0|64@1+ (1,0) [0|18446744073709551615] "" Vector__XXX

BO_ 2566749952 VDMA_FD7F_Engine_Configuration_2: 8 Vector__XXX
 SG_ Engine_Configuration_2_RawPayloa : 0|64@1+ (1,0) [0|18446744073709551615] "" Vector__XXX

BO_ 2566750208 VDMA_FD80_Emission_Related_Perma: 8 Vector__XXX
 SG_ Emission_Related_Permanent_Diagn : 0|64@1+ (1,0) [0|18446744073709551615] "" Vector__XXX

BO_ 2566750464 VDMA_FD81_EGR_Cooler_Bypass: 8 Vector__XXX
 SG_ EGR_Cooler_Bypass_RawPayload : 0|64@1+ (1,0) [0|18446744073709551615] "" Vector__XXX

BO_ 2566750720 VDMA_FD82_All_Pending_DTCs: 8 Vector__XXX
 SG_ All_Pending_DTCs_RawPayload : 0|64@1+ (1,0) [0|18446744073709551615] "" Vector__XXX

BO_ 2566750976 VDMA_FD83_Transfer_Case_Informat: 8 Vector__XXX
 SG_ Transfer_Case_Information_RawPay : 0|64@1+ (1,0) [0|18446744073709551615] "" Vector__XXX

BO_ 2566751232 VDMA_FD84_Engine_Fluid_Level_Pre: 8 Vector__XXX
 SG_ Engine_Fluid_Level_Pressure_9_Ra : 0|64@1+ (1,0) [0|18446744073709551615] "" Vector__XXX

BO_ 2566751488 VDMA_FD85_Engine_Fluid_Level_Pre: 8 Vector__XXX
 SG_ Engine_Fluid_Level_Pressure_8_Ra : 0|64@1+ (1,0) [0|18446744073709551615] "" Vector__XXX

BO_ 2566751744 VDMA_FD86_Engine_Fluid_Level_Pre: 8 Vector__XXX
 SG_ Engine_Fluid_Level_Pressure_7_Ra : 0|64@1+ (1,0) [0|18446744073709551615] "" Vector__XXX

BO_ 2566752000 VDMA_FD87_Engine_Fluid_Level_Pre: 8 Vector__XXX
 SG_ Engine_Fluid_Level_Pressure_6_Ra : 0|64@1+ (1,0) [0|18446744073709551615] "" Vector__XXX

BO_ 2566752256 VDMA_FD88_Engine_Fluid_Level_Pre: 8 Vector__XXX
 SG_ Engine_Fluid_Level_Pressure_5_Ra : 0|64@1+ (1,0) [0|18446744073709551615] "" Vector__XXX

BO_ 2566752512 VDMA_FD89_Vehicle_Direction_Spee: 8 Vector__XXX
 SG_ Vehicle_Direction_Speed_2_RawPay : 0|64@1+ (1,0) [0|18446744073709551615] "" Vector__XXX

BO_ 2566752768 VDMA_FD8A_SAE_J2012_2_Byte_DTC_D: 8 Vector__XXX
 SG_ SAE_J2012_2_Byte_DTC_Display_Raw : 0|64@1+ (1,0) [0|18446744073709551615] "" Vector__XXX

BO_ 2566753024 VDMA_FD8B_Aftertreatment_2_Gas_P: 8 Vector__XXX
 SG_ Aftertreatment_2_Gas_Parameters_ : 0|64@1+ (1,0) [0|18446744073709551615] "" Vector__XXX

BO_ 2566753280 VDMA_FD8C_Aftertreatment_1_Gas_P: 8 Vector__XXX
 SG_ Aftertreatment_1_Gas_Parameters_ : 0|64@1+ (1,0) [0|18446744073709551615] "" Vector__XXX

BO_ 2566753536 VDMA_FD8D_Utility_Total_AC_React: 8 Vector__XXX
 SG_ Utility_Total_AC_Reactive_Energy : 0|64@1+ (1,0) [0|18446744073709551615] "" Vector__XXX

BO_ 2566753792 VDMA_FD8E_Generator_Total_AC_Rea: 8 Vector__XXX
 SG_ Generator_Total_AC_Reactive_Ener : 0|64@1+ (1,0) [0|18446744073709551615] "" Vector__XXX

BO_ 2566754048 VDMA_FD8F_Generator_Total_AC_Per: 8 Vector__XXX
 SG_ Generator_Total_AC_Percent_Power : 0|64@1+ (1,0) [0|18446744073709551615] "" Vector__XXX

BO_ 2566754304 VDMA_FD90_Advertised_Engine_Torq: 8 Vector__XXX
 SG_ Advertised_Engine_Torque_Curve_R : 0|64@1+ (1,0) [0|18446744073709551615] "" Vector__XXX

BO_ 2566754560 VDMA_FD91_AC_Switching_Device_St: 8 Vector__XXX
 SG_ AC_Switching_Device_Status_RawPa : 0|64@1+ (1,0) [0|18446744073709551615] "" Vector__XXX

BO_ 2566754816 VDMA_FD92_Engine_Operating_Infor: 8 Vector__XXX
 SG_ Engine_Operating_Information_Raw : 0|64@1+ (1,0) [0|18446744073709551615] "" Vector__XXX

BO_ 2566755072 VDMA_FD93_Generator_Control_1: 8 Vector__XXX
 SG_ Generator_Control_1_RawPayload : 0|64@1+ (1,0) [0|18446744073709551615] "" Vector__XXX

BO_ 2566755328 VDMA_FD94_Electronic_Engine_Cont: 8 Vector__XXX
 SG_ Electronic_Engine_Controller_7_R : 0|64@1+ (1,0) [0|18446744073709551615] "" Vector__XXX

BO_ 2566755584 VDMA_FD95_Transmission_Fluids_2: 8 Vector__XXX
 SG_ Transmission_Fluids_2_RawPayload : 0|64@1+ (1,0) [0|18446744073709551615] "" Vector__XXX

BO_ 2566755840 VDMA_FD96_Fuel_Information_2_Liq: 8 Vector__XXX
 SG_ Fuel_Information_2_Liquid_RawPay : 0|64@1+ (1,0) [0|18446744073709551615] "" Vector__XXX

BO_ 2566756096 VDMA_FD97_Fuel_Information_3_Liq: 8 Vector__XXX
 SG_ Fuel_Information_3_Liquid_RawPay : 0|64@1+ (1,0) [0|18446744073709551615] "" Vector__XXX

BO_ 2566756352 VDMA_FD98_Aftertreatment_1_Histo: 8 Vector__XXX
 SG_ Aftertreatment_1_Historical_Info : 0|64@1+ (1,0) [0|18446744073709551615] "" Vector__XXX

BO_ 2566756608 VDMA_FD99_Aftertreatment_2_Histo: 8 Vector__XXX
 SG_ Aftertreatment_2_Historical_info : 0|64@1+ (1,0) [0|18446744073709551615] "" Vector__XXX

BO_ 2566756864 VDMA_FD9A_Electronic_Brake_Syste: 8 Vector__XXX
 SG_ Electronic_Brake_System_2_4_RawP : 0|64@1+ (1,0) [0|18446744073709551615] "" Vector__XXX

BO_ 2566757120 VDMA_FD9B_Aftertreatment_1_Diese: 8 Vector__XXX
 SG_ Aftertreatment_1_Diesel_Exhaust_ : 0|64@1+ (1,0) [0|18446744073709551615] "" Vector__XXX

BO_ 2566757376 VDMA_FD9C_Sensor_Electrical_Powe: 8 Vector__XXX
 SG_ Sensor_Electrical_Power_2_RawPay : 0|64@1+ (1,0) [0|18446744073709551615] "" Vector__XXX

BO_ 2566757632 VDMA_FD9D_Sensor_Electrical_Powe: 8 Vector__XXX
 SG_ Sensor_Electrical_Power_1_RawPay : 0|64@1+ (1,0) [0|18446744073709551615] "" Vector__XXX

BO_ 2566757888 VDMA_FD9E_Aftertreatment_2_Air_C: 8 Vector__XXX
 SG_ Aftertreatment_2_Air_Control_1_R : 0|64@1+ (1,0) [0|18446744073709551615] "" Vector__XXX

BO_ 2566758144 VDMA_FD9F_Aftertreatment_1_Air_C: 8 Vector__XXX
 SG_ Aftertreatment_1_Air_Control_1_R : 0|64@1+ (1,0) [0|18446744073709551615] "" Vector__XXX

BO_ 2566758400 VDMA_FDA0_Aftertreatment_2_Fuel_: 8 Vector__XXX
 SG_ Aftertreatment_2_Fuel_Control_1_ : 0|64@1+ (1,0) [0|18446744073709551615] "" Vector__XXX

BO_ 2566758656 VDMA_FDA1_Aftertreatment_1_Fuel_: 8 Vector__XXX
 SG_ Aftertreatment_1_Fuel_Control_1_ : 0|64@1+ (1,0) [0|18446744073709551615] "" Vector__XXX

BO_ 2566758912 VDMA_FDA2_Fuel_Information_3_Gas: 8 Vector__XXX
 SG_ Fuel_Information_3_Gaseous_RawPa : 0|64@1+ (1,0) [0|18446744073709551615] "" Vector__XXX

BO_ 2566759168 VDMA_FDA3_Electronic_Engine_Cont: 8 Vector__XXX
 SG_ Electronic_Engine_Controller_6_R : 0|64@1+ (1,0) [0|18446744073709551615] "" Vector__XXX

BO_ 2566759424 VDMA_FDA4_PTO_Drive_Engagement_1: 8 Vector__XXX
 SG_ PTO_Drive_Engagement_1_RawPayloa : 0|64@1+ (1,0) [0|18446744073709551615] "" Vector__XXX

BO_ 2566759680 VDMA_FDA5_Door_Control_2: 8 Vector__XXX
 SG_ Door_Control_2_RawPayload : 0|64@1+ (1,0) [0|18446744073709551615] "" Vector__XXX

BO_ 2566759936 VDMA_FDA6_Voltage_Regulator_Exci: 8 Vector__XXX
 SG_ Voltage_Regulator_Excitation_Sta : 0|64@1+ (1,0) [0|18446744073709551615] "" Vector__XXX

BO_ 2566760192 VDMA_FDA7_Voltage_Regulator_Oper: 8 Vector__XXX
 SG_ Voltage_Regulator_Operating_Mode : 0|64@1+ (1,0) [0|18446744073709551615] "" Vector__XXX

BO_ 2566760448 VDMA_FDA8_Wireless_Communication: 8 Vector__XXX
 SG_ Wireless_Communications_Message_ : 0|64@1+ (1,0) [0|18446744073709551615] "" Vector__XXX

BO_ 2566760704 VDMA_FDA9_Wireless_Communication: 8 Vector__XXX
 SG_ Wireless_Communications_Message_ : 0|64@1+ (1,0) [0|18446744073709551615] "" Vector__XXX

BO_ 2566760960 VDMA_FDAA_Engine_Fluid_Level_Pre: 8 Vector__XXX
 SG_ Engine_Fluid_Level_Pressure_4_Ra : 0|64@1+ (1,0) [0|18446744073709551615] "" Vector__XXX

BO_ 2566761216 VDMA_FDAB_Request_For_Complete_C: 8 Vector__XXX
 SG_ Request_For_Complete_Configurabl : 0|64@1+ (1,0) [0|18446744073709551615] "" Vector__XXX

BO_ 2566761472 VDMA_FDAC_Engine_Fuel_Informatio: 8 Vector__XXX
 SG_ Engine_Fuel_Information_RawPaylo : 0|64@1+ (1,0) [0|18446744073709551615] "" Vector__XXX

BO_ 2566761728 VDMA_FDAD_Request_For_Complete_C: 8 Vector__XXX
 SG_ Request_For_Complete_Configurabl : 0|64@1+ (1,0) [0|18446744073709551615] "" Vector__XXX

BO_ 2566761984 VDMA_FDAE_Fifth_Wheel_Smart_Syst: 8 Vector__XXX
 SG_ Fifth_Wheel_Smart_Systems_2_RawP : 0|64@1+ (1,0) [0|18446744073709551615] "" Vector__XXX

BO_ 2566762240 VDMA_FDAF_Aftertreatment_2_Inter: 8 Vector__XXX
 SG_ Aftertreatment_2_Intermediate_Ga : 0|64@1+ (1,0) [0|18446744073709551615] "" Vector__XXX

BO_ 2566762496 VDMA_FDB0_Aftertreatment_2_Outle: 8 Vector__XXX
 SG_ Aftertreatment_2_Outlet_Gas_2_Ra : 0|64@1+ (1,0) [0|18446744073709551615] "" Vector__XXX

BO_ 2566762752 VDMA_FDB1_Aftertreatment_2_Intak: 8 Vector__XXX
 SG_ Aftertreatment_2_Intake_Gas_2_Ra : 0|64@1+ (1,0) [0|18446744073709551615] "" Vector__XXX

BO_ 2566763008 VDMA_FDB2_Aftertreatment_1_Inter: 8 Vector__XXX
 SG_ Aftertreatment_1_Intermediate_Ga : 0|64@1+ (1,0) [0|18446744073709551615] "" Vector__XXX

BO_ 2566763264 VDMA_FDB3_Aftertreatment_1_Outle: 8 Vector__XXX
 SG_ Aftertreatment_1_Outlet_Gas_2_Ra : 0|64@1+ (1,0) [0|18446744073709551615] "" Vector__XXX

BO_ 2566763520 VDMA_FDB4_Aftertreatment_1_Intak: 8 Vector__XXX
 SG_ Aftertreatment_1_Intake_Gas_2_Ra : 0|64@1+ (1,0) [0|18446744073709551615] "" Vector__XXX

BO_ 2566763776 VDMA_FDB5_Emission_Related_Previ: 8 Vector__XXX
 SG_ Emission_Related_Previously_MIL_ : 0|64@1+ (1,0) [0|18446744073709551615] "" Vector__XXX

BO_ 2566764032 VDMA_FDB6_SPN_Support: 8 Vector__XXX
 SG_ SPN_Support_RawPayload : 0|64@1+ (1,0) [0|18446744073709551615] "" Vector__XXX

BO_ 2566764288 VDMA_FDB7_Expanded_Freeze_Frame: 8 Vector__XXX
 SG_ Expanded_Freeze_Frame_RawPayload : 0|64@1+ (1,0) [0|18446744073709551615] "" Vector__XXX

BO_ 2566764544 VDMA_FDB8_Diagnostic_Readiness_3: 8 Vector__XXX
 SG_ Diagnostic_Readiness_3_RawPayloa : 0|64@1+ (1,0) [0|18446744073709551615] "" Vector__XXX

BO_ 2566764800 VDMA_FDB9_Tire_Pressure_Referenc: 8 Vector__XXX
 SG_ Tire_Pressure_Reference_Informat : 0|64@1+ (1,0) [0|18446744073709551615] "" Vector__XXX

BO_ 2566765056 VDMA_FDBA_Farebox_Status: 8 Vector__XXX
 SG_ Farebox_Status_RawPayload : 0|64@1+ (1,0) [0|18446744073709551615] "" Vector__XXX

BO_ 2566765312 VDMA_FDBB_Farebox_Point_of_Sale: 8 Vector__XXX
 SG_ Farebox_Point_of_Sale_RawPayload : 0|64@1+ (1,0) [0|18446744073709551615] "" Vector__XXX

BO_ 2566765568 VDMA_FDBC_Farebox_Service_Detail: 8 Vector__XXX
 SG_ Farebox_Service_Detail_RawPayloa : 0|64@1+ (1,0) [0|18446744073709551615] "" Vector__XXX

BO_ 2566765824 VDMA_FDBD_Signal_Preemption: 8 Vector__XXX
 SG_ Signal_Preemption_RawPayload : 0|64@1+ (1,0) [0|18446744073709551615] "" Vector__XXX

BO_ 2566766080 VDMA_FDBE_Transit_Route: 8 Vector__XXX
 SG_ Transit_Route_RawPayload : 0|64@1+ (1,0) [0|18446744073709551615] "" Vector__XXX

BO_ 2566766336 VDMA_FDBF_Transit_Milepost: 8 Vector__XXX
 SG_ Transit_Milepost_RawPayload : 0|64@1+ (1,0) [0|18446744073709551615] "" Vector__XXX

BO_ 2566766592 VDMA_FDC0_Passenger_Counter: 8 Vector__XXX
 SG_ Passenger_Counter_RawPayload : 0|64@1+ (1,0) [0|18446744073709551615] "" Vector__XXX

BO_ 2566766848 VDMA_FDC1_Engine_Fluid_Level_Pre: 8 Vector__XXX
 SG_ Engine_Fluid_Level_Pressure_3_Ra : 0|64@1+ (1,0) [0|18446744073709551615] "" Vector__XXX

BO_ 2566767104 VDMA_FDC2_Electronic_Engine_Cont: 8 Vector__XXX
 SG_ Electronic_Engine_Controller_14_ : 0|64@1+ (1,0) [0|18446744073709551615] "" Vector__XXX

BO_ 2566767360 VDMA_FDC3_Electronic_Engine_Cont: 8 Vector__XXX
 SG_ Electronic_Engine_Controller_15_ : 0|64@1+ (1,0) [0|18446744073709551615] "" Vector__XXX

BO_ 2566767616 VDMA_FDC4_Electronic_Brake_Contr: 8 Vector__XXX
 SG_ Electronic_Brake_Controller_5_Ra : 0|64@1+ (1,0) [0|18446744073709551615] "" Vector__XXX

BO_ 2566768128 VDMA_FDC6_Cold_Start_Aids: 8 Vector__XXX
 SG_ Cold_Start_Aids_RawPayload : 0|64@1+ (1,0) [0|18446744073709551615] "" Vector__XXX

BO_ 2566768384 VDMA_FDC7_Off_Highway_Engine_Con: 8 Vector__XXX
 SG_ Off_Highway_Engine_Control_Selec : 0|64@1+ (1,0) [0|18446744073709551615] "" Vector__XXX

BO_ 2566768640 VDMA_FDC8_Operator_Primary_Inter: 8 Vector__XXX
 SG_ Operator_Primary_Intermediate_Sp : 0|64@1+ (1,0) [0|18446744073709551615] "" Vector__XXX

BO_ 2566768896 VDMA_FDC9_Electronic_Control_Mod: 8 Vector__XXX
 SG_ Electronic_Control_Module_Inform : 0|64@1+ (1,0) [0|18446744073709551615] "" Vector__XXX

BO_ 2566769152 VDMA_FDCA_Intermediate_Speed_Con: 8 Vector__XXX
 SG_ Intermediate_Speed_Control_RawPa : 0|64@1+ (1,0) [0|18446744073709551615] "" Vector__XXX

BO_ 2566769408 VDMA_FDCB_Off_Highway_Engine_Con: 8 Vector__XXX
 SG_ Off_Highway_Engine_Control_Selec : 0|64@1+ (1,0) [0|18446744073709551615] "" Vector__XXX

BO_ 2566769664 VDMA_FDCC_Operators_External_Lig: 8 Vector__XXX
 SG_ Operators_External_Light_Control : 0|64@1+ (1,0) [0|18446744073709551615] "" Vector__XXX

BO_ 2566769920 VDMA_FDCD_Operator_Wiper_and_Was: 8 Vector__XXX
 SG_ Operator_Wiper_and_Washer_Contro : 0|64@1+ (1,0) [0|18446744073709551615] "" Vector__XXX

BO_ 2566770176 VDMA_FDCE_Working_Set_Member_Mes: 8 Vector__XXX
 SG_ Working_Set_Member_Message_Obsol : 0|64@1+ (1,0) [0|18446744073709551615] "" Vector__XXX

BO_ 2566770432 VDMA_FDCF_Working_Set_Master_Mes: 8 Vector__XXX
 SG_ Working_Set_Master_Message_Obsol : 0|64@1+ (1,0) [0|18446744073709551615] "" Vector__XXX

BO_ 2566770688 VDMA_FDD0_Intake_Exhaust_Conditi: 8 Vector__XXX
 SG_ Intake_Exhaust_Conditions_2_RawP : 0|64@1+ (1,0) [0|18446744073709551615] "" Vector__XXX

BO_ 2566770944 VDMA_FDD1_FMS_standard_Interface: 8 Vector__XXX
 SG_ FMS_standard_Interface_Identity_ : 0|64@1+ (1,0) [0|18446744073709551615] "" Vector__XXX

BO_ 2566771200 VDMA_FDD2_ECU_Performance: 8 Vector__XXX
 SG_ ECU_Performance_RawPayload : 0|64@1+ (1,0) [0|18446744073709551615] "" Vector__XXX

BO_ 2566771456 VDMA_FDD3_Turbocharger_Informati: 8 Vector__XXX
 SG_ Turbocharger_Information_6_RawPa : 0|64@1+ (1,0) [0|18446744073709551615] "" Vector__XXX

BO_ 2566771712 VDMA_FDD4_Cab_Message_3: 8 Vector__XXX
 SG_ Cab_Message_3_RawPayload : 0|64@1+ (1,0) [0|18446744073709551615] "" Vector__XXX

BO_ 2566771968 VDMA_FDD5_Electronic_Engine_Cont: 8 Vector__XXX
 SG_ Electronic_Engine_Controller_5_R : 0|64@1+ (1,0) [0|18446744073709551615] "" Vector__XXX

BO_ 2566772224 VDMA_FDD6_Basic_Joystick_Message: 8 Vector__XXX
 SG_ Basic_Joystick_Message_1_RawPayl : 0|64@1+ (1,0) [0|18446744073709551615] "" Vector__XXX

BO_ 2566772480 VDMA_FDD7_Extended_Joystick_Mess: 8 Vector__XXX
 SG_ Extended_Joystick_Message_1_RawP : 0|64@1+ (1,0) [0|18446744073709551615] "" Vector__XXX

BO_ 2566772736 VDMA_FDD8_Basic_Joystick_Message: 8 Vector__XXX
 SG_ Basic_Joystick_Message_2_RawPayl : 0|64@1+ (1,0) [0|18446744073709551615] "" Vector__XXX

BO_ 2566772992 VDMA_FDD9_Extended_Joystick_Mess: 8 Vector__XXX
 SG_ Extended_Joystick_Message_2_RawP : 0|64@1+ (1,0) [0|18446744073709551615] "" Vector__XXX

BO_ 2566773248 VDMA_FDDA_Basic_Joystick_Message: 8 Vector__XXX
 SG_ Basic_Joystick_Message_3_RawPayl : 0|64@1+ (1,0) [0|18446744073709551615] "" Vector__XXX

BO_ 2566773504 VDMA_FDDB_Extended_Joystick_Mess: 8 Vector__XXX
 SG_ Extended_Joystick_Message_3_RawP : 0|64@1+ (1,0) [0|18446744073709551615] "" Vector__XXX

BO_ 2566773760 VDMA_FDDC_Marine_Control_Informa: 8 Vector__XXX
 SG_ Marine_Control_Information_RawPa : 0|64@1+ (1,0) [0|18446744073709551615] "" Vector__XXX

BO_ 2566774016 VDMA_FDDD_Military_Application_M: 8 Vector__XXX
 SG_ Military_Application_Message_1_1 : 0|64@1+ (1,0) [0|18446744073709551615] "" Vector__XXX

BO_ 2566774272 VDMA_FDDE_Military_Application_M: 8 Vector__XXX
 SG_ Military_Application_Message_2_1 : 0|64@1+ (1,0) [0|18446744073709551615] "" Vector__XXX

BO_ 2566774528 VDMA_FDDF_Front_Wheel_Drive_Stat: 8 Vector__XXX
 SG_ Front_Wheel_Drive_Status_RawPayl : 0|64@1+ (1,0) [0|18446744073709551615] "" Vector__XXX

BO_ 2566774784 VDMA_FDE0_Ambient_Conditions_2: 8 Vector__XXX
 SG_ Ambient_Conditions_2_RawPayload : 0|64@1+ (1,0) [0|18446744073709551615] "" Vector__XXX

BO_ 2566775040 VDMA_FDE1_Cab_Climate_System_Inf: 8 Vector__XXX
 SG_ Cab_Climate_System_Information_1 : 0|64@1+ (1,0) [0|18446744073709551615] "" Vector__XXX

BO_ 2566775296 VDMA_FDE2_Supply_Pressure_Demand: 8 Vector__XXX
 SG_ Supply_Pressure_Demand_RawPayloa : 0|64@1+ (1,0) [0|18446744073709551615] "" Vector__XXX

BO_ 2566775552 VDMA_FDE3_Equipment_Operation_an: 8 Vector__XXX
 SG_ Equipment_Operation_and_Control_ : 0|64@1+ (1,0) [0|18446744073709551615] "" Vector__XXX

BO_ 2566775808 VDMA_FDE4_Equipment_Performance_: 8 Vector__XXX
 SG_ Equipment_Performance_Data_RawPa : 0|64@1+ (1,0) [0|18446744073709551615] "" Vector__XXX

BO_ 2566776064 VDMA_FDE5_Maximum_Vehicle_Speed_: 8 Vector__XXX
 SG_ Maximum_Vehicle_Speed_Limit_Stat : 0|64@1+ (1,0) [0|18446744073709551615] "" Vector__XXX

BO_ 2566776320 VDMA_FDE6_Hydraulic_Braking_Syst: 8 Vector__XXX
 SG_ Hydraulic_Braking_System_RawPayl : 0|64@1+ (1,0) [0|18446744073709551615] "" Vector__XXX

BO_ 2566776576 VDMA_FDE7_Bus_1_Utility_Sync_Che: 8 Vector__XXX
 SG_ Bus_1_Utility_Sync_Check_Status_ : 0|64@1+ (1,0) [0|18446744073709551615] "" Vector__XXX

BO_ 2566776832 VDMA_FDE8_Bus_1_Generator_Sync_C: 8 Vector__XXX
 SG_ Bus_1_Generator_Sync_Check_Statu : 0|64@1+ (1,0) [0|18446744073709551615] "" Vector__XXX

BO_ 2566777088 VDMA_FDE9_Bus_1_Phase_C_Basic_AC: 8 Vector__XXX
 SG_ Bus_1_Phase_C_Basic_AC_Quantitie : 0|64@1+ (1,0) [0|18446744073709551615] "" Vector__XXX

BO_ 2566777344 VDMA_FDEA_Bus_1_Phase_B_Basic_AC: 8 Vector__XXX
 SG_ Bus_1_Phase_B_Basic_AC_Quantitie : 0|64@1+ (1,0) [0|18446744073709551615] "" Vector__XXX

BO_ 2566777600 VDMA_FDEB_Bus_1_Phase_A_Basic_AC: 8 Vector__XXX
 SG_ Bus_1_Phase_A_Basic_AC_Quantitie : 0|64@1+ (1,0) [0|18446744073709551615] "" Vector__XXX

BO_ 2566777856 VDMA_FDEC_Bus_1_Average_Basic_AC: 8 Vector__XXX
 SG_ Bus_1_Average_Basic_AC_Quantitie : 0|64@1+ (1,0) [0|18446744073709551615] "" Vector__XXX

BO_ 2566778112 VDMA_FDED_Utility_Total_AC_Energ: 8 Vector__XXX
 SG_ Utility_Total_AC_Energy_RawPaylo : 0|64@1+ (1,0) [0|18446744073709551615] "" Vector__XXX

BO_ 2566778368 VDMA_FDEE_Utility_Phase_C_AC_Rea: 8 Vector__XXX
 SG_ Utility_Phase_C_AC_Reactive_Powe : 0|64@1+ (1,0) [0|18446744073709551615] "" Vector__XXX

BO_ 2566778624 VDMA_FDEF_Utility_Phase_C_AC_Pow: 8 Vector__XXX
 SG_ Utility_Phase_C_AC_Power_RawPayl : 0|64@1+ (1,0) [0|18446744073709551615] "" Vector__XXX

BO_ 2566778880 VDMA_FDF0_Utility_Phase_C_AC_Bas: 8 Vector__XXX
 SG_ Utility_Phase_C_AC_Basic_Quantit : 0|64@1+ (1,0) [0|18446744073709551615] "" Vector__XXX

BO_ 2566779136 VDMA_FDF1_Utility_Phase_B_AC_Rea: 8 Vector__XXX
 SG_ Utility_Phase_B_AC_Reactive_Powe : 0|64@1+ (1,0) [0|18446744073709551615] "" Vector__XXX

BO_ 2566779392 VDMA_FDF2_Utility_Phase_B_AC_Pow: 8 Vector__XXX
 SG_ Utility_Phase_B_AC_Power_RawPayl : 0|64@1+ (1,0) [0|18446744073709551615] "" Vector__XXX

BO_ 2566779648 VDMA_FDF3_Utility_Phase_B_AC_Bas: 8 Vector__XXX
 SG_ Utility_Phase_B_AC_Basic_Quantit : 0|64@1+ (1,0) [0|18446744073709551615] "" Vector__XXX

BO_ 2566779904 VDMA_FDF4_Utility_Phase_A_AC_Rea: 8 Vector__XXX
 SG_ Utility_Phase_A_AC_Reactive_Powe : 0|64@1+ (1,0) [0|18446744073709551615] "" Vector__XXX

BO_ 2566780160 VDMA_FDF5_Utility_Phase_A_AC_Pow: 8 Vector__XXX
 SG_ Utility_Phase_A_AC_Power_RawPayl : 0|64@1+ (1,0) [0|18446744073709551615] "" Vector__XXX

BO_ 2566780416 VDMA_FDF6_Utility_Phase_A_Basic_: 8 Vector__XXX
 SG_ Utility_Phase_A_Basic_AC_Quantit : 0|64@1+ (1,0) [0|18446744073709551615] "" Vector__XXX

BO_ 2566780672 VDMA_FDF7_Utility_Total_AC_React: 8 Vector__XXX
 SG_ Utility_Total_AC_Reactive_Power_ : 0|64@1+ (1,0) [0|18446744073709551615] "" Vector__XXX

BO_ 2566780928 VDMA_FDF8_Utility_Total_AC_Power: 8 Vector__XXX
 SG_ Utility_Total_AC_Power_RawPayloa : 0|64@1+ (1,0) [0|18446744073709551615] "" Vector__XXX

BO_ 2566781184 VDMA_FDF9_Utility_Average_Basic_: 8 Vector__XXX
 SG_ Utility_Average_Basic_AC_Quantit : 0|64@1+ (1,0) [0|18446744073709551615] "" Vector__XXX

BO_ 2566781440 VDMA_FDFA_Generator_Total_AC_Ene: 8 Vector__XXX
 SG_ Generator_Total_AC_Energy_RawPay : 0|64@1+ (1,0) [0|18446744073709551615] "" Vector__XXX

BO_ 2566781696 VDMA_FDFB_Generator_Phase_C_AC_R: 8 Vector__XXX
 SG_ Generator_Phase_C_AC_Reactive_Po : 0|64@1+ (1,0) [0|18446744073709551615] "" Vector__XXX

BO_ 2566781952 VDMA_FDFC_Generator_Phase_C_AC_P: 8 Vector__XXX
 SG_ Generator_Phase_C_AC_Power_RawPa : 0|64@1+ (1,0) [0|18446744073709551615] "" Vector__XXX

BO_ 2566782208 VDMA_FDFD_Generator_Phase_C_Basi: 8 Vector__XXX
 SG_ Generator_Phase_C_Basic_AC_Quant : 0|64@1+ (1,0) [0|18446744073709551615] "" Vector__XXX

BO_ 2566782464 VDMA_FDFE_Generator_Phase_B_AC_R: 8 Vector__XXX
 SG_ Generator_Phase_B_AC_Reactive_Po : 0|64@1+ (1,0) [0|18446744073709551615] "" Vector__XXX

BO_ 2566782720 VDMA_FDFF_Generator_Phase_B_AC_P: 8 Vector__XXX
 SG_ Generator_Phase_B_AC_Power_RawPa : 0|64@1+ (1,0) [0|18446744073709551615] "" Vector__XXX

BO_ 2566782976 VDMA_FE00_Generator_Phase_B_Basi: 8 Vector__XXX
 SG_ Generator_Phase_B_Basic_AC_Quant : 0|64@1+ (1,0) [0|18446744073709551615] "" Vector__XXX

BO_ 2566783232 VDMA_FE01_Generator_Phase_A_AC_R: 8 Vector__XXX
 SG_ Generator_Phase_A_AC_Reactive_Po : 0|64@1+ (1,0) [0|18446744073709551615] "" Vector__XXX

BO_ 2566783488 VDMA_FE02_Generator_Phase_A_AC_P: 8 Vector__XXX
 SG_ Generator_Phase_A_AC_Power_RawPa : 0|64@1+ (1,0) [0|18446744073709551615] "" Vector__XXX

BO_ 2566783744 VDMA_FE03_Generator_Phase_A_Basi: 8 Vector__XXX
 SG_ Generator_Phase_A_Basic_AC_Quant : 0|64@1+ (1,0) [0|18446744073709551615] "" Vector__XXX

BO_ 2566784000 VDMA_FE04_Generator_Total_AC_Rea: 8 Vector__XXX
 SG_ Generator_Total_AC_Reactive_Powe : 0|64@1+ (1,0) [0|18446744073709551615] "" Vector__XXX

BO_ 2566784256 VDMA_FE05_Generator_Total_AC_Pow: 8 Vector__XXX
 SG_ Generator_Total_AC_Power_RawPayl : 0|64@1+ (1,0) [0|18446744073709551615] "" Vector__XXX

BO_ 2566784512 VDMA_FE06_Generator_Average_Basi: 8 Vector__XXX
 SG_ Generator_Average_Basic_AC_Quant : 0|64@1+ (1,0) [0|18446744073709551615] "" Vector__XXX

BO_ 2566784768 VDMA_FE07_Exhaust_Temperature: 8 Vector__XXX
 SG_ Exhaust_Temperature_RawPayload : 0|64@1+ (1,0) [0|18446744073709551615] "" Vector__XXX

BO_ 2566785024 VDMA_FE08_Required_Tractor_Facil: 8 Vector__XXX
 SG_ Required_Tractor_Facilities_mess : 0|64@1+ (1,0) [0|18446744073709551615] "" Vector__XXX

BO_ 2566785280 VDMA_FE09_Tractor_Facilities_res: 8 Vector__XXX
 SG_ Tractor_Facilities_response_mess : 0|64@1+ (1,0) [0|18446744073709551615] "" Vector__XXX

BO_ 2566785536 VDMA_FE0A_Tractor_control_comman: 8 Vector__XXX
 SG_ Tractor_control_command_tractor_ : 0|64@1+ (1,0) [0|18446744073709551615] "" Vector__XXX

BO_ 2566785792 VDMA_FE0B_Tractor_control_mode_c: 8 Vector__XXX
 SG_ Tractor_control_mode_command_Raw : 0|64@1+ (1,0) [0|18446744073709551615] "" Vector__XXX

BO_ 2566786048 VDMA_FE0C_Working_Set_Member: 8 Vector__XXX
 SG_ Working_Set_Member_RawPayload : 0|64@1+ (1,0) [0|18446744073709551615] "" Vector__XXX

BO_ 2566786560 VDMA_FE0E_Response_for_Repetitio: 8 Vector__XXX
 SG_ Response_for_Repetition_Rate_Raw : 0|64@1+ (1,0) [0|18446744073709551615] "" Vector__XXX

BO_ 2566787072 VDMA_FE10_Auxiliary_valve_0_esti: 8 Vector__XXX
 SG_ Auxiliary_valve_0_estimated_flow : 0|64@1+ (1,0) [0|18446744073709551615] "" Vector__XXX

BO_ 2566787328 VDMA_FE11_Auxiliary_valve_1_esti: 8 Vector__XXX
 SG_ Auxiliary_valve_1_estimated_flow : 0|64@1+ (1,0) [0|18446744073709551615] "" Vector__XXX

BO_ 2566787584 VDMA_FE12_Auxiliary_valve_2_esti: 8 Vector__XXX
 SG_ Auxiliary_valve_2_estimated_flow : 0|64@1+ (1,0) [0|18446744073709551615] "" Vector__XXX

BO_ 2566787840 VDMA_FE13_Auxiliary_valve_3_esti: 8 Vector__XXX
 SG_ Auxiliary_valve_3_estimated_flow : 0|64@1+ (1,0) [0|18446744073709551615] "" Vector__XXX

BO_ 2566788096 VDMA_FE14_Auxiliary_valve_4_esti: 8 Vector__XXX
 SG_ Auxiliary_valve_4_estimated_flow : 0|64@1+ (1,0) [0|18446744073709551615] "" Vector__XXX

BO_ 2566788352 VDMA_FE15_Auxiliary_valve_5_esti: 8 Vector__XXX
 SG_ Auxiliary_valve_5_estimated_flow : 0|64@1+ (1,0) [0|18446744073709551615] "" Vector__XXX

BO_ 2566788608 VDMA_FE16_Auxiliary_valve_6_esti: 8 Vector__XXX
 SG_ Auxiliary_valve_6_estimated_flow : 0|64@1+ (1,0) [0|18446744073709551615] "" Vector__XXX

BO_ 2566788864 VDMA_FE17_Auxiliary_valve_7_esti: 8 Vector__XXX
 SG_ Auxiliary_valve_7_estimated_flow : 0|64@1+ (1,0) [0|18446744073709551615] "" Vector__XXX

BO_ 2566789120 VDMA_FE18_Auxiliary_valve_8_esti: 8 Vector__XXX
 SG_ Auxiliary_valve_8_estimated_flow : 0|64@1+ (1,0) [0|18446744073709551615] "" Vector__XXX

BO_ 2566789376 VDMA_FE19_Auxiliary_valve_9_esti: 8 Vector__XXX
 SG_ Auxiliary_valve_9_estimated_flow : 0|64@1+ (1,0) [0|18446744073709551615] "" Vector__XXX

BO_ 2566789632 VDMA_FE1A_Auxiliary_valve_10_est: 8 Vector__XXX
 SG_ Auxiliary_valve_10_estimated_flo : 0|64@1+ (1,0) [0|18446744073709551615] "" Vector__XXX

BO_ 2566789888 VDMA_FE1B_Auxiliary_valve_11_est: 8 Vector__XXX
 SG_ Auxiliary_valve_11_estimated_flo : 0|64@1+ (1,0) [0|18446744073709551615] "" Vector__XXX

BO_ 2566790144 VDMA_FE1C_Auxiliary_valve_12_est: 8 Vector__XXX
 SG_ Auxiliary_valve_12_estimated_flo : 0|64@1+ (1,0) [0|18446744073709551615] "" Vector__XXX

BO_ 2566790400 VDMA_FE1D_Auxiliary_valve_13_est: 8 Vector__XXX
 SG_ Auxiliary_valve_13_estimated_flo : 0|64@1+ (1,0) [0|18446744073709551615] "" Vector__XXX

BO_ 2566790656 VDMA_FE1E_Auxiliary_valve_14_est: 8 Vector__XXX
 SG_ Auxiliary_valve_14_estimated_flo : 0|64@1+ (1,0) [0|18446744073709551615] "" Vector__XXX

BO_ 2566790912 VDMA_FE1F_Auxiliary_valve_15_est: 8 Vector__XXX
 SG_ Auxiliary_valve_15_estimated_flo : 0|64@1+ (1,0) [0|18446744073709551615] "" Vector__XXX

BO_ 2566791168 VDMA_FE20_Auxiliary_valve_0_meas: 8 Vector__XXX
 SG_ Auxiliary_valve_0_measured_flow_ : 0|64@1+ (1,0) [0|18446744073709551615] "" Vector__XXX

BO_ 2566791424 VDMA_FE21_Auxiliary_valve_1_meas: 8 Vector__XXX
 SG_ Auxiliary_valve_1_measured_flow_ : 0|64@1+ (1,0) [0|18446744073709551615] "" Vector__XXX

BO_ 2566791680 VDMA_FE22_Auxiliary_valve_2_meas: 8 Vector__XXX
 SG_ Auxiliary_valve_2_measured_flow_ : 0|64@1+ (1,0) [0|18446744073709551615] "" Vector__XXX

BO_ 2566791936 VDMA_FE23_Auxiliary_valve_3_meas: 8 Vector__XXX
 SG_ Auxiliary_valve_3_measured_flow_ : 0|64@1+ (1,0) [0|18446744073709551615] "" Vector__XXX

BO_ 2566792192 VDMA_FE24_Auxiliary_valve_4_meas: 8 Vector__XXX
 SG_ Auxiliary_valve_4_measured_flow_ : 0|64@1+ (1,0) [0|18446744073709551615] "" Vector__XXX

BO_ 2566792448 VDMA_FE25_Auxiliary_valve_5_meas: 8 Vector__XXX
 SG_ Auxiliary_valve_5_measured_flow_ : 0|64@1+ (1,0) [0|18446744073709551615] "" Vector__XXX

BO_ 2566792704 VDMA_FE26_Auxiliary_valve_6_meas: 8 Vector__XXX
 SG_ Auxiliary_valve_6_measured_flow_ : 0|64@1+ (1,0) [0|18446744073709551615] "" Vector__XXX

BO_ 2566792960 VDMA_FE27_Auxiliary_valve_7_meas: 8 Vector__XXX
 SG_ Auxiliary_valve_7_measured_flow_ : 0|64@1+ (1,0) [0|18446744073709551615] "" Vector__XXX

BO_ 2566793216 VDMA_FE28_Auxiliary_valve_8_meas: 8 Vector__XXX
 SG_ Auxiliary_valve_8_measured_flow_ : 0|64@1+ (1,0) [0|18446744073709551615] "" Vector__XXX

BO_ 2566793472 VDMA_FE29_Auxiliary_valve_9_meas: 8 Vector__XXX
 SG_ Auxiliary_valve_9_measured_flow_ : 0|64@1+ (1,0) [0|18446744073709551615] "" Vector__XXX

BO_ 2566793728 VDMA_FE2A_Auxiliary_valve_10_mea: 8 Vector__XXX
 SG_ Auxiliary_valve_10_measured_flow : 0|64@1+ (1,0) [0|18446744073709551615] "" Vector__XXX

BO_ 2566793984 VDMA_FE2B_Auxiliary_valve_11_mea: 8 Vector__XXX
 SG_ Auxiliary_valve_11_measured_flow : 0|64@1+ (1,0) [0|18446744073709551615] "" Vector__XXX

BO_ 2566794240 VDMA_FE2C_Auxiliary_valve_12_mea: 8 Vector__XXX
 SG_ Auxiliary_valve_12_measured_flow : 0|64@1+ (1,0) [0|18446744073709551615] "" Vector__XXX

BO_ 2566794496 VDMA_FE2D_Auxiliary_valve_13_mea: 8 Vector__XXX
 SG_ Auxiliary_valve_13_measured_flow : 0|64@1+ (1,0) [0|18446744073709551615] "" Vector__XXX

BO_ 2566794752 VDMA_FE2E_Auxiliary_valve_14_mea: 8 Vector__XXX
 SG_ Auxiliary_valve_14_measured_flow : 0|64@1+ (1,0) [0|18446744073709551615] "" Vector__XXX

BO_ 2566795008 VDMA_FE2F_Auxiliary_valve_15_mea: 8 Vector__XXX
 SG_ Auxiliary_valve_15_measured_flow : 0|64@1+ (1,0) [0|18446744073709551615] "" Vector__XXX

BO_ 2566795264 VDMA_FE30_Auxiliary_valve_0_comm: 8 Vector__XXX
 SG_ Auxiliary_valve_0_command_RawPay : 0|64@1+ (1,0) [0|18446744073709551615] "" Vector__XXX

BO_ 2566795520 VDMA_FE31_Auxiliary_valve_1_comm: 8 Vector__XXX
 SG_ Auxiliary_valve_1_command_RawPay : 0|64@1+ (1,0) [0|18446744073709551615] "" Vector__XXX

BO_ 2566795776 VDMA_FE32_Auxiliary_valve_2_comm: 8 Vector__XXX
 SG_ Auxiliary_valve_2_command_RawPay : 0|64@1+ (1,0) [0|18446744073709551615] "" Vector__XXX

BO_ 2566796032 VDMA_FE33_Auxiliary_valve_3_comm: 8 Vector__XXX
 SG_ Auxiliary_valve_3_command_RawPay : 0|64@1+ (1,0) [0|18446744073709551615] "" Vector__XXX

BO_ 2566796288 VDMA_FE34_Auxiliary_valve_4_comm: 8 Vector__XXX
 SG_ Auxiliary_valve_4_command_RawPay : 0|64@1+ (1,0) [0|18446744073709551615] "" Vector__XXX

BO_ 2566796544 VDMA_FE35_Auxiliary_valve_5_comm: 8 Vector__XXX
 SG_ Auxiliary_valve_5_command_RawPay : 0|64@1+ (1,0) [0|18446744073709551615] "" Vector__XXX

BO_ 2566796800 VDMA_FE36_Auxiliary_valve_6_comm: 8 Vector__XXX
 SG_ Auxiliary_valve_6_command_RawPay : 0|64@1+ (1,0) [0|18446744073709551615] "" Vector__XXX

BO_ 2566797056 VDMA_FE37_Auxiliary_valve_7_comm: 8 Vector__XXX
 SG_ Auxiliary_valve_7_command_RawPay : 0|64@1+ (1,0) [0|18446744073709551615] "" Vector__XXX

BO_ 2566797312 VDMA_FE38_Auxiliary_valve_8_comm: 8 Vector__XXX
 SG_ Auxiliary_valve_8_command_RawPay : 0|64@1+ (1,0) [0|18446744073709551615] "" Vector__XXX

BO_ 2566797568 VDMA_FE39_Auxiliary_valve_9_comm: 8 Vector__XXX
 SG_ Auxiliary_valve_9_command_RawPay : 0|64@1+ (1,0) [0|18446744073709551615] "" Vector__XXX

BO_ 2566797824 VDMA_FE3A_Auxiliary_valve_10_com: 8 Vector__XXX
 SG_ Auxiliary_valve_10_command_RawPa : 0|64@1+ (1,0) [0|18446744073709551615] "" Vector__XXX

BO_ 2566798080 VDMA_FE3B_Auxiliary_valve_11_com: 8 Vector__XXX
 SG_ Auxiliary_valve_11_command_RawPa : 0|64@1+ (1,0) [0|18446744073709551615] "" Vector__XXX

BO_ 2566798336 VDMA_FE3C_Auxiliary_valve_12_com: 8 Vector__XXX
 SG_ Auxiliary_valve_12_command_RawPa : 0|64@1+ (1,0) [0|18446744073709551615] "" Vector__XXX

BO_ 2566798592 VDMA_FE3D_Auxiliary_valve_13_com: 8 Vector__XXX
 SG_ Auxiliary_valve_13_command_RawPa : 0|64@1+ (1,0) [0|18446744073709551615] "" Vector__XXX

BO_ 2566798848 VDMA_FE3E_Auxiliary_valve_14_com: 8 Vector__XXX
 SG_ Auxiliary_valve_14_command_RawPa : 0|64@1+ (1,0) [0|18446744073709551615] "" Vector__XXX

BO_ 2566799104 VDMA_FE3F_Auxiliary_valve_15_com: 8 Vector__XXX
 SG_ Auxiliary_valve_15_command_RawPa : 0|64@1+ (1,0) [0|18446744073709551615] "" Vector__XXX

BO_ 2566799360 VDMA_FE40_Lighting_Data: 8 Vector__XXX
 SG_ Lighting_Data_RawPayload : 0|64@1+ (1,0) [0|18446744073709551615] "" Vector__XXX

BO_ 2566799616 VDMA_FE41_Lighting_command: 8 Vector__XXX
 SG_ Lighting_command_RawPayload : 0|64@1+ (1,0) [0|18446744073709551615] "" Vector__XXX

BO_ 2566799872 VDMA_FE42_Hitch_and_PTO_commands: 8 Vector__XXX
 SG_ Hitch_and_PTO_commands_RawPayloa : 0|64@1+ (1,0) [0|18446744073709551615] "" Vector__XXX

BO_ 2566800128 VDMA_FE43_Primary_or_Rear_Power_: 8 Vector__XXX
 SG_ Primary_or_Rear_Power_Take_off_O : 0|64@1+ (1,0) [0|18446744073709551615] "" Vector__XXX

BO_ 2566800384 VDMA_FE44_Secondary_or_Front_Pow: 8 Vector__XXX
 SG_ Secondary_or_Front_Power_Take_of : 0|64@1+ (1,0) [0|18446744073709551615] "" Vector__XXX

BO_ 2566800640 VDMA_FE45_Primary_or_Rear_Hitch_: 8 Vector__XXX
 SG_ Primary_or_Rear_Hitch_Status_Raw : 0|64@1+ (1,0) [0|18446744073709551615] "" Vector__XXX

BO_ 2566800896 VDMA_FE46_Secondary_or_Front_Hit: 8 Vector__XXX
 SG_ Secondary_or_Front_Hitch_Status_ : 0|64@1+ (1,0) [0|18446744073709551615] "" Vector__XXX

BO_ 2566801920 VDMA_FE4A_Electronic_Transmissio: 8 Vector__XXX
 SG_ Electronic_Transmission_Controll : 0|64@1+ (1,0) [0|18446744073709551615] "" Vector__XXX

BO_ 2566802176 VDMA_FE4B_Transmission_Configura: 8 Vector__XXX
 SG_ Transmission_Configuration_2_Raw : 0|64@1+ (1,0) [0|18446744073709551615] "" Vector__XXX

BO_ 2566802432 VDMA_FE4C_Military_Lighting_Comm: 8 Vector__XXX
 SG_ Military_Lighting_Command_RawPay : 0|64@1+ (1,0) [0|18446744073709551615] "" Vector__XXX

BO_ 2566802688 VDMA_FE4D_Total_Averaged_Informa: 8 Vector__XXX
 SG_ Total_Averaged_Information_RawPa : 0|64@1+ (1,0) [0|18446744073709551615] "" Vector__XXX

BO_ 2566802944 VDMA_FE4E_Door_Control_1: 8 Vector__XXX
 SG_ Door_Control_1_RawPayload : 0|64@1+ (1,0) [0|18446744073709551615] "" Vector__XXX

BO_ 2566803200 VDMA_FE4F_Vehicle_Dynamic_Stabil: 8 Vector__XXX
 SG_ Vehicle_Dynamic_Stability_Contro : 0|64@1+ (1,0) [0|18446744073709551615] "" Vector__XXX

BO_ 2566803456 VDMA_FE50_Battery_Temperature: 8 Vector__XXX
 SG_ Battery_Temperature_RawPayload : 0|64@1+ (1,0) [0|18446744073709551615] "" Vector__XXX

BO_ 2566803712 VDMA_FE51_Adaptive_Cruise_Contro: 8 Vector__XXX
 SG_ Adaptive_Cruise_Control_Operator : 0|64@1+ (1,0) [0|18446744073709551615] "" Vector__XXX

BO_ 2566803968 VDMA_FE52_Vehicle_Electrical_Pow: 8 Vector__XXX
 SG_ Vehicle_Electrical_Power_3_RawPa : 0|64@1+ (1,0) [0|18446744073709551615] "" Vector__XXX

BO_ 2566804224 VDMA_FE53_Retarder_Continuous_To: 8 Vector__XXX
 SG_ Retarder_Continuous_Torque_Speed : 0|64@1+ (1,0) [0|18446744073709551615] "" Vector__XXX

BO_ 2566804480 VDMA_FE54_Engine_Continuous_Torq: 8 Vector__XXX
 SG_ Engine_Continuous_Torque_Speed_L : 0|64@1+ (1,0) [0|18446744073709551615] "" Vector__XXX

BO_ 2566804736 VDMA_FE55_Gaseous_Fuel_Propertie: 8 Vector__XXX
 SG_ Gaseous_Fuel_Properties_RawPaylo : 0|64@1+ (1,0) [0|18446744073709551615] "" Vector__XXX

BO_ 2566804992 VDMA_FE56_Aftertreatment_1_Diese: 8 Vector__XXX
 SG_ Aftertreatment_1_Diesel_Exhaust_ : 0|64@1+ (1,0) [0|18446744073709551615] "" Vector__XXX

BO_ 2566805248 VDMA_FE57_Air_Suspension_Control: 8 Vector__XXX
 SG_ Air_Suspension_Control_5_RawPayl : 0|64@1+ (1,0) [0|18446744073709551615] "" Vector__XXX

BO_ 2566805504 VDMA_FE58_Air_Suspension_Control: 8 Vector__XXX
 SG_ Air_Suspension_Control_4_RawPayl : 0|64@1+ (1,0) [0|18446744073709551615] "" Vector__XXX

BO_ 2566805760 VDMA_FE59_Air_Suspension_Control: 8 Vector__XXX
 SG_ Air_Suspension_Control_3_RawPayl : 0|64@1+ (1,0) [0|18446744073709551615] "" Vector__XXX

BO_ 2566806016 VDMA_FE5A_Air_Suspension_Control: 8 Vector__XXX
 SG_ Air_Suspension_Control_1_RawPayl : 0|64@1+ (1,0) [0|18446744073709551615] "" Vector__XXX

BO_ 2566806272 VDMA_FE5B_Forward_Lane_Image_2: 8 Vector__XXX
 SG_ Forward_Lane_Image_2_RawPayload : 0|64@1+ (1,0) [0|18446744073709551615] "" Vector__XXX

BO_ 2566806528 VDMA_FE5C_Running_Gear_Equipment: 8 Vector__XXX
 SG_ Running_Gear_Equipment_2_2_RawPa : 0|64@1+ (1,0) [0|18446744073709551615] "" Vector__XXX

BO_ 2566806784 VDMA_FE5D_General_Purpose_Messag: 8 Vector__XXX
 SG_ General_Purpose_Message_1_2_RawP : 0|64@1+ (1,0) [0|18446744073709551615] "" Vector__XXX

BO_ 2566807040 VDMA_FE5E_Running_Gear_Equipment: 8 Vector__XXX
 SG_ Running_Gear_Equipment_2_3_RawPa : 0|64@1+ (1,0) [0|18446744073709551615] "" Vector__XXX

BO_ 2566807296 VDMA_FE5F_General_Purpose_Messag: 8 Vector__XXX
 SG_ General_Purpose_Message_1_3_RawP : 0|64@1+ (1,0) [0|18446744073709551615] "" Vector__XXX

BO_ 2566807552 VDMA_FE60_General_Purpose_Messag: 8 Vector__XXX
 SG_ General_Purpose_Message_2_3_RawP : 0|64@1+ (1,0) [0|18446744073709551615] "" Vector__XXX

BO_ 2566807808 VDMA_FE61_General_Purpose_Messag: 8 Vector__XXX
 SG_ General_Purpose_Message_1_4_RawP : 0|64@1+ (1,0) [0|18446744073709551615] "" Vector__XXX

BO_ 2566808064 VDMA_FE62_General_Purpose_Messag: 8 Vector__XXX
 SG_ General_Purpose_Message_2_4_RawP : 0|64@1+ (1,0) [0|18446744073709551615] "" Vector__XXX

BO_ 2566808320 VDMA_FE63_General_Purpose_Messag: 8 Vector__XXX
 SG_ General_Purpose_Message_1_5_RawP : 0|64@1+ (1,0) [0|18446744073709551615] "" Vector__XXX

BO_ 2566808576 VDMA_FE64_General_Purpose_Messag: 8 Vector__XXX
 SG_ General_Purpose_Message_2_5_RawP : 0|64@1+ (1,0) [0|18446744073709551615] "" Vector__XXX

BO_ 2566808832 VDMA_FE65_General_Purpose_Messag: 8 Vector__XXX
 SG_ General_Purpose_Message_1_6_RawP : 0|64@1+ (1,0) [0|18446744073709551615] "" Vector__XXX

BO_ 2566809088 VDMA_FE66_Battery_Main_Switch_In: 8 Vector__XXX
 SG_ Battery_Main_Switch_Information_ : 0|64@1+ (1,0) [0|18446744073709551615] "" Vector__XXX

BO_ 2566809344 VDMA_FE67_Climate_Control_Config: 8 Vector__XXX
 SG_ Climate_Control_Configuration_Ra : 0|64@1+ (1,0) [0|18446744073709551615] "" Vector__XXX

BO_ 2566809600 VDMA_FE68_Vehicle_Fluids: 8 Vector__XXX
 SG_ Vehicle_Fluids_RawPayload : 0|64@1+ (1,0) [0|18446744073709551615] "" Vector__XXX

BO_ 2566809856 VDMA_FE69_Engine_Temperature_3: 8 Vector__XXX
 SG_ Engine_Temperature_3_RawPayload : 0|64@1+ (1,0) [0|18446744073709551615] "" Vector__XXX

BO_ 2566810112 VDMA_FE6A_Engine_Fuel_Lube_Syste: 8 Vector__XXX
 SG_ Engine_Fuel_Lube_Systems_RawPayl : 0|64@1+ (1,0) [0|18446744073709551615] "" Vector__XXX

BO_ 2566810368 VDMA_FE6B_Driver_s_Identificatio: 8 Vector__XXX
 SG_ Driver_s_Identification_RawPaylo : 0|64@1+ (1,0) [0|18446744073709551615] "" Vector__XXX

BO_ 2566810880 VDMA_FE6D_Heater_Information: 8 Vector__XXX
 SG_ Heater_Information_RawPayload : 0|64@1+ (1,0) [0|18446744073709551615] "" Vector__XXX

BO_ 2566811136 VDMA_FE6E_High_Resolution_Wheel_: 8 Vector__XXX
 SG_ High_Resolution_Wheel_Speed_RawP : 0|64@1+ (1,0) [0|18446744073709551615] "" Vector__XXX

BO_ 2566811392 VDMA_FE6F_Adaptive_Cruise_Contro: 8 Vector__XXX
 SG_ Adaptive_Cruise_Control_1_RawPay : 0|64@1+ (1,0) [0|18446744073709551615] "" Vector__XXX

BO_ 2566811648 VDMA_FE70_Combination_Vehicle_We: 8 Vector__XXX
 SG_ Combination_Vehicle_Weight_RawPa : 0|64@1+ (1,0) [0|18446744073709551615] "" Vector__XXX

BO_ 2566811904 VDMA_FE71_Laser_Tracer_Position: 8 Vector__XXX
 SG_ Laser_Tracer_Position_RawPayload : 0|64@1+ (1,0) [0|18446744073709551615] "" Vector__XXX

BO_ 2566812160 VDMA_FE72_Laser_Leveling_System_: 8 Vector__XXX
 SG_ Laser_Leveling_System_Blade_Cont : 0|64@1+ (1,0) [0|18446744073709551615] "" Vector__XXX

BO_ 2566812416 VDMA_FE73_Laser_Receiver_Mast_Po: 8 Vector__XXX
 SG_ Laser_Receiver_Mast_Position_Raw : 0|64@1+ (1,0) [0|18446744073709551615] "" Vector__XXX

BO_ 2566812672 VDMA_FE74_Modify_Leveling_System: 8 Vector__XXX
 SG_ Modify_Leveling_System_Control_S : 0|64@1+ (1,0) [0|18446744073709551615] "" Vector__XXX

BO_ 2566812928 VDMA_FE75_Laser_Leveling_System_: 8 Vector__XXX
 SG_ Laser_Leveling_System_Vertical_D : 0|64@1+ (1,0) [0|18446744073709551615] "" Vector__XXX

BO_ 2566813184 VDMA_FE76_Laser_Leveling_System_: 8 Vector__XXX
 SG_ Laser_Leveling_System_Vertical_P : 0|64@1+ (1,0) [0|18446744073709551615] "" Vector__XXX

BO_ 2566813440 VDMA_FE77_Auxiliary_Pressures: 8 Vector__XXX
 SG_ Auxiliary_Pressures_RawPayload : 0|64@1+ (1,0) [0|18446744073709551615] "" Vector__XXX

BO_ 2566813696 VDMA_FE78_Tire_Pressure_Control_: 8 Vector__XXX
 SG_ Tire_Pressure_Control_Unit_Mode_ : 0|64@1+ (1,0) [0|18446744073709551615] "" Vector__XXX

BO_ 2566813952 VDMA_FE79_Tire_Pressure_Control_: 8 Vector__XXX
 SG_ Tire_Pressure_Control_Unit_Targe : 0|64@1+ (1,0) [0|18446744073709551615] "" Vector__XXX

BO_ 2566814208 VDMA_FE7A_Tire_Pressure_Control_: 8 Vector__XXX
 SG_ Tire_Pressure_Control_Unit_Curre : 0|64@1+ (1,0) [0|18446744073709551615] "" Vector__XXX

BO_ 2566814464 VDMA_FE7B_Combustion_Time_1: 8 Vector__XXX
 SG_ Combustion_Time_1_RawPayload : 0|64@1+ (1,0) [0|18446744073709551615] "" Vector__XXX

BO_ 2566814720 VDMA_FE7C_Combustion_Time_2: 8 Vector__XXX
 SG_ Combustion_Time_2_RawPayload : 0|64@1+ (1,0) [0|18446744073709551615] "" Vector__XXX

BO_ 2566814976 VDMA_FE7D_Combustion_Time_3: 8 Vector__XXX
 SG_ Combustion_Time_3_RawPayload : 0|64@1+ (1,0) [0|18446744073709551615] "" Vector__XXX

BO_ 2566815232 VDMA_FE7E_Combustion_Time_4: 8 Vector__XXX
 SG_ Combustion_Time_4_RawPayload : 0|64@1+ (1,0) [0|18446744073709551615] "" Vector__XXX

BO_ 2566815488 VDMA_FE7F_Combustion_Time_5: 8 Vector__XXX
 SG_ Combustion_Time_5_RawPayload : 0|64@1+ (1,0) [0|18446744073709551615] "" Vector__XXX

BO_ 2566815744 VDMA_FE80_Combustion_Time_6: 8 Vector__XXX
 SG_ Combustion_Time_6_RawPayload : 0|64@1+ (1,0) [0|18446744073709551615] "" Vector__XXX

BO_ 2566816000 VDMA_FE81_Fuel_Information_2_Gas: 8 Vector__XXX
 SG_ Fuel_Information_2_Gaseous_RawPa : 0|64@1+ (1,0) [0|18446744073709551615] "" Vector__XXX

BO_ 2566816256 VDMA_FE82_Ignition_Timing_1: 8 Vector__XXX
 SG_ Ignition_Timing_1_RawPayload : 0|64@1+ (1,0) [0|18446744073709551615] "" Vector__XXX

BO_ 2566816512 VDMA_FE83_Ignition_Timing_2: 8 Vector__XXX
 SG_ Ignition_Timing_2_RawPayload : 0|64@1+ (1,0) [0|18446744073709551615] "" Vector__XXX

BO_ 2566816768 VDMA_FE84_Ignition_Timing_3: 8 Vector__XXX
 SG_ Ignition_Timing_3_RawPayload : 0|64@1+ (1,0) [0|18446744073709551615] "" Vector__XXX

BO_ 2566817024 VDMA_FE85_Ignition_Timing_4: 8 Vector__XXX
 SG_ Ignition_Timing_4_RawPayload : 0|64@1+ (1,0) [0|18446744073709551615] "" Vector__XXX

BO_ 2566817280 VDMA_FE86_Ignition_Timing_5: 8 Vector__XXX
 SG_ Ignition_Timing_5_RawPayload : 0|64@1+ (1,0) [0|18446744073709551615] "" Vector__XXX

BO_ 2566817536 VDMA_FE87_Ignition_Timing_6: 8 Vector__XXX
 SG_ Ignition_Timing_6_RawPayload : 0|64@1+ (1,0) [0|18446744073709551615] "" Vector__XXX

BO_ 2566817792 VDMA_FE88_Ignition_Transformer_S: 8 Vector__XXX
 SG_ Ignition_Transformer_Secondary_O : 0|64@1+ (1,0) [0|18446744073709551615] "" Vector__XXX

BO_ 2566818048 VDMA_FE89_Ignition_Transformer_S: 8 Vector__XXX
 SG_ Ignition_Transformer_Secondary_O : 0|64@1+ (1,0) [0|18446744073709551615] "" Vector__XXX

BO_ 2566818304 VDMA_FE8A_Ignition_Transformer_S: 8 Vector__XXX
 SG_ Ignition_Transformer_Secondary_O : 0|64@1+ (1,0) [0|18446744073709551615] "" Vector__XXX

BO_ 2566818560 VDMA_FE8B_Gaseous_Fuel_Pressure_: 8 Vector__XXX
 SG_ Gaseous_Fuel_Pressure_1_RawPaylo : 0|64@1+ (1,0) [0|18446744073709551615] "" Vector__XXX

BO_ 2566818816 VDMA_FE8C_Auxiliary_Analog_Infor: 8 Vector__XXX
 SG_ Auxiliary_Analog_Information_Raw : 0|64@1+ (1,0) [0|18446744073709551615] "" Vector__XXX

BO_ 2566819072 VDMA_FE8D_Vehicle_Electrical_Pow: 8 Vector__XXX
 SG_ Vehicle_Electrical_Power_2_RawPa : 0|64@1+ (1,0) [0|18446744073709551615] "" Vector__XXX

BO_ 2566819328 VDMA_FE8E_Service_2: 8 Vector__XXX
 SG_ Service_2_RawPayload : 0|64@1+ (1,0) [0|18446744073709551615] "" Vector__XXX

BO_ 2566819584 VDMA_FE8F_Supply_Pressure_2: 8 Vector__XXX
 SG_ Supply_Pressure_2_RawPayload : 0|64@1+ (1,0) [0|18446744073709551615] "" Vector__XXX

BO_ 2566819840 VDMA_FE90_Engine_Torque_History: 8 Vector__XXX
 SG_ Engine_Torque_History_RawPayload : 0|64@1+ (1,0) [0|18446744073709551615] "" Vector__XXX

BO_ 2566820096 VDMA_FE91_Fuel_Leakage: 8 Vector__XXX
 SG_ Fuel_Leakage_RawPayload : 0|64@1+ (1,0) [0|18446744073709551615] "" Vector__XXX

BO_ 2566820352 VDMA_FE92_Engine_Information_1: 8 Vector__XXX
 SG_ Engine_Information_1_RawPayload : 0|64@1+ (1,0) [0|18446744073709551615] "" Vector__XXX

BO_ 2566820608 VDMA_FE93_Engine_Electrical_Syst: 8 Vector__XXX
 SG_ Engine_Electrical_System_Module_ : 0|64@1+ (1,0) [0|18446744073709551615] "" Vector__XXX

BO_ 2566820864 VDMA_FE94_Engine_Auxiliary_Coola: 8 Vector__XXX
 SG_ Engine_Auxiliary_Coolant_RawPayl : 0|64@1+ (1,0) [0|18446744073709551615] "" Vector__XXX

BO_ 2566821120 VDMA_FE95_Rebuild_Information: 8 Vector__XXX
 SG_ Rebuild_Information_RawPayload : 0|64@1+ (1,0) [0|18446744073709551615] "" Vector__XXX

BO_ 2566821376 VDMA_FE96_Turbocharger_Wastegate: 8 Vector__XXX
 SG_ Turbocharger_Wastegate_RawPayloa : 0|64@1+ (1,0) [0|18446744073709551615] "" Vector__XXX

BO_ 2566821632 VDMA_FE97_Turbocharger_Informati: 8 Vector__XXX
 SG_ Turbocharger_Information_5_RawPa : 0|64@1+ (1,0) [0|18446744073709551615] "" Vector__XXX

BO_ 2566821888 VDMA_FE98_Turbocharger_Informati: 8 Vector__XXX
 SG_ Turbocharger_Information_4_RawPa : 0|64@1+ (1,0) [0|18446744073709551615] "" Vector__XXX

BO_ 2566822144 VDMA_FE99_Turbocharger_Informati: 8 Vector__XXX
 SG_ Turbocharger_Information_3_RawPa : 0|64@1+ (1,0) [0|18446744073709551615] "" Vector__XXX

BO_ 2566822400 VDMA_FE9A_Turbocharger_Informati: 8 Vector__XXX
 SG_ Turbocharger_Information_2_RawPa : 0|64@1+ (1,0) [0|18446744073709551615] "" Vector__XXX

BO_ 2566822656 VDMA_FE9B_Turbocharger_Informati: 8 Vector__XXX
 SG_ Turbocharger_Information_1_RawPa : 0|64@1+ (1,0) [0|18446744073709551615] "" Vector__XXX

BO_ 2566822912 VDMA_FE9C_Main_Bearing_Temperatu: 8 Vector__XXX
 SG_ Main_Bearing_Temperature_3_RawPa : 0|64@1+ (1,0) [0|18446744073709551615] "" Vector__XXX

BO_ 2566823168 VDMA_FE9D_Main_Bearing_Temperatu: 8 Vector__XXX
 SG_ Main_Bearing_Temperature_2_RawPa : 0|64@1+ (1,0) [0|18446744073709551615] "" Vector__XXX

BO_ 2566823424 VDMA_FE9E_Main_Bearing_Temperatu: 8 Vector__XXX
 SG_ Main_Bearing_Temperature_1_RawPa : 0|64@1+ (1,0) [0|18446744073709551615] "" Vector__XXX

BO_ 2566823680 VDMA_FE9F_Exhaust_Port_Temperatu: 8 Vector__XXX
 SG_ Exhaust_Port_Temperature_5_RawPa : 0|64@1+ (1,0) [0|18446744073709551615] "" Vector__XXX

BO_ 2566823936 VDMA_FEA0_Exhaust_Port_Temperatu: 8 Vector__XXX
 SG_ Exhaust_Port_Temperature_4_RawPa : 0|64@1+ (1,0) [0|18446744073709551615] "" Vector__XXX

BO_ 2566824192 VDMA_FEA1_Exhaust_Port_Temperatu: 8 Vector__XXX
 SG_ Exhaust_Port_Temperature_3_RawPa : 0|64@1+ (1,0) [0|18446744073709551615] "" Vector__XXX

BO_ 2566824448 VDMA_FEA2_Exhaust_Port_Temperatu: 8 Vector__XXX
 SG_ Exhaust_Port_Temperature_2_RawPa : 0|64@1+ (1,0) [0|18446744073709551615] "" Vector__XXX

BO_ 2566824704 VDMA_FEA3_Exhaust_Port_Temperatu: 8 Vector__XXX
 SG_ Exhaust_Port_Temperature_1_RawPa : 0|64@1+ (1,0) [0|18446744073709551615] "" Vector__XXX

BO_ 2566824960 VDMA_FEA4_Engine_Temperature_2: 8 Vector__XXX
 SG_ Engine_Temperature_2_RawPayload : 0|64@1+ (1,0) [0|18446744073709551615] "" Vector__XXX

BO_ 2566825216 VDMA_FEA5_Intake_Manifold_Inform: 8 Vector__XXX
 SG_ Intake_Manifold_Information_2_Ra : 0|64@1+ (1,0) [0|18446744073709551615] "" Vector__XXX

BO_ 2566825472 VDMA_FEA6_Intake_Manifold_Inform: 8 Vector__XXX
 SG_ Intake_Manifold_Information_1_Ra : 0|64@1+ (1,0) [0|18446744073709551615] "" Vector__XXX

BO_ 2566825728 VDMA_FEA7_Alternator_Temperature: 8 Vector__XXX
 SG_ Alternator_Temperature_1_RawPayl : 0|64@1+ (1,0) [0|18446744073709551615] "" Vector__XXX

BO_ 2566825984 VDMA_FEA8_Articulation_Control: 8 Vector__XXX
 SG_ Articulation_Control_RawPayload : 0|64@1+ (1,0) [0|18446744073709551615] "" Vector__XXX

BO_ 2566826240 VDMA_FEA9_Exhaust_Oxygen_1: 8 Vector__XXX
 SG_ Exhaust_Oxygen_1_RawPayload : 0|64@1+ (1,0) [0|18446744073709551615] "" Vector__XXX

BO_ 2566826496 VDMA_FEAA_Alternate_Fuel_2: 8 Vector__XXX
 SG_ Alternate_Fuel_2_RawPayload : 0|64@1+ (1,0) [0|18446744073709551615] "" Vector__XXX

BO_ 2566826752 VDMA_FEAB_Electronic_Transmissio: 8 Vector__XXX
 SG_ Electronic_Transmission_Controll : 0|64@1+ (1,0) [0|18446744073709551615] "" Vector__XXX

BO_ 2566827008 VDMA_FEAC_Wheel_Brake_Lining_Rem: 8 Vector__XXX
 SG_ Wheel_Brake_Lining_Remaining_Inf : 0|64@1+ (1,0) [0|18446744073709551615] "" Vector__XXX

BO_ 2566827264 VDMA_FEAD_Wheel_Application_Pres: 8 Vector__XXX
 SG_ Wheel_Application_Pressure_High_ : 0|64@1+ (1,0) [0|18446744073709551615] "" Vector__XXX

BO_ 2566827520 VDMA_FEAE_Air_Supply_Pressure: 8 Vector__XXX
 SG_ Air_Supply_Pressure_RawPayload : 0|64@1+ (1,0) [0|18446744073709551615] "" Vector__XXX

BO_ 2566827776 VDMA_FEAF_Fuel_Consumption_Gaseo: 8 Vector__XXX
 SG_ Fuel_Consumption_Gaseous_RawPayl : 0|64@1+ (1,0) [0|18446744073709551615] "" Vector__XXX

BO_ 2566828032 VDMA_FEB0_Trip_Time_Information_: 8 Vector__XXX
 SG_ Trip_Time_Information_2_RawPaylo : 0|64@1+ (1,0) [0|18446744073709551615] "" Vector__XXX

BO_ 2566828288 VDMA_FEB1_ECU_History: 8 Vector__XXX
 SG_ ECU_History_RawPayload : 0|64@1+ (1,0) [0|18446744073709551615] "" Vector__XXX

BO_ 2566828544 VDMA_FEB2_Fuel_Information_1_Gas: 8 Vector__XXX
 SG_ Fuel_Information_1_Gaseous_RawPa : 0|64@1+ (1,0) [0|18446744073709551615] "" Vector__XXX

BO_ 2566828800 VDMA_FEB3_Fuel_Information_1_Liq: 8 Vector__XXX
 SG_ Fuel_Information_1_Liquid_RawPay : 0|64@1+ (1,0) [0|18446744073709551615] "" Vector__XXX

BO_ 2566829056 VDMA_FEB4_Trip_Time_Information_: 8 Vector__XXX
 SG_ Trip_Time_Information_1_RawPaylo : 0|64@1+ (1,0) [0|18446744073709551615] "" Vector__XXX

BO_ 2566829312 VDMA_FEB5_Trip_Shutdown_Informat: 8 Vector__XXX
 SG_ Trip_Shutdown_Information_RawPay : 0|64@1+ (1,0) [0|18446744073709551615] "" Vector__XXX

BO_ 2566829568 VDMA_FEB6_Trip_Vehicle_Speed_Cru: 8 Vector__XXX
 SG_ Trip_Vehicle_Speed_Cruise_Distan : 0|64@1+ (1,0) [0|18446744073709551615] "" Vector__XXX

BO_ 2566829824 VDMA_FEB7_Engine_Speed_Load_Fact: 8 Vector__XXX
 SG_ Engine_Speed_Load_Factor_Informa : 0|64@1+ (1,0) [0|18446744073709551615] "" Vector__XXX

BO_ 2566830080 VDMA_FEB8_Trip_Fuel_Information_: 8 Vector__XXX
 SG_ Trip_Fuel_Information_Gaseous_Ra : 0|64@1+ (1,0) [0|18446744073709551615] "" Vector__XXX

BO_ 2566830336 VDMA_FEB9_Trip_Fuel_Information_: 8 Vector__XXX
 SG_ Trip_Fuel_Information_Liquid_Raw : 0|64@1+ (1,0) [0|18446744073709551615] "" Vector__XXX

BO_ 2566830592 VDMA_FEBA_Trip_Distance_Informat: 8 Vector__XXX
 SG_ Trip_Distance_Information_RawPay : 0|64@1+ (1,0) [0|18446744073709551615] "" Vector__XXX

BO_ 2566830848 VDMA_FEBB_Trip_Fan_Information: 8 Vector__XXX
 SG_ Trip_Fan_Information_RawPayload : 0|64@1+ (1,0) [0|18446744073709551615] "" Vector__XXX

BO_ 2566831104 VDMA_FEBC_Compression_Service_Br: 8 Vector__XXX
 SG_ Compression_Service_Brake_Inform : 0|64@1+ (1,0) [0|18446744073709551615] "" Vector__XXX

BO_ 2566831360 VDMA_FEBD_Fan_Drive_1: 8 Vector__XXX
 SG_ Fan_Drive_1_RawPayload : 0|64@1+ (1,0) [0|18446744073709551615] "" Vector__XXX

BO_ 2566831616 VDMA_FEBE_Electronic_Engine_Cont: 8 Vector__XXX
 SG_ Electronic_Engine_Controller_4_R : 0|64@1+ (1,0) [0|18446744073709551615] "" Vector__XXX

BO_ 2566831872 VDMA_FEBF_Wheel_Speed_Informatio: 8 Vector__XXX
 SG_ Wheel_Speed_Information_RawPaylo : 0|64@1+ (1,0) [0|18446744073709551615] "" Vector__XXX

BO_ 2566832128 VDMA_FEC0_Service_Information: 8 Vector__XXX
 SG_ Service_Information_RawPayload : 0|64@1+ (1,0) [0|18446744073709551615] "" Vector__XXX

BO_ 2566832640 VDMA_FEC2_Electronic_Retarder_Co: 8 Vector__XXX
 SG_ Electronic_Retarder_Controller_2 : 0|64@1+ (1,0) [0|18446744073709551615] "" Vector__XXX

BO_ 2566832896 VDMA_FEC3_Electronic_Transmissio: 8 Vector__XXX
 SG_ Electronic_Transmission_Controll : 0|64@1+ (1,0) [0|18446744073709551615] "" Vector__XXX

BO_ 2566833152 VDMA_FEC4_Electronic_Brake_Syste: 8 Vector__XXX
 SG_ Electronic_Brake_System_2_2_RawP : 0|64@1+ (1,0) [0|18446744073709551615] "" Vector__XXX

BO_ 2566833408 VDMA_FEC5_Electronic_Transmissio: 8 Vector__XXX
 SG_ Electronic_Transmission_Controll : 0|64@1+ (1,0) [0|18446744073709551615] "" Vector__XXX

BO_ 2566833664 VDMA_FEC6_Electronic_Brake_Syste: 8 Vector__XXX
 SG_ Electronic_Brake_System_2_3_RawP : 0|64@1+ (1,0) [0|18446744073709551615] "" Vector__XXX

BO_ 2566833920 VDMA_FEC7_Electronic_Transmissio: 8 Vector__XXX
 SG_ Electronic_Transmission_Controll : 0|64@1+ (1,0) [0|18446744073709551615] "" Vector__XXX

BO_ 2566834176 VDMA_FEC8_General_Purpose_Messag: 8 Vector__XXX
 SG_ General_Purpose_Message_2_2_RawP : 0|64@1+ (1,0) [0|18446744073709551615] "" Vector__XXX

BO_ 2566834432 VDMA_FEC9_Electronic_Brake_Syste: 8 Vector__XXX
 SG_ Electronic_Brake_System_1_2_RawP : 0|64@1+ (1,0) [0|18446744073709551615] "" Vector__XXX

BO_ 2566835456 VDMA_FECD_Freeze_Frame_Parameter: 8 Vector__XXX
 SG_ Freeze_Frame_Parameters_RawPaylo : 0|64@1+ (1,0) [0|18446744073709551615] "" Vector__XXX

BO_ 2566835712 VDMA_FECE_Diagnostic_Readiness_1: 8 Vector__XXX
 SG_ Diagnostic_Readiness_1_RawPayloa : 0|64@1+ (1,0) [0|18446744073709551615] "" Vector__XXX

BO_ 2566835968 VDMA_FECF_Emission_Related_Pendi: 8 Vector__XXX
 SG_ Emission_Related_Pending_Diagnos : 0|64@1+ (1,0) [0|18446744073709551615] "" Vector__XXX

BO_ 2566836224 VDMA_FED0_Test_Results_for_Non_c: 8 Vector__XXX
 SG_ Test_Results_for_Non_continuousl : 0|64@1+ (1,0) [0|18446744073709551615] "" Vector__XXX

BO_ 2566836480 VDMA_FED1_Oxygen_Sensor_Test_Res: 8 Vector__XXX
 SG_ Oxygen_Sensor_Test_Results_RawPa : 0|64@1+ (1,0) [0|18446744073709551615] "" Vector__XXX

BO_ 2566836736 VDMA_FED2_Non_Continuously_Monit: 8 Vector__XXX
 SG_ Non_Continuously_Monitored_Syste : 0|64@1+ (1,0) [0|18446744073709551615] "" Vector__XXX

BO_ 2566837248 VDMA_FED4_Emission_Related_MIL_O: 8 Vector__XXX
 SG_ Emission_Related_MIL_On_Diagnost : 0|64@1+ (1,0) [0|18446744073709551615] "" Vector__XXX

BO_ 2566837504 VDMA_FED5_Alternator_Information: 8 Vector__XXX
 SG_ Alternator_Information_1_RawPayl : 0|64@1+ (1,0) [0|18446744073709551615] "" Vector__XXX

BO_ 2566837760 VDMA_FED6_Hybrid_or_EV_System_In: 8 Vector__XXX
 SG_ Hybrid_or_EV_System_Inputs_1_Raw : 0|64@1+ (1,0) [0|18446744073709551615] "" Vector__XXX

BO_ 2566838528 VDMA_FED9_Auxiliary_Input_Output: 8 Vector__XXX
 SG_ Auxiliary_Input_Output_Status_1_ : 0|64@1+ (1,0) [0|18446744073709551615] "" Vector__XXX

BO_ 2566839040 VDMA_FEDB_Engine_Fluid_Level_Pre: 8 Vector__XXX
 SG_ Engine_Fluid_Level_Pressure_2_Ra : 0|64@1+ (1,0) [0|18446744073709551615] "" Vector__XXX

BO_ 2566839296 VDMA_FEDC_Idle_Operation: 8 Vector__XXX
 SG_ Idle_Operation_RawPayload : 0|64@1+ (1,0) [0|18446744073709551615] "" Vector__XXX

BO_ 2566839552 VDMA_FEDD_Turbocharger: 8 Vector__XXX
 SG_ Turbocharger_RawPayload : 0|64@1+ (1,0) [0|18446744073709551615] "" Vector__XXX

BO_ 2566839808 VDMA_FEDE_Engine_Air_Start_Press: 8 Vector__XXX
 SG_ Engine_Air_Start_Pressure_RawPay : 0|64@1+ (1,0) [0|18446744073709551615] "" Vector__XXX

BO_ 2566840320 VDMA_FEE0_Vehicle_Distance: 8 Vector__XXX
 SG_ Vehicle_Distance_RawPayload : 0|64@1+ (1,0) [0|18446744073709551615] "" Vector__XXX

BO_ 2566840576 VDMA_FEE1_Retarder_Configuration: 8 Vector__XXX
 SG_ Retarder_Configuration_RawPayloa : 0|64@1+ (1,0) [0|18446744073709551615] "" Vector__XXX

BO_ 2566840832 VDMA_FEE2_Transmission_Configura: 8 Vector__XXX
 SG_ Transmission_Configuration_RawPa : 0|64@1+ (1,0) [0|18446744073709551615] "" Vector__XXX

BO_ 2566841344 VDMA_FEE4_Shutdown: 8 Vector__XXX
 SG_ Shutdown_RawPayload : 0|64@1+ (1,0) [0|18446744073709551615] "" Vector__XXX

BO_ 2566842112 VDMA_FEE7_Vehicle_Hours: 8 Vector__XXX
 SG_ Vehicle_Hours_RawPayload : 0|64@1+ (1,0) [0|18446744073709551615] "" Vector__XXX

BO_ 2566842368 VDMA_FEE8_Vehicle_Direction_Spee: 8 Vector__XXX
 SG_ Vehicle_Direction_Speed_RawPaylo : 0|64@1+ (1,0) [0|18446744073709551615] "" Vector__XXX

CM_ BO_ 2566746368  "Source: isobus.net VDMA Data Dictionary (https://www.isobus.net/isobus/pGNAndSPN/14841?type=PGN)";
CM_ BO_ 2566746624  "Source: isobus.net VDMA Data Dictionary (https://www.isobus.net/isobus/pGNAndSPN/14845?type=PGN)";
CM_ BO_ 2566746880  "Source: isobus.net VDMA Data Dictionary (https://www.isobus.net/isobus/pGNAndSPN/14849?type=PGN)";
CM_ BO_ 2566747136  "Source: isobus.net VDMA Data Dictionary (https://www.isobus.net/isobus/pGNAndSPN/14853?type=PGN)";
CM_ BO_ 2566747392  "Source: isobus.net VDMA Data Dictionary (https://www.isobus.net/isobus/pGNAndSPN/14857?type=PGN)";
CM_ BO_ 2566747648  "Source: isobus.net VDMA Data Dictionary (https://www.isobus.net/isobus/pGNAndSPN/14861?type=PGN)";
CM_ BO_ 2566747904  "Source: isobus.net VDMA Data Dictionary (https://www.isobus.net/isobus/pGNAndSPN/14865?type=PGN)";
CM_ BO_ 2566748160  "Source: isobus.net VDMA Data Dictionary (https://www.isobus.net/isobus/pGNAndSPN/14873?type=PGN)";
CM_ BO_ 2566748416  "Source: isobus.net VDMA Data Dictionary (https://www.isobus.net/isobus/pGNAndSPN/14881?type=PGN)";
CM_ BO_ 2566748672  "Source: isobus.net VDMA Data Dictionary (https://www.isobus.net/isobus/pGNAndSPN/14885?type=PGN)";
CM_ BO_ 2566748928  "Source: isobus.net VDMA Data Dictionary (https://www.isobus.net/isobus/pGNAndSPN/14889?type=PGN)";
CM_ BO_ 2566749696  "Source: isobus.net VDMA Data Dictionary (https://www.isobus.net/isobus/pGNAndSPN/14922?type=PGN)";
CM_ BO_ 2566749952  "Source: isobus.net VDMA Data Dictionary (https://www.isobus.net/isobus/pGNAndSPN/14926?type=PGN)";
CM_ BO_ 2566750208  "Source: isobus.net VDMA Data Dictionary (https://www.isobus.net/isobus/pGNAndSPN/14938?type=PGN)";
CM_ BO_ 2566750464  "Source: isobus.net VDMA Data Dictionary (https://www.isobus.net/isobus/pGNAndSPN/14939?type=PGN)";
CM_ BO_ 2566750720  "Source: isobus.net VDMA Data Dictionary (https://www.isobus.net/isobus/pGNAndSPN/14951?type=PGN)";
CM_ BO_ 2566750976  "Source: isobus.net VDMA Data Dictionary (https://www.isobus.net/isobus/pGNAndSPN/14956?type=PGN)";
CM_ BO_ 2566751232  "Source: isobus.net VDMA Data Dictionary (https://www.isobus.net/isobus/pGNAndSPN/14960?type=PGN)";
CM_ BO_ 2566751488  "Source: isobus.net VDMA Data Dictionary (https://www.isobus.net/isobus/pGNAndSPN/14964?type=PGN)";
CM_ BO_ 2566751744  "Source: isobus.net VDMA Data Dictionary (https://www.isobus.net/isobus/pGNAndSPN/14968?type=PGN)";
CM_ BO_ 2566752000  "Source: isobus.net VDMA Data Dictionary (https://www.isobus.net/isobus/pGNAndSPN/14972?type=PGN)";
CM_ BO_ 2566752256  "Source: isobus.net VDMA Data Dictionary (https://www.isobus.net/isobus/pGNAndSPN/14976?type=PGN)";
CM_ BO_ 2566752512  "Source: isobus.net VDMA Data Dictionary (https://www.isobus.net/isobus/pGNAndSPN/14977?type=PGN)";
CM_ BO_ 2566752768  "Source: isobus.net VDMA Data Dictionary (https://www.isobus.net/isobus/pGNAndSPN/14981?type=PGN)";
CM_ BO_ 2566753024  "Source: isobus.net VDMA Data Dictionary (https://www.isobus.net/isobus/pGNAndSPN/14983?type=PGN)";
CM_ BO_ 2566753280  "Source: isobus.net VDMA Data Dictionary (https://www.isobus.net/isobus/pGNAndSPN/14985?type=PGN)";
CM_ BO_ 2566753536  "Source: isobus.net VDMA Data Dictionary (https://www.isobus.net/isobus/pGNAndSPN/14987?type=PGN)";
CM_ BO_ 2566753792  "Source: isobus.net VDMA Data Dictionary (https://www.isobus.net/isobus/pGNAndSPN/14989?type=PGN)";
CM_ BO_ 2566754048  "Source: isobus.net VDMA Data Dictionary (https://www.isobus.net/isobus/pGNAndSPN/14992?type=PGN)";
CM_ BO_ 2566754304  "Source: isobus.net VDMA Data Dictionary (https://www.isobus.net/isobus/pGNAndSPN/14996?type=PGN)";
CM_ BO_ 2566754560  "Source: isobus.net VDMA Data Dictionary (https://www.isobus.net/isobus/pGNAndSPN/15007?type=PGN)";
CM_ BO_ 2566754816  "Source: isobus.net VDMA Data Dictionary (https://www.isobus.net/isobus/pGNAndSPN/15025?type=PGN)";
CM_ BO_ 2566755072  "Source: isobus.net VDMA Data Dictionary (https://www.isobus.net/isobus/pGNAndSPN/15033?type=PGN)";
CM_ BO_ 2566755328  "Source: isobus.net VDMA Data Dictionary (https://www.isobus.net/isobus/pGNAndSPN/15037?type=PGN)";
CM_ BO_ 2566755584  "Source: isobus.net VDMA Data Dictionary (https://www.isobus.net/isobus/pGNAndSPN/15047?type=PGN)";
CM_ BO_ 2566755840  "Source: isobus.net VDMA Data Dictionary (https://www.isobus.net/isobus/pGNAndSPN/15049?type=PGN)";
CM_ BO_ 2566756096  "Source: isobus.net VDMA Data Dictionary (https://www.isobus.net/isobus/pGNAndSPN/15051?type=PGN)";
CM_ BO_ 2566756352  "Source: isobus.net VDMA Data Dictionary (https://www.isobus.net/isobus/pGNAndSPN/15062?type=PGN)";
CM_ BO_ 2566756608  "Source: isobus.net VDMA Data Dictionary (https://www.isobus.net/isobus/pGNAndSPN/15073?type=PGN)";
CM_ BO_ 2566756864  "Source: isobus.net VDMA Data Dictionary (https://www.isobus.net/isobus/pGNAndSPN/15074?type=PGN)";
CM_ BO_ 2566757120  "Source: isobus.net VDMA Data Dictionary (https://www.isobus.net/isobus/pGNAndSPN/15081?type=PGN)";
CM_ BO_ 2566757376  "Source: isobus.net VDMA Data Dictionary (https://www.isobus.net/isobus/pGNAndSPN/15085?type=PGN)";
CM_ BO_ 2566757632  "Source: isobus.net VDMA Data Dictionary (https://www.isobus.net/isobus/pGNAndSPN/15089?type=PGN)";
CM_ BO_ 2566757888  "Source: isobus.net VDMA Data Dictionary (https://www.isobus.net/isobus/pGNAndSPN/15097?type=PGN)";
CM_ BO_ 2566758144  "Source: isobus.net VDMA Data Dictionary (https://www.isobus.net/isobus/pGNAndSPN/15105?type=PGN)";
CM_ BO_ 2566758400  "Source: isobus.net VDMA Data Dictionary (https://www.isobus.net/isobus/pGNAndSPN/15113?type=PGN)";
CM_ BO_ 2566758656  "Source: isobus.net VDMA Data Dictionary (https://www.isobus.net/isobus/pGNAndSPN/15121?type=PGN)";
CM_ BO_ 2566758912  "Source: isobus.net VDMA Data Dictionary (https://www.isobus.net/isobus/pGNAndSPN/15125?type=PGN)";
CM_ BO_ 2566759168  "Source: isobus.net VDMA Data Dictionary (https://www.isobus.net/isobus/pGNAndSPN/15132?type=PGN)";
CM_ BO_ 2566759424  "Source: isobus.net VDMA Data Dictionary (https://www.isobus.net/isobus/pGNAndSPN/15160?type=PGN)";
CM_ BO_ 2566759680  "Source: isobus.net VDMA Data Dictionary (https://www.isobus.net/isobus/pGNAndSPN/15190?type=PGN)";
CM_ BO_ 2566759936  "Source: isobus.net VDMA Data Dictionary (https://www.isobus.net/isobus/pGNAndSPN/15193?type=PGN)";
CM_ BO_ 2566760192  "Source: isobus.net VDMA Data Dictionary (https://www.isobus.net/isobus/pGNAndSPN/15198?type=PGN)";
CM_ BO_ 2566760448  "Source: isobus.net VDMA Data Dictionary (https://www.isobus.net/isobus/pGNAndSPN/15203?type=PGN)";
CM_ BO_ 2566760704  "Source: isobus.net VDMA Data Dictionary (https://www.isobus.net/isobus/pGNAndSPN/15208?type=PGN)";
CM_ BO_ 2566760960  "Source: isobus.net VDMA Data Dictionary (https://www.isobus.net/isobus/pGNAndSPN/15215?type=PGN)";
CM_ BO_ 2566761216  "Source: isobus.net VDMA Data Dictionary (https://www.isobus.net/isobus/pGNAndSPN/15216?type=PGN)";
CM_ BO_ 2566761472  "Source: isobus.net VDMA Data Dictionary (https://www.isobus.net/isobus/pGNAndSPN/15218?type=PGN)";
CM_ BO_ 2566761728  "Source: isobus.net VDMA Data Dictionary (https://www.isobus.net/isobus/pGNAndSPN/15220?type=PGN)";
CM_ BO_ 2566761984  "Source: isobus.net VDMA Data Dictionary (https://www.isobus.net/isobus/pGNAndSPN/15225?type=PGN)";
CM_ BO_ 2566762240  "Source: isobus.net VDMA Data Dictionary (https://www.isobus.net/isobus/pGNAndSPN/15231?type=PGN)";
CM_ BO_ 2566762496  "Source: isobus.net VDMA Data Dictionary (https://www.isobus.net/isobus/pGNAndSPN/15236?type=PGN)";
CM_ BO_ 2566762752  "Source: isobus.net VDMA Data Dictionary (https://www.isobus.net/isobus/pGNAndSPN/15241?type=PGN)";
CM_ BO_ 2566763008  "Source: isobus.net VDMA Data Dictionary (https://www.isobus.net/isobus/pGNAndSPN/15247?type=PGN)";
CM_ BO_ 2566763264  "Source: isobus.net VDMA Data Dictionary (https://www.isobus.net/isobus/pGNAndSPN/15252?type=PGN)";
CM_ BO_ 2566763520  "Source: isobus.net VDMA Data Dictionary (https://www.isobus.net/isobus/pGNAndSPN/15257?type=PGN)";
CM_ BO_ 2566763776  "Source: isobus.net VDMA Data Dictionary (https://www.isobus.net/isobus/pGNAndSPN/15269?type=PGN)";
CM_ BO_ 2566764032  "Source: isobus.net VDMA Data Dictionary (https://www.isobus.net/isobus/pGNAndSPN/15275?type=PGN)";
CM_ BO_ 2566764288  "Source: isobus.net VDMA Data Dictionary (https://www.isobus.net/isobus/pGNAndSPN/15281?type=PGN)";
CM_ BO_ 2566764544  "Source: isobus.net VDMA Data Dictionary (https://www.isobus.net/isobus/pGNAndSPN/15286?type=PGN)";
CM_ BO_ 2566764800  "Source: isobus.net VDMA Data Dictionary (https://www.isobus.net/isobus/pGNAndSPN/15288?type=PGN)";
CM_ BO_ 2566765056  "Source: isobus.net VDMA Data Dictionary (https://www.isobus.net/isobus/pGNAndSPN/15290?type=PGN)";
CM_ BO_ 2566765312  "Source: isobus.net VDMA Data Dictionary (https://www.isobus.net/isobus/pGNAndSPN/15301?type=PGN)";
CM_ BO_ 2566765568  "Source: isobus.net VDMA Data Dictionary (https://www.isobus.net/isobus/pGNAndSPN/15311?type=PGN)";
CM_ BO_ 2566765824  "Source: isobus.net VDMA Data Dictionary (https://www.isobus.net/isobus/pGNAndSPN/15318?type=PGN)";
CM_ BO_ 2566766080  "Source: isobus.net VDMA Data Dictionary (https://www.isobus.net/isobus/pGNAndSPN/15325?type=PGN)";
CM_ BO_ 2566766336  "Source: isobus.net VDMA Data Dictionary (https://www.isobus.net/isobus/pGNAndSPN/15327?type=PGN)";
CM_ BO_ 2566766592  "Source: isobus.net VDMA Data Dictionary (https://www.isobus.net/isobus/pGNAndSPN/15332?type=PGN)";
CM_ BO_ 2566766848  "Source: isobus.net VDMA Data Dictionary (https://www.isobus.net/isobus/pGNAndSPN/15337?type=PGN)";
CM_ BO_ 2566767104  "Source: isobus.net VDMA Data Dictionary (https://www.isobus.net/isobus/pGNAndSPN/15342?type=PGN)";
CM_ BO_ 2566767360  "Source: isobus.net VDMA Data Dictionary (https://www.isobus.net/isobus/pGNAndSPN/15347?type=PGN)";
CM_ BO_ 2566767616  "Source: isobus.net VDMA Data Dictionary (https://www.isobus.net/isobus/pGNAndSPN/15360?type=PGN)";
CM_ BO_ 2566768128  "Source: isobus.net VDMA Data Dictionary (https://www.isobus.net/isobus/pGNAndSPN/15373?type=PGN)";
CM_ BO_ 2566768384  "Source: isobus.net VDMA Data Dictionary (https://www.isobus.net/isobus/pGNAndSPN/15383?type=PGN)";
CM_ BO_ 2566768640  "Source: isobus.net VDMA Data Dictionary (https://www.isobus.net/isobus/pGNAndSPN/15384?type=PGN)";
CM_ BO_ 2566768896  "Source: isobus.net VDMA Data Dictionary (https://www.isobus.net/isobus/pGNAndSPN/15385?type=PGN)";
CM_ BO_ 2566769152  "Source: isobus.net VDMA Data Dictionary (https://www.isobus.net/isobus/pGNAndSPN/15386?type=PGN)";
CM_ BO_ 2566769408  "Source: isobus.net VDMA Data Dictionary (https://www.isobus.net/isobus/pGNAndSPN/15396?type=PGN)";
CM_ BO_ 2566769664  "Source: isobus.net VDMA Data Dictionary (https://www.isobus.net/isobus/pGNAndSPN/15407?type=PGN)";
CM_ BO_ 2566769920  "Source: isobus.net VDMA Data Dictionary (https://www.isobus.net/isobus/pGNAndSPN/15416?type=PGN)";
CM_ BO_ 2566770176  "Source: isobus.net VDMA Data Dictionary (https://www.isobus.net/isobus/pGNAndSPN/15417?type=PGN)";
CM_ BO_ 2566770432  "Source: isobus.net VDMA Data Dictionary (https://www.isobus.net/isobus/pGNAndSPN/15418?type=PGN)";
CM_ BO_ 2566770688  "Source: isobus.net VDMA Data Dictionary (https://www.isobus.net/isobus/pGNAndSPN/15425?type=PGN)";
CM_ BO_ 2566770944  "Source: isobus.net VDMA Data Dictionary (https://www.isobus.net/isobus/pGNAndSPN/15428?type=PGN)";
CM_ BO_ 2566771200  "Source: isobus.net VDMA Data Dictionary (https://www.isobus.net/isobus/pGNAndSPN/15430?type=PGN)";
CM_ BO_ 2566771456  "Source: isobus.net VDMA Data Dictionary (https://www.isobus.net/isobus/pGNAndSPN/15434?type=PGN)";
CM_ BO_ 2566771712  "Source: isobus.net VDMA Data Dictionary (https://www.isobus.net/isobus/pGNAndSPN/15452?type=PGN)";
CM_ BO_ 2566771968  "Source: isobus.net VDMA Data Dictionary (https://www.isobus.net/isobus/pGNAndSPN/15459?type=PGN)";
CM_ BO_ 2566772224  "Source: isobus.net VDMA Data Dictionary (https://www.isobus.net/isobus/pGNAndSPN/15481?type=PGN)";
CM_ BO_ 2566772480  "Source: isobus.net VDMA Data Dictionary (https://www.isobus.net/isobus/pGNAndSPN/15500?type=PGN)";
CM_ BO_ 2566772736  "Source: isobus.net VDMA Data Dictionary (https://www.isobus.net/isobus/pGNAndSPN/15522?type=PGN)";
CM_ BO_ 2566772992  "Source: isobus.net VDMA Data Dictionary (https://www.isobus.net/isobus/pGNAndSPN/15541?type=PGN)";
CM_ BO_ 2566773248  "Source: isobus.net VDMA Data Dictionary (https://www.isobus.net/isobus/pGNAndSPN/15563?type=PGN)";
CM_ BO_ 2566773504  "Source: isobus.net VDMA Data Dictionary (https://www.isobus.net/isobus/pGNAndSPN/15582?type=PGN)";
CM_ BO_ 2566773760  "Source: isobus.net VDMA Data Dictionary (https://www.isobus.net/isobus/pGNAndSPN/15586?type=PGN)";
CM_ BO_ 2566774016  "Source: isobus.net VDMA Data Dictionary (https://www.isobus.net/isobus/pGNAndSPN/15587?type=PGN)";
CM_ BO_ 2566774272  "Source: isobus.net VDMA Data Dictionary (https://www.isobus.net/isobus/pGNAndSPN/15588?type=PGN)";
CM_ BO_ 2566774528  "Source: isobus.net VDMA Data Dictionary (https://www.isobus.net/isobus/pGNAndSPN/15589?type=PGN)";
CM_ BO_ 2566774784  "Source: isobus.net VDMA Data Dictionary (https://www.isobus.net/isobus/pGNAndSPN/15594?type=PGN)";
CM_ BO_ 2566775040  "Source: isobus.net VDMA Data Dictionary (https://www.isobus.net/isobus/pGNAndSPN/15603?type=PGN)";
CM_ BO_ 2566775296  "Source: isobus.net VDMA Data Dictionary (https://www.isobus.net/isobus/pGNAndSPN/15610?type=PGN)";
CM_ BO_ 2566775552  "Source: isobus.net VDMA Data Dictionary (https://www.isobus.net/isobus/pGNAndSPN/15611?type=PGN)";
CM_ BO_ 2566775808  "Source: isobus.net VDMA Data Dictionary (https://www.isobus.net/isobus/pGNAndSPN/15616?type=PGN)";
CM_ BO_ 2566776064  "Source: isobus.net VDMA Data Dictionary (https://www.isobus.net/isobus/pGNAndSPN/15624?type=PGN)";
CM_ BO_ 2566776320  "Source: isobus.net VDMA Data Dictionary (https://www.isobus.net/isobus/pGNAndSPN/15632?type=PGN)";
CM_ BO_ 2566776576  "Source: isobus.net VDMA Data Dictionary (https://www.isobus.net/isobus/pGNAndSPN/15638?type=PGN)";
CM_ BO_ 2566776832  "Source: isobus.net VDMA Data Dictionary (https://www.isobus.net/isobus/pGNAndSPN/15644?type=PGN)";
CM_ BO_ 2566777088  "Source: isobus.net VDMA Data Dictionary (https://www.isobus.net/isobus/pGNAndSPN/15647?type=PGN)";
CM_ BO_ 2566777344  "Source: isobus.net VDMA Data Dictionary (https://www.isobus.net/isobus/pGNAndSPN/15650?type=PGN)";
CM_ BO_ 2566777600  "Source: isobus.net VDMA Data Dictionary (https://www.isobus.net/isobus/pGNAndSPN/15653?type=PGN)";
CM_ BO_ 2566777856  "Source: isobus.net VDMA Data Dictionary (https://www.isobus.net/isobus/pGNAndSPN/15656?type=PGN)";
CM_ BO_ 2566778112  "Source: isobus.net VDMA Data Dictionary (https://www.isobus.net/isobus/pGNAndSPN/15658?type=PGN)";
CM_ BO_ 2566778368  "Source: isobus.net VDMA Data Dictionary (https://www.isobus.net/isobus/pGNAndSPN/15661?type=PGN)";
CM_ BO_ 2566778624  "Source: isobus.net VDMA Data Dictionary (https://www.isobus.net/isobus/pGNAndSPN/15663?type=PGN)";
CM_ BO_ 2566778880  "Source: isobus.net VDMA Data Dictionary (https://www.isobus.net/isobus/pGNAndSPN/15667?type=PGN)";
CM_ BO_ 2566779136  "Source: isobus.net VDMA Data Dictionary (https://www.isobus.net/isobus/pGNAndSPN/15670?type=PGN)";
CM_ BO_ 2566779392  "Source: isobus.net VDMA Data Dictionary (https://www.isobus.net/isobus/pGNAndSPN/15672?type=PGN)";
CM_ BO_ 2566779648  "Source: isobus.net VDMA Data Dictionary (https://www.isobus.net/isobus/pGNAndSPN/15676?type=PGN)";
CM_ BO_ 2566779904  "Source: isobus.net VDMA Data Dictionary (https://www.isobus.net/isobus/pGNAndSPN/15679?type=PGN)";
CM_ BO_ 2566780160  "Source: isobus.net VDMA Data Dictionary (https://www.isobus.net/isobus/pGNAndSPN/15681?type=PGN)";
CM_ BO_ 2566780416  "Source: isobus.net VDMA Data Dictionary (https://www.isobus.net/isobus/pGNAndSPN/15685?type=PGN)";
CM_ BO_ 2566780672  "Source: isobus.net VDMA Data Dictionary (https://www.isobus.net/isobus/pGNAndSPN/15688?type=PGN)";
CM_ BO_ 2566780928  "Source: isobus.net VDMA Data Dictionary (https://www.isobus.net/isobus/pGNAndSPN/15690?type=PGN)";
CM_ BO_ 2566781184  "Source: isobus.net VDMA Data Dictionary (https://www.isobus.net/isobus/pGNAndSPN/15694?type=PGN)";
CM_ BO_ 2566781440  "Source: isobus.net VDMA Data Dictionary (https://www.isobus.net/isobus/pGNAndSPN/15696?type=PGN)";
CM_ BO_ 2566781696  "Source: isobus.net VDMA Data Dictionary (https://www.isobus.net/isobus/pGNAndSPN/15699?type=PGN)";
CM_ BO_ 2566781952  "Source: isobus.net VDMA Data Dictionary (https://www.isobus.net/isobus/pGNAndSPN/15701?type=PGN)";
CM_ BO_ 2566782208  "Source: isobus.net VDMA Data Dictionary (https://www.isobus.net/isobus/pGNAndSPN/15705?type=PGN)";
CM_ BO_ 2566782464  "Source: isobus.net VDMA Data Dictionary (https://www.isobus.net/isobus/pGNAndSPN/15708?type=PGN)";
CM_ BO_ 2566782720  "Source: isobus.net VDMA Data Dictionary (https://www.isobus.net/isobus/pGNAndSPN/15710?type=PGN)";
CM_ BO_ 2566782976  "Source: isobus.net VDMA Data Dictionary (https://www.isobus.net/isobus/pGNAndSPN/15714?type=PGN)";
CM_ BO_ 2566783232  "Source: isobus.net VDMA Data Dictionary (https://www.isobus.net/isobus/pGNAndSPN/15717?type=PGN)";
CM_ BO_ 2566783488  "Source: isobus.net VDMA Data Dictionary (https://www.isobus.net/isobus/pGNAndSPN/15719?type=PGN)";
CM_ BO_ 2566783744  "Source: isobus.net VDMA Data Dictionary (https://www.isobus.net/isobus/pGNAndSPN/15723?type=PGN)";
CM_ BO_ 2566784000  "Source: isobus.net VDMA Data Dictionary (https://www.isobus.net/isobus/pGNAndSPN/15726?type=PGN)";
CM_ BO_ 2566784256  "Source: isobus.net VDMA Data Dictionary (https://www.isobus.net/isobus/pGNAndSPN/15728?type=PGN)";
CM_ BO_ 2566784512  "Source: isobus.net VDMA Data Dictionary (https://www.isobus.net/isobus/pGNAndSPN/15732?type=PGN)";
CM_ BO_ 2566784768  "Source: isobus.net VDMA Data Dictionary (https://www.isobus.net/isobus/pGNAndSPN/15736?type=PGN)";
CM_ BO_ 2566785024  "Source: isobus.net VDMA Data Dictionary (https://www.isobus.net/isobus/pGNAndSPN/15782?type=PGN)";
CM_ BO_ 2566785280  "Source: isobus.net VDMA Data Dictionary (https://www.isobus.net/isobus/pGNAndSPN/15828?type=PGN)";
CM_ BO_ 2566785536  "Source: isobus.net VDMA Data Dictionary (https://www.isobus.net/isobus/pGNAndSPN/15829?type=PGN)";
CM_ BO_ 2566785792  "Source: isobus.net VDMA Data Dictionary (https://www.isobus.net/isobus/pGNAndSPN/15831?type=PGN)";
CM_ BO_ 2566786048  "Source: isobus.net VDMA Data Dictionary (https://www.isobus.net/isobus/pGNAndSPN/15832?type=PGN)";
CM_ BO_ 2566786560  "Source: isobus.net VDMA Data Dictionary (https://www.isobus.net/isobus/pGNAndSPN/15835?type=PGN)";
CM_ BO_ 2566787072  "Source: isobus.net VDMA Data Dictionary (https://www.isobus.net/isobus/pGNAndSPN/15855?type=PGN)";
CM_ BO_ 2566787328  "Source: isobus.net VDMA Data Dictionary (https://www.isobus.net/isobus/pGNAndSPN/15862?type=PGN)";
CM_ BO_ 2566787584  "Source: isobus.net VDMA Data Dictionary (https://www.isobus.net/isobus/pGNAndSPN/15869?type=PGN)";
CM_ BO_ 2566787840  "Source: isobus.net VDMA Data Dictionary (https://www.isobus.net/isobus/pGNAndSPN/15876?type=PGN)";
CM_ BO_ 2566788096  "Source: isobus.net VDMA Data Dictionary (https://www.isobus.net/isobus/pGNAndSPN/15883?type=PGN)";
CM_ BO_ 2566788352  "Source: isobus.net VDMA Data Dictionary (https://www.isobus.net/isobus/pGNAndSPN/15890?type=PGN)";
CM_ BO_ 2566788608  "Source: isobus.net VDMA Data Dictionary (https://www.isobus.net/isobus/pGNAndSPN/15897?type=PGN)";
CM_ BO_ 2566788864  "Source: isobus.net VDMA Data Dictionary (https://www.isobus.net/isobus/pGNAndSPN/15904?type=PGN)";
CM_ BO_ 2566789120  "Source: isobus.net VDMA Data Dictionary (https://www.isobus.net/isobus/pGNAndSPN/15911?type=PGN)";
CM_ BO_ 2566789376  "Source: isobus.net VDMA Data Dictionary (https://www.isobus.net/isobus/pGNAndSPN/15918?type=PGN)";
CM_ BO_ 2566789632  "Source: isobus.net VDMA Data Dictionary (https://www.isobus.net/isobus/pGNAndSPN/15925?type=PGN)";
CM_ BO_ 2566789888  "Source: isobus.net VDMA Data Dictionary (https://www.isobus.net/isobus/pGNAndSPN/15932?type=PGN)";
CM_ BO_ 2566790144  "Source: isobus.net VDMA Data Dictionary (https://www.isobus.net/isobus/pGNAndSPN/15939?type=PGN)";
CM_ BO_ 2566790400  "Source: isobus.net VDMA Data Dictionary (https://www.isobus.net/isobus/pGNAndSPN/15946?type=PGN)";
CM_ BO_ 2566790656  "Source: isobus.net VDMA Data Dictionary (https://www.isobus.net/isobus/pGNAndSPN/15953?type=PGN)";
CM_ BO_ 2566790912  "Source: isobus.net VDMA Data Dictionary (https://www.isobus.net/isobus/pGNAndSPN/15960?type=PGN)";
CM_ BO_ 2566791168  "Source: isobus.net VDMA Data Dictionary (https://www.isobus.net/isobus/pGNAndSPN/15966?type=PGN)";
CM_ BO_ 2566791424  "Source: isobus.net VDMA Data Dictionary (https://www.isobus.net/isobus/pGNAndSPN/15972?type=PGN)";
CM_ BO_ 2566791680  "Source: isobus.net VDMA Data Dictionary (https://www.isobus.net/isobus/pGNAndSPN/15978?type=PGN)";
CM_ BO_ 2566791936  "Source: isobus.net VDMA Data Dictionary (https://www.isobus.net/isobus/pGNAndSPN/15984?type=PGN)";
CM_ BO_ 2566792192  "Source: isobus.net VDMA Data Dictionary (https://www.isobus.net/isobus/pGNAndSPN/15990?type=PGN)";
CM_ BO_ 2566792448  "Source: isobus.net VDMA Data Dictionary (https://www.isobus.net/isobus/pGNAndSPN/15996?type=PGN)";
CM_ BO_ 2566792704  "Source: isobus.net VDMA Data Dictionary (https://www.isobus.net/isobus/pGNAndSPN/16002?type=PGN)";
CM_ BO_ 2566792960  "Source: isobus.net VDMA Data Dictionary (https://www.isobus.net/isobus/pGNAndSPN/16008?type=PGN)";
CM_ BO_ 2566793216  "Source: isobus.net VDMA Data Dictionary (https://www.isobus.net/isobus/pGNAndSPN/16014?type=PGN)";
CM_ BO_ 2566793472  "Source: isobus.net VDMA Data Dictionary (https://www.isobus.net/isobus/pGNAndSPN/16020?type=PGN)";
CM_ BO_ 2566793728  "Source: isobus.net VDMA Data Dictionary (https://www.isobus.net/isobus/pGNAndSPN/16026?type=PGN)";
CM_ BO_ 2566793984  "Source: isobus.net VDMA Data Dictionary (https://www.isobus.net/isobus/pGNAndSPN/16032?type=PGN)";
CM_ BO_ 2566794240  "Source: isobus.net VDMA Data Dictionary (https://www.isobus.net/isobus/pGNAndSPN/16038?type=PGN)";
CM_ BO_ 2566794496  "Source: isobus.net VDMA Data Dictionary (https://www.isobus.net/isobus/pGNAndSPN/16044?type=PGN)";
CM_ BO_ 2566794752  "Source: isobus.net VDMA Data Dictionary (https://www.isobus.net/isobus/pGNAndSPN/16050?type=PGN)";
CM_ BO_ 2566795008  "Source: isobus.net VDMA Data Dictionary (https://www.isobus.net/isobus/pGNAndSPN/16056?type=PGN)";
CM_ BO_ 2566795264  "Source: isobus.net VDMA Data Dictionary (https://www.isobus.net/isobus/pGNAndSPN/16061?type=PGN)";
CM_ BO_ 2566795520  "Source: isobus.net VDMA Data Dictionary (https://www.isobus.net/isobus/pGNAndSPN/16066?type=PGN)";
CM_ BO_ 2566795776  "Source: isobus.net VDMA Data Dictionary (https://www.isobus.net/isobus/pGNAndSPN/16071?type=PGN)";
CM_ BO_ 2566796032  "Source: isobus.net VDMA Data Dictionary (https://www.isobus.net/isobus/pGNAndSPN/16076?type=PGN)";
CM_ BO_ 2566796288  "Source: isobus.net VDMA Data Dictionary (https://www.isobus.net/isobus/pGNAndSPN/16081?type=PGN)";
CM_ BO_ 2566796544  "Source: isobus.net VDMA Data Dictionary (https://www.isobus.net/isobus/pGNAndSPN/16086?type=PGN)";
CM_ BO_ 2566796800  "Source: isobus.net VDMA Data Dictionary (https://www.isobus.net/isobus/pGNAndSPN/16091?type=PGN)";
CM_ BO_ 2566797056  "Source: isobus.net VDMA Data Dictionary (https://www.isobus.net/isobus/pGNAndSPN/16096?type=PGN)";
CM_ BO_ 2566797312  "Source: isobus.net VDMA Data Dictionary (https://www.isobus.net/isobus/pGNAndSPN/16101?type=PGN)";
CM_ BO_ 2566797568  "Source: isobus.net VDMA Data Dictionary (https://www.isobus.net/isobus/pGNAndSPN/16106?type=PGN)";
CM_ BO_ 2566797824  "Source: isobus.net VDMA Data Dictionary (https://www.isobus.net/isobus/pGNAndSPN/16111?type=PGN)";
CM_ BO_ 2566798080  "Source: isobus.net VDMA Data Dictionary (https://www.isobus.net/isobus/pGNAndSPN/16116?type=PGN)";
CM_ BO_ 2566798336  "Source: isobus.net VDMA Data Dictionary (https://www.isobus.net/isobus/pGNAndSPN/16121?type=PGN)";
CM_ BO_ 2566798592  "Source: isobus.net VDMA Data Dictionary (https://www.isobus.net/isobus/pGNAndSPN/16126?type=PGN)";
CM_ BO_ 2566798848  "Source: isobus.net VDMA Data Dictionary (https://www.isobus.net/isobus/pGNAndSPN/16131?type=PGN)";
CM_ BO_ 2566799104  "Source: isobus.net VDMA Data Dictionary (https://www.isobus.net/isobus/pGNAndSPN/16136?type=PGN)";
CM_ BO_ 2566799360  "Source: isobus.net VDMA Data Dictionary (https://www.isobus.net/isobus/pGNAndSPN/16167?type=PGN)";
CM_ BO_ 2566799616  "Source: isobus.net VDMA Data Dictionary (https://www.isobus.net/isobus/pGNAndSPN/16199?type=PGN)";
CM_ BO_ 2566799872  "Source: isobus.net VDMA Data Dictionary (https://www.isobus.net/isobus/pGNAndSPN/16209?type=PGN)";
CM_ BO_ 2566800128  "Source: isobus.net VDMA Data Dictionary (https://www.isobus.net/isobus/pGNAndSPN/16219?type=PGN)";
CM_ BO_ 2566800384  "Source: isobus.net VDMA Data Dictionary (https://www.isobus.net/isobus/pGNAndSPN/16229?type=PGN)";
CM_ BO_ 2566800640  "Source: isobus.net VDMA Data Dictionary (https://www.isobus.net/isobus/pGNAndSPN/16235?type=PGN)";
CM_ BO_ 2566800896  "Source: isobus.net VDMA Data Dictionary (https://www.isobus.net/isobus/pGNAndSPN/16241?type=PGN)";
CM_ BO_ 2566801920  "Source: isobus.net VDMA Data Dictionary (https://www.isobus.net/isobus/pGNAndSPN/16285?type=PGN)";
CM_ BO_ 2566802176  "Source: isobus.net VDMA Data Dictionary (https://www.isobus.net/isobus/pGNAndSPN/16290?type=PGN)";
CM_ BO_ 2566802432  "Source: isobus.net VDMA Data Dictionary (https://www.isobus.net/isobus/pGNAndSPN/16298?type=PGN)";
CM_ BO_ 2566802688  "Source: isobus.net VDMA Data Dictionary (https://www.isobus.net/isobus/pGNAndSPN/16300?type=PGN)";
CM_ BO_ 2566802944  "Source: isobus.net VDMA Data Dictionary (https://www.isobus.net/isobus/pGNAndSPN/16303?type=PGN)";
CM_ BO_ 2566803200  "Source: isobus.net VDMA Data Dictionary (https://www.isobus.net/isobus/pGNAndSPN/16311?type=PGN)";
CM_ BO_ 2566803456  "Source: isobus.net VDMA Data Dictionary (https://www.isobus.net/isobus/pGNAndSPN/16315?type=PGN)";
CM_ BO_ 2566803712  "Source: isobus.net VDMA Data Dictionary (https://www.isobus.net/isobus/pGNAndSPN/16317?type=PGN)";
CM_ BO_ 2566803968  "Source: isobus.net VDMA Data Dictionary (https://www.isobus.net/isobus/pGNAndSPN/16321?type=PGN)";
CM_ BO_ 2566804224  "Source: isobus.net VDMA Data Dictionary (https://www.isobus.net/isobus/pGNAndSPN/16329?type=PGN)";
CM_ BO_ 2566804480  "Source: isobus.net VDMA Data Dictionary (https://www.isobus.net/isobus/pGNAndSPN/16337?type=PGN)";
CM_ BO_ 2566804736  "Source: isobus.net VDMA Data Dictionary (https://www.isobus.net/isobus/pGNAndSPN/16340?type=PGN)";
CM_ BO_ 2566804992  "Source: isobus.net VDMA Data Dictionary (https://www.isobus.net/isobus/pGNAndSPN/16349?type=PGN)";
CM_ BO_ 2566805248  "Source: isobus.net VDMA Data Dictionary (https://www.isobus.net/isobus/pGNAndSPN/16355?type=PGN)";
CM_ BO_ 2566805504  "Source: isobus.net VDMA Data Dictionary (https://www.isobus.net/isobus/pGNAndSPN/16359?type=PGN)";
CM_ BO_ 2566805760  "Source: isobus.net VDMA Data Dictionary (https://www.isobus.net/isobus/pGNAndSPN/16363?type=PGN)";
CM_ BO_ 2566806016  "Source: isobus.net VDMA Data Dictionary (https://www.isobus.net/isobus/pGNAndSPN/16388?type=PGN)";
CM_ BO_ 2566806272  "Source: isobus.net VDMA Data Dictionary (https://www.isobus.net/isobus/pGNAndSPN/16397?type=PGN)";
CM_ BO_ 2566806528  "Source: isobus.net VDMA Data Dictionary (https://www.isobus.net/isobus/pGNAndSPN/16398?type=PGN)";
CM_ BO_ 2566806784  "Source: isobus.net VDMA Data Dictionary (https://www.isobus.net/isobus/pGNAndSPN/16399?type=PGN)";
CM_ BO_ 2566807040  "Source: isobus.net VDMA Data Dictionary (https://www.isobus.net/isobus/pGNAndSPN/16400?type=PGN)";
CM_ BO_ 2566807296  "Source: isobus.net VDMA Data Dictionary (https://www.isobus.net/isobus/pGNAndSPN/16401?type=PGN)";
CM_ BO_ 2566807552  "Source: isobus.net VDMA Data Dictionary (https://www.isobus.net/isobus/pGNAndSPN/16402?type=PGN)";
CM_ BO_ 2566807808  "Source: isobus.net VDMA Data Dictionary (https://www.isobus.net/isobus/pGNAndSPN/16403?type=PGN)";
CM_ BO_ 2566808064  "Source: isobus.net VDMA Data Dictionary (https://www.isobus.net/isobus/pGNAndSPN/16404?type=PGN)";
CM_ BO_ 2566808320  "Source: isobus.net VDMA Data Dictionary (https://www.isobus.net/isobus/pGNAndSPN/16405?type=PGN)";
CM_ BO_ 2566808576  "Source: isobus.net VDMA Data Dictionary (https://www.isobus.net/isobus/pGNAndSPN/16406?type=PGN)";
CM_ BO_ 2566808832  "Source: isobus.net VDMA Data Dictionary (https://www.isobus.net/isobus/pGNAndSPN/16407?type=PGN)";
CM_ BO_ 2566809088  "Source: isobus.net VDMA Data Dictionary (https://www.isobus.net/isobus/pGNAndSPN/16408?type=PGN)";
CM_ BO_ 2566809344  "Source: isobus.net VDMA Data Dictionary (https://www.isobus.net/isobus/pGNAndSPN/16409?type=PGN)";
CM_ BO_ 2566809600  "Source: isobus.net VDMA Data Dictionary (https://www.isobus.net/isobus/pGNAndSPN/16413?type=PGN)";
CM_ BO_ 2566809856  "Source: isobus.net VDMA Data Dictionary (https://www.isobus.net/isobus/pGNAndSPN/16417?type=PGN)";
CM_ BO_ 2566810112  "Source: isobus.net VDMA Data Dictionary (https://www.isobus.net/isobus/pGNAndSPN/16430?type=PGN)";
CM_ BO_ 2566810368  "Source: isobus.net VDMA Data Dictionary (https://www.isobus.net/isobus/pGNAndSPN/16432?type=PGN)";
CM_ BO_ 2566810880  "Source: isobus.net VDMA Data Dictionary (https://www.isobus.net/isobus/pGNAndSPN/16455?type=PGN)";
CM_ BO_ 2566811136  "Source: isobus.net VDMA Data Dictionary (https://www.isobus.net/isobus/pGNAndSPN/16459?type=PGN)";
CM_ BO_ 2566811392  "Source: isobus.net VDMA Data Dictionary (https://www.isobus.net/isobus/pGNAndSPN/16469?type=PGN)";
CM_ BO_ 2566811648  "Source: isobus.net VDMA Data Dictionary (https://www.isobus.net/isobus/pGNAndSPN/16472?type=PGN)";
CM_ BO_ 2566811904  "Source: isobus.net VDMA Data Dictionary (https://www.isobus.net/isobus/pGNAndSPN/16477?type=PGN)";
CM_ BO_ 2566812160  "Source: isobus.net VDMA Data Dictionary (https://www.isobus.net/isobus/pGNAndSPN/16482?type=PGN)";
CM_ BO_ 2566812416  "Source: isobus.net VDMA Data Dictionary (https://www.isobus.net/isobus/pGNAndSPN/16483?type=PGN)";
CM_ BO_ 2566812672  "Source: isobus.net VDMA Data Dictionary (https://www.isobus.net/isobus/pGNAndSPN/16485?type=PGN)";
CM_ BO_ 2566812928  "Source: isobus.net VDMA Data Dictionary (https://www.isobus.net/isobus/pGNAndSPN/16489?type=PGN)";
CM_ BO_ 2566813184  "Source: isobus.net VDMA Data Dictionary (https://www.isobus.net/isobus/pGNAndSPN/16494?type=PGN)";
CM_ BO_ 2566813440  "Source: isobus.net VDMA Data Dictionary (https://www.isobus.net/isobus/pGNAndSPN/16497?type=PGN)";
CM_ BO_ 2566813696  "Source: isobus.net VDMA Data Dictionary (https://www.isobus.net/isobus/pGNAndSPN/16508?type=PGN)";
CM_ BO_ 2566813952  "Source: isobus.net VDMA Data Dictionary (https://www.isobus.net/isobus/pGNAndSPN/16511?type=PGN)";
CM_ BO_ 2566814208  "Source: isobus.net VDMA Data Dictionary (https://www.isobus.net/isobus/pGNAndSPN/16514?type=PGN)";
CM_ BO_ 2566814464  "Source: isobus.net VDMA Data Dictionary (https://www.isobus.net/isobus/pGNAndSPN/16518?type=PGN)";
CM_ BO_ 2566814720  "Source: isobus.net VDMA Data Dictionary (https://www.isobus.net/isobus/pGNAndSPN/16522?type=PGN)";
CM_ BO_ 2566814976  "Source: isobus.net VDMA Data Dictionary (https://www.isobus.net/isobus/pGNAndSPN/16526?type=PGN)";
CM_ BO_ 2566815232  "Source: isobus.net VDMA Data Dictionary (https://www.isobus.net/isobus/pGNAndSPN/16530?type=PGN)";
CM_ BO_ 2566815488  "Source: isobus.net VDMA Data Dictionary (https://www.isobus.net/isobus/pGNAndSPN/16534?type=PGN)";
CM_ BO_ 2566815744  "Source: isobus.net VDMA Data Dictionary (https://www.isobus.net/isobus/pGNAndSPN/16536?type=PGN)";
CM_ BO_ 2566816000  "Source: isobus.net VDMA Data Dictionary (https://www.isobus.net/isobus/pGNAndSPN/16542?type=PGN)";
CM_ BO_ 2566816256  "Source: isobus.net VDMA Data Dictionary (https://www.isobus.net/isobus/pGNAndSPN/16546?type=PGN)";
CM_ BO_ 2566816512  "Source: isobus.net VDMA Data Dictionary (https://www.isobus.net/isobus/pGNAndSPN/16550?type=PGN)";
CM_ BO_ 2566816768  "Source: isobus.net VDMA Data Dictionary (https://www.isobus.net/isobus/pGNAndSPN/16554?type=PGN)";
CM_ BO_ 2566817024  "Source: isobus.net VDMA Data Dictionary (https://www.isobus.net/isobus/pGNAndSPN/16558?type=PGN)";
CM_ BO_ 2566817280  "Source: isobus.net VDMA Data Dictionary (https://www.isobus.net/isobus/pGNAndSPN/16562?type=PGN)";
CM_ BO_ 2566817536  "Source: isobus.net VDMA Data Dictionary (https://www.isobus.net/isobus/pGNAndSPN/16566?type=PGN)";
CM_ BO_ 2566817792  "Source: isobus.net VDMA Data Dictionary (https://www.isobus.net/isobus/pGNAndSPN/16574?type=PGN)";
CM_ BO_ 2566818048  "Source: isobus.net VDMA Data Dictionary (https://www.isobus.net/isobus/pGNAndSPN/16582?type=PGN)";
CM_ BO_ 2566818304  "Source: isobus.net VDMA Data Dictionary (https://www.isobus.net/isobus/pGNAndSPN/16586?type=PGN)";
CM_ BO_ 2566818560  "Source: isobus.net VDMA Data Dictionary (https://www.isobus.net/isobus/pGNAndSPN/16590?type=PGN)";
CM_ BO_ 2566818816  "Source: isobus.net VDMA Data Dictionary (https://www.isobus.net/isobus/pGNAndSPN/16597?type=PGN)";
CM_ BO_ 2566819072  "Source: isobus.net VDMA Data Dictionary (https://www.isobus.net/isobus/pGNAndSPN/16601?type=PGN)";
CM_ BO_ 2566819328  "Source: isobus.net VDMA Data Dictionary (https://www.isobus.net/isobus/pGNAndSPN/16603?type=PGN)";
CM_ BO_ 2566819584  "Source: isobus.net VDMA Data Dictionary (https://www.isobus.net/isobus/pGNAndSPN/16604?type=PGN)";
CM_ BO_ 2566819840  "Source: isobus.net VDMA Data Dictionary (https://www.isobus.net/isobus/pGNAndSPN/16623?type=PGN)";
CM_ BO_ 2566820096  "Source: isobus.net VDMA Data Dictionary (https://www.isobus.net/isobus/pGNAndSPN/16626?type=PGN)";
CM_ BO_ 2566820352  "Source: isobus.net VDMA Data Dictionary (https://www.isobus.net/isobus/pGNAndSPN/16631?type=PGN)";
CM_ BO_ 2566820608  "Source: isobus.net VDMA Data Dictionary (https://www.isobus.net/isobus/pGNAndSPN/16634?type=PGN)";
CM_ BO_ 2566820864  "Source: isobus.net VDMA Data Dictionary (https://www.isobus.net/isobus/pGNAndSPN/16642?type=PGN)";
CM_ BO_ 2566821120  "Source: isobus.net VDMA Data Dictionary (https://www.isobus.net/isobus/pGNAndSPN/16643?type=PGN)";
CM_ BO_ 2566821376  "Source: isobus.net VDMA Data Dictionary (https://www.isobus.net/isobus/pGNAndSPN/16652?type=PGN)";
CM_ BO_ 2566821632  "Source: isobus.net VDMA Data Dictionary (https://www.isobus.net/isobus/pGNAndSPN/16656?type=PGN)";
CM_ BO_ 2566821888  "Source: isobus.net VDMA Data Dictionary (https://www.isobus.net/isobus/pGNAndSPN/16660?type=PGN)";
CM_ BO_ 2566822144  "Source: isobus.net VDMA Data Dictionary (https://www.isobus.net/isobus/pGNAndSPN/16664?type=PGN)";
CM_ BO_ 2566822400  "Source: isobus.net VDMA Data Dictionary (https://www.isobus.net/isobus/pGNAndSPN/16668?type=PGN)";
CM_ BO_ 2566822656  "Source: isobus.net VDMA Data Dictionary (https://www.isobus.net/isobus/pGNAndSPN/16672?type=PGN)";
CM_ BO_ 2566822912  "Source: isobus.net VDMA Data Dictionary (https://www.isobus.net/isobus/pGNAndSPN/16676?type=PGN)";
CM_ BO_ 2566823168  "Source: isobus.net VDMA Data Dictionary (https://www.isobus.net/isobus/pGNAndSPN/16680?type=PGN)";
CM_ BO_ 2566823424  "Source: isobus.net VDMA Data Dictionary (https://www.isobus.net/isobus/pGNAndSPN/16684?type=PGN)";
CM_ BO_ 2566823680  "Source: isobus.net VDMA Data Dictionary (https://www.isobus.net/isobus/pGNAndSPN/16688?type=PGN)";
CM_ BO_ 2566823936  "Source: isobus.net VDMA Data Dictionary (https://www.isobus.net/isobus/pGNAndSPN/16692?type=PGN)";
CM_ BO_ 2566824192  "Source: isobus.net VDMA Data Dictionary (https://www.isobus.net/isobus/pGNAndSPN/16696?type=PGN)";
CM_ BO_ 2566824448  "Source: isobus.net VDMA Data Dictionary (https://www.isobus.net/isobus/pGNAndSPN/16700?type=PGN)";
CM_ BO_ 2566824704  "Source: isobus.net VDMA Data Dictionary (https://www.isobus.net/isobus/pGNAndSPN/16704?type=PGN)";
CM_ BO_ 2566824960  "Source: isobus.net VDMA Data Dictionary (https://www.isobus.net/isobus/pGNAndSPN/16708?type=PGN)";
CM_ BO_ 2566825216  "Source: isobus.net VDMA Data Dictionary (https://www.isobus.net/isobus/pGNAndSPN/16715?type=PGN)";
CM_ BO_ 2566825472  "Source: isobus.net VDMA Data Dictionary (https://www.isobus.net/isobus/pGNAndSPN/16719?type=PGN)";
CM_ BO_ 2566825728  "Source: isobus.net VDMA Data Dictionary (https://www.isobus.net/isobus/pGNAndSPN/16727?type=PGN)";
CM_ BO_ 2566825984  "Source: isobus.net VDMA Data Dictionary (https://www.isobus.net/isobus/pGNAndSPN/16729?type=PGN)";
CM_ BO_ 2566826240  "Source: isobus.net VDMA Data Dictionary (https://www.isobus.net/isobus/pGNAndSPN/16734?type=PGN)";
CM_ BO_ 2566826496  "Source: isobus.net VDMA Data Dictionary (https://www.isobus.net/isobus/pGNAndSPN/16739?type=PGN)";
CM_ BO_ 2566826752  "Source: isobus.net VDMA Data Dictionary (https://www.isobus.net/isobus/pGNAndSPN/16743?type=PGN)";
CM_ BO_ 2566827008  "Source: isobus.net VDMA Data Dictionary (https://www.isobus.net/isobus/pGNAndSPN/16751?type=PGN)";
CM_ BO_ 2566827264  "Source: isobus.net VDMA Data Dictionary (https://www.isobus.net/isobus/pGNAndSPN/16759?type=PGN)";
CM_ BO_ 2566827520  "Source: isobus.net VDMA Data Dictionary (https://www.isobus.net/isobus/pGNAndSPN/16767?type=PGN)";
CM_ BO_ 2566827776  "Source: isobus.net VDMA Data Dictionary (https://www.isobus.net/isobus/pGNAndSPN/16769?type=PGN)";
CM_ BO_ 2566828032  "Source: isobus.net VDMA Data Dictionary (https://www.isobus.net/isobus/pGNAndSPN/16774?type=PGN)";
CM_ BO_ 2566828288  "Source: isobus.net VDMA Data Dictionary (https://www.isobus.net/isobus/pGNAndSPN/16776?type=PGN)";
CM_ BO_ 2566828544  "Source: isobus.net VDMA Data Dictionary (https://www.isobus.net/isobus/pGNAndSPN/16779?type=PGN)";
CM_ BO_ 2566828800  "Source: isobus.net VDMA Data Dictionary (https://www.isobus.net/isobus/pGNAndSPN/16782?type=PGN)";
CM_ BO_ 2566829056  "Source: isobus.net VDMA Data Dictionary (https://www.isobus.net/isobus/pGNAndSPN/16786?type=PGN)";
CM_ BO_ 2566829312  "Source: isobus.net VDMA Data Dictionary (https://www.isobus.net/isobus/pGNAndSPN/16790?type=PGN)";
CM_ BO_ 2566829568  "Source: isobus.net VDMA Data Dictionary (https://www.isobus.net/isobus/pGNAndSPN/16792?type=PGN)";
CM_ BO_ 2566829824  "Source: isobus.net VDMA Data Dictionary (https://www.isobus.net/isobus/pGNAndSPN/16797?type=PGN)";
CM_ BO_ 2566830080  "Source: isobus.net VDMA Data Dictionary (https://www.isobus.net/isobus/pGNAndSPN/16803?type=PGN)";
CM_ BO_ 2566830336  "Source: isobus.net VDMA Data Dictionary (https://www.isobus.net/isobus/pGNAndSPN/16809?type=PGN)";
CM_ BO_ 2566830592  "Source: isobus.net VDMA Data Dictionary (https://www.isobus.net/isobus/pGNAndSPN/16812?type=PGN)";
CM_ BO_ 2566830848  "Source: isobus.net VDMA Data Dictionary (https://www.isobus.net/isobus/pGNAndSPN/16816?type=PGN)";
CM_ BO_ 2566831104  "Source: isobus.net VDMA Data Dictionary (https://www.isobus.net/isobus/pGNAndSPN/16820?type=PGN)";
CM_ BO_ 2566831360  "Source: isobus.net VDMA Data Dictionary (https://www.isobus.net/isobus/pGNAndSPN/16827?type=PGN)";
CM_ BO_ 2566831616  "Source: isobus.net VDMA Data Dictionary (https://www.isobus.net/isobus/pGNAndSPN/16833?type=PGN)";
CM_ BO_ 2566831872  "Source: isobus.net VDMA Data Dictionary (https://www.isobus.net/isobus/pGNAndSPN/16840?type=PGN)";
CM_ BO_ 2566832128  "Source: isobus.net VDMA Data Dictionary (https://www.isobus.net/isobus/pGNAndSPN/16846?type=PGN)";
CM_ BO_ 2566832640  "Source: isobus.net VDMA Data Dictionary (https://www.isobus.net/isobus/pGNAndSPN/16856?type=PGN)";
CM_ BO_ 2566832896  "Source: isobus.net VDMA Data Dictionary (https://www.isobus.net/isobus/pGNAndSPN/16862?type=PGN)";
CM_ BO_ 2566833152  "Source: isobus.net VDMA Data Dictionary (https://www.isobus.net/isobus/pGNAndSPN/16863?type=PGN)";
CM_ BO_ 2566833408  "Source: isobus.net VDMA Data Dictionary (https://www.isobus.net/isobus/pGNAndSPN/16865?type=PGN)";
CM_ BO_ 2566833664  "Source: isobus.net VDMA Data Dictionary (https://www.isobus.net/isobus/pGNAndSPN/16866?type=PGN)";
CM_ BO_ 2566833920  "Source: isobus.net VDMA Data Dictionary (https://www.isobus.net/isobus/pGNAndSPN/16883?type=PGN)";
CM_ BO_ 2566834176  "Source: isobus.net VDMA Data Dictionary (https://www.isobus.net/isobus/pGNAndSPN/16884?type=PGN)";
CM_ BO_ 2566834432  "Source: isobus.net VDMA Data Dictionary (https://www.isobus.net/isobus/pGNAndSPN/16885?type=PGN)";
CM_ BO_ 2566835456  "Source: isobus.net VDMA Data Dictionary (https://www.isobus.net/isobus/pGNAndSPN/16900?type=PGN)";
CM_ BO_ 2566835712  "Source: isobus.net VDMA Data Dictionary (https://www.isobus.net/isobus/pGNAndSPN/16906?type=PGN)";
CM_ BO_ 2566835968  "Source: isobus.net VDMA Data Dictionary (https://www.isobus.net/isobus/pGNAndSPN/16918?type=PGN)";
CM_ BO_ 2566836224  "Source: isobus.net VDMA Data Dictionary (https://www.isobus.net/isobus/pGNAndSPN/16923?type=PGN)";
CM_ BO_ 2566836480  "Source: isobus.net VDMA Data Dictionary (https://www.isobus.net/isobus/pGNAndSPN/16924?type=PGN)";
CM_ BO_ 2566836736  "Source: isobus.net VDMA Data Dictionary (https://www.isobus.net/isobus/pGNAndSPN/16925?type=PGN)";
CM_ BO_ 2566837248  "Source: isobus.net VDMA Data Dictionary (https://www.isobus.net/isobus/pGNAndSPN/16938?type=PGN)";
CM_ BO_ 2566837504  "Source: isobus.net VDMA Data Dictionary (https://www.isobus.net/isobus/pGNAndSPN/16950?type=PGN)";
CM_ BO_ 2566837760  "Source: isobus.net VDMA Data Dictionary (https://www.isobus.net/isobus/pGNAndSPN/16966?type=PGN)";
CM_ BO_ 2566838528  "Source: isobus.net VDMA Data Dictionary (https://www.isobus.net/isobus/pGNAndSPN/16986?type=PGN)";
CM_ BO_ 2566839040  "Source: isobus.net VDMA Data Dictionary (https://www.isobus.net/isobus/pGNAndSPN/16992?type=PGN)";
CM_ BO_ 2566839296  "Source: isobus.net VDMA Data Dictionary (https://www.isobus.net/isobus/pGNAndSPN/16994?type=PGN)";
CM_ BO_ 2566839552  "Source: isobus.net VDMA Data Dictionary (https://www.isobus.net/isobus/pGNAndSPN/16998?type=PGN)";
CM_ BO_ 2566839808  "Source: isobus.net VDMA Data Dictionary (https://www.isobus.net/isobus/pGNAndSPN/17001?type=PGN)";
CM_ BO_ 2566840320  "Source: isobus.net VDMA Data Dictionary (https://www.isobus.net/isobus/pGNAndSPN/17012?type=PGN)";
CM_ BO_ 2566840576  "Source: isobus.net VDMA Data Dictionary (https://www.isobus.net/isobus/pGNAndSPN/17026?type=PGN)";
CM_ BO_ 2566840832  "Source: isobus.net VDMA Data Dictionary (https://www.isobus.net/isobus/pGNAndSPN/17029?type=PGN)";
CM_ BO_ 2566841344  "Source: isobus.net VDMA Data Dictionary (https://www.isobus.net/isobus/pGNAndSPN/17081?type=PGN)";
CM_ BO_ 2566842112  "Source: isobus.net VDMA Data Dictionary (https://www.isobus.net/isobus/pGNAndSPN/17093?type=PGN)";
CM_ BO_ 2566842368  "Source: isobus.net VDMA Data Dictionary (https://www.isobus.net/isobus/pGNAndSPN/17097?type=PGN)";
CM_ SG_ 2566746368 Brake_actuator_stroke_status_Raw "Generic 8-byte raw payload. Detail page: https://www.isobus.net/isobus/pGNAndSPN/14841?type=PGN. Signal-level enrichment via PR welcome  see CONTRIBUTING.md.";
CM_ SG_ 2566746624 Engine_Spark_Voltage_6_RawPayloa "Generic 8-byte raw payload. Detail page: https://www.isobus.net/isobus/pGNAndSPN/14845?type=PGN. Signal-level enrichment via PR welcome  see CONTRIBUTING.md.";
CM_ SG_ 2566746880 Engine_Spark_Voltage_5_RawPayloa "Generic 8-byte raw payload. Detail page: https://www.isobus.net/isobus/pGNAndSPN/14849?type=PGN. Signal-level enrichment via PR welcome  see CONTRIBUTING.md.";
CM_ SG_ 2566747136 Engine_Spark_Voltage_4_RawPayloa "Generic 8-byte raw payload. Detail page: https://www.isobus.net/isobus/pGNAndSPN/14853?type=PGN. Signal-level enrichment via PR welcome  see CONTRIBUTING.md.";
CM_ SG_ 2566747392 Engine_Spark_Voltage_3_RawPayloa "Generic 8-byte raw payload. Detail page: https://www.isobus.net/isobus/pGNAndSPN/14857?type=PGN. Signal-level enrichment via PR welcome  see CONTRIBUTING.md.";
CM_ SG_ 2566747648 Engine_Spark_Voltage_2_RawPayloa "Generic 8-byte raw payload. Detail page: https://www.isobus.net/isobus/pGNAndSPN/14861?type=PGN. Signal-level enrichment via PR welcome  see CONTRIBUTING.md.";
CM_ SG_ 2566747904 Engine_Spark_Voltage_1_RawPayloa "Generic 8-byte raw payload. Detail page: https://www.isobus.net/isobus/pGNAndSPN/14865?type=PGN. Signal-level enrichment via PR welcome  see CONTRIBUTING.md.";
CM_ SG_ 2566748160 Aftertreatment_2_Trip_Informatio "Generic 8-byte raw payload. Detail page: https://www.isobus.net/isobus/pGNAndSPN/14873?type=PGN. Signal-level enrichment via PR welcome  see CONTRIBUTING.md.";
CM_ SG_ 2566748416 Aftertreatment_1_Trip_Informatio "Generic 8-byte raw payload. Detail page: https://www.isobus.net/isobus/pGNAndSPN/14881?type=PGN. Signal-level enrichment via PR welcome  see CONTRIBUTING.md.";
CM_ SG_ 2566748672 Aftertreatment_2_Service_1_RawPa "Generic 8-byte raw payload. Detail page: https://www.isobus.net/isobus/pGNAndSPN/14885?type=PGN. Signal-level enrichment via PR welcome  see CONTRIBUTING.md.";
CM_ SG_ 2566748928 Aftertreatment_1_Service_1_RawPa "Generic 8-byte raw payload. Detail page: https://www.isobus.net/isobus/pGNAndSPN/14889?type=PGN. Signal-level enrichment via PR welcome  see CONTRIBUTING.md.";
CM_ SG_ 2566749696 Adaptive_Front_Lighting_System_S "Generic 8-byte raw payload. Detail page: https://www.isobus.net/isobus/pGNAndSPN/14922?type=PGN. Signal-level enrichment via PR welcome  see CONTRIBUTING.md.";
CM_ SG_ 2566749952 Engine_Configuration_2_RawPayloa "Generic 8-byte raw payload. Detail page: https://www.isobus.net/isobus/pGNAndSPN/14926?type=PGN. Signal-level enrichment via PR welcome  see CONTRIBUTING.md.";
CM_ SG_ 2566750208 Emission_Related_Permanent_Diagn "Generic 8-byte raw payload. Detail page: https://www.isobus.net/isobus/pGNAndSPN/14938?type=PGN. Signal-level enrichment via PR welcome  see CONTRIBUTING.md.";
CM_ SG_ 2566750464 EGR_Cooler_Bypass_RawPayload "Generic 8-byte raw payload. Detail page: https://www.isobus.net/isobus/pGNAndSPN/14939?type=PGN. Signal-level enrichment via PR welcome  see CONTRIBUTING.md.";
CM_ SG_ 2566750720 All_Pending_DTCs_RawPayload "Generic 8-byte raw payload. Detail page: https://www.isobus.net/isobus/pGNAndSPN/14951?type=PGN. Signal-level enrichment via PR welcome  see CONTRIBUTING.md.";
CM_ SG_ 2566750976 Transfer_Case_Information_RawPay "Generic 8-byte raw payload. Detail page: https://www.isobus.net/isobus/pGNAndSPN/14956?type=PGN. Signal-level enrichment via PR welcome  see CONTRIBUTING.md.";
CM_ SG_ 2566751232 Engine_Fluid_Level_Pressure_9_Ra "Generic 8-byte raw payload. Detail page: https://www.isobus.net/isobus/pGNAndSPN/14960?type=PGN. Signal-level enrichment via PR welcome  see CONTRIBUTING.md.";
CM_ SG_ 2566751488 Engine_Fluid_Level_Pressure_8_Ra "Generic 8-byte raw payload. Detail page: https://www.isobus.net/isobus/pGNAndSPN/14964?type=PGN. Signal-level enrichment via PR welcome  see CONTRIBUTING.md.";
CM_ SG_ 2566751744 Engine_Fluid_Level_Pressure_7_Ra "Generic 8-byte raw payload. Detail page: https://www.isobus.net/isobus/pGNAndSPN/14968?type=PGN. Signal-level enrichment via PR welcome  see CONTRIBUTING.md.";
CM_ SG_ 2566752000 Engine_Fluid_Level_Pressure_6_Ra "Generic 8-byte raw payload. Detail page: https://www.isobus.net/isobus/pGNAndSPN/14972?type=PGN. Signal-level enrichment via PR welcome  see CONTRIBUTING.md.";
CM_ SG_ 2566752256 Engine_Fluid_Level_Pressure_5_Ra "Generic 8-byte raw payload. Detail page: https://www.isobus.net/isobus/pGNAndSPN/14976?type=PGN. Signal-level enrichment via PR welcome  see CONTRIBUTING.md.";
CM_ SG_ 2566752512 Vehicle_Direction_Speed_2_RawPay "Generic 8-byte raw payload. Detail page: https://www.isobus.net/isobus/pGNAndSPN/14977?type=PGN. Signal-level enrichment via PR welcome  see CONTRIBUTING.md.";
CM_ SG_ 2566752768 SAE_J2012_2_Byte_DTC_Display_Raw "Generic 8-byte raw payload. Detail page: https://www.isobus.net/isobus/pGNAndSPN/14981?type=PGN. Signal-level enrichment via PR welcome  see CONTRIBUTING.md.";
CM_ SG_ 2566753024 Aftertreatment_2_Gas_Parameters_ "Generic 8-byte raw payload. Detail page: https://www.isobus.net/isobus/pGNAndSPN/14983?type=PGN. Signal-level enrichment via PR welcome  see CONTRIBUTING.md.";
CM_ SG_ 2566753280 Aftertreatment_1_Gas_Parameters_ "Generic 8-byte raw payload. Detail page: https://www.isobus.net/isobus/pGNAndSPN/14985?type=PGN. Signal-level enrichment via PR welcome  see CONTRIBUTING.md.";
CM_ SG_ 2566753536 Utility_Total_AC_Reactive_Energy "Generic 8-byte raw payload. Detail page: https://www.isobus.net/isobus/pGNAndSPN/14987?type=PGN. Signal-level enrichment via PR welcome  see CONTRIBUTING.md.";
CM_ SG_ 2566753792 Generator_Total_AC_Reactive_Ener "Generic 8-byte raw payload. Detail page: https://www.isobus.net/isobus/pGNAndSPN/14989?type=PGN. Signal-level enrichment via PR welcome  see CONTRIBUTING.md.";
CM_ SG_ 2566754048 Generator_Total_AC_Percent_Power "Generic 8-byte raw payload. Detail page: https://www.isobus.net/isobus/pGNAndSPN/14992?type=PGN. Signal-level enrichment via PR welcome  see CONTRIBUTING.md.";
CM_ SG_ 2566754304 Advertised_Engine_Torque_Curve_R "Generic 8-byte raw payload. Detail page: https://www.isobus.net/isobus/pGNAndSPN/14996?type=PGN. Signal-level enrichment via PR welcome  see CONTRIBUTING.md.";
CM_ SG_ 2566754560 AC_Switching_Device_Status_RawPa "Generic 8-byte raw payload. Detail page: https://www.isobus.net/isobus/pGNAndSPN/15007?type=PGN. Signal-level enrichment via PR welcome  see CONTRIBUTING.md.";
CM_ SG_ 2566754816 Engine_Operating_Information_Raw "Generic 8-byte raw payload. Detail page: https://www.isobus.net/isobus/pGNAndSPN/15025?type=PGN. Signal-level enrichment via PR welcome  see CONTRIBUTING.md.";
CM_ SG_ 2566755072 Generator_Control_1_RawPayload "Generic 8-byte raw payload. Detail page: https://www.isobus.net/isobus/pGNAndSPN/15033?type=PGN. Signal-level enrichment via PR welcome  see CONTRIBUTING.md.";
CM_ SG_ 2566755328 Electronic_Engine_Controller_7_R "Generic 8-byte raw payload. Detail page: https://www.isobus.net/isobus/pGNAndSPN/15037?type=PGN. Signal-level enrichment via PR welcome  see CONTRIBUTING.md.";
CM_ SG_ 2566755584 Transmission_Fluids_2_RawPayload "Generic 8-byte raw payload. Detail page: https://www.isobus.net/isobus/pGNAndSPN/15047?type=PGN. Signal-level enrichment via PR welcome  see CONTRIBUTING.md.";
CM_ SG_ 2566755840 Fuel_Information_2_Liquid_RawPay "Generic 8-byte raw payload. Detail page: https://www.isobus.net/isobus/pGNAndSPN/15049?type=PGN. Signal-level enrichment via PR welcome  see CONTRIBUTING.md.";
CM_ SG_ 2566756096 Fuel_Information_3_Liquid_RawPay "Generic 8-byte raw payload. Detail page: https://www.isobus.net/isobus/pGNAndSPN/15051?type=PGN. Signal-level enrichment via PR welcome  see CONTRIBUTING.md.";
CM_ SG_ 2566756352 Aftertreatment_1_Historical_Info "Generic 8-byte raw payload. Detail page: https://www.isobus.net/isobus/pGNAndSPN/15062?type=PGN. Signal-level enrichment via PR welcome  see CONTRIBUTING.md.";
CM_ SG_ 2566756608 Aftertreatment_2_Historical_info "Generic 8-byte raw payload. Detail page: https://www.isobus.net/isobus/pGNAndSPN/15073?type=PGN. Signal-level enrichment via PR welcome  see CONTRIBUTING.md.";
CM_ SG_ 2566756864 Electronic_Brake_System_2_4_RawP "Generic 8-byte raw payload. Detail page: https://www.isobus.net/isobus/pGNAndSPN/15074?type=PGN. Signal-level enrichment via PR welcome  see CONTRIBUTING.md.";
CM_ SG_ 2566757120 Aftertreatment_1_Diesel_Exhaust_ "Generic 8-byte raw payload. Detail page: https://www.isobus.net/isobus/pGNAndSPN/15081?type=PGN. Signal-level enrichment via PR welcome  see CONTRIBUTING.md.";
CM_ SG_ 2566757376 Sensor_Electrical_Power_2_RawPay "Generic 8-byte raw payload. Detail page: https://www.isobus.net/isobus/pGNAndSPN/15085?type=PGN. Signal-level enrichment via PR welcome  see CONTRIBUTING.md.";
CM_ SG_ 2566757632 Sensor_Electrical_Power_1_RawPay "Generic 8-byte raw payload. Detail page: https://www.isobus.net/isobus/pGNAndSPN/15089?type=PGN. Signal-level enrichment via PR welcome  see CONTRIBUTING.md.";
CM_ SG_ 2566757888 Aftertreatment_2_Air_Control_1_R "Generic 8-byte raw payload. Detail page: https://www.isobus.net/isobus/pGNAndSPN/15097?type=PGN. Signal-level enrichment via PR welcome  see CONTRIBUTING.md.";
CM_ SG_ 2566758144 Aftertreatment_1_Air_Control_1_R "Generic 8-byte raw payload. Detail page: https://www.isobus.net/isobus/pGNAndSPN/15105?type=PGN. Signal-level enrichment via PR welcome  see CONTRIBUTING.md.";
CM_ SG_ 2566758400 Aftertreatment_2_Fuel_Control_1_ "Generic 8-byte raw payload. Detail page: https://www.isobus.net/isobus/pGNAndSPN/15113?type=PGN. Signal-level enrichment via PR welcome  see CONTRIBUTING.md.";
CM_ SG_ 2566758656 Aftertreatment_1_Fuel_Control_1_ "Generic 8-byte raw payload. Detail page: https://www.isobus.net/isobus/pGNAndSPN/15121?type=PGN. Signal-level enrichment via PR welcome  see CONTRIBUTING.md.";
CM_ SG_ 2566758912 Fuel_Information_3_Gaseous_RawPa "Generic 8-byte raw payload. Detail page: https://www.isobus.net/isobus/pGNAndSPN/15125?type=PGN. Signal-level enrichment via PR welcome  see CONTRIBUTING.md.";
CM_ SG_ 2566759168 Electronic_Engine_Controller_6_R "Generic 8-byte raw payload. Detail page: https://www.isobus.net/isobus/pGNAndSPN/15132?type=PGN. Signal-level enrichment via PR welcome  see CONTRIBUTING.md.";
CM_ SG_ 2566759424 PTO_Drive_Engagement_1_RawPayloa "Generic 8-byte raw payload. Detail page: https://www.isobus.net/isobus/pGNAndSPN/15160?type=PGN. Signal-level enrichment via PR welcome  see CONTRIBUTING.md.";
CM_ SG_ 2566759680 Door_Control_2_RawPayload "Generic 8-byte raw payload. Detail page: https://www.isobus.net/isobus/pGNAndSPN/15190?type=PGN. Signal-level enrichment via PR welcome  see CONTRIBUTING.md.";
CM_ SG_ 2566759936 Voltage_Regulator_Excitation_Sta "Generic 8-byte raw payload. Detail page: https://www.isobus.net/isobus/pGNAndSPN/15193?type=PGN. Signal-level enrichment via PR welcome  see CONTRIBUTING.md.";
CM_ SG_ 2566760192 Voltage_Regulator_Operating_Mode "Generic 8-byte raw payload. Detail page: https://www.isobus.net/isobus/pGNAndSPN/15198?type=PGN. Signal-level enrichment via PR welcome  see CONTRIBUTING.md.";
CM_ SG_ 2566760448 Wireless_Communications_Message_ "Generic 8-byte raw payload. Detail page: https://www.isobus.net/isobus/pGNAndSPN/15203?type=PGN. Signal-level enrichment via PR welcome  see CONTRIBUTING.md.";
CM_ SG_ 2566760704 Wireless_Communications_Message_ "Generic 8-byte raw payload. Detail page: https://www.isobus.net/isobus/pGNAndSPN/15208?type=PGN. Signal-level enrichment via PR welcome  see CONTRIBUTING.md.";
CM_ SG_ 2566760960 Engine_Fluid_Level_Pressure_4_Ra "Generic 8-byte raw payload. Detail page: https://www.isobus.net/isobus/pGNAndSPN/15215?type=PGN. Signal-level enrichment via PR welcome  see CONTRIBUTING.md.";
CM_ SG_ 2566761216 Request_For_Complete_Configurabl "Generic 8-byte raw payload. Detail page: https://www.isobus.net/isobus/pGNAndSPN/15216?type=PGN. Signal-level enrichment via PR welcome  see CONTRIBUTING.md.";
CM_ SG_ 2566761472 Engine_Fuel_Information_RawPaylo "Generic 8-byte raw payload. Detail page: https://www.isobus.net/isobus/pGNAndSPN/15218?type=PGN. Signal-level enrichment via PR welcome  see CONTRIBUTING.md.";
CM_ SG_ 2566761728 Request_For_Complete_Configurabl "Generic 8-byte raw payload. Detail page: https://www.isobus.net/isobus/pGNAndSPN/15220?type=PGN. Signal-level enrichment via PR welcome  see CONTRIBUTING.md.";
CM_ SG_ 2566761984 Fifth_Wheel_Smart_Systems_2_RawP "Generic 8-byte raw payload. Detail page: https://www.isobus.net/isobus/pGNAndSPN/15225?type=PGN. Signal-level enrichment via PR welcome  see CONTRIBUTING.md.";
CM_ SG_ 2566762240 Aftertreatment_2_Intermediate_Ga "Generic 8-byte raw payload. Detail page: https://www.isobus.net/isobus/pGNAndSPN/15231?type=PGN. Signal-level enrichment via PR welcome  see CONTRIBUTING.md.";
CM_ SG_ 2566762496 Aftertreatment_2_Outlet_Gas_2_Ra "Generic 8-byte raw payload. Detail page: https://www.isobus.net/isobus/pGNAndSPN/15236?type=PGN. Signal-level enrichment via PR welcome  see CONTRIBUTING.md.";
CM_ SG_ 2566762752 Aftertreatment_2_Intake_Gas_2_Ra "Generic 8-byte raw payload. Detail page: https://www.isobus.net/isobus/pGNAndSPN/15241?type=PGN. Signal-level enrichment via PR welcome  see CONTRIBUTING.md.";
CM_ SG_ 2566763008 Aftertreatment_1_Intermediate_Ga "Generic 8-byte raw payload. Detail page: https://www.isobus.net/isobus/pGNAndSPN/15247?type=PGN. Signal-level enrichment via PR welcome  see CONTRIBUTING.md.";
CM_ SG_ 2566763264 Aftertreatment_1_Outlet_Gas_2_Ra "Generic 8-byte raw payload. Detail page: https://www.isobus.net/isobus/pGNAndSPN/15252?type=PGN. Signal-level enrichment via PR welcome  see CONTRIBUTING.md.";
CM_ SG_ 2566763520 Aftertreatment_1_Intake_Gas_2_Ra "Generic 8-byte raw payload. Detail page: https://www.isobus.net/isobus/pGNAndSPN/15257?type=PGN. Signal-level enrichment via PR welcome  see CONTRIBUTING.md.";
CM_ SG_ 2566763776 Emission_Related_Previously_MIL_ "Generic 8-byte raw payload. Detail page: https://www.isobus.net/isobus/pGNAndSPN/15269?type=PGN. Signal-level enrichment via PR welcome  see CONTRIBUTING.md.";
CM_ SG_ 2566764032 SPN_Support_RawPayload "Generic 8-byte raw payload. Detail page: https://www.isobus.net/isobus/pGNAndSPN/15275?type=PGN. Signal-level enrichment via PR welcome  see CONTRIBUTING.md.";
CM_ SG_ 2566764288 Expanded_Freeze_Frame_RawPayload "Generic 8-byte raw payload. Detail page: https://www.isobus.net/isobus/pGNAndSPN/15281?type=PGN. Signal-level enrichment via PR welcome  see CONTRIBUTING.md.";
CM_ SG_ 2566764544 Diagnostic_Readiness_3_RawPayloa "Generic 8-byte raw payload. Detail page: https://www.isobus.net/isobus/pGNAndSPN/15286?type=PGN. Signal-level enrichment via PR welcome  see CONTRIBUTING.md.";
CM_ SG_ 2566764800 Tire_Pressure_Reference_Informat "Generic 8-byte raw payload. Detail page: https://www.isobus.net/isobus/pGNAndSPN/15288?type=PGN. Signal-level enrichment via PR welcome  see CONTRIBUTING.md.";
CM_ SG_ 2566765056 Farebox_Status_RawPayload "Generic 8-byte raw payload. Detail page: https://www.isobus.net/isobus/pGNAndSPN/15290?type=PGN. Signal-level enrichment via PR welcome  see CONTRIBUTING.md.";
CM_ SG_ 2566765312 Farebox_Point_of_Sale_RawPayload "Generic 8-byte raw payload. Detail page: https://www.isobus.net/isobus/pGNAndSPN/15301?type=PGN. Signal-level enrichment via PR welcome  see CONTRIBUTING.md.";
CM_ SG_ 2566765568 Farebox_Service_Detail_RawPayloa "Generic 8-byte raw payload. Detail page: https://www.isobus.net/isobus/pGNAndSPN/15311?type=PGN. Signal-level enrichment via PR welcome  see CONTRIBUTING.md.";
CM_ SG_ 2566765824 Signal_Preemption_RawPayload "Generic 8-byte raw payload. Detail page: https://www.isobus.net/isobus/pGNAndSPN/15318?type=PGN. Signal-level enrichment via PR welcome  see CONTRIBUTING.md.";
CM_ SG_ 2566766080 Transit_Route_RawPayload "Generic 8-byte raw payload. Detail page: https://www.isobus.net/isobus/pGNAndSPN/15325?type=PGN. Signal-level enrichment via PR welcome  see CONTRIBUTING.md.";
CM_ SG_ 2566766336 Transit_Milepost_RawPayload "Generic 8-byte raw payload. Detail page: https://www.isobus.net/isobus/pGNAndSPN/15327?type=PGN. Signal-level enrichment via PR welcome  see CONTRIBUTING.md.";
CM_ SG_ 2566766592 Passenger_Counter_RawPayload "Generic 8-byte raw payload. Detail page: https://www.isobus.net/isobus/pGNAndSPN/15332?type=PGN. Signal-level enrichment via PR welcome  see CONTRIBUTING.md.";
CM_ SG_ 2566766848 Engine_Fluid_Level_Pressure_3_Ra "Generic 8-byte raw payload. Detail page: https://www.isobus.net/isobus/pGNAndSPN/15337?type=PGN. Signal-level enrichment via PR welcome  see CONTRIBUTING.md.";
CM_ SG_ 2566767104 Electronic_Engine_Controller_14_ "Generic 8-byte raw payload. Detail page: https://www.isobus.net/isobus/pGNAndSPN/15342?type=PGN. Signal-level enrichment via PR welcome  see CONTRIBUTING.md.";
CM_ SG_ 2566767360 Electronic_Engine_Controller_15_ "Generic 8-byte raw payload. Detail page: https://www.isobus.net/isobus/pGNAndSPN/15347?type=PGN. Signal-level enrichment via PR welcome  see CONTRIBUTING.md.";
CM_ SG_ 2566767616 Electronic_Brake_Controller_5_Ra "Generic 8-byte raw payload. Detail page: https://www.isobus.net/isobus/pGNAndSPN/15360?type=PGN. Signal-level enrichment via PR welcome  see CONTRIBUTING.md.";
CM_ SG_ 2566768128 Cold_Start_Aids_RawPayload "Generic 8-byte raw payload. Detail page: https://www.isobus.net/isobus/pGNAndSPN/15373?type=PGN. Signal-level enrichment via PR welcome  see CONTRIBUTING.md.";
CM_ SG_ 2566768384 Off_Highway_Engine_Control_Selec "Generic 8-byte raw payload. Detail page: https://www.isobus.net/isobus/pGNAndSPN/15383?type=PGN. Signal-level enrichment via PR welcome  see CONTRIBUTING.md.";
CM_ SG_ 2566768640 Operator_Primary_Intermediate_Sp "Generic 8-byte raw payload. Detail page: https://www.isobus.net/isobus/pGNAndSPN/15384?type=PGN. Signal-level enrichment via PR welcome  see CONTRIBUTING.md.";
CM_ SG_ 2566768896 Electronic_Control_Module_Inform "Generic 8-byte raw payload. Detail page: https://www.isobus.net/isobus/pGNAndSPN/15385?type=PGN. Signal-level enrichment via PR welcome  see CONTRIBUTING.md.";
CM_ SG_ 2566769152 Intermediate_Speed_Control_RawPa "Generic 8-byte raw payload. Detail page: https://www.isobus.net/isobus/pGNAndSPN/15386?type=PGN. Signal-level enrichment via PR welcome  see CONTRIBUTING.md.";
CM_ SG_ 2566769408 Off_Highway_Engine_Control_Selec "Generic 8-byte raw payload. Detail page: https://www.isobus.net/isobus/pGNAndSPN/15396?type=PGN. Signal-level enrichment via PR welcome  see CONTRIBUTING.md.";
CM_ SG_ 2566769664 Operators_External_Light_Control "Generic 8-byte raw payload. Detail page: https://www.isobus.net/isobus/pGNAndSPN/15407?type=PGN. Signal-level enrichment via PR welcome  see CONTRIBUTING.md.";
CM_ SG_ 2566769920 Operator_Wiper_and_Washer_Contro "Generic 8-byte raw payload. Detail page: https://www.isobus.net/isobus/pGNAndSPN/15416?type=PGN. Signal-level enrichment via PR welcome  see CONTRIBUTING.md.";
CM_ SG_ 2566770176 Working_Set_Member_Message_Obsol "Generic 8-byte raw payload. Detail page: https://www.isobus.net/isobus/pGNAndSPN/15417?type=PGN. Signal-level enrichment via PR welcome  see CONTRIBUTING.md.";
CM_ SG_ 2566770432 Working_Set_Master_Message_Obsol "Generic 8-byte raw payload. Detail page: https://www.isobus.net/isobus/pGNAndSPN/15418?type=PGN. Signal-level enrichment via PR welcome  see CONTRIBUTING.md.";
CM_ SG_ 2566770688 Intake_Exhaust_Conditions_2_RawP "Generic 8-byte raw payload. Detail page: https://www.isobus.net/isobus/pGNAndSPN/15425?type=PGN. Signal-level enrichment via PR welcome  see CONTRIBUTING.md.";
CM_ SG_ 2566770944 FMS_standard_Interface_Identity_ "Generic 8-byte raw payload. Detail page: https://www.isobus.net/isobus/pGNAndSPN/15428?type=PGN. Signal-level enrichment via PR welcome  see CONTRIBUTING.md.";
CM_ SG_ 2566771200 ECU_Performance_RawPayload "Generic 8-byte raw payload. Detail page: https://www.isobus.net/isobus/pGNAndSPN/15430?type=PGN. Signal-level enrichment via PR welcome  see CONTRIBUTING.md.";
CM_ SG_ 2566771456 Turbocharger_Information_6_RawPa "Generic 8-byte raw payload. Detail page: https://www.isobus.net/isobus/pGNAndSPN/15434?type=PGN. Signal-level enrichment via PR welcome  see CONTRIBUTING.md.";
CM_ SG_ 2566771712 Cab_Message_3_RawPayload "Generic 8-byte raw payload. Detail page: https://www.isobus.net/isobus/pGNAndSPN/15452?type=PGN. Signal-level enrichment via PR welcome  see CONTRIBUTING.md.";
CM_ SG_ 2566771968 Electronic_Engine_Controller_5_R "Generic 8-byte raw payload. Detail page: https://www.isobus.net/isobus/pGNAndSPN/15459?type=PGN. Signal-level enrichment via PR welcome  see CONTRIBUTING.md.";
CM_ SG_ 2566772224 Basic_Joystick_Message_1_RawPayl "Generic 8-byte raw payload. Detail page: https://www.isobus.net/isobus/pGNAndSPN/15481?type=PGN. Signal-level enrichment via PR welcome  see CONTRIBUTING.md.";
CM_ SG_ 2566772480 Extended_Joystick_Message_1_RawP "Generic 8-byte raw payload. Detail page: https://www.isobus.net/isobus/pGNAndSPN/15500?type=PGN. Signal-level enrichment via PR welcome  see CONTRIBUTING.md.";
CM_ SG_ 2566772736 Basic_Joystick_Message_2_RawPayl "Generic 8-byte raw payload. Detail page: https://www.isobus.net/isobus/pGNAndSPN/15522?type=PGN. Signal-level enrichment via PR welcome  see CONTRIBUTING.md.";
CM_ SG_ 2566772992 Extended_Joystick_Message_2_RawP "Generic 8-byte raw payload. Detail page: https://www.isobus.net/isobus/pGNAndSPN/15541?type=PGN. Signal-level enrichment via PR welcome  see CONTRIBUTING.md.";
CM_ SG_ 2566773248 Basic_Joystick_Message_3_RawPayl "Generic 8-byte raw payload. Detail page: https://www.isobus.net/isobus/pGNAndSPN/15563?type=PGN. Signal-level enrichment via PR welcome  see CONTRIBUTING.md.";
CM_ SG_ 2566773504 Extended_Joystick_Message_3_RawP "Generic 8-byte raw payload. Detail page: https://www.isobus.net/isobus/pGNAndSPN/15582?type=PGN. Signal-level enrichment via PR welcome  see CONTRIBUTING.md.";
CM_ SG_ 2566773760 Marine_Control_Information_RawPa "Generic 8-byte raw payload. Detail page: https://www.isobus.net/isobus/pGNAndSPN/15586?type=PGN. Signal-level enrichment via PR welcome  see CONTRIBUTING.md.";
CM_ SG_ 2566774016 Military_Application_Message_1_1 "Generic 8-byte raw payload. Detail page: https://www.isobus.net/isobus/pGNAndSPN/15587?type=PGN. Signal-level enrichment via PR welcome  see CONTRIBUTING.md.";
CM_ SG_ 2566774272 Military_Application_Message_2_1 "Generic 8-byte raw payload. Detail page: https://www.isobus.net/isobus/pGNAndSPN/15588?type=PGN. Signal-level enrichment via PR welcome  see CONTRIBUTING.md.";
CM_ SG_ 2566774528 Front_Wheel_Drive_Status_RawPayl "Generic 8-byte raw payload. Detail page: https://www.isobus.net/isobus/pGNAndSPN/15589?type=PGN. Signal-level enrichment via PR welcome  see CONTRIBUTING.md.";
CM_ SG_ 2566774784 Ambient_Conditions_2_RawPayload "Generic 8-byte raw payload. Detail page: https://www.isobus.net/isobus/pGNAndSPN/15594?type=PGN. Signal-level enrichment via PR welcome  see CONTRIBUTING.md.";
CM_ SG_ 2566775040 Cab_Climate_System_Information_1 "Generic 8-byte raw payload. Detail page: https://www.isobus.net/isobus/pGNAndSPN/15603?type=PGN. Signal-level enrichment via PR welcome  see CONTRIBUTING.md.";
CM_ SG_ 2566775296 Supply_Pressure_Demand_RawPayloa "Generic 8-byte raw payload. Detail page: https://www.isobus.net/isobus/pGNAndSPN/15610?type=PGN. Signal-level enrichment via PR welcome  see CONTRIBUTING.md.";
CM_ SG_ 2566775552 Equipment_Operation_and_Control_ "Generic 8-byte raw payload. Detail page: https://www.isobus.net/isobus/pGNAndSPN/15611?type=PGN. Signal-level enrichment via PR welcome  see CONTRIBUTING.md.";
CM_ SG_ 2566775808 Equipment_Performance_Data_RawPa "Generic 8-byte raw payload. Detail page: https://www.isobus.net/isobus/pGNAndSPN/15616?type=PGN. Signal-level enrichment via PR welcome  see CONTRIBUTING.md.";
CM_ SG_ 2566776064 Maximum_Vehicle_Speed_Limit_Stat "Generic 8-byte raw payload. Detail page: https://www.isobus.net/isobus/pGNAndSPN/15624?type=PGN. Signal-level enrichment via PR welcome  see CONTRIBUTING.md.";
CM_ SG_ 2566776320 Hydraulic_Braking_System_RawPayl "Generic 8-byte raw payload. Detail page: https://www.isobus.net/isobus/pGNAndSPN/15632?type=PGN. Signal-level enrichment via PR welcome  see CONTRIBUTING.md.";
CM_ SG_ 2566776576 Bus_1_Utility_Sync_Check_Status_ "Generic 8-byte raw payload. Detail page: https://www.isobus.net/isobus/pGNAndSPN/15638?type=PGN. Signal-level enrichment via PR welcome  see CONTRIBUTING.md.";
CM_ SG_ 2566776832 Bus_1_Generator_Sync_Check_Statu "Generic 8-byte raw payload. Detail page: https://www.isobus.net/isobus/pGNAndSPN/15644?type=PGN. Signal-level enrichment via PR welcome  see CONTRIBUTING.md.";
CM_ SG_ 2566777088 Bus_1_Phase_C_Basic_AC_Quantitie "Generic 8-byte raw payload. Detail page: https://www.isobus.net/isobus/pGNAndSPN/15647?type=PGN. Signal-level enrichment via PR welcome  see CONTRIBUTING.md.";
CM_ SG_ 2566777344 Bus_1_Phase_B_Basic_AC_Quantitie "Generic 8-byte raw payload. Detail page: https://www.isobus.net/isobus/pGNAndSPN/15650?type=PGN. Signal-level enrichment via PR welcome  see CONTRIBUTING.md.";
CM_ SG_ 2566777600 Bus_1_Phase_A_Basic_AC_Quantitie "Generic 8-byte raw payload. Detail page: https://www.isobus.net/isobus/pGNAndSPN/15653?type=PGN. Signal-level enrichment via PR welcome  see CONTRIBUTING.md.";
CM_ SG_ 2566777856 Bus_1_Average_Basic_AC_Quantitie "Generic 8-byte raw payload. Detail page: https://www.isobus.net/isobus/pGNAndSPN/15656?type=PGN. Signal-level enrichment via PR welcome  see CONTRIBUTING.md.";
CM_ SG_ 2566778112 Utility_Total_AC_Energy_RawPaylo "Generic 8-byte raw payload. Detail page: https://www.isobus.net/isobus/pGNAndSPN/15658?type=PGN. Signal-level enrichment via PR welcome  see CONTRIBUTING.md.";
CM_ SG_ 2566778368 Utility_Phase_C_AC_Reactive_Powe "Generic 8-byte raw payload. Detail page: https://www.isobus.net/isobus/pGNAndSPN/15661?type=PGN. Signal-level enrichment via PR welcome  see CONTRIBUTING.md.";
CM_ SG_ 2566778624 Utility_Phase_C_AC_Power_RawPayl "Generic 8-byte raw payload. Detail page: https://www.isobus.net/isobus/pGNAndSPN/15663?type=PGN. Signal-level enrichment via PR welcome  see CONTRIBUTING.md.";
CM_ SG_ 2566778880 Utility_Phase_C_AC_Basic_Quantit "Generic 8-byte raw payload. Detail page: https://www.isobus.net/isobus/pGNAndSPN/15667?type=PGN. Signal-level enrichment via PR welcome  see CONTRIBUTING.md.";
CM_ SG_ 2566779136 Utility_Phase_B_AC_Reactive_Powe "Generic 8-byte raw payload. Detail page: https://www.isobus.net/isobus/pGNAndSPN/15670?type=PGN. Signal-level enrichment via PR welcome  see CONTRIBUTING.md.";
CM_ SG_ 2566779392 Utility_Phase_B_AC_Power_RawPayl "Generic 8-byte raw payload. Detail page: https://www.isobus.net/isobus/pGNAndSPN/15672?type=PGN. Signal-level enrichment via PR welcome  see CONTRIBUTING.md.";
CM_ SG_ 2566779648 Utility_Phase_B_AC_Basic_Quantit "Generic 8-byte raw payload. Detail page: https://www.isobus.net/isobus/pGNAndSPN/15676?type=PGN. Signal-level enrichment via PR welcome  see CONTRIBUTING.md.";
CM_ SG_ 2566779904 Utility_Phase_A_AC_Reactive_Powe "Generic 8-byte raw payload. Detail page: https://www.isobus.net/isobus/pGNAndSPN/15679?type=PGN. Signal-level enrichment via PR welcome  see CONTRIBUTING.md.";
CM_ SG_ 2566780160 Utility_Phase_A_AC_Power_RawPayl "Generic 8-byte raw payload. Detail page: https://www.isobus.net/isobus/pGNAndSPN/15681?type=PGN. Signal-level enrichment via PR welcome  see CONTRIBUTING.md.";
CM_ SG_ 2566780416 Utility_Phase_A_Basic_AC_Quantit "Generic 8-byte raw payload. Detail page: https://www.isobus.net/isobus/pGNAndSPN/15685?type=PGN. Signal-level enrichment via PR welcome  see CONTRIBUTING.md.";
CM_ SG_ 2566780672 Utility_Total_AC_Reactive_Power_ "Generic 8-byte raw payload. Detail page: https://www.isobus.net/isobus/pGNAndSPN/15688?type=PGN. Signal-level enrichment via PR welcome  see CONTRIBUTING.md.";
CM_ SG_ 2566780928 Utility_Total_AC_Power_RawPayloa "Generic 8-byte raw payload. Detail page: https://www.isobus.net/isobus/pGNAndSPN/15690?type=PGN. Signal-level enrichment via PR welcome  see CONTRIBUTING.md.";
CM_ SG_ 2566781184 Utility_Average_Basic_AC_Quantit "Generic 8-byte raw payload. Detail page: https://www.isobus.net/isobus/pGNAndSPN/15694?type=PGN. Signal-level enrichment via PR welcome  see CONTRIBUTING.md.";
CM_ SG_ 2566781440 Generator_Total_AC_Energy_RawPay "Generic 8-byte raw payload. Detail page: https://www.isobus.net/isobus/pGNAndSPN/15696?type=PGN. Signal-level enrichment via PR welcome  see CONTRIBUTING.md.";
CM_ SG_ 2566781696 Generator_Phase_C_AC_Reactive_Po "Generic 8-byte raw payload. Detail page: https://www.isobus.net/isobus/pGNAndSPN/15699?type=PGN. Signal-level enrichment via PR welcome  see CONTRIBUTING.md.";
CM_ SG_ 2566781952 Generator_Phase_C_AC_Power_RawPa "Generic 8-byte raw payload. Detail page: https://www.isobus.net/isobus/pGNAndSPN/15701?type=PGN. Signal-level enrichment via PR welcome  see CONTRIBUTING.md.";
CM_ SG_ 2566782208 Generator_Phase_C_Basic_AC_Quant "Generic 8-byte raw payload. Detail page: https://www.isobus.net/isobus/pGNAndSPN/15705?type=PGN. Signal-level enrichment via PR welcome  see CONTRIBUTING.md.";
CM_ SG_ 2566782464 Generator_Phase_B_AC_Reactive_Po "Generic 8-byte raw payload. Detail page: https://www.isobus.net/isobus/pGNAndSPN/15708?type=PGN. Signal-level enrichment via PR welcome  see CONTRIBUTING.md.";
CM_ SG_ 2566782720 Generator_Phase_B_AC_Power_RawPa "Generic 8-byte raw payload. Detail page: https://www.isobus.net/isobus/pGNAndSPN/15710?type=PGN. Signal-level enrichment via PR welcome  see CONTRIBUTING.md.";
CM_ SG_ 2566782976 Generator_Phase_B_Basic_AC_Quant "Generic 8-byte raw payload. Detail page: https://www.isobus.net/isobus/pGNAndSPN/15714?type=PGN. Signal-level enrichment via PR welcome  see CONTRIBUTING.md.";
CM_ SG_ 2566783232 Generator_Phase_A_AC_Reactive_Po "Generic 8-byte raw payload. Detail page: https://www.isobus.net/isobus/pGNAndSPN/15717?type=PGN. Signal-level enrichment via PR welcome  see CONTRIBUTING.md.";
CM_ SG_ 2566783488 Generator_Phase_A_AC_Power_RawPa "Generic 8-byte raw payload. Detail page: https://www.isobus.net/isobus/pGNAndSPN/15719?type=PGN. Signal-level enrichment via PR welcome  see CONTRIBUTING.md.";
CM_ SG_ 2566783744 Generator_Phase_A_Basic_AC_Quant "Generic 8-byte raw payload. Detail page: https://www.isobus.net/isobus/pGNAndSPN/15723?type=PGN. Signal-level enrichment via PR welcome  see CONTRIBUTING.md.";
CM_ SG_ 2566784000 Generator_Total_AC_Reactive_Powe "Generic 8-byte raw payload. Detail page: https://www.isobus.net/isobus/pGNAndSPN/15726?type=PGN. Signal-level enrichment via PR welcome  see CONTRIBUTING.md.";
CM_ SG_ 2566784256 Generator_Total_AC_Power_RawPayl "Generic 8-byte raw payload. Detail page: https://www.isobus.net/isobus/pGNAndSPN/15728?type=PGN. Signal-level enrichment via PR welcome  see CONTRIBUTING.md.";
CM_ SG_ 2566784512 Generator_Average_Basic_AC_Quant "Generic 8-byte raw payload. Detail page: https://www.isobus.net/isobus/pGNAndSPN/15732?type=PGN. Signal-level enrichment via PR welcome  see CONTRIBUTING.md.";
CM_ SG_ 2566784768 Exhaust_Temperature_RawPayload "Generic 8-byte raw payload. Detail page: https://www.isobus.net/isobus/pGNAndSPN/15736?type=PGN. Signal-level enrichment via PR welcome  see CONTRIBUTING.md.";
CM_ SG_ 2566785024 Required_Tractor_Facilities_mess "Generic 8-byte raw payload. Detail page: https://www.isobus.net/isobus/pGNAndSPN/15782?type=PGN. Signal-level enrichment via PR welcome  see CONTRIBUTING.md.";
CM_ SG_ 2566785280 Tractor_Facilities_response_mess "Generic 8-byte raw payload. Detail page: https://www.isobus.net/isobus/pGNAndSPN/15828?type=PGN. Signal-level enrichment via PR welcome  see CONTRIBUTING.md.";
CM_ SG_ 2566785536 Tractor_control_command_tractor_ "Generic 8-byte raw payload. Detail page: https://www.isobus.net/isobus/pGNAndSPN/15829?type=PGN. Signal-level enrichment via PR welcome  see CONTRIBUTING.md.";
CM_ SG_ 2566785792 Tractor_control_mode_command_Raw "Generic 8-byte raw payload. Detail page: https://www.isobus.net/isobus/pGNAndSPN/15831?type=PGN. Signal-level enrichment via PR welcome  see CONTRIBUTING.md.";
CM_ SG_ 2566786048 Working_Set_Member_RawPayload "Generic 8-byte raw payload. Detail page: https://www.isobus.net/isobus/pGNAndSPN/15832?type=PGN. Signal-level enrichment via PR welcome  see CONTRIBUTING.md.";
CM_ SG_ 2566786560 Response_for_Repetition_Rate_Raw "Generic 8-byte raw payload. Detail page: https://www.isobus.net/isobus/pGNAndSPN/15835?type=PGN. Signal-level enrichment via PR welcome  see CONTRIBUTING.md.";
CM_ SG_ 2566787072 Auxiliary_valve_0_estimated_flow "Generic 8-byte raw payload. Detail page: https://www.isobus.net/isobus/pGNAndSPN/15855?type=PGN. Signal-level enrichment via PR welcome  see CONTRIBUTING.md.";
CM_ SG_ 2566787328 Auxiliary_valve_1_estimated_flow "Generic 8-byte raw payload. Detail page: https://www.isobus.net/isobus/pGNAndSPN/15862?type=PGN. Signal-level enrichment via PR welcome  see CONTRIBUTING.md.";
CM_ SG_ 2566787584 Auxiliary_valve_2_estimated_flow "Generic 8-byte raw payload. Detail page: https://www.isobus.net/isobus/pGNAndSPN/15869?type=PGN. Signal-level enrichment via PR welcome  see CONTRIBUTING.md.";
CM_ SG_ 2566787840 Auxiliary_valve_3_estimated_flow "Generic 8-byte raw payload. Detail page: https://www.isobus.net/isobus/pGNAndSPN/15876?type=PGN. Signal-level enrichment via PR welcome  see CONTRIBUTING.md.";
CM_ SG_ 2566788096 Auxiliary_valve_4_estimated_flow "Generic 8-byte raw payload. Detail page: https://www.isobus.net/isobus/pGNAndSPN/15883?type=PGN. Signal-level enrichment via PR welcome  see CONTRIBUTING.md.";
CM_ SG_ 2566788352 Auxiliary_valve_5_estimated_flow "Generic 8-byte raw payload. Detail page: https://www.isobus.net/isobus/pGNAndSPN/15890?type=PGN. Signal-level enrichment via PR welcome  see CONTRIBUTING.md.";
CM_ SG_ 2566788608 Auxiliary_valve_6_estimated_flow "Generic 8-byte raw payload. Detail page: https://www.isobus.net/isobus/pGNAndSPN/15897?type=PGN. Signal-level enrichment via PR welcome  see CONTRIBUTING.md.";
CM_ SG_ 2566788864 Auxiliary_valve_7_estimated_flow "Generic 8-byte raw payload. Detail page: https://www.isobus.net/isobus/pGNAndSPN/15904?type=PGN. Signal-level enrichment via PR welcome  see CONTRIBUTING.md.";
CM_ SG_ 2566789120 Auxiliary_valve_8_estimated_flow "Generic 8-byte raw payload. Detail page: https://www.isobus.net/isobus/pGNAndSPN/15911?type=PGN. Signal-level enrichment via PR welcome  see CONTRIBUTING.md.";
CM_ SG_ 2566789376 Auxiliary_valve_9_estimated_flow "Generic 8-byte raw payload. Detail page: https://www.isobus.net/isobus/pGNAndSPN/15918?type=PGN. Signal-level enrichment via PR welcome  see CONTRIBUTING.md.";
CM_ SG_ 2566789632 Auxiliary_valve_10_estimated_flo "Generic 8-byte raw payload. Detail page: https://www.isobus.net/isobus/pGNAndSPN/15925?type=PGN. Signal-level enrichment via PR welcome  see CONTRIBUTING.md.";
CM_ SG_ 2566789888 Auxiliary_valve_11_estimated_flo "Generic 8-byte raw payload. Detail page: https://www.isobus.net/isobus/pGNAndSPN/15932?type=PGN. Signal-level enrichment via PR welcome  see CONTRIBUTING.md.";
CM_ SG_ 2566790144 Auxiliary_valve_12_estimated_flo "Generic 8-byte raw payload. Detail page: https://www.isobus.net/isobus/pGNAndSPN/15939?type=PGN. Signal-level enrichment via PR welcome  see CONTRIBUTING.md.";
CM_ SG_ 2566790400 Auxiliary_valve_13_estimated_flo "Generic 8-byte raw payload. Detail page: https://www.isobus.net/isobus/pGNAndSPN/15946?type=PGN. Signal-level enrichment via PR welcome  see CONTRIBUTING.md.";
CM_ SG_ 2566790656 Auxiliary_valve_14_estimated_flo "Generic 8-byte raw payload. Detail page: https://www.isobus.net/isobus/pGNAndSPN/15953?type=PGN. Signal-level enrichment via PR welcome  see CONTRIBUTING.md.";
CM_ SG_ 2566790912 Auxiliary_valve_15_estimated_flo "Generic 8-byte raw payload. Detail page: https://www.isobus.net/isobus/pGNAndSPN/15960?type=PGN. Signal-level enrichment via PR welcome  see CONTRIBUTING.md.";
CM_ SG_ 2566791168 Auxiliary_valve_0_measured_flow_ "Generic 8-byte raw payload. Detail page: https://www.isobus.net/isobus/pGNAndSPN/15966?type=PGN. Signal-level enrichment via PR welcome  see CONTRIBUTING.md.";
CM_ SG_ 2566791424 Auxiliary_valve_1_measured_flow_ "Generic 8-byte raw payload. Detail page: https://www.isobus.net/isobus/pGNAndSPN/15972?type=PGN. Signal-level enrichment via PR welcome  see CONTRIBUTING.md.";
CM_ SG_ 2566791680 Auxiliary_valve_2_measured_flow_ "Generic 8-byte raw payload. Detail page: https://www.isobus.net/isobus/pGNAndSPN/15978?type=PGN. Signal-level enrichment via PR welcome  see CONTRIBUTING.md.";
CM_ SG_ 2566791936 Auxiliary_valve_3_measured_flow_ "Generic 8-byte raw payload. Detail page: https://www.isobus.net/isobus/pGNAndSPN/15984?type=PGN. Signal-level enrichment via PR welcome  see CONTRIBUTING.md.";
CM_ SG_ 2566792192 Auxiliary_valve_4_measured_flow_ "Generic 8-byte raw payload. Detail page: https://www.isobus.net/isobus/pGNAndSPN/15990?type=PGN. Signal-level enrichment via PR welcome  see CONTRIBUTING.md.";
CM_ SG_ 2566792448 Auxiliary_valve_5_measured_flow_ "Generic 8-byte raw payload. Detail page: https://www.isobus.net/isobus/pGNAndSPN/15996?type=PGN. Signal-level enrichment via PR welcome  see CONTRIBUTING.md.";
CM_ SG_ 2566792704 Auxiliary_valve_6_measured_flow_ "Generic 8-byte raw payload. Detail page: https://www.isobus.net/isobus/pGNAndSPN/16002?type=PGN. Signal-level enrichment via PR welcome  see CONTRIBUTING.md.";
CM_ SG_ 2566792960 Auxiliary_valve_7_measured_flow_ "Generic 8-byte raw payload. Detail page: https://www.isobus.net/isobus/pGNAndSPN/16008?type=PGN. Signal-level enrichment via PR welcome  see CONTRIBUTING.md.";
CM_ SG_ 2566793216 Auxiliary_valve_8_measured_flow_ "Generic 8-byte raw payload. Detail page: https://www.isobus.net/isobus/pGNAndSPN/16014?type=PGN. Signal-level enrichment via PR welcome  see CONTRIBUTING.md.";
CM_ SG_ 2566793472 Auxiliary_valve_9_measured_flow_ "Generic 8-byte raw payload. Detail page: https://www.isobus.net/isobus/pGNAndSPN/16020?type=PGN. Signal-level enrichment via PR welcome  see CONTRIBUTING.md.";
CM_ SG_ 2566793728 Auxiliary_valve_10_measured_flow "Generic 8-byte raw payload. Detail page: https://www.isobus.net/isobus/pGNAndSPN/16026?type=PGN. Signal-level enrichment via PR welcome  see CONTRIBUTING.md.";
CM_ SG_ 2566793984 Auxiliary_valve_11_measured_flow "Generic 8-byte raw payload. Detail page: https://www.isobus.net/isobus/pGNAndSPN/16032?type=PGN. Signal-level enrichment via PR welcome  see CONTRIBUTING.md.";
CM_ SG_ 2566794240 Auxiliary_valve_12_measured_flow "Generic 8-byte raw payload. Detail page: https://www.isobus.net/isobus/pGNAndSPN/16038?type=PGN. Signal-level enrichment via PR welcome  see CONTRIBUTING.md.";
CM_ SG_ 2566794496 Auxiliary_valve_13_measured_flow "Generic 8-byte raw payload. Detail page: https://www.isobus.net/isobus/pGNAndSPN/16044?type=PGN. Signal-level enrichment via PR welcome  see CONTRIBUTING.md.";
CM_ SG_ 2566794752 Auxiliary_valve_14_measured_flow "Generic 8-byte raw payload. Detail page: https://www.isobus.net/isobus/pGNAndSPN/16050?type=PGN. Signal-level enrichment via PR welcome  see CONTRIBUTING.md.";
CM_ SG_ 2566795008 Auxiliary_valve_15_measured_flow "Generic 8-byte raw payload. Detail page: https://www.isobus.net/isobus/pGNAndSPN/16056?type=PGN. Signal-level enrichment via PR welcome  see CONTRIBUTING.md.";
CM_ SG_ 2566795264 Auxiliary_valve_0_command_RawPay "Generic 8-byte raw payload. Detail page: https://www.isobus.net/isobus/pGNAndSPN/16061?type=PGN. Signal-level enrichment via PR welcome  see CONTRIBUTING.md.";
CM_ SG_ 2566795520 Auxiliary_valve_1_command_RawPay "Generic 8-byte raw payload. Detail page: https://www.isobus.net/isobus/pGNAndSPN/16066?type=PGN. Signal-level enrichment via PR welcome  see CONTRIBUTING.md.";
CM_ SG_ 2566795776 Auxiliary_valve_2_command_RawPay "Generic 8-byte raw payload. Detail page: https://www.isobus.net/isobus/pGNAndSPN/16071?type=PGN. Signal-level enrichment via PR welcome  see CONTRIBUTING.md.";
CM_ SG_ 2566796032 Auxiliary_valve_3_command_RawPay "Generic 8-byte raw payload. Detail page: https://www.isobus.net/isobus/pGNAndSPN/16076?type=PGN. Signal-level enrichment via PR welcome  see CONTRIBUTING.md.";
CM_ SG_ 2566796288 Auxiliary_valve_4_command_RawPay "Generic 8-byte raw payload. Detail page: https://www.isobus.net/isobus/pGNAndSPN/16081?type=PGN. Signal-level enrichment via PR welcome  see CONTRIBUTING.md.";
CM_ SG_ 2566796544 Auxiliary_valve_5_command_RawPay "Generic 8-byte raw payload. Detail page: https://www.isobus.net/isobus/pGNAndSPN/16086?type=PGN. Signal-level enrichment via PR welcome  see CONTRIBUTING.md.";
CM_ SG_ 2566796800 Auxiliary_valve_6_command_RawPay "Generic 8-byte raw payload. Detail page: https://www.isobus.net/isobus/pGNAndSPN/16091?type=PGN. Signal-level enrichment via PR welcome  see CONTRIBUTING.md.";
CM_ SG_ 2566797056 Auxiliary_valve_7_command_RawPay "Generic 8-byte raw payload. Detail page: https://www.isobus.net/isobus/pGNAndSPN/16096?type=PGN. Signal-level enrichment via PR welcome  see CONTRIBUTING.md.";
CM_ SG_ 2566797312 Auxiliary_valve_8_command_RawPay "Generic 8-byte raw payload. Detail page: https://www.isobus.net/isobus/pGNAndSPN/16101?type=PGN. Signal-level enrichment via PR welcome  see CONTRIBUTING.md.";
CM_ SG_ 2566797568 Auxiliary_valve_9_command_RawPay "Generic 8-byte raw payload. Detail page: https://www.isobus.net/isobus/pGNAndSPN/16106?type=PGN. Signal-level enrichment via PR welcome  see CONTRIBUTING.md.";
CM_ SG_ 2566797824 Auxiliary_valve_10_command_RawPa "Generic 8-byte raw payload. Detail page: https://www.isobus.net/isobus/pGNAndSPN/16111?type=PGN. Signal-level enrichment via PR welcome  see CONTRIBUTING.md.";
CM_ SG_ 2566798080 Auxiliary_valve_11_command_RawPa "Generic 8-byte raw payload. Detail page: https://www.isobus.net/isobus/pGNAndSPN/16116?type=PGN. Signal-level enrichment via PR welcome  see CONTRIBUTING.md.";
CM_ SG_ 2566798336 Auxiliary_valve_12_command_RawPa "Generic 8-byte raw payload. Detail page: https://www.isobus.net/isobus/pGNAndSPN/16121?type=PGN. Signal-level enrichment via PR welcome  see CONTRIBUTING.md.";
CM_ SG_ 2566798592 Auxiliary_valve_13_command_RawPa "Generic 8-byte raw payload. Detail page: https://www.isobus.net/isobus/pGNAndSPN/16126?type=PGN. Signal-level enrichment via PR welcome  see CONTRIBUTING.md.";
CM_ SG_ 2566798848 Auxiliary_valve_14_command_RawPa "Generic 8-byte raw payload. Detail page: https://www.isobus.net/isobus/pGNAndSPN/16131?type=PGN. Signal-level enrichment via PR welcome  see CONTRIBUTING.md.";
CM_ SG_ 2566799104 Auxiliary_valve_15_command_RawPa "Generic 8-byte raw payload. Detail page: https://www.isobus.net/isobus/pGNAndSPN/16136?type=PGN. Signal-level enrichment via PR welcome  see CONTRIBUTING.md.";
CM_ SG_ 2566799360 Lighting_Data_RawPayload "Generic 8-byte raw payload. Detail page: https://www.isobus.net/isobus/pGNAndSPN/16167?type=PGN. Signal-level enrichment via PR welcome  see CONTRIBUTING.md.";
CM_ SG_ 2566799616 Lighting_command_RawPayload "Generic 8-byte raw payload. Detail page: https://www.isobus.net/isobus/pGNAndSPN/16199?type=PGN. Signal-level enrichment via PR welcome  see CONTRIBUTING.md.";
CM_ SG_ 2566799872 Hitch_and_PTO_commands_RawPayloa "Generic 8-byte raw payload. Detail page: https://www.isobus.net/isobus/pGNAndSPN/16209?type=PGN. Signal-level enrichment via PR welcome  see CONTRIBUTING.md.";
CM_ SG_ 2566800128 Primary_or_Rear_Power_Take_off_O "Generic 8-byte raw payload. Detail page: https://www.isobus.net/isobus/pGNAndSPN/16219?type=PGN. Signal-level enrichment via PR welcome  see CONTRIBUTING.md.";
CM_ SG_ 2566800384 Secondary_or_Front_Power_Take_of "Generic 8-byte raw payload. Detail page: https://www.isobus.net/isobus/pGNAndSPN/16229?type=PGN. Signal-level enrichment via PR welcome  see CONTRIBUTING.md.";
CM_ SG_ 2566800640 Primary_or_Rear_Hitch_Status_Raw "Generic 8-byte raw payload. Detail page: https://www.isobus.net/isobus/pGNAndSPN/16235?type=PGN. Signal-level enrichment via PR welcome  see CONTRIBUTING.md.";
CM_ SG_ 2566800896 Secondary_or_Front_Hitch_Status_ "Generic 8-byte raw payload. Detail page: https://www.isobus.net/isobus/pGNAndSPN/16241?type=PGN. Signal-level enrichment via PR welcome  see CONTRIBUTING.md.";
CM_ SG_ 2566801920 Electronic_Transmission_Controll "Generic 8-byte raw payload. Detail page: https://www.isobus.net/isobus/pGNAndSPN/16285?type=PGN. Signal-level enrichment via PR welcome  see CONTRIBUTING.md.";
CM_ SG_ 2566802176 Transmission_Configuration_2_Raw "Generic 8-byte raw payload. Detail page: https://www.isobus.net/isobus/pGNAndSPN/16290?type=PGN. Signal-level enrichment via PR welcome  see CONTRIBUTING.md.";
CM_ SG_ 2566802432 Military_Lighting_Command_RawPay "Generic 8-byte raw payload. Detail page: https://www.isobus.net/isobus/pGNAndSPN/16298?type=PGN. Signal-level enrichment via PR welcome  see CONTRIBUTING.md.";
CM_ SG_ 2566802688 Total_Averaged_Information_RawPa "Generic 8-byte raw payload. Detail page: https://www.isobus.net/isobus/pGNAndSPN/16300?type=PGN. Signal-level enrichment via PR welcome  see CONTRIBUTING.md.";
CM_ SG_ 2566802944 Door_Control_1_RawPayload "Generic 8-byte raw payload. Detail page: https://www.isobus.net/isobus/pGNAndSPN/16303?type=PGN. Signal-level enrichment via PR welcome  see CONTRIBUTING.md.";
CM_ SG_ 2566803200 Vehicle_Dynamic_Stability_Contro "Generic 8-byte raw payload. Detail page: https://www.isobus.net/isobus/pGNAndSPN/16311?type=PGN. Signal-level enrichment via PR welcome  see CONTRIBUTING.md.";
CM_ SG_ 2566803456 Battery_Temperature_RawPayload "Generic 8-byte raw payload. Detail page: https://www.isobus.net/isobus/pGNAndSPN/16315?type=PGN. Signal-level enrichment via PR welcome  see CONTRIBUTING.md.";
CM_ SG_ 2566803712 Adaptive_Cruise_Control_Operator "Generic 8-byte raw payload. Detail page: https://www.isobus.net/isobus/pGNAndSPN/16317?type=PGN. Signal-level enrichment via PR welcome  see CONTRIBUTING.md.";
CM_ SG_ 2566803968 Vehicle_Electrical_Power_3_RawPa "Generic 8-byte raw payload. Detail page: https://www.isobus.net/isobus/pGNAndSPN/16321?type=PGN. Signal-level enrichment via PR welcome  see CONTRIBUTING.md.";
CM_ SG_ 2566804224 Retarder_Continuous_Torque_Speed "Generic 8-byte raw payload. Detail page: https://www.isobus.net/isobus/pGNAndSPN/16329?type=PGN. Signal-level enrichment via PR welcome  see CONTRIBUTING.md.";
CM_ SG_ 2566804480 Engine_Continuous_Torque_Speed_L "Generic 8-byte raw payload. Detail page: https://www.isobus.net/isobus/pGNAndSPN/16337?type=PGN. Signal-level enrichment via PR welcome  see CONTRIBUTING.md.";
CM_ SG_ 2566804736 Gaseous_Fuel_Properties_RawPaylo "Generic 8-byte raw payload. Detail page: https://www.isobus.net/isobus/pGNAndSPN/16340?type=PGN. Signal-level enrichment via PR welcome  see CONTRIBUTING.md.";
CM_ SG_ 2566804992 Aftertreatment_1_Diesel_Exhaust_ "Generic 8-byte raw payload. Detail page: https://www.isobus.net/isobus/pGNAndSPN/16349?type=PGN. Signal-level enrichment via PR welcome  see CONTRIBUTING.md.";
CM_ SG_ 2566805248 Air_Suspension_Control_5_RawPayl "Generic 8-byte raw payload. Detail page: https://www.isobus.net/isobus/pGNAndSPN/16355?type=PGN. Signal-level enrichment via PR welcome  see CONTRIBUTING.md.";
CM_ SG_ 2566805504 Air_Suspension_Control_4_RawPayl "Generic 8-byte raw payload. Detail page: https://www.isobus.net/isobus/pGNAndSPN/16359?type=PGN. Signal-level enrichment via PR welcome  see CONTRIBUTING.md.";
CM_ SG_ 2566805760 Air_Suspension_Control_3_RawPayl "Generic 8-byte raw payload. Detail page: https://www.isobus.net/isobus/pGNAndSPN/16363?type=PGN. Signal-level enrichment via PR welcome  see CONTRIBUTING.md.";
CM_ SG_ 2566806016 Air_Suspension_Control_1_RawPayl "Generic 8-byte raw payload. Detail page: https://www.isobus.net/isobus/pGNAndSPN/16388?type=PGN. Signal-level enrichment via PR welcome  see CONTRIBUTING.md.";
CM_ SG_ 2566806272 Forward_Lane_Image_2_RawPayload "Generic 8-byte raw payload. Detail page: https://www.isobus.net/isobus/pGNAndSPN/16397?type=PGN. Signal-level enrichment via PR welcome  see CONTRIBUTING.md.";
CM_ SG_ 2566806528 Running_Gear_Equipment_2_2_RawPa "Generic 8-byte raw payload. Detail page: https://www.isobus.net/isobus/pGNAndSPN/16398?type=PGN. Signal-level enrichment via PR welcome  see CONTRIBUTING.md.";
CM_ SG_ 2566806784 General_Purpose_Message_1_2_RawP "Generic 8-byte raw payload. Detail page: https://www.isobus.net/isobus/pGNAndSPN/16399?type=PGN. Signal-level enrichment via PR welcome  see CONTRIBUTING.md.";
CM_ SG_ 2566807040 Running_Gear_Equipment_2_3_RawPa "Generic 8-byte raw payload. Detail page: https://www.isobus.net/isobus/pGNAndSPN/16400?type=PGN. Signal-level enrichment via PR welcome  see CONTRIBUTING.md.";
CM_ SG_ 2566807296 General_Purpose_Message_1_3_RawP "Generic 8-byte raw payload. Detail page: https://www.isobus.net/isobus/pGNAndSPN/16401?type=PGN. Signal-level enrichment via PR welcome  see CONTRIBUTING.md.";
CM_ SG_ 2566807552 General_Purpose_Message_2_3_RawP "Generic 8-byte raw payload. Detail page: https://www.isobus.net/isobus/pGNAndSPN/16402?type=PGN. Signal-level enrichment via PR welcome  see CONTRIBUTING.md.";
CM_ SG_ 2566807808 General_Purpose_Message_1_4_RawP "Generic 8-byte raw payload. Detail page: https://www.isobus.net/isobus/pGNAndSPN/16403?type=PGN. Signal-level enrichment via PR welcome  see CONTRIBUTING.md.";
CM_ SG_ 2566808064 General_Purpose_Message_2_4_RawP "Generic 8-byte raw payload. Detail page: https://www.isobus.net/isobus/pGNAndSPN/16404?type=PGN. Signal-level enrichment via PR welcome  see CONTRIBUTING.md.";
CM_ SG_ 2566808320 General_Purpose_Message_1_5_RawP "Generic 8-byte raw payload. Detail page: https://www.isobus.net/isobus/pGNAndSPN/16405?type=PGN. Signal-level enrichment via PR welcome  see CONTRIBUTING.md.";
CM_ SG_ 2566808576 General_Purpose_Message_2_5_RawP "Generic 8-byte raw payload. Detail page: https://www.isobus.net/isobus/pGNAndSPN/16406?type=PGN. Signal-level enrichment via PR welcome  see CONTRIBUTING.md.";
CM_ SG_ 2566808832 General_Purpose_Message_1_6_RawP "Generic 8-byte raw payload. Detail page: https://www.isobus.net/isobus/pGNAndSPN/16407?type=PGN. Signal-level enrichment via PR welcome  see CONTRIBUTING.md.";
CM_ SG_ 2566809088 Battery_Main_Switch_Information_ "Generic 8-byte raw payload. Detail page: https://www.isobus.net/isobus/pGNAndSPN/16408?type=PGN. Signal-level enrichment via PR welcome  see CONTRIBUTING.md.";
CM_ SG_ 2566809344 Climate_Control_Configuration_Ra "Generic 8-byte raw payload. Detail page: https://www.isobus.net/isobus/pGNAndSPN/16409?type=PGN. Signal-level enrichment via PR welcome  see CONTRIBUTING.md.";
CM_ SG_ 2566809600 Vehicle_Fluids_RawPayload "Generic 8-byte raw payload. Detail page: https://www.isobus.net/isobus/pGNAndSPN/16413?type=PGN. Signal-level enrichment via PR welcome  see CONTRIBUTING.md.";
CM_ SG_ 2566809856 Engine_Temperature_3_RawPayload "Generic 8-byte raw payload. Detail page: https://www.isobus.net/isobus/pGNAndSPN/16417?type=PGN. Signal-level enrichment via PR welcome  see CONTRIBUTING.md.";
CM_ SG_ 2566810112 Engine_Fuel_Lube_Systems_RawPayl "Generic 8-byte raw payload. Detail page: https://www.isobus.net/isobus/pGNAndSPN/16430?type=PGN. Signal-level enrichment via PR welcome  see CONTRIBUTING.md.";
CM_ SG_ 2566810368 Driver_s_Identification_RawPaylo "Generic 8-byte raw payload. Detail page: https://www.isobus.net/isobus/pGNAndSPN/16432?type=PGN. Signal-level enrichment via PR welcome  see CONTRIBUTING.md.";
CM_ SG_ 2566810880 Heater_Information_RawPayload "Generic 8-byte raw payload. Detail page: https://www.isobus.net/isobus/pGNAndSPN/16455?type=PGN. Signal-level enrichment via PR welcome  see CONTRIBUTING.md.";
CM_ SG_ 2566811136 High_Resolution_Wheel_Speed_RawP "Generic 8-byte raw payload. Detail page: https://www.isobus.net/isobus/pGNAndSPN/16459?type=PGN. Signal-level enrichment via PR welcome  see CONTRIBUTING.md.";
CM_ SG_ 2566811392 Adaptive_Cruise_Control_1_RawPay "Generic 8-byte raw payload. Detail page: https://www.isobus.net/isobus/pGNAndSPN/16469?type=PGN. Signal-level enrichment via PR welcome  see CONTRIBUTING.md.";
CM_ SG_ 2566811648 Combination_Vehicle_Weight_RawPa "Generic 8-byte raw payload. Detail page: https://www.isobus.net/isobus/pGNAndSPN/16472?type=PGN. Signal-level enrichment via PR welcome  see CONTRIBUTING.md.";
CM_ SG_ 2566811904 Laser_Tracer_Position_RawPayload "Generic 8-byte raw payload. Detail page: https://www.isobus.net/isobus/pGNAndSPN/16477?type=PGN. Signal-level enrichment via PR welcome  see CONTRIBUTING.md.";
CM_ SG_ 2566812160 Laser_Leveling_System_Blade_Cont "Generic 8-byte raw payload. Detail page: https://www.isobus.net/isobus/pGNAndSPN/16482?type=PGN. Signal-level enrichment via PR welcome  see CONTRIBUTING.md.";
CM_ SG_ 2566812416 Laser_Receiver_Mast_Position_Raw "Generic 8-byte raw payload. Detail page: https://www.isobus.net/isobus/pGNAndSPN/16483?type=PGN. Signal-level enrichment via PR welcome  see CONTRIBUTING.md.";
CM_ SG_ 2566812672 Modify_Leveling_System_Control_S "Generic 8-byte raw payload. Detail page: https://www.isobus.net/isobus/pGNAndSPN/16485?type=PGN. Signal-level enrichment via PR welcome  see CONTRIBUTING.md.";
CM_ SG_ 2566812928 Laser_Leveling_System_Vertical_D "Generic 8-byte raw payload. Detail page: https://www.isobus.net/isobus/pGNAndSPN/16489?type=PGN. Signal-level enrichment via PR welcome  see CONTRIBUTING.md.";
CM_ SG_ 2566813184 Laser_Leveling_System_Vertical_P "Generic 8-byte raw payload. Detail page: https://www.isobus.net/isobus/pGNAndSPN/16494?type=PGN. Signal-level enrichment via PR welcome  see CONTRIBUTING.md.";
CM_ SG_ 2566813440 Auxiliary_Pressures_RawPayload "Generic 8-byte raw payload. Detail page: https://www.isobus.net/isobus/pGNAndSPN/16497?type=PGN. Signal-level enrichment via PR welcome  see CONTRIBUTING.md.";
CM_ SG_ 2566813696 Tire_Pressure_Control_Unit_Mode_ "Generic 8-byte raw payload. Detail page: https://www.isobus.net/isobus/pGNAndSPN/16508?type=PGN. Signal-level enrichment via PR welcome  see CONTRIBUTING.md.";
CM_ SG_ 2566813952 Tire_Pressure_Control_Unit_Targe "Generic 8-byte raw payload. Detail page: https://www.isobus.net/isobus/pGNAndSPN/16511?type=PGN. Signal-level enrichment via PR welcome  see CONTRIBUTING.md.";
CM_ SG_ 2566814208 Tire_Pressure_Control_Unit_Curre "Generic 8-byte raw payload. Detail page: https://www.isobus.net/isobus/pGNAndSPN/16514?type=PGN. Signal-level enrichment via PR welcome  see CONTRIBUTING.md.";
CM_ SG_ 2566814464 Combustion_Time_1_RawPayload "Generic 8-byte raw payload. Detail page: https://www.isobus.net/isobus/pGNAndSPN/16518?type=PGN. Signal-level enrichment via PR welcome  see CONTRIBUTING.md.";
CM_ SG_ 2566814720 Combustion_Time_2_RawPayload "Generic 8-byte raw payload. Detail page: https://www.isobus.net/isobus/pGNAndSPN/16522?type=PGN. Signal-level enrichment via PR welcome  see CONTRIBUTING.md.";
CM_ SG_ 2566814976 Combustion_Time_3_RawPayload "Generic 8-byte raw payload. Detail page: https://www.isobus.net/isobus/pGNAndSPN/16526?type=PGN. Signal-level enrichment via PR welcome  see CONTRIBUTING.md.";
CM_ SG_ 2566815232 Combustion_Time_4_RawPayload "Generic 8-byte raw payload. Detail page: https://www.isobus.net/isobus/pGNAndSPN/16530?type=PGN. Signal-level enrichment via PR welcome  see CONTRIBUTING.md.";
CM_ SG_ 2566815488 Combustion_Time_5_RawPayload "Generic 8-byte raw payload. Detail page: https://www.isobus.net/isobus/pGNAndSPN/16534?type=PGN. Signal-level enrichment via PR welcome  see CONTRIBUTING.md.";
CM_ SG_ 2566815744 Combustion_Time_6_RawPayload "Generic 8-byte raw payload. Detail page: https://www.isobus.net/isobus/pGNAndSPN/16536?type=PGN. Signal-level enrichment via PR welcome  see CONTRIBUTING.md.";
CM_ SG_ 2566816000 Fuel_Information_2_Gaseous_RawPa "Generic 8-byte raw payload. Detail page: https://www.isobus.net/isobus/pGNAndSPN/16542?type=PGN. Signal-level enrichment via PR welcome  see CONTRIBUTING.md.";
CM_ SG_ 2566816256 Ignition_Timing_1_RawPayload "Generic 8-byte raw payload. Detail page: https://www.isobus.net/isobus/pGNAndSPN/16546?type=PGN. Signal-level enrichment via PR welcome  see CONTRIBUTING.md.";
CM_ SG_ 2566816512 Ignition_Timing_2_RawPayload "Generic 8-byte raw payload. Detail page: https://www.isobus.net/isobus/pGNAndSPN/16550?type=PGN. Signal-level enrichment via PR welcome  see CONTRIBUTING.md.";
CM_ SG_ 2566816768 Ignition_Timing_3_RawPayload "Generic 8-byte raw payload. Detail page: https://www.isobus.net/isobus/pGNAndSPN/16554?type=PGN. Signal-level enrichment via PR welcome  see CONTRIBUTING.md.";
CM_ SG_ 2566817024 Ignition_Timing_4_RawPayload "Generic 8-byte raw payload. Detail page: https://www.isobus.net/isobus/pGNAndSPN/16558?type=PGN. Signal-level enrichment via PR welcome  see CONTRIBUTING.md.";
CM_ SG_ 2566817280 Ignition_Timing_5_RawPayload "Generic 8-byte raw payload. Detail page: https://www.isobus.net/isobus/pGNAndSPN/16562?type=PGN. Signal-level enrichment via PR welcome  see CONTRIBUTING.md.";
CM_ SG_ 2566817536 Ignition_Timing_6_RawPayload "Generic 8-byte raw payload. Detail page: https://www.isobus.net/isobus/pGNAndSPN/16566?type=PGN. Signal-level enrichment via PR welcome  see CONTRIBUTING.md.";
CM_ SG_ 2566817792 Ignition_Transformer_Secondary_O "Generic 8-byte raw payload. Detail page: https://www.isobus.net/isobus/pGNAndSPN/16574?type=PGN. Signal-level enrichment via PR welcome  see CONTRIBUTING.md.";
CM_ SG_ 2566818048 Ignition_Transformer_Secondary_O "Generic 8-byte raw payload. Detail page: https://www.isobus.net/isobus/pGNAndSPN/16582?type=PGN. Signal-level enrichment via PR welcome  see CONTRIBUTING.md.";
CM_ SG_ 2566818304 Ignition_Transformer_Secondary_O "Generic 8-byte raw payload. Detail page: https://www.isobus.net/isobus/pGNAndSPN/16586?type=PGN. Signal-level enrichment via PR welcome  see CONTRIBUTING.md.";
CM_ SG_ 2566818560 Gaseous_Fuel_Pressure_1_RawPaylo "Generic 8-byte raw payload. Detail page: https://www.isobus.net/isobus/pGNAndSPN/16590?type=PGN. Signal-level enrichment via PR welcome  see CONTRIBUTING.md.";
CM_ SG_ 2566818816 Auxiliary_Analog_Information_Raw "Generic 8-byte raw payload. Detail page: https://www.isobus.net/isobus/pGNAndSPN/16597?type=PGN. Signal-level enrichment via PR welcome  see CONTRIBUTING.md.";
CM_ SG_ 2566819072 Vehicle_Electrical_Power_2_RawPa "Generic 8-byte raw payload. Detail page: https://www.isobus.net/isobus/pGNAndSPN/16601?type=PGN. Signal-level enrichment via PR welcome  see CONTRIBUTING.md.";
CM_ SG_ 2566819328 Service_2_RawPayload "Generic 8-byte raw payload. Detail page: https://www.isobus.net/isobus/pGNAndSPN/16603?type=PGN. Signal-level enrichment via PR welcome  see CONTRIBUTING.md.";
CM_ SG_ 2566819584 Supply_Pressure_2_RawPayload "Generic 8-byte raw payload. Detail page: https://www.isobus.net/isobus/pGNAndSPN/16604?type=PGN. Signal-level enrichment via PR welcome  see CONTRIBUTING.md.";
CM_ SG_ 2566819840 Engine_Torque_History_RawPayload "Generic 8-byte raw payload. Detail page: https://www.isobus.net/isobus/pGNAndSPN/16623?type=PGN. Signal-level enrichment via PR welcome  see CONTRIBUTING.md.";
CM_ SG_ 2566820096 Fuel_Leakage_RawPayload "Generic 8-byte raw payload. Detail page: https://www.isobus.net/isobus/pGNAndSPN/16626?type=PGN. Signal-level enrichment via PR welcome  see CONTRIBUTING.md.";
CM_ SG_ 2566820352 Engine_Information_1_RawPayload "Generic 8-byte raw payload. Detail page: https://www.isobus.net/isobus/pGNAndSPN/16631?type=PGN. Signal-level enrichment via PR welcome  see CONTRIBUTING.md.";
CM_ SG_ 2566820608 Engine_Electrical_System_Module_ "Generic 8-byte raw payload. Detail page: https://www.isobus.net/isobus/pGNAndSPN/16634?type=PGN. Signal-level enrichment via PR welcome  see CONTRIBUTING.md.";
CM_ SG_ 2566820864 Engine_Auxiliary_Coolant_RawPayl "Generic 8-byte raw payload. Detail page: https://www.isobus.net/isobus/pGNAndSPN/16642?type=PGN. Signal-level enrichment via PR welcome  see CONTRIBUTING.md.";
CM_ SG_ 2566821120 Rebuild_Information_RawPayload "Generic 8-byte raw payload. Detail page: https://www.isobus.net/isobus/pGNAndSPN/16643?type=PGN. Signal-level enrichment via PR welcome  see CONTRIBUTING.md.";
CM_ SG_ 2566821376 Turbocharger_Wastegate_RawPayloa "Generic 8-byte raw payload. Detail page: https://www.isobus.net/isobus/pGNAndSPN/16652?type=PGN. Signal-level enrichment via PR welcome  see CONTRIBUTING.md.";
CM_ SG_ 2566821632 Turbocharger_Information_5_RawPa "Generic 8-byte raw payload. Detail page: https://www.isobus.net/isobus/pGNAndSPN/16656?type=PGN. Signal-level enrichment via PR welcome  see CONTRIBUTING.md.";
CM_ SG_ 2566821888 Turbocharger_Information_4_RawPa "Generic 8-byte raw payload. Detail page: https://www.isobus.net/isobus/pGNAndSPN/16660?type=PGN. Signal-level enrichment via PR welcome  see CONTRIBUTING.md.";
CM_ SG_ 2566822144 Turbocharger_Information_3_RawPa "Generic 8-byte raw payload. Detail page: https://www.isobus.net/isobus/pGNAndSPN/16664?type=PGN. Signal-level enrichment via PR welcome  see CONTRIBUTING.md.";
CM_ SG_ 2566822400 Turbocharger_Information_2_RawPa "Generic 8-byte raw payload. Detail page: https://www.isobus.net/isobus/pGNAndSPN/16668?type=PGN. Signal-level enrichment via PR welcome  see CONTRIBUTING.md.";
CM_ SG_ 2566822656 Turbocharger_Information_1_RawPa "Generic 8-byte raw payload. Detail page: https://www.isobus.net/isobus/pGNAndSPN/16672?type=PGN. Signal-level enrichment via PR welcome  see CONTRIBUTING.md.";
CM_ SG_ 2566822912 Main_Bearing_Temperature_3_RawPa "Generic 8-byte raw payload. Detail page: https://www.isobus.net/isobus/pGNAndSPN/16676?type=PGN. Signal-level enrichment via PR welcome  see CONTRIBUTING.md.";
CM_ SG_ 2566823168 Main_Bearing_Temperature_2_RawPa "Generic 8-byte raw payload. Detail page: https://www.isobus.net/isobus/pGNAndSPN/16680?type=PGN. Signal-level enrichment via PR welcome  see CONTRIBUTING.md.";
CM_ SG_ 2566823424 Main_Bearing_Temperature_1_RawPa "Generic 8-byte raw payload. Detail page: https://www.isobus.net/isobus/pGNAndSPN/16684?type=PGN. Signal-level enrichment via PR welcome  see CONTRIBUTING.md.";
CM_ SG_ 2566823680 Exhaust_Port_Temperature_5_RawPa "Generic 8-byte raw payload. Detail page: https://www.isobus.net/isobus/pGNAndSPN/16688?type=PGN. Signal-level enrichment via PR welcome  see CONTRIBUTING.md.";
CM_ SG_ 2566823936 Exhaust_Port_Temperature_4_RawPa "Generic 8-byte raw payload. Detail page: https://www.isobus.net/isobus/pGNAndSPN/16692?type=PGN. Signal-level enrichment via PR welcome  see CONTRIBUTING.md.";
CM_ SG_ 2566824192 Exhaust_Port_Temperature_3_RawPa "Generic 8-byte raw payload. Detail page: https://www.isobus.net/isobus/pGNAndSPN/16696?type=PGN. Signal-level enrichment via PR welcome  see CONTRIBUTING.md.";
CM_ SG_ 2566824448 Exhaust_Port_Temperature_2_RawPa "Generic 8-byte raw payload. Detail page: https://www.isobus.net/isobus/pGNAndSPN/16700?type=PGN. Signal-level enrichment via PR welcome  see CONTRIBUTING.md.";
CM_ SG_ 2566824704 Exhaust_Port_Temperature_1_RawPa "Generic 8-byte raw payload. Detail page: https://www.isobus.net/isobus/pGNAndSPN/16704?type=PGN. Signal-level enrichment via PR welcome  see CONTRIBUTING.md.";
CM_ SG_ 2566824960 Engine_Temperature_2_RawPayload "Generic 8-byte raw payload. Detail page: https://www.isobus.net/isobus/pGNAndSPN/16708?type=PGN. Signal-level enrichment via PR welcome  see CONTRIBUTING.md.";
CM_ SG_ 2566825216 Intake_Manifold_Information_2_Ra "Generic 8-byte raw payload. Detail page: https://www.isobus.net/isobus/pGNAndSPN/16715?type=PGN. Signal-level enrichment via PR welcome  see CONTRIBUTING.md.";
CM_ SG_ 2566825472 Intake_Manifold_Information_1_Ra "Generic 8-byte raw payload. Detail page: https://www.isobus.net/isobus/pGNAndSPN/16719?type=PGN. Signal-level enrichment via PR welcome  see CONTRIBUTING.md.";
CM_ SG_ 2566825728 Alternator_Temperature_1_RawPayl "Generic 8-byte raw payload. Detail page: https://www.isobus.net/isobus/pGNAndSPN/16727?type=PGN. Signal-level enrichment via PR welcome  see CONTRIBUTING.md.";
CM_ SG_ 2566825984 Articulation_Control_RawPayload "Generic 8-byte raw payload. Detail page: https://www.isobus.net/isobus/pGNAndSPN/16729?type=PGN. Signal-level enrichment via PR welcome  see CONTRIBUTING.md.";
CM_ SG_ 2566826240 Exhaust_Oxygen_1_RawPayload "Generic 8-byte raw payload. Detail page: https://www.isobus.net/isobus/pGNAndSPN/16734?type=PGN. Signal-level enrichment via PR welcome  see CONTRIBUTING.md.";
CM_ SG_ 2566826496 Alternate_Fuel_2_RawPayload "Generic 8-byte raw payload. Detail page: https://www.isobus.net/isobus/pGNAndSPN/16739?type=PGN. Signal-level enrichment via PR welcome  see CONTRIBUTING.md.";
CM_ SG_ 2566826752 Electronic_Transmission_Controll "Generic 8-byte raw payload. Detail page: https://www.isobus.net/isobus/pGNAndSPN/16743?type=PGN. Signal-level enrichment via PR welcome  see CONTRIBUTING.md.";
CM_ SG_ 2566827008 Wheel_Brake_Lining_Remaining_Inf "Generic 8-byte raw payload. Detail page: https://www.isobus.net/isobus/pGNAndSPN/16751?type=PGN. Signal-level enrichment via PR welcome  see CONTRIBUTING.md.";
CM_ SG_ 2566827264 Wheel_Application_Pressure_High_ "Generic 8-byte raw payload. Detail page: https://www.isobus.net/isobus/pGNAndSPN/16759?type=PGN. Signal-level enrichment via PR welcome  see CONTRIBUTING.md.";
CM_ SG_ 2566827520 Air_Supply_Pressure_RawPayload "Generic 8-byte raw payload. Detail page: https://www.isobus.net/isobus/pGNAndSPN/16767?type=PGN. Signal-level enrichment via PR welcome  see CONTRIBUTING.md.";
CM_ SG_ 2566827776 Fuel_Consumption_Gaseous_RawPayl "Generic 8-byte raw payload. Detail page: https://www.isobus.net/isobus/pGNAndSPN/16769?type=PGN. Signal-level enrichment via PR welcome  see CONTRIBUTING.md.";
CM_ SG_ 2566828032 Trip_Time_Information_2_RawPaylo "Generic 8-byte raw payload. Detail page: https://www.isobus.net/isobus/pGNAndSPN/16774?type=PGN. Signal-level enrichment via PR welcome  see CONTRIBUTING.md.";
CM_ SG_ 2566828288 ECU_History_RawPayload "Generic 8-byte raw payload. Detail page: https://www.isobus.net/isobus/pGNAndSPN/16776?type=PGN. Signal-level enrichment via PR welcome  see CONTRIBUTING.md.";
CM_ SG_ 2566828544 Fuel_Information_1_Gaseous_RawPa "Generic 8-byte raw payload. Detail page: https://www.isobus.net/isobus/pGNAndSPN/16779?type=PGN. Signal-level enrichment via PR welcome  see CONTRIBUTING.md.";
CM_ SG_ 2566828800 Fuel_Information_1_Liquid_RawPay "Generic 8-byte raw payload. Detail page: https://www.isobus.net/isobus/pGNAndSPN/16782?type=PGN. Signal-level enrichment via PR welcome  see CONTRIBUTING.md.";
CM_ SG_ 2566829056 Trip_Time_Information_1_RawPaylo "Generic 8-byte raw payload. Detail page: https://www.isobus.net/isobus/pGNAndSPN/16786?type=PGN. Signal-level enrichment via PR welcome  see CONTRIBUTING.md.";
CM_ SG_ 2566829312 Trip_Shutdown_Information_RawPay "Generic 8-byte raw payload. Detail page: https://www.isobus.net/isobus/pGNAndSPN/16790?type=PGN. Signal-level enrichment via PR welcome  see CONTRIBUTING.md.";
CM_ SG_ 2566829568 Trip_Vehicle_Speed_Cruise_Distan "Generic 8-byte raw payload. Detail page: https://www.isobus.net/isobus/pGNAndSPN/16792?type=PGN. Signal-level enrichment via PR welcome  see CONTRIBUTING.md.";
CM_ SG_ 2566829824 Engine_Speed_Load_Factor_Informa "Generic 8-byte raw payload. Detail page: https://www.isobus.net/isobus/pGNAndSPN/16797?type=PGN. Signal-level enrichment via PR welcome  see CONTRIBUTING.md.";
CM_ SG_ 2566830080 Trip_Fuel_Information_Gaseous_Ra "Generic 8-byte raw payload. Detail page: https://www.isobus.net/isobus/pGNAndSPN/16803?type=PGN. Signal-level enrichment via PR welcome  see CONTRIBUTING.md.";
CM_ SG_ 2566830336 Trip_Fuel_Information_Liquid_Raw "Generic 8-byte raw payload. Detail page: https://www.isobus.net/isobus/pGNAndSPN/16809?type=PGN. Signal-level enrichment via PR welcome  see CONTRIBUTING.md.";
CM_ SG_ 2566830592 Trip_Distance_Information_RawPay "Generic 8-byte raw payload. Detail page: https://www.isobus.net/isobus/pGNAndSPN/16812?type=PGN. Signal-level enrichment via PR welcome  see CONTRIBUTING.md.";
CM_ SG_ 2566830848 Trip_Fan_Information_RawPayload "Generic 8-byte raw payload. Detail page: https://www.isobus.net/isobus/pGNAndSPN/16816?type=PGN. Signal-level enrichment via PR welcome  see CONTRIBUTING.md.";
CM_ SG_ 2566831104 Compression_Service_Brake_Inform "Generic 8-byte raw payload. Detail page: https://www.isobus.net/isobus/pGNAndSPN/16820?type=PGN. Signal-level enrichment via PR welcome  see CONTRIBUTING.md.";
CM_ SG_ 2566831360 Fan_Drive_1_RawPayload "Generic 8-byte raw payload. Detail page: https://www.isobus.net/isobus/pGNAndSPN/16827?type=PGN. Signal-level enrichment via PR welcome  see CONTRIBUTING.md.";
CM_ SG_ 2566831616 Electronic_Engine_Controller_4_R "Generic 8-byte raw payload. Detail page: https://www.isobus.net/isobus/pGNAndSPN/16833?type=PGN. Signal-level enrichment via PR welcome  see CONTRIBUTING.md.";
CM_ SG_ 2566831872 Wheel_Speed_Information_RawPaylo "Generic 8-byte raw payload. Detail page: https://www.isobus.net/isobus/pGNAndSPN/16840?type=PGN. Signal-level enrichment via PR welcome  see CONTRIBUTING.md.";
CM_ SG_ 2566832128 Service_Information_RawPayload "Generic 8-byte raw payload. Detail page: https://www.isobus.net/isobus/pGNAndSPN/16846?type=PGN. Signal-level enrichment via PR welcome  see CONTRIBUTING.md.";
CM_ SG_ 2566832640 Electronic_Retarder_Controller_2 "Generic 8-byte raw payload. Detail page: https://www.isobus.net/isobus/pGNAndSPN/16856?type=PGN. Signal-level enrichment via PR welcome  see CONTRIBUTING.md.";
CM_ SG_ 2566832896 Electronic_Transmission_Controll "Generic 8-byte raw payload. Detail page: https://www.isobus.net/isobus/pGNAndSPN/16862?type=PGN. Signal-level enrichment via PR welcome  see CONTRIBUTING.md.";
CM_ SG_ 2566833152 Electronic_Brake_System_2_2_RawP "Generic 8-byte raw payload. Detail page: https://www.isobus.net/isobus/pGNAndSPN/16863?type=PGN. Signal-level enrichment via PR welcome  see CONTRIBUTING.md.";
CM_ SG_ 2566833408 Electronic_Transmission_Controll "Generic 8-byte raw payload. Detail page: https://www.isobus.net/isobus/pGNAndSPN/16865?type=PGN. Signal-level enrichment via PR welcome  see CONTRIBUTING.md.";
CM_ SG_ 2566833664 Electronic_Brake_System_2_3_RawP "Generic 8-byte raw payload. Detail page: https://www.isobus.net/isobus/pGNAndSPN/16866?type=PGN. Signal-level enrichment via PR welcome  see CONTRIBUTING.md.";
CM_ SG_ 2566833920 Electronic_Transmission_Controll "Generic 8-byte raw payload. Detail page: https://www.isobus.net/isobus/pGNAndSPN/16883?type=PGN. Signal-level enrichment via PR welcome  see CONTRIBUTING.md.";
CM_ SG_ 2566834176 General_Purpose_Message_2_2_RawP "Generic 8-byte raw payload. Detail page: https://www.isobus.net/isobus/pGNAndSPN/16884?type=PGN. Signal-level enrichment via PR welcome  see CONTRIBUTING.md.";
CM_ SG_ 2566834432 Electronic_Brake_System_1_2_RawP "Generic 8-byte raw payload. Detail page: https://www.isobus.net/isobus/pGNAndSPN/16885?type=PGN. Signal-level enrichment via PR welcome  see CONTRIBUTING.md.";
CM_ SG_ 2566835456 Freeze_Frame_Parameters_RawPaylo "Generic 8-byte raw payload. Detail page: https://www.isobus.net/isobus/pGNAndSPN/16900?type=PGN. Signal-level enrichment via PR welcome  see CONTRIBUTING.md.";
CM_ SG_ 2566835712 Diagnostic_Readiness_1_RawPayloa "Generic 8-byte raw payload. Detail page: https://www.isobus.net/isobus/pGNAndSPN/16906?type=PGN. Signal-level enrichment via PR welcome  see CONTRIBUTING.md.";
CM_ SG_ 2566835968 Emission_Related_Pending_Diagnos "Generic 8-byte raw payload. Detail page: https://www.isobus.net/isobus/pGNAndSPN/16918?type=PGN. Signal-level enrichment via PR welcome  see CONTRIBUTING.md.";
CM_ SG_ 2566836224 Test_Results_for_Non_continuousl "Generic 8-byte raw payload. Detail page: https://www.isobus.net/isobus/pGNAndSPN/16923?type=PGN. Signal-level enrichment via PR welcome  see CONTRIBUTING.md.";
CM_ SG_ 2566836480 Oxygen_Sensor_Test_Results_RawPa "Generic 8-byte raw payload. Detail page: https://www.isobus.net/isobus/pGNAndSPN/16924?type=PGN. Signal-level enrichment via PR welcome  see CONTRIBUTING.md.";
CM_ SG_ 2566836736 Non_Continuously_Monitored_Syste "Generic 8-byte raw payload. Detail page: https://www.isobus.net/isobus/pGNAndSPN/16925?type=PGN. Signal-level enrichment via PR welcome  see CONTRIBUTING.md.";
CM_ SG_ 2566837248 Emission_Related_MIL_On_Diagnost "Generic 8-byte raw payload. Detail page: https://www.isobus.net/isobus/pGNAndSPN/16938?type=PGN. Signal-level enrichment via PR welcome  see CONTRIBUTING.md.";
CM_ SG_ 2566837504 Alternator_Information_1_RawPayl "Generic 8-byte raw payload. Detail page: https://www.isobus.net/isobus/pGNAndSPN/16950?type=PGN. Signal-level enrichment via PR welcome  see CONTRIBUTING.md.";
CM_ SG_ 2566837760 Hybrid_or_EV_System_Inputs_1_Raw "Generic 8-byte raw payload. Detail page: https://www.isobus.net/isobus/pGNAndSPN/16966?type=PGN. Signal-level enrichment via PR welcome  see CONTRIBUTING.md.";
CM_ SG_ 2566838528 Auxiliary_Input_Output_Status_1_ "Generic 8-byte raw payload. Detail page: https://www.isobus.net/isobus/pGNAndSPN/16986?type=PGN. Signal-level enrichment via PR welcome  see CONTRIBUTING.md.";
CM_ SG_ 2566839040 Engine_Fluid_Level_Pressure_2_Ra "Generic 8-byte raw payload. Detail page: https://www.isobus.net/isobus/pGNAndSPN/16992?type=PGN. Signal-level enrichment via PR welcome  see CONTRIBUTING.md.";
CM_ SG_ 2566839296 Idle_Operation_RawPayload "Generic 8-byte raw payload. Detail page: https://www.isobus.net/isobus/pGNAndSPN/16994?type=PGN. Signal-level enrichment via PR welcome  see CONTRIBUTING.md.";
CM_ SG_ 2566839552 Turbocharger_RawPayload "Generic 8-byte raw payload. Detail page: https://www.isobus.net/isobus/pGNAndSPN/16998?type=PGN. Signal-level enrichment via PR welcome  see CONTRIBUTING.md.";
CM_ SG_ 2566839808 Engine_Air_Start_Pressure_RawPay "Generic 8-byte raw payload. Detail page: https://www.isobus.net/isobus/pGNAndSPN/17001?type=PGN. Signal-level enrichment via PR welcome  see CONTRIBUTING.md.";
CM_ SG_ 2566840320 Vehicle_Distance_RawPayload "Generic 8-byte raw payload. Detail page: https://www.isobus.net/isobus/pGNAndSPN/17012?type=PGN. Signal-level enrichment via PR welcome  see CONTRIBUTING.md.";
CM_ SG_ 2566840576 Retarder_Configuration_RawPayloa "Generic 8-byte raw payload. Detail page: https://www.isobus.net/isobus/pGNAndSPN/17026?type=PGN. Signal-level enrichment via PR welcome  see CONTRIBUTING.md.";
CM_ SG_ 2566840832 Transmission_Configuration_RawPa "Generic 8-byte raw payload. Detail page: https://www.isobus.net/isobus/pGNAndSPN/17029?type=PGN. Signal-level enrichment via PR welcome  see CONTRIBUTING.md.";
CM_ SG_ 2566841344 Shutdown_RawPayload "Generic 8-byte raw payload. Detail page: https://www.isobus.net/isobus/pGNAndSPN/17081?type=PGN. Signal-level enrichment via PR welcome  see CONTRIBUTING.md.";
CM_ SG_ 2566842112 Vehicle_Hours_RawPayload "Generic 8-byte raw payload. Detail page: https://www.isobus.net/isobus/pGNAndSPN/17093?type=PGN. Signal-level enrichment via PR welcome  see CONTRIBUTING.md.";
CM_ SG_ 2566842368 Vehicle_Direction_Speed_RawPaylo "Generic 8-byte raw payload. Detail page: https://www.isobus.net/isobus/pGNAndSPN/17097?type=PGN. Signal-level enrichment via PR welcome  see CONTRIBUTING.md.";

BA_DEF_ BO_ "SystemMessageLongSymbol" STRING;
BA_DEF_ SG_ "SystemSignalLongSymbol" STRING;
BA_ "SystemMessageLongSymbol" BO_ 2566746368 "VDMA_FD71_Brake_actuator_stroke_status";
BA_ "SystemMessageLongSymbol" BO_ 2566748160 "VDMA_FD78_Aftertreatment_2_Trip_Informatio";
BA_ "SystemMessageLongSymbol" BO_ 2566748416 "VDMA_FD79_Aftertreatment_1_Trip_Informatio";
BA_ "SystemMessageLongSymbol" BO_ 2566748672 "VDMA_FD7A_Aftertreatment_2_Service_1";
BA_ "SystemMessageLongSymbol" BO_ 2566748928 "VDMA_FD7B_Aftertreatment_1_Service_1";
BA_ "SystemMessageLongSymbol" BO_ 2566749696 "VDMA_FD7E_Adaptive_Front_Lighting_System_S";
BA_ "SystemMessageLongSymbol" BO_ 2566750208 "VDMA_FD80_Emission_Related_Permanent_Diagn";
BA_ "SystemMessageLongSymbol" BO_ 2566750976 "VDMA_FD83_Transfer_Case_Information";
BA_ "SystemMessageLongSymbol" BO_ 2566751232 "VDMA_FD84_Engine_Fluid_Level_Pressure_9";
BA_ "SystemMessageLongSymbol" BO_ 2566751488 "VDMA_FD85_Engine_Fluid_Level_Pressure_8";
BA_ "SystemMessageLongSymbol" BO_ 2566751744 "VDMA_FD86_Engine_Fluid_Level_Pressure_7";
BA_ "SystemMessageLongSymbol" BO_ 2566752000 "VDMA_FD87_Engine_Fluid_Level_Pressure_6";
BA_ "SystemMessageLongSymbol" BO_ 2566752256 "VDMA_FD88_Engine_Fluid_Level_Pressure_5";
BA_ "SystemMessageLongSymbol" BO_ 2566752512 "VDMA_FD89_Vehicle_Direction_Speed_2";
BA_ "SystemMessageLongSymbol" BO_ 2566752768 "VDMA_FD8A_SAE_J2012_2_Byte_DTC_Display";
BA_ "SystemMessageLongSymbol" BO_ 2566753024 "VDMA_FD8B_Aftertreatment_2_Gas_Parameters";
BA_ "SystemMessageLongSymbol" BO_ 2566753280 "VDMA_FD8C_Aftertreatment_1_Gas_Parameters";
BA_ "SystemMessageLongSymbol" BO_ 2566753536 "VDMA_FD8D_Utility_Total_AC_Reactive_Energy";
BA_ "SystemMessageLongSymbol" BO_ 2566753792 "VDMA_FD8E_Generator_Total_AC_Reactive_Ener";
BA_ "SystemMessageLongSymbol" BO_ 2566754048 "VDMA_FD8F_Generator_Total_AC_Percent_Power";
BA_ "SystemMessageLongSymbol" BO_ 2566754304 "VDMA_FD90_Advertised_Engine_Torque_Curve";
BA_ "SystemMessageLongSymbol" BO_ 2566754560 "VDMA_FD91_AC_Switching_Device_Status";
BA_ "SystemMessageLongSymbol" BO_ 2566754816 "VDMA_FD92_Engine_Operating_Information";
BA_ "SystemMessageLongSymbol" BO_ 2566755328 "VDMA_FD94_Electronic_Engine_Controller_7";
BA_ "SystemMessageLongSymbol" BO_ 2566755840 "VDMA_FD96_Fuel_Information_2_Liquid";
BA_ "SystemMessageLongSymbol" BO_ 2566756096 "VDMA_FD97_Fuel_Information_3_Liquid";
BA_ "SystemMessageLongSymbol" BO_ 2566756352 "VDMA_FD98_Aftertreatment_1_Historical_Info";
BA_ "SystemMessageLongSymbol" BO_ 2566756608 "VDMA_FD99_Aftertreatment_2_Historical_info";
BA_ "SystemMessageLongSymbol" BO_ 2566756864 "VDMA_FD9A_Electronic_Brake_System_2_4";
BA_ "SystemMessageLongSymbol" BO_ 2566757120 "VDMA_FD9B_Aftertreatment_1_Diesel_Exhaust_";
BA_ "SystemMessageLongSymbol" BO_ 2566757376 "VDMA_FD9C_Sensor_Electrical_Power_2";
BA_ "SystemMessageLongSymbol" BO_ 2566757632 "VDMA_FD9D_Sensor_Electrical_Power_1";
BA_ "SystemMessageLongSymbol" BO_ 2566757888 "VDMA_FD9E_Aftertreatment_2_Air_Control_1";
BA_ "SystemMessageLongSymbol" BO_ 2566758144 "VDMA_FD9F_Aftertreatment_1_Air_Control_1";
BA_ "SystemMessageLongSymbol" BO_ 2566758400 "VDMA_FDA0_Aftertreatment_2_Fuel_Control_1";
BA_ "SystemMessageLongSymbol" BO_ 2566758656 "VDMA_FDA1_Aftertreatment_1_Fuel_Control_1";
BA_ "SystemMessageLongSymbol" BO_ 2566758912 "VDMA_FDA2_Fuel_Information_3_Gaseous";
BA_ "SystemMessageLongSymbol" BO_ 2566759168 "VDMA_FDA3_Electronic_Engine_Controller_6";
BA_ "SystemMessageLongSymbol" BO_ 2566759936 "VDMA_FDA6_Voltage_Regulator_Excitation_Sta";
BA_ "SystemMessageLongSymbol" BO_ 2566760192 "VDMA_FDA7_Voltage_Regulator_Operating_Mode";
BA_ "SystemMessageLongSymbol" BO_ 2566760448 "VDMA_FDA8_Wireless_Communications_Message_";
BA_ "SystemMessageLongSymbol" BO_ 2566760704 "VDMA_FDA9_Wireless_Communications_Message_";
BA_ "SystemMessageLongSymbol" BO_ 2566760960 "VDMA_FDAA_Engine_Fluid_Level_Pressure_4";
BA_ "SystemMessageLongSymbol" BO_ 2566761216 "VDMA_FDAB_Request_For_Complete_Configurabl";
BA_ "SystemMessageLongSymbol" BO_ 2566761472 "VDMA_FDAC_Engine_Fuel_Information";
BA_ "SystemMessageLongSymbol" BO_ 2566761728 "VDMA_FDAD_Request_For_Complete_Configurabl";
BA_ "SystemMessageLongSymbol" BO_ 2566761984 "VDMA_FDAE_Fifth_Wheel_Smart_Systems_2";
BA_ "SystemMessageLongSymbol" BO_ 2566762240 "VDMA_FDAF_Aftertreatment_2_Intermediate_Ga";
BA_ "SystemMessageLongSymbol" BO_ 2566762496 "VDMA_FDB0_Aftertreatment_2_Outlet_Gas_2";
BA_ "SystemMessageLongSymbol" BO_ 2566762752 "VDMA_FDB1_Aftertreatment_2_Intake_Gas_2";
BA_ "SystemMessageLongSymbol" BO_ 2566763008 "VDMA_FDB2_Aftertreatment_1_Intermediate_Ga";
BA_ "SystemMessageLongSymbol" BO_ 2566763264 "VDMA_FDB3_Aftertreatment_1_Outlet_Gas_2";
BA_ "SystemMessageLongSymbol" BO_ 2566763520 "VDMA_FDB4_Aftertreatment_1_Intake_Gas_2";
BA_ "SystemMessageLongSymbol" BO_ 2566763776 "VDMA_FDB5_Emission_Related_Previously_MIL_";
BA_ "SystemMessageLongSymbol" BO_ 2566764800 "VDMA_FDB9_Tire_Pressure_Reference_Informat";
BA_ "SystemMessageLongSymbol" BO_ 2566766848 "VDMA_FDC1_Engine_Fluid_Level_Pressure_3";
BA_ "SystemMessageLongSymbol" BO_ 2566767104 "VDMA_FDC2_Electronic_Engine_Controller_14";
BA_ "SystemMessageLongSymbol" BO_ 2566767360 "VDMA_FDC3_Electronic_Engine_Controller_15";
BA_ "SystemMessageLongSymbol" BO_ 2566767616 "VDMA_FDC4_Electronic_Brake_Controller_5";
BA_ "SystemMessageLongSymbol" BO_ 2566768384 "VDMA_FDC7_Off_Highway_Engine_Control_Selec";
BA_ "SystemMessageLongSymbol" BO_ 2566768640 "VDMA_FDC8_Operator_Primary_Intermediate_Sp";
BA_ "SystemMessageLongSymbol" BO_ 2566768896 "VDMA_FDC9_Electronic_Control_Module_Inform";
BA_ "SystemMessageLongSymbol" BO_ 2566769152 "VDMA_FDCA_Intermediate_Speed_Control";
BA_ "SystemMessageLongSymbol" BO_ 2566769408 "VDMA_FDCB_Off_Highway_Engine_Control_Selec";
BA_ "SystemMessageLongSymbol" BO_ 2566769664 "VDMA_FDCC_Operators_External_Light_Control";
BA_ "SystemMessageLongSymbol" BO_ 2566769920 "VDMA_FDCD_Operator_Wiper_and_Washer_Contro";
BA_ "SystemMessageLongSymbol" BO_ 2566770176 "VDMA_FDCE_Working_Set_Member_Message_Obsol";
BA_ "SystemMessageLongSymbol" BO_ 2566770432 "VDMA_FDCF_Working_Set_Master_Message_Obsol";
BA_ "SystemMessageLongSymbol" BO_ 2566770688 "VDMA_FDD0_Intake_Exhaust_Conditions_2";
BA_ "SystemMessageLongSymbol" BO_ 2566770944 "VDMA_FDD1_FMS_standard_Interface_Identity_";
BA_ "SystemMessageLongSymbol" BO_ 2566771456 "VDMA_FDD3_Turbocharger_Information_6";
BA_ "SystemMessageLongSymbol" BO_ 2566771968 "VDMA_FDD5_Electronic_Engine_Controller_5";
BA_ "SystemMessageLongSymbol" BO_ 2566772224 "VDMA_FDD6_Basic_Joystick_Message_1";
BA_ "SystemMessageLongSymbol" BO_ 2566772480 "VDMA_FDD7_Extended_Joystick_Message_1";
BA_ "SystemMessageLongSymbol" BO_ 2566772736 "VDMA_FDD8_Basic_Joystick_Message_2";
BA_ "SystemMessageLongSymbol" BO_ 2566772992 "VDMA_FDD9_Extended_Joystick_Message_2";
BA_ "SystemMessageLongSymbol" BO_ 2566773248 "VDMA_FDDA_Basic_Joystick_Message_3";
BA_ "SystemMessageLongSymbol" BO_ 2566773504 "VDMA_FDDB_Extended_Joystick_Message_3";
BA_ "SystemMessageLongSymbol" BO_ 2566773760 "VDMA_FDDC_Marine_Control_Information";
BA_ "SystemMessageLongSymbol" BO_ 2566774016 "VDMA_FDDD_Military_Application_Message_1_1";
BA_ "SystemMessageLongSymbol" BO_ 2566774272 "VDMA_FDDE_Military_Application_Message_2_1";
BA_ "SystemMessageLongSymbol" BO_ 2566774528 "VDMA_FDDF_Front_Wheel_Drive_Status";
BA_ "SystemMessageLongSymbol" BO_ 2566775040 "VDMA_FDE1_Cab_Climate_System_Information_1";
BA_ "SystemMessageLongSymbol" BO_ 2566775552 "VDMA_FDE3_Equipment_Operation_and_Control";
BA_ "SystemMessageLongSymbol" BO_ 2566775808 "VDMA_FDE4_Equipment_Performance_Data";
BA_ "SystemMessageLongSymbol" BO_ 2566776064 "VDMA_FDE5_Maximum_Vehicle_Speed_Limit_Stat";
BA_ "SystemMessageLongSymbol" BO_ 2566776320 "VDMA_FDE6_Hydraulic_Braking_System";
BA_ "SystemMessageLongSymbol" BO_ 2566776576 "VDMA_FDE7_Bus_1_Utility_Sync_Check_Status";
BA_ "SystemMessageLongSymbol" BO_ 2566776832 "VDMA_FDE8_Bus_1_Generator_Sync_Check_Statu";
BA_ "SystemMessageLongSymbol" BO_ 2566777088 "VDMA_FDE9_Bus_1_Phase_C_Basic_AC_Quantitie";
BA_ "SystemMessageLongSymbol" BO_ 2566777344 "VDMA_FDEA_Bus_1_Phase_B_Basic_AC_Quantitie";
BA_ "SystemMessageLongSymbol" BO_ 2566777600 "VDMA_FDEB_Bus_1_Phase_A_Basic_AC_Quantitie";
BA_ "SystemMessageLongSymbol" BO_ 2566777856 "VDMA_FDEC_Bus_1_Average_Basic_AC_Quantitie";
BA_ "SystemMessageLongSymbol" BO_ 2566778112 "VDMA_FDED_Utility_Total_AC_Energy";
BA_ "SystemMessageLongSymbol" BO_ 2566778368 "VDMA_FDEE_Utility_Phase_C_AC_Reactive_Powe";
BA_ "SystemMessageLongSymbol" BO_ 2566778624 "VDMA_FDEF_Utility_Phase_C_AC_Power";
BA_ "SystemMessageLongSymbol" BO_ 2566778880 "VDMA_FDF0_Utility_Phase_C_AC_Basic_Quantit";
BA_ "SystemMessageLongSymbol" BO_ 2566779136 "VDMA_FDF1_Utility_Phase_B_AC_Reactive_Powe";
BA_ "SystemMessageLongSymbol" BO_ 2566779392 "VDMA_FDF2_Utility_Phase_B_AC_Power";
BA_ "SystemMessageLongSymbol" BO_ 2566779648 "VDMA_FDF3_Utility_Phase_B_AC_Basic_Quantit";
BA_ "SystemMessageLongSymbol" BO_ 2566779904 "VDMA_FDF4_Utility_Phase_A_AC_Reactive_Powe";
BA_ "SystemMessageLongSymbol" BO_ 2566780160 "VDMA_FDF5_Utility_Phase_A_AC_Power";
BA_ "SystemMessageLongSymbol" BO_ 2566780416 "VDMA_FDF6_Utility_Phase_A_Basic_AC_Quantit";
BA_ "SystemMessageLongSymbol" BO_ 2566780672 "VDMA_FDF7_Utility_Total_AC_Reactive_Power";
BA_ "SystemMessageLongSymbol" BO_ 2566781184 "VDMA_FDF9_Utility_Average_Basic_AC_Quantit";
BA_ "SystemMessageLongSymbol" BO_ 2566781440 "VDMA_FDFA_Generator_Total_AC_Energy";
BA_ "SystemMessageLongSymbol" BO_ 2566781696 "VDMA_FDFB_Generator_Phase_C_AC_Reactive_Po";
BA_ "SystemMessageLongSymbol" BO_ 2566781952 "VDMA_FDFC_Generator_Phase_C_AC_Power";
BA_ "SystemMessageLongSymbol" BO_ 2566782208 "VDMA_FDFD_Generator_Phase_C_Basic_AC_Quant";
BA_ "SystemMessageLongSymbol" BO_ 2566782464 "VDMA_FDFE_Generator_Phase_B_AC_Reactive_Po";
BA_ "SystemMessageLongSymbol" BO_ 2566782720 "VDMA_FDFF_Generator_Phase_B_AC_Power";
BA_ "SystemMessageLongSymbol" BO_ 2566782976 "VDMA_FE00_Generator_Phase_B_Basic_AC_Quant";
BA_ "SystemMessageLongSymbol" BO_ 2566783232 "VDMA_FE01_Generator_Phase_A_AC_Reactive_Po";
BA_ "SystemMessageLongSymbol" BO_ 2566783488 "VDMA_FE02_Generator_Phase_A_AC_Power";
BA_ "SystemMessageLongSymbol" BO_ 2566783744 "VDMA_FE03_Generator_Phase_A_Basic_AC_Quant";
BA_ "SystemMessageLongSymbol" BO_ 2566784000 "VDMA_FE04_Generator_Total_AC_Reactive_Powe";
BA_ "SystemMessageLongSymbol" BO_ 2566784256 "VDMA_FE05_Generator_Total_AC_Power";
BA_ "SystemMessageLongSymbol" BO_ 2566784512 "VDMA_FE06_Generator_Average_Basic_AC_Quant";
BA_ "SystemMessageLongSymbol" BO_ 2566785024 "VDMA_FE08_Required_Tractor_Facilities_mess";
BA_ "SystemMessageLongSymbol" BO_ 2566785280 "VDMA_FE09_Tractor_Facilities_response_mess";
BA_ "SystemMessageLongSymbol" BO_ 2566785536 "VDMA_FE0A_Tractor_control_command_tractor_";
BA_ "SystemMessageLongSymbol" BO_ 2566785792 "VDMA_FE0B_Tractor_control_mode_command";
BA_ "SystemMessageLongSymbol" BO_ 2566786560 "VDMA_FE0E_Response_for_Repetition_Rate";
BA_ "SystemMessageLongSymbol" BO_ 2566787072 "VDMA_FE10_Auxiliary_valve_0_estimated_flow";
BA_ "SystemMessageLongSymbol" BO_ 2566787328 "VDMA_FE11_Auxiliary_valve_1_estimated_flow";
BA_ "SystemMessageLongSymbol" BO_ 2566787584 "VDMA_FE12_Auxiliary_valve_2_estimated_flow";
BA_ "SystemMessageLongSymbol" BO_ 2566787840 "VDMA_FE13_Auxiliary_valve_3_estimated_flow";
BA_ "SystemMessageLongSymbol" BO_ 2566788096 "VDMA_FE14_Auxiliary_valve_4_estimated_flow";
BA_ "SystemMessageLongSymbol" BO_ 2566788352 "VDMA_FE15_Auxiliary_valve_5_estimated_flow";
BA_ "SystemMessageLongSymbol" BO_ 2566788608 "VDMA_FE16_Auxiliary_valve_6_estimated_flow";
BA_ "SystemMessageLongSymbol" BO_ 2566788864 "VDMA_FE17_Auxiliary_valve_7_estimated_flow";
BA_ "SystemMessageLongSymbol" BO_ 2566789120 "VDMA_FE18_Auxiliary_valve_8_estimated_flow";
BA_ "SystemMessageLongSymbol" BO_ 2566789376 "VDMA_FE19_Auxiliary_valve_9_estimated_flow";
BA_ "SystemMessageLongSymbol" BO_ 2566789632 "VDMA_FE1A_Auxiliary_valve_10_estimated_flo";
BA_ "SystemMessageLongSymbol" BO_ 2566789888 "VDMA_FE1B_Auxiliary_valve_11_estimated_flo";
BA_ "SystemMessageLongSymbol" BO_ 2566790144 "VDMA_FE1C_Auxiliary_valve_12_estimated_flo";
BA_ "SystemMessageLongSymbol" BO_ 2566790400 "VDMA_FE1D_Auxiliary_valve_13_estimated_flo";
BA_ "SystemMessageLongSymbol" BO_ 2566790656 "VDMA_FE1E_Auxiliary_valve_14_estimated_flo";
BA_ "SystemMessageLongSymbol" BO_ 2566790912 "VDMA_FE1F_Auxiliary_valve_15_estimated_flo";
BA_ "SystemMessageLongSymbol" BO_ 2566791168 "VDMA_FE20_Auxiliary_valve_0_measured_flow";
BA_ "SystemMessageLongSymbol" BO_ 2566791424 "VDMA_FE21_Auxiliary_valve_1_measured_flow";
BA_ "SystemMessageLongSymbol" BO_ 2566791680 "VDMA_FE22_Auxiliary_valve_2_measured_flow";
BA_ "SystemMessageLongSymbol" BO_ 2566791936 "VDMA_FE23_Auxiliary_valve_3_measured_flow";
BA_ "SystemMessageLongSymbol" BO_ 2566792192 "VDMA_FE24_Auxiliary_valve_4_measured_flow";
BA_ "SystemMessageLongSymbol" BO_ 2566792448 "VDMA_FE25_Auxiliary_valve_5_measured_flow";
BA_ "SystemMessageLongSymbol" BO_ 2566792704 "VDMA_FE26_Auxiliary_valve_6_measured_flow";
BA_ "SystemMessageLongSymbol" BO_ 2566792960 "VDMA_FE27_Auxiliary_valve_7_measured_flow";
BA_ "SystemMessageLongSymbol" BO_ 2566793216 "VDMA_FE28_Auxiliary_valve_8_measured_flow";
BA_ "SystemMessageLongSymbol" BO_ 2566793472 "VDMA_FE29_Auxiliary_valve_9_measured_flow";
BA_ "SystemMessageLongSymbol" BO_ 2566793728 "VDMA_FE2A_Auxiliary_valve_10_measured_flow";
BA_ "SystemMessageLongSymbol" BO_ 2566793984 "VDMA_FE2B_Auxiliary_valve_11_measured_flow";
BA_ "SystemMessageLongSymbol" BO_ 2566794240 "VDMA_FE2C_Auxiliary_valve_12_measured_flow";
BA_ "SystemMessageLongSymbol" BO_ 2566794496 "VDMA_FE2D_Auxiliary_valve_13_measured_flow";
BA_ "SystemMessageLongSymbol" BO_ 2566794752 "VDMA_FE2E_Auxiliary_valve_14_measured_flow";
BA_ "SystemMessageLongSymbol" BO_ 2566795008 "VDMA_FE2F_Auxiliary_valve_15_measured_flow";
BA_ "SystemMessageLongSymbol" BO_ 2566795264 "VDMA_FE30_Auxiliary_valve_0_command";
BA_ "SystemMessageLongSymbol" BO_ 2566795520 "VDMA_FE31_Auxiliary_valve_1_command";
BA_ "SystemMessageLongSymbol" BO_ 2566795776 "VDMA_FE32_Auxiliary_valve_2_command";
BA_ "SystemMessageLongSymbol" BO_ 2566796032 "VDMA_FE33_Auxiliary_valve_3_command";
BA_ "SystemMessageLongSymbol" BO_ 2566796288 "VDMA_FE34_Auxiliary_valve_4_command";
BA_ "SystemMessageLongSymbol" BO_ 2566796544 "VDMA_FE35_Auxiliary_valve_5_command";
BA_ "SystemMessageLongSymbol" BO_ 2566796800 "VDMA_FE36_Auxiliary_valve_6_command";
BA_ "SystemMessageLongSymbol" BO_ 2566797056 "VDMA_FE37_Auxiliary_valve_7_command";
BA_ "SystemMessageLongSymbol" BO_ 2566797312 "VDMA_FE38_Auxiliary_valve_8_command";
BA_ "SystemMessageLongSymbol" BO_ 2566797568 "VDMA_FE39_Auxiliary_valve_9_command";
BA_ "SystemMessageLongSymbol" BO_ 2566797824 "VDMA_FE3A_Auxiliary_valve_10_command";
BA_ "SystemMessageLongSymbol" BO_ 2566798080 "VDMA_FE3B_Auxiliary_valve_11_command";
BA_ "SystemMessageLongSymbol" BO_ 2566798336 "VDMA_FE3C_Auxiliary_valve_12_command";
BA_ "SystemMessageLongSymbol" BO_ 2566798592 "VDMA_FE3D_Auxiliary_valve_13_command";
BA_ "SystemMessageLongSymbol" BO_ 2566798848 "VDMA_FE3E_Auxiliary_valve_14_command";
BA_ "SystemMessageLongSymbol" BO_ 2566799104 "VDMA_FE3F_Auxiliary_valve_15_command";
BA_ "SystemMessageLongSymbol" BO_ 2566800128 "VDMA_FE43_Primary_or_Rear_Power_Take_off_O";
BA_ "SystemMessageLongSymbol" BO_ 2566800384 "VDMA_FE44_Secondary_or_Front_Power_Take_of";
BA_ "SystemMessageLongSymbol" BO_ 2566800640 "VDMA_FE45_Primary_or_Rear_Hitch_Status";
BA_ "SystemMessageLongSymbol" BO_ 2566800896 "VDMA_FE46_Secondary_or_Front_Hitch_Status";
BA_ "SystemMessageLongSymbol" BO_ 2566801920 "VDMA_FE4A_Electronic_Transmission_Controll";
BA_ "SystemMessageLongSymbol" BO_ 2566802176 "VDMA_FE4B_Transmission_Configuration_2";
BA_ "SystemMessageLongSymbol" BO_ 2566802432 "VDMA_FE4C_Military_Lighting_Command";
BA_ "SystemMessageLongSymbol" BO_ 2566802688 "VDMA_FE4D_Total_Averaged_Information";
BA_ "SystemMessageLongSymbol" BO_ 2566803200 "VDMA_FE4F_Vehicle_Dynamic_Stability_Contro";
BA_ "SystemMessageLongSymbol" BO_ 2566803712 "VDMA_FE51_Adaptive_Cruise_Control_Operator";
BA_ "SystemMessageLongSymbol" BO_ 2566803968 "VDMA_FE52_Vehicle_Electrical_Power_3";
BA_ "SystemMessageLongSymbol" BO_ 2566804224 "VDMA_FE53_Retarder_Continuous_Torque_Speed";
BA_ "SystemMessageLongSymbol" BO_ 2566804480 "VDMA_FE54_Engine_Continuous_Torque_Speed_L";
BA_ "SystemMessageLongSymbol" BO_ 2566804736 "VDMA_FE55_Gaseous_Fuel_Properties";
BA_ "SystemMessageLongSymbol" BO_ 2566804992 "VDMA_FE56_Aftertreatment_1_Diesel_Exhaust_";
BA_ "SystemMessageLongSymbol" BO_ 2566805248 "VDMA_FE57_Air_Suspension_Control_5";
BA_ "SystemMessageLongSymbol" BO_ 2566805504 "VDMA_FE58_Air_Suspension_Control_4";
BA_ "SystemMessageLongSymbol" BO_ 2566805760 "VDMA_FE59_Air_Suspension_Control_3";
BA_ "SystemMessageLongSymbol" BO_ 2566806016 "VDMA_FE5A_Air_Suspension_Control_1";
BA_ "SystemMessageLongSymbol" BO_ 2566806528 "VDMA_FE5C_Running_Gear_Equipment_2_2";
BA_ "SystemMessageLongSymbol" BO_ 2566806784 "VDMA_FE5D_General_Purpose_Message_1_2";
BA_ "SystemMessageLongSymbol" BO_ 2566807040 "VDMA_FE5E_Running_Gear_Equipment_2_3";
BA_ "SystemMessageLongSymbol" BO_ 2566807296 "VDMA_FE5F_General_Purpose_Message_1_3";
BA_ "SystemMessageLongSymbol" BO_ 2566807552 "VDMA_FE60_General_Purpose_Message_2_3";
BA_ "SystemMessageLongSymbol" BO_ 2566807808 "VDMA_FE61_General_Purpose_Message_1_4";
BA_ "SystemMessageLongSymbol" BO_ 2566808064 "VDMA_FE62_General_Purpose_Message_2_4";
BA_ "SystemMessageLongSymbol" BO_ 2566808320 "VDMA_FE63_General_Purpose_Message_1_5";
BA_ "SystemMessageLongSymbol" BO_ 2566808576 "VDMA_FE64_General_Purpose_Message_2_5";
BA_ "SystemMessageLongSymbol" BO_ 2566808832 "VDMA_FE65_General_Purpose_Message_1_6";
BA_ "SystemMessageLongSymbol" BO_ 2566809088 "VDMA_FE66_Battery_Main_Switch_Information";
BA_ "SystemMessageLongSymbol" BO_ 2566809344 "VDMA_FE67_Climate_Control_Configuration";
BA_ "SystemMessageLongSymbol" BO_ 2566810112 "VDMA_FE6A_Engine_Fuel_Lube_Systems";
BA_ "SystemMessageLongSymbol" BO_ 2566810368 "VDMA_FE6B_Driver_s_Identification";
BA_ "SystemMessageLongSymbol" BO_ 2566811136 "VDMA_FE6E_High_Resolution_Wheel_Speed";
BA_ "SystemMessageLongSymbol" BO_ 2566811392 "VDMA_FE6F_Adaptive_Cruise_Control_1";
BA_ "SystemMessageLongSymbol" BO_ 2566811648 "VDMA_FE70_Combination_Vehicle_Weight";
BA_ "SystemMessageLongSymbol" BO_ 2566812160 "VDMA_FE72_Laser_Leveling_System_Blade_Cont";
BA_ "SystemMessageLongSymbol" BO_ 2566812416 "VDMA_FE73_Laser_Receiver_Mast_Position";
BA_ "SystemMessageLongSymbol" BO_ 2566812672 "VDMA_FE74_Modify_Leveling_System_Control_S";
BA_ "SystemMessageLongSymbol" BO_ 2566812928 "VDMA_FE75_Laser_Leveling_System_Vertical_D";
BA_ "SystemMessageLongSymbol" BO_ 2566813184 "VDMA_FE76_Laser_Leveling_System_Vertical_P";
BA_ "SystemMessageLongSymbol" BO_ 2566813696 "VDMA_FE78_Tire_Pressure_Control_Unit_Mode_";
BA_ "SystemMessageLongSymbol" BO_ 2566813952 "VDMA_FE79_Tire_Pressure_Control_Unit_Targe";
BA_ "SystemMessageLongSymbol" BO_ 2566814208 "VDMA_FE7A_Tire_Pressure_Control_Unit_Curre";
BA_ "SystemMessageLongSymbol" BO_ 2566816000 "VDMA_FE81_Fuel_Information_2_Gaseous";
BA_ "SystemMessageLongSymbol" BO_ 2566817792 "VDMA_FE88_Ignition_Transformer_Secondary_O";
BA_ "SystemMessageLongSymbol" BO_ 2566818048 "VDMA_FE89_Ignition_Transformer_Secondary_O";
BA_ "SystemMessageLongSymbol" BO_ 2566818304 "VDMA_FE8A_Ignition_Transformer_Secondary_O";
BA_ "SystemMessageLongSymbol" BO_ 2566818560 "VDMA_FE8B_Gaseous_Fuel_Pressure_1";
BA_ "SystemMessageLongSymbol" BO_ 2566818816 "VDMA_FE8C_Auxiliary_Analog_Information";
BA_ "SystemMessageLongSymbol" BO_ 2566819072 "VDMA_FE8D_Vehicle_Electrical_Power_2";
BA_ "SystemMessageLongSymbol" BO_ 2566820608 "VDMA_FE93_Engine_Electrical_System_Module_";
BA_ "SystemMessageLongSymbol" BO_ 2566820864 "VDMA_FE94_Engine_Auxiliary_Coolant";
BA_ "SystemMessageLongSymbol" BO_ 2566821632 "VDMA_FE97_Turbocharger_Information_5";
BA_ "SystemMessageLongSymbol" BO_ 2566821888 "VDMA_FE98_Turbocharger_Information_4";
BA_ "SystemMessageLongSymbol" BO_ 2566822144 "VDMA_FE99_Turbocharger_Information_3";
BA_ "SystemMessageLongSymbol" BO_ 2566822400 "VDMA_FE9A_Turbocharger_Information_2";
BA_ "SystemMessageLongSymbol" BO_ 2566822656 "VDMA_FE9B_Turbocharger_Information_1";
BA_ "SystemMessageLongSymbol" BO_ 2566822912 "VDMA_FE9C_Main_Bearing_Temperature_3";
BA_ "SystemMessageLongSymbol" BO_ 2566823168 "VDMA_FE9D_Main_Bearing_Temperature_2";
BA_ "SystemMessageLongSymbol" BO_ 2566823424 "VDMA_FE9E_Main_Bearing_Temperature_1";
BA_ "SystemMessageLongSymbol" BO_ 2566823680 "VDMA_FE9F_Exhaust_Port_Temperature_5";
BA_ "SystemMessageLongSymbol" BO_ 2566823936 "VDMA_FEA0_Exhaust_Port_Temperature_4";
BA_ "SystemMessageLongSymbol" BO_ 2566824192 "VDMA_FEA1_Exhaust_Port_Temperature_3";
BA_ "SystemMessageLongSymbol" BO_ 2566824448 "VDMA_FEA2_Exhaust_Port_Temperature_2";
BA_ "SystemMessageLongSymbol" BO_ 2566824704 "VDMA_FEA3_Exhaust_Port_Temperature_1";
BA_ "SystemMessageLongSymbol" BO_ 2566825216 "VDMA_FEA5_Intake_Manifold_Information_2";
BA_ "SystemMessageLongSymbol" BO_ 2566825472 "VDMA_FEA6_Intake_Manifold_Information_1";
BA_ "SystemMessageLongSymbol" BO_ 2566825728 "VDMA_FEA7_Alternator_Temperature_1";
BA_ "SystemMessageLongSymbol" BO_ 2566826752 "VDMA_FEAB_Electronic_Transmission_Controll";
BA_ "SystemMessageLongSymbol" BO_ 2566827008 "VDMA_FEAC_Wheel_Brake_Lining_Remaining_Inf";
BA_ "SystemMessageLongSymbol" BO_ 2566827264 "VDMA_FEAD_Wheel_Application_Pressure_High_";
BA_ "SystemMessageLongSymbol" BO_ 2566827776 "VDMA_FEAF_Fuel_Consumption_Gaseous";
BA_ "SystemMessageLongSymbol" BO_ 2566828032 "VDMA_FEB0_Trip_Time_Information_2";
BA_ "SystemMessageLongSymbol" BO_ 2566828544 "VDMA_FEB2_Fuel_Information_1_Gaseous";
BA_ "SystemMessageLongSymbol" BO_ 2566828800 "VDMA_FEB3_Fuel_Information_1_Liquid";
BA_ "SystemMessageLongSymbol" BO_ 2566829056 "VDMA_FEB4_Trip_Time_Information_1";
BA_ "SystemMessageLongSymbol" BO_ 2566829312 "VDMA_FEB5_Trip_Shutdown_Information";
BA_ "SystemMessageLongSymbol" BO_ 2566829568 "VDMA_FEB6_Trip_Vehicle_Speed_Cruise_Distan";
BA_ "SystemMessageLongSymbol" BO_ 2566829824 "VDMA_FEB7_Engine_Speed_Load_Factor_Informa";
BA_ "SystemMessageLongSymbol" BO_ 2566830080 "VDMA_FEB8_Trip_Fuel_Information_Gaseous";
BA_ "SystemMessageLongSymbol" BO_ 2566830336 "VDMA_FEB9_Trip_Fuel_Information_Liquid";
BA_ "SystemMessageLongSymbol" BO_ 2566830592 "VDMA_FEBA_Trip_Distance_Information";
BA_ "SystemMessageLongSymbol" BO_ 2566831104 "VDMA_FEBC_Compression_Service_Brake_Inform";
BA_ "SystemMessageLongSymbol" BO_ 2566831616 "VDMA_FEBE_Electronic_Engine_Controller_4";
BA_ "SystemMessageLongSymbol" BO_ 2566831872 "VDMA_FEBF_Wheel_Speed_Information";
BA_ "SystemMessageLongSymbol" BO_ 2566832640 "VDMA_FEC2_Electronic_Retarder_Controller_2";
BA_ "SystemMessageLongSymbol" BO_ 2566832896 "VDMA_FEC3_Electronic_Transmission_Controll";
BA_ "SystemMessageLongSymbol" BO_ 2566833152 "VDMA_FEC4_Electronic_Brake_System_2_2";
BA_ "SystemMessageLongSymbol" BO_ 2566833408 "VDMA_FEC5_Electronic_Transmission_Controll";
BA_ "SystemMessageLongSymbol" BO_ 2566833664 "VDMA_FEC6_Electronic_Brake_System_2_3";
BA_ "SystemMessageLongSymbol" BO_ 2566833920 "VDMA_FEC7_Electronic_Transmission_Controll";
BA_ "SystemMessageLongSymbol" BO_ 2566834176 "VDMA_FEC8_General_Purpose_Message_2_2";
BA_ "SystemMessageLongSymbol" BO_ 2566834432 "VDMA_FEC9_Electronic_Brake_System_1_2";
BA_ "SystemMessageLongSymbol" BO_ 2566835456 "VDMA_FECD_Freeze_Frame_Parameters";
BA_ "SystemMessageLongSymbol" BO_ 2566835968 "VDMA_FECF_Emission_Related_Pending_Diagnos";
BA_ "SystemMessageLongSymbol" BO_ 2566836224 "VDMA_FED0_Test_Results_for_Non_continuousl";
BA_ "SystemMessageLongSymbol" BO_ 2566836480 "VDMA_FED1_Oxygen_Sensor_Test_Results";
BA_ "SystemMessageLongSymbol" BO_ 2566836736 "VDMA_FED2_Non_Continuously_Monitored_Syste";
BA_ "SystemMessageLongSymbol" BO_ 2566837248 "VDMA_FED4_Emission_Related_MIL_On_Diagnost";
BA_ "SystemMessageLongSymbol" BO_ 2566837504 "VDMA_FED5_Alternator_Information_1";
BA_ "SystemMessageLongSymbol" BO_ 2566837760 "VDMA_FED6_Hybrid_or_EV_System_Inputs_1";
BA_ "SystemMessageLongSymbol" BO_ 2566838528 "VDMA_FED9_Auxiliary_Input_Output_Status_1";
BA_ "SystemMessageLongSymbol" BO_ 2566839040 "VDMA_FEDB_Engine_Fluid_Level_Pressure_2";
BA_ "SystemMessageLongSymbol" BO_ 2566839808 "VDMA_FEDE_Engine_Air_Start_Pressure";
BA_ "SystemMessageLongSymbol" BO_ 2566840832 "VDMA_FEE2_Transmission_Configuration";
BA_ "SystemMessageLongSymbol" BO_ 2566842368 "VDMA_FEE8_Vehicle_Direction_Speed";
