VERSION "created by canmatrix"

NS_ :

BS_:

BU_:

BO_ 2566005248 VDMA_F222_High_Voltage_Energy_St: 8 Vector__XXX
 SG_ High_Voltage_Energy_Storage_Pack : 0|64@1+ (1,0) [0|18446744073709551615] "" Vector__XXX

BO_ 2566005504 VDMA_F223_High_Voltage_Energy_St: 8 Vector__XXX
 SG_ High_Voltage_Energy_Storage_Pack : 0|64@1+ (1,0) [0|18446744073709551615] "" Vector__XXX

BO_ 2566005760 VDMA_F224_High_Voltage_Energy_St: 8 Vector__XXX
 SG_ High_Voltage_Energy_Storage_Pack : 0|64@1+ (1,0) [0|18446744073709551615] "" Vector__XXX

BO_ 2566006016 VDMA_F225_High_Voltage_Energy_St: 8 Vector__XXX
 SG_ High_Voltage_Energy_Storage_Pack : 0|64@1+ (1,0) [0|18446744073709551615] "" Vector__XXX

BO_ 2566006272 VDMA_F226_High_Voltage_Energy_St: 8 Vector__XXX
 SG_ High_Voltage_Energy_Storage_Pack : 0|64@1+ (1,0) [0|18446744073709551615] "" Vector__XXX

BO_ 2566006528 VDMA_F227_High_Voltage_Energy_St: 8 Vector__XXX
 SG_ High_Voltage_Energy_Storage_Pack : 0|64@1+ (1,0) [0|18446744073709551615] "" Vector__XXX

BO_ 2566006784 VDMA_F228_High_Voltage_Energy_St: 8 Vector__XXX
 SG_ High_Voltage_Energy_Storage_Pack : 0|64@1+ (1,0) [0|18446744073709551615] "" Vector__XXX

BO_ 2566007040 VDMA_F229_High_Voltage_Energy_St: 8 Vector__XXX
 SG_ High_Voltage_Energy_Storage_Pack : 0|64@1+ (1,0) [0|18446744073709551615] "" Vector__XXX

BO_ 2566007296 VDMA_F22A_High_Voltage_Energy_St: 8 Vector__XXX
 SG_ High_Voltage_Energy_Storage_Pack : 0|64@1+ (1,0) [0|18446744073709551615] "" Vector__XXX

BO_ 2566007552 VDMA_F22B_High_Voltage_Energy_St: 8 Vector__XXX
 SG_ High_Voltage_Energy_Storage_Pack : 0|64@1+ (1,0) [0|18446744073709551615] "" Vector__XXX

BO_ 2566007808 VDMA_F22C_High_Voltage_Energy_St: 8 Vector__XXX
 SG_ High_Voltage_Energy_Storage_Pack : 0|64@1+ (1,0) [0|18446744073709551615] "" Vector__XXX

BO_ 2566008064 VDMA_F22D_High_Voltage_Energy_St: 8 Vector__XXX
 SG_ High_Voltage_Energy_Storage_Pack : 0|64@1+ (1,0) [0|18446744073709551615] "" Vector__XXX

BO_ 2566008320 VDMA_F22E_High_Voltage_Energy_St: 8 Vector__XXX
 SG_ High_Voltage_Energy_Storage_Pack : 0|64@1+ (1,0) [0|18446744073709551615] "" Vector__XXX

BO_ 2566008576 VDMA_F22F_High_Voltage_Energy_St: 8 Vector__XXX
 SG_ High_Voltage_Energy_Storage_Pack : 0|64@1+ (1,0) [0|18446744073709551615] "" Vector__XXX

BO_ 2566008832 VDMA_F230_High_Voltage_Energy_St: 8 Vector__XXX
 SG_ High_Voltage_Energy_Storage_Pack : 0|64@1+ (1,0) [0|18446744073709551615] "" Vector__XXX

BO_ 2566009088 VDMA_F231_High_Voltage_Energy_St: 8 Vector__XXX
 SG_ High_Voltage_Energy_Storage_Pack : 0|64@1+ (1,0) [0|18446744073709551615] "" Vector__XXX

BO_ 2566009344 VDMA_F232_High_Voltage_Energy_St: 8 Vector__XXX
 SG_ High_Voltage_Energy_Storage_Pack : 0|64@1+ (1,0) [0|18446744073709551615] "" Vector__XXX

BO_ 2566009600 VDMA_F233_High_Voltage_Energy_St: 8 Vector__XXX
 SG_ High_Voltage_Energy_Storage_Pack : 0|64@1+ (1,0) [0|18446744073709551615] "" Vector__XXX

BO_ 2566009856 VDMA_F234_High_Voltage_Energy_St: 8 Vector__XXX
 SG_ High_Voltage_Energy_Storage_Pack : 0|64@1+ (1,0) [0|18446744073709551615] "" Vector__XXX

BO_ 2566010112 VDMA_F235_High_Voltage_Energy_St: 8 Vector__XXX
 SG_ High_Voltage_Energy_Storage_Pack : 0|64@1+ (1,0) [0|18446744073709551615] "" Vector__XXX

BO_ 2566010368 VDMA_F236_High_Voltage_Energy_St: 8 Vector__XXX
 SG_ High_Voltage_Energy_Storage_Pack : 0|64@1+ (1,0) [0|18446744073709551615] "" Vector__XXX

BO_ 2566010624 VDMA_F237_High_Voltage_Energy_St: 8 Vector__XXX
 SG_ High_Voltage_Energy_Storage_Pack : 0|64@1+ (1,0) [0|18446744073709551615] "" Vector__XXX

BO_ 2566010880 VDMA_F238_High_Voltage_Energy_St: 8 Vector__XXX
 SG_ High_Voltage_Energy_Storage_Pack : 0|64@1+ (1,0) [0|18446744073709551615] "" Vector__XXX

BO_ 2566011136 VDMA_F239_High_Voltage_Energy_St: 8 Vector__XXX
 SG_ High_Voltage_Energy_Storage_Pack : 0|64@1+ (1,0) [0|18446744073709551615] "" Vector__XXX

BO_ 2566011392 VDMA_F23A_High_Voltage_Energy_St: 8 Vector__XXX
 SG_ High_Voltage_Energy_Storage_Pack : 0|64@1+ (1,0) [0|18446744073709551615] "" Vector__XXX

BO_ 2566011648 VDMA_F23B_High_Voltage_Energy_St: 8 Vector__XXX
 SG_ High_Voltage_Energy_Storage_Pack : 0|64@1+ (1,0) [0|18446744073709551615] "" Vector__XXX

BO_ 2566011904 VDMA_F23C_High_Voltage_Energy_St: 8 Vector__XXX
 SG_ High_Voltage_Energy_Storage_Pack : 0|64@1+ (1,0) [0|18446744073709551615] "" Vector__XXX

BO_ 2566012160 VDMA_F23D_High_Voltage_Energy_St: 8 Vector__XXX
 SG_ High_Voltage_Energy_Storage_Pack : 0|64@1+ (1,0) [0|18446744073709551615] "" Vector__XXX

BO_ 2566012416 VDMA_F23E_High_Voltage_Energy_St: 8 Vector__XXX
 SG_ High_Voltage_Energy_Storage_Pack : 0|64@1+ (1,0) [0|18446744073709551615] "" Vector__XXX

BO_ 2566012672 VDMA_F23F_High_Voltage_Energy_St: 8 Vector__XXX
 SG_ High_Voltage_Energy_Storage_Pack : 0|64@1+ (1,0) [0|18446744073709551615] "" Vector__XXX

BO_ 2566012928 VDMA_F240_High_Voltage_Energy_St: 8 Vector__XXX
 SG_ High_Voltage_Energy_Storage_Pack : 0|64@1+ (1,0) [0|18446744073709551615] "" Vector__XXX

BO_ 2566013184 VDMA_F241_High_Voltage_Energy_St: 8 Vector__XXX
 SG_ High_Voltage_Energy_Storage_Pack : 0|64@1+ (1,0) [0|18446744073709551615] "" Vector__XXX

BO_ 2566013440 VDMA_F242_High_Voltage_Energy_St: 8 Vector__XXX
 SG_ High_Voltage_Energy_Storage_Pack : 0|64@1+ (1,0) [0|18446744073709551615] "" Vector__XXX

BO_ 2566013696 VDMA_F243_High_Voltage_Energy_St: 8 Vector__XXX
 SG_ High_Voltage_Energy_Storage_Pack : 0|64@1+ (1,0) [0|18446744073709551615] "" Vector__XXX

BO_ 2566013952 VDMA_F244_High_Voltage_Energy_St: 8 Vector__XXX
 SG_ High_Voltage_Energy_Storage_Pack : 0|64@1+ (1,0) [0|18446744073709551615] "" Vector__XXX

BO_ 2566014208 VDMA_F245_High_Voltage_Energy_St: 8 Vector__XXX
 SG_ High_Voltage_Energy_Storage_Pack : 0|64@1+ (1,0) [0|18446744073709551615] "" Vector__XXX

BO_ 2566014464 VDMA_F246_High_Voltage_Energy_St: 8 Vector__XXX
 SG_ High_Voltage_Energy_Storage_Pack : 0|64@1+ (1,0) [0|18446744073709551615] "" Vector__XXX

BO_ 2566014720 VDMA_F247_High_Voltage_Energy_St: 8 Vector__XXX
 SG_ High_Voltage_Energy_Storage_Pack : 0|64@1+ (1,0) [0|18446744073709551615] "" Vector__XXX

BO_ 2566014976 VDMA_F248_High_Voltage_Energy_St: 8 Vector__XXX
 SG_ High_Voltage_Energy_Storage_Pack : 0|64@1+ (1,0) [0|18446744073709551615] "" Vector__XXX

BO_ 2566015232 VDMA_F249_High_Voltage_Energy_St: 8 Vector__XXX
 SG_ High_Voltage_Energy_Storage_Pack : 0|64@1+ (1,0) [0|18446744073709551615] "" Vector__XXX

BO_ 2566015488 VDMA_F24A_High_Voltage_Energy_St: 8 Vector__XXX
 SG_ High_Voltage_Energy_Storage_Pack : 0|64@1+ (1,0) [0|18446744073709551615] "" Vector__XXX

BO_ 2566015744 VDMA_F24B_High_Voltage_Energy_St: 8 Vector__XXX
 SG_ High_Voltage_Energy_Storage_Pack : 0|64@1+ (1,0) [0|18446744073709551615] "" Vector__XXX

BO_ 2566016000 VDMA_F24C_High_Voltage_Energy_St: 8 Vector__XXX
 SG_ High_Voltage_Energy_Storage_Pack : 0|64@1+ (1,0) [0|18446744073709551615] "" Vector__XXX

BO_ 2566016256 VDMA_F24D_High_Voltage_Energy_St: 8 Vector__XXX
 SG_ High_Voltage_Energy_Storage_Pack : 0|64@1+ (1,0) [0|18446744073709551615] "" Vector__XXX

BO_ 2566016512 VDMA_F24E_High_Voltage_Energy_St: 8 Vector__XXX
 SG_ High_Voltage_Energy_Storage_Pack : 0|64@1+ (1,0) [0|18446744073709551615] "" Vector__XXX

BO_ 2566016768 VDMA_F24F_High_Voltage_Energy_St: 8 Vector__XXX
 SG_ High_Voltage_Energy_Storage_Pack : 0|64@1+ (1,0) [0|18446744073709551615] "" Vector__XXX

BO_ 2566017024 VDMA_F250_Electronic_Auxiliary_T: 8 Vector__XXX
 SG_ Electronic_Auxiliary_Transmissio : 0|64@1+ (1,0) [0|18446744073709551615] "" Vector__XXX

BO_ 2566017280 VDMA_F251_High_Voltage_Energy_St: 8 Vector__XXX
 SG_ High_Voltage_Energy_Storage_Pack : 0|64@1+ (1,0) [0|18446744073709551615] "" Vector__XXX

BO_ 2566017536 VDMA_F252_High_Voltage_Energy_St: 8 Vector__XXX
 SG_ High_Voltage_Energy_Storage_Pack : 0|64@1+ (1,0) [0|18446744073709551615] "" Vector__XXX

BO_ 2566017792 VDMA_F253_High_Voltage_Energy_St: 8 Vector__XXX
 SG_ High_Voltage_Energy_Storage_Pack : 0|64@1+ (1,0) [0|18446744073709551615] "" Vector__XXX

BO_ 2566018048 VDMA_F254_High_Voltage_Energy_St: 8 Vector__XXX
 SG_ High_Voltage_Energy_Storage_Pack : 0|64@1+ (1,0) [0|18446744073709551615] "" Vector__XXX

BO_ 2566018304 VDMA_F255_High_Voltage_Energy_St: 8 Vector__XXX
 SG_ High_Voltage_Energy_Storage_Pack : 0|64@1+ (1,0) [0|18446744073709551615] "" Vector__XXX

BO_ 2566018560 VDMA_F256_High_Voltage_Energy_St: 8 Vector__XXX
 SG_ High_Voltage_Energy_Storage_Pack : 0|64@1+ (1,0) [0|18446744073709551615] "" Vector__XXX

BO_ 2566018816 VDMA_F257_High_Voltage_Energy_St: 8 Vector__XXX
 SG_ High_Voltage_Energy_Storage_Pack : 0|64@1+ (1,0) [0|18446744073709551615] "" Vector__XXX

BO_ 2566019072 VDMA_F258_High_Voltage_Energy_St: 8 Vector__XXX
 SG_ High_Voltage_Energy_Storage_Pack : 0|64@1+ (1,0) [0|18446744073709551615] "" Vector__XXX

BO_ 2566019328 VDMA_F259_High_Voltage_Energy_St: 8 Vector__XXX
 SG_ High_Voltage_Energy_Storage_Pack : 0|64@1+ (1,0) [0|18446744073709551615] "" Vector__XXX

BO_ 2566019584 VDMA_F25A_High_Voltage_Energy_St: 8 Vector__XXX
 SG_ High_Voltage_Energy_Storage_Pack : 0|64@1+ (1,0) [0|18446744073709551615] "" Vector__XXX

BO_ 2566019840 VDMA_F25B_High_Voltage_Energy_St: 8 Vector__XXX
 SG_ High_Voltage_Energy_Storage_Pack : 0|64@1+ (1,0) [0|18446744073709551615] "" Vector__XXX

BO_ 2566020096 VDMA_F25C_High_Voltage_Energy_St: 8 Vector__XXX
 SG_ High_Voltage_Energy_Storage_Pack : 0|64@1+ (1,0) [0|18446744073709551615] "" Vector__XXX

BO_ 2566020352 VDMA_F25D_High_Voltage_Energy_St: 8 Vector__XXX
 SG_ High_Voltage_Energy_Storage_Pack : 0|64@1+ (1,0) [0|18446744073709551615] "" Vector__XXX

BO_ 2566020608 VDMA_F25E_High_Voltage_Energy_St: 8 Vector__XXX
 SG_ High_Voltage_Energy_Storage_Pack : 0|64@1+ (1,0) [0|18446744073709551615] "" Vector__XXX

BO_ 2566020864 VDMA_F25F_High_Voltage_Energy_St: 8 Vector__XXX
 SG_ High_Voltage_Energy_Storage_Pack : 0|64@1+ (1,0) [0|18446744073709551615] "" Vector__XXX

BO_ 2566021120 VDMA_F260_High_Voltage_Energy_St: 8 Vector__XXX
 SG_ High_Voltage_Energy_Storage_Pack : 0|64@1+ (1,0) [0|18446744073709551615] "" Vector__XXX

BO_ 2566021376 VDMA_F261_High_Voltage_Energy_St: 8 Vector__XXX
 SG_ High_Voltage_Energy_Storage_Pack : 0|64@1+ (1,0) [0|18446744073709551615] "" Vector__XXX

BO_ 2566021632 VDMA_F262_High_Voltage_Energy_St: 8 Vector__XXX
 SG_ High_Voltage_Energy_Storage_Pack : 0|64@1+ (1,0) [0|18446744073709551615] "" Vector__XXX

BO_ 2566021888 VDMA_F263_High_Voltage_Energy_St: 8 Vector__XXX
 SG_ High_Voltage_Energy_Storage_Pack : 0|64@1+ (1,0) [0|18446744073709551615] "" Vector__XXX

BO_ 2566022144 VDMA_F264_High_Voltage_Energy_St: 8 Vector__XXX
 SG_ High_Voltage_Energy_Storage_Pack : 0|64@1+ (1,0) [0|18446744073709551615] "" Vector__XXX

BO_ 2566022400 VDMA_F265_High_Voltage_Energy_St: 8 Vector__XXX
 SG_ High_Voltage_Energy_Storage_Pack : 0|64@1+ (1,0) [0|18446744073709551615] "" Vector__XXX

BO_ 2566022656 VDMA_F266_High_Voltage_Energy_St: 8 Vector__XXX
 SG_ High_Voltage_Energy_Storage_Pack : 0|64@1+ (1,0) [0|18446744073709551615] "" Vector__XXX

BO_ 2566022912 VDMA_F267_High_Voltage_Energy_St: 8 Vector__XXX
 SG_ High_Voltage_Energy_Storage_Pack : 0|64@1+ (1,0) [0|18446744073709551615] "" Vector__XXX

BO_ 2566023168 VDMA_F268_High_Voltage_Energy_St: 8 Vector__XXX
 SG_ High_Voltage_Energy_Storage_Pack : 0|64@1+ (1,0) [0|18446744073709551615] "" Vector__XXX

BO_ 2566023424 VDMA_F269_High_Voltage_Energy_St: 8 Vector__XXX
 SG_ High_Voltage_Energy_Storage_Pack : 0|64@1+ (1,0) [0|18446744073709551615] "" Vector__XXX

BO_ 2566023680 VDMA_F26A_High_Voltage_Energy_St: 8 Vector__XXX
 SG_ High_Voltage_Energy_Storage_Pack : 0|64@1+ (1,0) [0|18446744073709551615] "" Vector__XXX

BO_ 2566023936 VDMA_F26B_High_Voltage_Energy_St: 8 Vector__XXX
 SG_ High_Voltage_Energy_Storage_Pack : 0|64@1+ (1,0) [0|18446744073709551615] "" Vector__XXX

BO_ 2566024192 VDMA_F26C_High_Voltage_Energy_St: 8 Vector__XXX
 SG_ High_Voltage_Energy_Storage_Pack : 0|64@1+ (1,0) [0|18446744073709551615] "" Vector__XXX

BO_ 2566024448 VDMA_F26D_High_Voltage_Energy_St: 8 Vector__XXX
 SG_ High_Voltage_Energy_Storage_Pack : 0|64@1+ (1,0) [0|18446744073709551615] "" Vector__XXX

BO_ 2566024704 VDMA_F26E_High_Voltage_Energy_St: 8 Vector__XXX
 SG_ High_Voltage_Energy_Storage_Pack : 0|64@1+ (1,0) [0|18446744073709551615] "" Vector__XXX

BO_ 2566024960 VDMA_F26F_High_Voltage_Energy_St: 8 Vector__XXX
 SG_ High_Voltage_Energy_Storage_Pack : 0|64@1+ (1,0) [0|18446744073709551615] "" Vector__XXX

BO_ 2566025216 VDMA_F270_High_Voltage_Energy_St: 8 Vector__XXX
 SG_ High_Voltage_Energy_Storage_Pack : 0|64@1+ (1,0) [0|18446744073709551615] "" Vector__XXX

BO_ 2566025472 VDMA_F271_High_Voltage_Energy_St: 8 Vector__XXX
 SG_ High_Voltage_Energy_Storage_Pack : 0|64@1+ (1,0) [0|18446744073709551615] "" Vector__XXX

BO_ 2566025728 VDMA_F272_High_Voltage_Energy_St: 8 Vector__XXX
 SG_ High_Voltage_Energy_Storage_Pack : 0|64@1+ (1,0) [0|18446744073709551615] "" Vector__XXX

BO_ 2566025984 VDMA_F273_High_Voltage_Energy_St: 8 Vector__XXX
 SG_ High_Voltage_Energy_Storage_Pack : 0|64@1+ (1,0) [0|18446744073709551615] "" Vector__XXX

BO_ 2566026240 VDMA_F274_High_Voltage_Energy_St: 8 Vector__XXX
 SG_ High_Voltage_Energy_Storage_Pack : 0|64@1+ (1,0) [0|18446744073709551615] "" Vector__XXX

BO_ 2566026496 VDMA_F275_High_Voltage_Energy_St: 8 Vector__XXX
 SG_ High_Voltage_Energy_Storage_Pack : 0|64@1+ (1,0) [0|18446744073709551615] "" Vector__XXX

BO_ 2566026752 VDMA_F276_High_Voltage_Energy_St: 8 Vector__XXX
 SG_ High_Voltage_Energy_Storage_Pack : 0|64@1+ (1,0) [0|18446744073709551615] "" Vector__XXX

BO_ 2566027008 VDMA_F277_High_Voltage_Energy_St: 8 Vector__XXX
 SG_ High_Voltage_Energy_Storage_Pack : 0|64@1+ (1,0) [0|18446744073709551615] "" Vector__XXX

BO_ 2566027264 VDMA_F278_High_Voltage_Energy_St: 8 Vector__XXX
 SG_ High_Voltage_Energy_Storage_Pack : 0|64@1+ (1,0) [0|18446744073709551615] "" Vector__XXX

BO_ 2566027520 VDMA_F279_High_Voltage_Energy_St: 8 Vector__XXX
 SG_ High_Voltage_Energy_Storage_Pack : 0|64@1+ (1,0) [0|18446744073709551615] "" Vector__XXX

BO_ 2566027776 VDMA_F27A_High_Voltage_Energy_St: 8 Vector__XXX
 SG_ High_Voltage_Energy_Storage_Pack : 0|64@1+ (1,0) [0|18446744073709551615] "" Vector__XXX

BO_ 2566028032 VDMA_F27B_High_Voltage_Energy_St: 8 Vector__XXX
 SG_ High_Voltage_Energy_Storage_Pack : 0|64@1+ (1,0) [0|18446744073709551615] "" Vector__XXX

BO_ 2566028288 VDMA_F27C_High_Voltage_Energy_St: 8 Vector__XXX
 SG_ High_Voltage_Energy_Storage_Pack : 0|64@1+ (1,0) [0|18446744073709551615] "" Vector__XXX

BO_ 2566028544 VDMA_F27D_High_Voltage_Energy_St: 8 Vector__XXX
 SG_ High_Voltage_Energy_Storage_Pack : 0|64@1+ (1,0) [0|18446744073709551615] "" Vector__XXX

BO_ 2566028800 VDMA_F27E_High_Voltage_Energy_St: 8 Vector__XXX
 SG_ High_Voltage_Energy_Storage_Pack : 0|64@1+ (1,0) [0|18446744073709551615] "" Vector__XXX

BO_ 2566029056 VDMA_F27F_High_Voltage_Energy_St: 8 Vector__XXX
 SG_ High_Voltage_Energy_Storage_Pack : 0|64@1+ (1,0) [0|18446744073709551615] "" Vector__XXX

BO_ 2566029312 VDMA_F280_High_Voltage_Energy_St: 8 Vector__XXX
 SG_ High_Voltage_Energy_Storage_Pack : 0|64@1+ (1,0) [0|18446744073709551615] "" Vector__XXX

BO_ 2566029568 VDMA_F281_High_Voltage_Energy_St: 8 Vector__XXX
 SG_ High_Voltage_Energy_Storage_Pack : 0|64@1+ (1,0) [0|18446744073709551615] "" Vector__XXX

BO_ 2566029824 VDMA_F282_High_Voltage_Energy_St: 8 Vector__XXX
 SG_ High_Voltage_Energy_Storage_Pack : 0|64@1+ (1,0) [0|18446744073709551615] "" Vector__XXX

BO_ 2566030080 VDMA_F283_High_Voltage_Energy_St: 8 Vector__XXX
 SG_ High_Voltage_Energy_Storage_Pack : 0|64@1+ (1,0) [0|18446744073709551615] "" Vector__XXX

BO_ 2566030336 VDMA_F284_High_Voltage_Energy_St: 8 Vector__XXX
 SG_ High_Voltage_Energy_Storage_Pack : 0|64@1+ (1,0) [0|18446744073709551615] "" Vector__XXX

BO_ 2566030592 VDMA_F285_High_Voltage_Energy_St: 8 Vector__XXX
 SG_ High_Voltage_Energy_Storage_Pack : 0|64@1+ (1,0) [0|18446744073709551615] "" Vector__XXX

BO_ 2566030848 VDMA_F286_High_Voltage_Energy_St: 8 Vector__XXX
 SG_ High_Voltage_Energy_Storage_Pack : 0|64@1+ (1,0) [0|18446744073709551615] "" Vector__XXX

BO_ 2566031104 VDMA_F287_High_Voltage_Energy_St: 8 Vector__XXX
 SG_ High_Voltage_Energy_Storage_Pack : 0|64@1+ (1,0) [0|18446744073709551615] "" Vector__XXX

BO_ 2566031360 VDMA_F288_High_Voltage_Energy_St: 8 Vector__XXX
 SG_ High_Voltage_Energy_Storage_Pack : 0|64@1+ (1,0) [0|18446744073709551615] "" Vector__XXX

BO_ 2566031616 VDMA_F289_High_Voltage_Energy_St: 8 Vector__XXX
 SG_ High_Voltage_Energy_Storage_Pack : 0|64@1+ (1,0) [0|18446744073709551615] "" Vector__XXX

BO_ 2566031872 VDMA_F28A_High_Voltage_Energy_St: 8 Vector__XXX
 SG_ High_Voltage_Energy_Storage_Pack : 0|64@1+ (1,0) [0|18446744073709551615] "" Vector__XXX

BO_ 2566032128 VDMA_F28B_High_Voltage_Energy_St: 8 Vector__XXX
 SG_ High_Voltage_Energy_Storage_Pack : 0|64@1+ (1,0) [0|18446744073709551615] "" Vector__XXX

BO_ 2566032384 VDMA_F28C_High_Voltage_Energy_St: 8 Vector__XXX
 SG_ High_Voltage_Energy_Storage_Pack : 0|64@1+ (1,0) [0|18446744073709551615] "" Vector__XXX

BO_ 2566032640 VDMA_F28D_High_Voltage_Energy_St: 8 Vector__XXX
 SG_ High_Voltage_Energy_Storage_Pack : 0|64@1+ (1,0) [0|18446744073709551615] "" Vector__XXX

BO_ 2566032896 VDMA_F28E_High_Voltage_Energy_St: 8 Vector__XXX
 SG_ High_Voltage_Energy_Storage_Pack : 0|64@1+ (1,0) [0|18446744073709551615] "" Vector__XXX

BO_ 2566033152 VDMA_F28F_High_Voltage_Energy_St: 8 Vector__XXX
 SG_ High_Voltage_Energy_Storage_Pack : 0|64@1+ (1,0) [0|18446744073709551615] "" Vector__XXX

BO_ 2566033408 VDMA_F290_High_Voltage_Energy_St: 8 Vector__XXX
 SG_ High_Voltage_Energy_Storage_Pack : 0|64@1+ (1,0) [0|18446744073709551615] "" Vector__XXX

BO_ 2566033664 VDMA_F291_High_Voltage_Energy_St: 8 Vector__XXX
 SG_ High_Voltage_Energy_Storage_Pack : 0|64@1+ (1,0) [0|18446744073709551615] "" Vector__XXX

BO_ 2566033920 VDMA_F292_High_Voltage_Energy_St: 8 Vector__XXX
 SG_ High_Voltage_Energy_Storage_Pack : 0|64@1+ (1,0) [0|18446744073709551615] "" Vector__XXX

BO_ 2566034176 VDMA_F293_High_Voltage_Energy_St: 8 Vector__XXX
 SG_ High_Voltage_Energy_Storage_Pack : 0|64@1+ (1,0) [0|18446744073709551615] "" Vector__XXX

BO_ 2566034432 VDMA_F294_High_Voltage_Energy_St: 8 Vector__XXX
 SG_ High_Voltage_Energy_Storage_Pack : 0|64@1+ (1,0) [0|18446744073709551615] "" Vector__XXX

BO_ 2566034688 VDMA_F295_High_Voltage_Energy_St: 8 Vector__XXX
 SG_ High_Voltage_Energy_Storage_Pack : 0|64@1+ (1,0) [0|18446744073709551615] "" Vector__XXX

BO_ 2566034944 VDMA_F296_High_Voltage_Energy_St: 8 Vector__XXX
 SG_ High_Voltage_Energy_Storage_Pack : 0|64@1+ (1,0) [0|18446744073709551615] "" Vector__XXX

BO_ 2566035200 VDMA_F297_High_Voltage_Energy_St: 8 Vector__XXX
 SG_ High_Voltage_Energy_Storage_Pack : 0|64@1+ (1,0) [0|18446744073709551615] "" Vector__XXX

BO_ 2566035456 VDMA_F298_High_Voltage_Energy_St: 8 Vector__XXX
 SG_ High_Voltage_Energy_Storage_Pack : 0|64@1+ (1,0) [0|18446744073709551615] "" Vector__XXX

BO_ 2566035712 VDMA_F299_High_Voltage_Energy_St: 8 Vector__XXX
 SG_ High_Voltage_Energy_Storage_Pack : 0|64@1+ (1,0) [0|18446744073709551615] "" Vector__XXX

BO_ 2566035968 VDMA_F29A_High_Voltage_Energy_St: 8 Vector__XXX
 SG_ High_Voltage_Energy_Storage_Pack : 0|64@1+ (1,0) [0|18446744073709551615] "" Vector__XXX

BO_ 2566036224 VDMA_F29B_High_Voltage_Energy_St: 8 Vector__XXX
 SG_ High_Voltage_Energy_Storage_Pack : 0|64@1+ (1,0) [0|18446744073709551615] "" Vector__XXX

BO_ 2566036480 VDMA_F29C_High_Voltage_Energy_St: 8 Vector__XXX
 SG_ High_Voltage_Energy_Storage_Pack : 0|64@1+ (1,0) [0|18446744073709551615] "" Vector__XXX

BO_ 2566036736 VDMA_F29D_High_Voltage_Energy_St: 8 Vector__XXX
 SG_ High_Voltage_Energy_Storage_Pack : 0|64@1+ (1,0) [0|18446744073709551615] "" Vector__XXX

BO_ 2566036992 VDMA_F29E_High_Voltage_Energy_St: 8 Vector__XXX
 SG_ High_Voltage_Energy_Storage_Pack : 0|64@1+ (1,0) [0|18446744073709551615] "" Vector__XXX

BO_ 2566037248 VDMA_F29F_High_Voltage_Energy_St: 8 Vector__XXX
 SG_ High_Voltage_Energy_Storage_Pack : 0|64@1+ (1,0) [0|18446744073709551615] "" Vector__XXX

BO_ 2566037504 VDMA_F2A0_High_Voltage_Energy_St: 8 Vector__XXX
 SG_ High_Voltage_Energy_Storage_Pack : 0|64@1+ (1,0) [0|18446744073709551615] "" Vector__XXX

BO_ 2566037760 VDMA_F2A1_High_Voltage_Energy_St: 8 Vector__XXX
 SG_ High_Voltage_Energy_Storage_Pack : 0|64@1+ (1,0) [0|18446744073709551615] "" Vector__XXX

BO_ 2566038016 VDMA_F2A2_High_Voltage_Energy_St: 8 Vector__XXX
 SG_ High_Voltage_Energy_Storage_Pack : 0|64@1+ (1,0) [0|18446744073709551615] "" Vector__XXX

BO_ 2566038272 VDMA_F2A3_High_Voltage_Energy_St: 8 Vector__XXX
 SG_ High_Voltage_Energy_Storage_Pack : 0|64@1+ (1,0) [0|18446744073709551615] "" Vector__XXX

BO_ 2566038528 VDMA_F2A4_High_Voltage_Energy_St: 8 Vector__XXX
 SG_ High_Voltage_Energy_Storage_Pack : 0|64@1+ (1,0) [0|18446744073709551615] "" Vector__XXX

BO_ 2566038784 VDMA_F2A5_High_Voltage_Energy_St: 8 Vector__XXX
 SG_ High_Voltage_Energy_Storage_Pack : 0|64@1+ (1,0) [0|18446744073709551615] "" Vector__XXX

BO_ 2566039040 VDMA_F2A6_High_Voltage_Energy_St: 8 Vector__XXX
 SG_ High_Voltage_Energy_Storage_Pack : 0|64@1+ (1,0) [0|18446744073709551615] "" Vector__XXX

BO_ 2566039296 VDMA_F2A7_High_Voltage_Energy_St: 8 Vector__XXX
 SG_ High_Voltage_Energy_Storage_Pack : 0|64@1+ (1,0) [0|18446744073709551615] "" Vector__XXX

BO_ 2566039552 VDMA_F2A8_High_Voltage_Energy_St: 8 Vector__XXX
 SG_ High_Voltage_Energy_Storage_Pack : 0|64@1+ (1,0) [0|18446744073709551615] "" Vector__XXX

BO_ 2566039808 VDMA_F2A9_High_Voltage_Energy_St: 8 Vector__XXX
 SG_ High_Voltage_Energy_Storage_Pack : 0|64@1+ (1,0) [0|18446744073709551615] "" Vector__XXX

BO_ 2566040064 VDMA_F2AA_High_Voltage_Energy_St: 8 Vector__XXX
 SG_ High_Voltage_Energy_Storage_Pack : 0|64@1+ (1,0) [0|18446744073709551615] "" Vector__XXX

BO_ 2566040320 VDMA_F2AB_High_Voltage_Energy_St: 8 Vector__XXX
 SG_ High_Voltage_Energy_Storage_Pack : 0|64@1+ (1,0) [0|18446744073709551615] "" Vector__XXX

BO_ 2566040576 VDMA_F2AC_High_Voltage_Energy_St: 8 Vector__XXX
 SG_ High_Voltage_Energy_Storage_Pack : 0|64@1+ (1,0) [0|18446744073709551615] "" Vector__XXX

BO_ 2566040832 VDMA_F2AD_High_Voltage_Energy_St: 8 Vector__XXX
 SG_ High_Voltage_Energy_Storage_Pack : 0|64@1+ (1,0) [0|18446744073709551615] "" Vector__XXX

BO_ 2566041088 VDMA_F2AE_High_Voltage_Energy_St: 8 Vector__XXX
 SG_ High_Voltage_Energy_Storage_Pack : 0|64@1+ (1,0) [0|18446744073709551615] "" Vector__XXX

BO_ 2566041344 VDMA_F2AF_High_Voltage_Energy_St: 8 Vector__XXX
 SG_ High_Voltage_Energy_Storage_Pack : 0|64@1+ (1,0) [0|18446744073709551615] "" Vector__XXX

BO_ 2566041600 VDMA_F2B0_High_Voltage_Energy_St: 8 Vector__XXX
 SG_ High_Voltage_Energy_Storage_Pack : 0|64@1+ (1,0) [0|18446744073709551615] "" Vector__XXX

BO_ 2566041856 VDMA_F2B1_High_Voltage_Energy_St: 8 Vector__XXX
 SG_ High_Voltage_Energy_Storage_Pack : 0|64@1+ (1,0) [0|18446744073709551615] "" Vector__XXX

BO_ 2566042112 VDMA_F2B2_High_Voltage_Energy_St: 8 Vector__XXX
 SG_ High_Voltage_Energy_Storage_Pack : 0|64@1+ (1,0) [0|18446744073709551615] "" Vector__XXX

BO_ 2566042368 VDMA_F2B3_High_Voltage_Energy_St: 8 Vector__XXX
 SG_ High_Voltage_Energy_Storage_Pack : 0|64@1+ (1,0) [0|18446744073709551615] "" Vector__XXX

BO_ 2566042624 VDMA_F2B4_High_Voltage_Energy_St: 8 Vector__XXX
 SG_ High_Voltage_Energy_Storage_Pack : 0|64@1+ (1,0) [0|18446744073709551615] "" Vector__XXX

BO_ 2566042880 VDMA_F2B5_High_Voltage_Energy_St: 8 Vector__XXX
 SG_ High_Voltage_Energy_Storage_Pack : 0|64@1+ (1,0) [0|18446744073709551615] "" Vector__XXX

BO_ 2566043136 VDMA_F2B6_High_Voltage_Energy_St: 8 Vector__XXX
 SG_ High_Voltage_Energy_Storage_Pack : 0|64@1+ (1,0) [0|18446744073709551615] "" Vector__XXX

BO_ 2566043392 VDMA_F2B7_High_Voltage_Energy_St: 8 Vector__XXX
 SG_ High_Voltage_Energy_Storage_Pack : 0|64@1+ (1,0) [0|18446744073709551615] "" Vector__XXX

BO_ 2566043648 VDMA_F2B8_High_Voltage_Energy_St: 8 Vector__XXX
 SG_ High_Voltage_Energy_Storage_Pack : 0|64@1+ (1,0) [0|18446744073709551615] "" Vector__XXX

BO_ 2566043904 VDMA_F2B9_High_Voltage_Energy_St: 8 Vector__XXX
 SG_ High_Voltage_Energy_Storage_Pack : 0|64@1+ (1,0) [0|18446744073709551615] "" Vector__XXX

BO_ 2566044160 VDMA_F2BA_High_Voltage_Energy_St: 8 Vector__XXX
 SG_ High_Voltage_Energy_Storage_Pack : 0|64@1+ (1,0) [0|18446744073709551615] "" Vector__XXX

BO_ 2566044416 VDMA_F2BB_High_Voltage_Energy_St: 8 Vector__XXX
 SG_ High_Voltage_Energy_Storage_Pack : 0|64@1+ (1,0) [0|18446744073709551615] "" Vector__XXX

BO_ 2566044672 VDMA_F2BC_High_Voltage_Energy_St: 8 Vector__XXX
 SG_ High_Voltage_Energy_Storage_Pack : 0|64@1+ (1,0) [0|18446744073709551615] "" Vector__XXX

BO_ 2566044928 VDMA_F2BD_High_Voltage_Energy_St: 8 Vector__XXX
 SG_ High_Voltage_Energy_Storage_Pack : 0|64@1+ (1,0) [0|18446744073709551615] "" Vector__XXX

BO_ 2566045184 VDMA_F2BE_High_Voltage_Energy_St: 8 Vector__XXX
 SG_ High_Voltage_Energy_Storage_Pack : 0|64@1+ (1,0) [0|18446744073709551615] "" Vector__XXX

BO_ 2566045440 VDMA_F2BF_High_Voltage_Energy_St: 8 Vector__XXX
 SG_ High_Voltage_Energy_Storage_Pack : 0|64@1+ (1,0) [0|18446744073709551615] "" Vector__XXX

BO_ 2566045696 VDMA_F2C0_High_Voltage_Energy_St: 8 Vector__XXX
 SG_ High_Voltage_Energy_Storage_Pack : 0|64@1+ (1,0) [0|18446744073709551615] "" Vector__XXX

BO_ 2566045952 VDMA_F2C1_High_Voltage_Energy_St: 8 Vector__XXX
 SG_ High_Voltage_Energy_Storage_Pack : 0|64@1+ (1,0) [0|18446744073709551615] "" Vector__XXX

BO_ 2566046208 VDMA_F2C2_High_Voltage_Energy_St: 8 Vector__XXX
 SG_ High_Voltage_Energy_Storage_Pack : 0|64@1+ (1,0) [0|18446744073709551615] "" Vector__XXX

BO_ 2566046464 VDMA_F2C3_High_Voltage_Energy_St: 8 Vector__XXX
 SG_ High_Voltage_Energy_Storage_Pack : 0|64@1+ (1,0) [0|18446744073709551615] "" Vector__XXX

BO_ 2566046720 VDMA_F2C4_High_Voltage_Energy_St: 8 Vector__XXX
 SG_ High_Voltage_Energy_Storage_Pack : 0|64@1+ (1,0) [0|18446744073709551615] "" Vector__XXX

BO_ 2566046976 VDMA_F2C5_High_Voltage_Energy_St: 8 Vector__XXX
 SG_ High_Voltage_Energy_Storage_Pack : 0|64@1+ (1,0) [0|18446744073709551615] "" Vector__XXX

BO_ 2566047232 VDMA_F2C6_High_Voltage_Energy_St: 8 Vector__XXX
 SG_ High_Voltage_Energy_Storage_Pack : 0|64@1+ (1,0) [0|18446744073709551615] "" Vector__XXX

BO_ 2566047488 VDMA_F2C7_High_Voltage_Energy_St: 8 Vector__XXX
 SG_ High_Voltage_Energy_Storage_Pack : 0|64@1+ (1,0) [0|18446744073709551615] "" Vector__XXX

BO_ 2566047744 VDMA_F2C8_High_Voltage_Energy_St: 8 Vector__XXX
 SG_ High_Voltage_Energy_Storage_Pack : 0|64@1+ (1,0) [0|18446744073709551615] "" Vector__XXX

BO_ 2566048000 VDMA_F2C9_High_Voltage_Energy_St: 8 Vector__XXX
 SG_ High_Voltage_Energy_Storage_Pack : 0|64@1+ (1,0) [0|18446744073709551615] "" Vector__XXX

BO_ 2566048256 VDMA_F2CA_High_Voltage_Energy_St: 8 Vector__XXX
 SG_ High_Voltage_Energy_Storage_Pack : 0|64@1+ (1,0) [0|18446744073709551615] "" Vector__XXX

BO_ 2566048512 VDMA_F2CB_High_Voltage_Energy_St: 8 Vector__XXX
 SG_ High_Voltage_Energy_Storage_Pack : 0|64@1+ (1,0) [0|18446744073709551615] "" Vector__XXX

BO_ 2566048768 VDMA_F2CC_High_Voltage_Energy_St: 8 Vector__XXX
 SG_ High_Voltage_Energy_Storage_Pack : 0|64@1+ (1,0) [0|18446744073709551615] "" Vector__XXX

BO_ 2566049024 VDMA_F2CD_High_Voltage_Energy_St: 8 Vector__XXX
 SG_ High_Voltage_Energy_Storage_Pack : 0|64@1+ (1,0) [0|18446744073709551615] "" Vector__XXX

BO_ 2566049280 VDMA_F2CE_High_Voltage_Energy_St: 8 Vector__XXX
 SG_ High_Voltage_Energy_Storage_Pack : 0|64@1+ (1,0) [0|18446744073709551615] "" Vector__XXX

BO_ 2566049536 VDMA_F2CF_High_Voltage_Energy_St: 8 Vector__XXX
 SG_ High_Voltage_Energy_Storage_Pack : 0|64@1+ (1,0) [0|18446744073709551615] "" Vector__XXX

BO_ 2566049792 VDMA_F2D0_High_Voltage_Energy_St: 8 Vector__XXX
 SG_ High_Voltage_Energy_Storage_Pack : 0|64@1+ (1,0) [0|18446744073709551615] "" Vector__XXX

BO_ 2566050048 VDMA_F2D1_High_Voltage_Energy_St: 8 Vector__XXX
 SG_ High_Voltage_Energy_Storage_Pack : 0|64@1+ (1,0) [0|18446744073709551615] "" Vector__XXX

BO_ 2566050304 VDMA_F2D2_High_Voltage_Energy_St: 8 Vector__XXX
 SG_ High_Voltage_Energy_Storage_Pack : 0|64@1+ (1,0) [0|18446744073709551615] "" Vector__XXX

BO_ 2566050560 VDMA_F2D3_High_Voltage_Energy_St: 8 Vector__XXX
 SG_ High_Voltage_Energy_Storage_Pack : 0|64@1+ (1,0) [0|18446744073709551615] "" Vector__XXX

BO_ 2566050816 VDMA_F2D4_High_Voltage_Energy_St: 8 Vector__XXX
 SG_ High_Voltage_Energy_Storage_Pack : 0|64@1+ (1,0) [0|18446744073709551615] "" Vector__XXX

BO_ 2566051072 VDMA_F2D5_High_Voltage_Energy_St: 8 Vector__XXX
 SG_ High_Voltage_Energy_Storage_Pack : 0|64@1+ (1,0) [0|18446744073709551615] "" Vector__XXX

BO_ 2566051328 VDMA_F2D6_High_Voltage_Energy_St: 8 Vector__XXX
 SG_ High_Voltage_Energy_Storage_Pack : 0|64@1+ (1,0) [0|18446744073709551615] "" Vector__XXX

BO_ 2566051584 VDMA_F2D7_High_Voltage_Energy_St: 8 Vector__XXX
 SG_ High_Voltage_Energy_Storage_Pack : 0|64@1+ (1,0) [0|18446744073709551615] "" Vector__XXX

BO_ 2566051840 VDMA_F2D8_High_Voltage_Energy_St: 8 Vector__XXX
 SG_ High_Voltage_Energy_Storage_Pack : 0|64@1+ (1,0) [0|18446744073709551615] "" Vector__XXX

BO_ 2566052096 VDMA_F2D9_High_Voltage_Energy_St: 8 Vector__XXX
 SG_ High_Voltage_Energy_Storage_Pack : 0|64@1+ (1,0) [0|18446744073709551615] "" Vector__XXX

BO_ 2566052352 VDMA_F2DA_High_Voltage_Energy_St: 8 Vector__XXX
 SG_ High_Voltage_Energy_Storage_Pack : 0|64@1+ (1,0) [0|18446744073709551615] "" Vector__XXX

BO_ 2566052608 VDMA_F2DB_High_Voltage_Energy_St: 8 Vector__XXX
 SG_ High_Voltage_Energy_Storage_Pack : 0|64@1+ (1,0) [0|18446744073709551615] "" Vector__XXX

BO_ 2566052864 VDMA_F2DC_High_Voltage_Energy_St: 8 Vector__XXX
 SG_ High_Voltage_Energy_Storage_Pack : 0|64@1+ (1,0) [0|18446744073709551615] "" Vector__XXX

BO_ 2566053120 VDMA_F2DD_High_Voltage_Energy_St: 8 Vector__XXX
 SG_ High_Voltage_Energy_Storage_Pack : 0|64@1+ (1,0) [0|18446744073709551615] "" Vector__XXX

BO_ 2566053376 VDMA_F2DE_High_Voltage_Energy_St: 8 Vector__XXX
 SG_ High_Voltage_Energy_Storage_Pack : 0|64@1+ (1,0) [0|18446744073709551615] "" Vector__XXX

BO_ 2566053632 VDMA_F2DF_High_Voltage_Energy_St: 8 Vector__XXX
 SG_ High_Voltage_Energy_Storage_Pack : 0|64@1+ (1,0) [0|18446744073709551615] "" Vector__XXX

BO_ 2566053888 VDMA_F2E0_High_Voltage_Energy_St: 8 Vector__XXX
 SG_ High_Voltage_Energy_Storage_Pack : 0|64@1+ (1,0) [0|18446744073709551615] "" Vector__XXX

BO_ 2566054144 VDMA_F2E1_High_Voltage_Energy_St: 8 Vector__XXX
 SG_ High_Voltage_Energy_Storage_Pack : 0|64@1+ (1,0) [0|18446744073709551615] "" Vector__XXX

BO_ 2566054400 VDMA_F2E2_High_Voltage_Energy_St: 8 Vector__XXX
 SG_ High_Voltage_Energy_Storage_Pack : 0|64@1+ (1,0) [0|18446744073709551615] "" Vector__XXX

BO_ 2566054656 VDMA_F2E3_High_Voltage_Energy_St: 8 Vector__XXX
 SG_ High_Voltage_Energy_Storage_Pack : 0|64@1+ (1,0) [0|18446744073709551615] "" Vector__XXX

BO_ 2566054912 VDMA_F2E4_High_Voltage_Energy_St: 8 Vector__XXX
 SG_ High_Voltage_Energy_Storage_Pack : 0|64@1+ (1,0) [0|18446744073709551615] "" Vector__XXX

BO_ 2566055168 VDMA_F2E5_High_Voltage_Energy_St: 8 Vector__XXX
 SG_ High_Voltage_Energy_Storage_Pack : 0|64@1+ (1,0) [0|18446744073709551615] "" Vector__XXX

BO_ 2566055424 VDMA_F2E6_High_Voltage_Energy_St: 8 Vector__XXX
 SG_ High_Voltage_Energy_Storage_Pack : 0|64@1+ (1,0) [0|18446744073709551615] "" Vector__XXX

BO_ 2566055680 VDMA_F2E7_High_Voltage_Energy_St: 8 Vector__XXX
 SG_ High_Voltage_Energy_Storage_Pack : 0|64@1+ (1,0) [0|18446744073709551615] "" Vector__XXX

BO_ 2566055936 VDMA_F2E8_High_Voltage_Energy_St: 8 Vector__XXX
 SG_ High_Voltage_Energy_Storage_Pack : 0|64@1+ (1,0) [0|18446744073709551615] "" Vector__XXX

BO_ 2566056192 VDMA_F2E9_High_Voltage_Energy_St: 8 Vector__XXX
 SG_ High_Voltage_Energy_Storage_Pack : 0|64@1+ (1,0) [0|18446744073709551615] "" Vector__XXX

BO_ 2566056448 VDMA_F2EA_High_Voltage_Energy_St: 8 Vector__XXX
 SG_ High_Voltage_Energy_Storage_Pack : 0|64@1+ (1,0) [0|18446744073709551615] "" Vector__XXX

BO_ 2566056704 VDMA_F2EB_High_Voltage_Energy_St: 8 Vector__XXX
 SG_ High_Voltage_Energy_Storage_Pack : 0|64@1+ (1,0) [0|18446744073709551615] "" Vector__XXX

BO_ 2566056960 VDMA_F2EC_High_Voltage_Energy_St: 8 Vector__XXX
 SG_ High_Voltage_Energy_Storage_Pack : 0|64@1+ (1,0) [0|18446744073709551615] "" Vector__XXX

BO_ 2566057216 VDMA_F2ED_High_Voltage_Energy_St: 8 Vector__XXX
 SG_ High_Voltage_Energy_Storage_Pack : 0|64@1+ (1,0) [0|18446744073709551615] "" Vector__XXX

BO_ 2566057472 VDMA_F2EE_High_Voltage_Energy_St: 8 Vector__XXX
 SG_ High_Voltage_Energy_Storage_Pack : 0|64@1+ (1,0) [0|18446744073709551615] "" Vector__XXX

BO_ 2566057728 VDMA_F2EF_High_Voltage_Energy_St: 8 Vector__XXX
 SG_ High_Voltage_Energy_Storage_Pack : 0|64@1+ (1,0) [0|18446744073709551615] "" Vector__XXX

BO_ 2566057984 VDMA_F2F0_High_Voltage_Energy_St: 8 Vector__XXX
 SG_ High_Voltage_Energy_Storage_Pack : 0|64@1+ (1,0) [0|18446744073709551615] "" Vector__XXX

BO_ 2566058240 VDMA_F2F1_High_Voltage_Energy_St: 8 Vector__XXX
 SG_ High_Voltage_Energy_Storage_Pack : 0|64@1+ (1,0) [0|18446744073709551615] "" Vector__XXX

BO_ 2566058496 VDMA_F2F2_High_Voltage_Energy_St: 8 Vector__XXX
 SG_ High_Voltage_Energy_Storage_Pack : 0|64@1+ (1,0) [0|18446744073709551615] "" Vector__XXX

BO_ 2566058752 VDMA_F2F3_High_Voltage_Energy_St: 8 Vector__XXX
 SG_ High_Voltage_Energy_Storage_Pack : 0|64@1+ (1,0) [0|18446744073709551615] "" Vector__XXX

BO_ 2566059008 VDMA_F2F4_High_Voltage_Energy_St: 8 Vector__XXX
 SG_ High_Voltage_Energy_Storage_Pack : 0|64@1+ (1,0) [0|18446744073709551615] "" Vector__XXX

BO_ 2566059264 VDMA_F2F5_High_Voltage_Energy_St: 8 Vector__XXX
 SG_ High_Voltage_Energy_Storage_Pack : 0|64@1+ (1,0) [0|18446744073709551615] "" Vector__XXX

BO_ 2566059520 VDMA_F2F6_High_Voltage_Energy_St: 8 Vector__XXX
 SG_ High_Voltage_Energy_Storage_Pack : 0|64@1+ (1,0) [0|18446744073709551615] "" Vector__XXX

BO_ 2566059776 VDMA_F2F7_High_Voltage_Energy_St: 8 Vector__XXX
 SG_ High_Voltage_Energy_Storage_Pack : 0|64@1+ (1,0) [0|18446744073709551615] "" Vector__XXX

BO_ 2566060032 VDMA_F2F8_High_Voltage_Energy_St: 8 Vector__XXX
 SG_ High_Voltage_Energy_Storage_Pack : 0|64@1+ (1,0) [0|18446744073709551615] "" Vector__XXX

BO_ 2566060288 VDMA_F2F9_High_Voltage_Energy_St: 8 Vector__XXX
 SG_ High_Voltage_Energy_Storage_Pack : 0|64@1+ (1,0) [0|18446744073709551615] "" Vector__XXX

BO_ 2566060544 VDMA_F2FA_High_Voltage_Energy_St: 8 Vector__XXX
 SG_ High_Voltage_Energy_Storage_Pack : 0|64@1+ (1,0) [0|18446744073709551615] "" Vector__XXX

BO_ 2566060800 VDMA_F2FB_High_Voltage_Energy_St: 8 Vector__XXX
 SG_ High_Voltage_Energy_Storage_Pack : 0|64@1+ (1,0) [0|18446744073709551615] "" Vector__XXX

BO_ 2566061056 VDMA_F2FC_High_Voltage_Energy_St: 8 Vector__XXX
 SG_ High_Voltage_Energy_Storage_Pack : 0|64@1+ (1,0) [0|18446744073709551615] "" Vector__XXX

BO_ 2566061312 VDMA_F2FD_High_Voltage_Energy_St: 8 Vector__XXX
 SG_ High_Voltage_Energy_Storage_Pack : 0|64@1+ (1,0) [0|18446744073709551615] "" Vector__XXX

BO_ 2566061568 VDMA_F2FE_High_Voltage_Energy_St: 8 Vector__XXX
 SG_ High_Voltage_Energy_Storage_Pack : 0|64@1+ (1,0) [0|18446744073709551615] "" Vector__XXX

BO_ 2566061824 VDMA_F2FF_High_Voltage_Energy_St: 8 Vector__XXX
 SG_ High_Voltage_Energy_Storage_Pack : 0|64@1+ (1,0) [0|18446744073709551615] "" Vector__XXX

BO_ 2566062080 VDMA_F300_High_Voltage_Energy_St: 8 Vector__XXX
 SG_ High_Voltage_Energy_Storage_Pack : 0|64@1+ (1,0) [0|18446744073709551615] "" Vector__XXX

BO_ 2566062336 VDMA_F301_High_Voltage_Energy_St: 8 Vector__XXX
 SG_ High_Voltage_Energy_Storage_Pack : 0|64@1+ (1,0) [0|18446744073709551615] "" Vector__XXX

BO_ 2566062592 VDMA_F302_High_Voltage_Energy_St: 8 Vector__XXX
 SG_ High_Voltage_Energy_Storage_Pack : 0|64@1+ (1,0) [0|18446744073709551615] "" Vector__XXX

BO_ 2566062848 VDMA_F303_High_Voltage_Energy_St: 8 Vector__XXX
 SG_ High_Voltage_Energy_Storage_Pack : 0|64@1+ (1,0) [0|18446744073709551615] "" Vector__XXX

BO_ 2566063104 VDMA_F304_High_Voltage_Energy_St: 8 Vector__XXX
 SG_ High_Voltage_Energy_Storage_Pack : 0|64@1+ (1,0) [0|18446744073709551615] "" Vector__XXX

BO_ 2566063360 VDMA_F305_High_Voltage_Energy_St: 8 Vector__XXX
 SG_ High_Voltage_Energy_Storage_Pack : 0|64@1+ (1,0) [0|18446744073709551615] "" Vector__XXX

BO_ 2566063616 VDMA_F306_High_Voltage_Energy_St: 8 Vector__XXX
 SG_ High_Voltage_Energy_Storage_Pack : 0|64@1+ (1,0) [0|18446744073709551615] "" Vector__XXX

BO_ 2566063872 VDMA_F307_High_Voltage_Energy_St: 8 Vector__XXX
 SG_ High_Voltage_Energy_Storage_Pack : 0|64@1+ (1,0) [0|18446744073709551615] "" Vector__XXX

BO_ 2566064128 VDMA_F308_High_Voltage_Energy_St: 8 Vector__XXX
 SG_ High_Voltage_Energy_Storage_Pack : 0|64@1+ (1,0) [0|18446744073709551615] "" Vector__XXX

BO_ 2566064384 VDMA_F309_High_Voltage_Energy_St: 8 Vector__XXX
 SG_ High_Voltage_Energy_Storage_Pack : 0|64@1+ (1,0) [0|18446744073709551615] "" Vector__XXX

BO_ 2566064640 VDMA_F30A_High_Voltage_Energy_St: 8 Vector__XXX
 SG_ High_Voltage_Energy_Storage_Pack : 0|64@1+ (1,0) [0|18446744073709551615] "" Vector__XXX

BO_ 2566064896 VDMA_F30B_High_Voltage_Energy_St: 8 Vector__XXX
 SG_ High_Voltage_Energy_Storage_Pack : 0|64@1+ (1,0) [0|18446744073709551615] "" Vector__XXX

BO_ 2566065152 VDMA_F30C_High_Voltage_Energy_St: 8 Vector__XXX
 SG_ High_Voltage_Energy_Storage_Pack : 0|64@1+ (1,0) [0|18446744073709551615] "" Vector__XXX

BO_ 2566065408 VDMA_F30D_High_Voltage_Energy_St: 8 Vector__XXX
 SG_ High_Voltage_Energy_Storage_Pack : 0|64@1+ (1,0) [0|18446744073709551615] "" Vector__XXX

BO_ 2566065664 VDMA_F30E_High_Voltage_Energy_St: 8 Vector__XXX
 SG_ High_Voltage_Energy_Storage_Pack : 0|64@1+ (1,0) [0|18446744073709551615] "" Vector__XXX

BO_ 2566065920 VDMA_F30F_High_Voltage_Energy_St: 8 Vector__XXX
 SG_ High_Voltage_Energy_Storage_Pack : 0|64@1+ (1,0) [0|18446744073709551615] "" Vector__XXX

BO_ 2566066176 VDMA_F310_High_Voltage_Energy_St: 8 Vector__XXX
 SG_ High_Voltage_Energy_Storage_Pack : 0|64@1+ (1,0) [0|18446744073709551615] "" Vector__XXX

BO_ 2566066432 VDMA_F311_High_Voltage_Energy_St: 8 Vector__XXX
 SG_ High_Voltage_Energy_Storage_Pack : 0|64@1+ (1,0) [0|18446744073709551615] "" Vector__XXX

BO_ 2566066688 VDMA_F312_High_Voltage_Energy_St: 8 Vector__XXX
 SG_ High_Voltage_Energy_Storage_Pack : 0|64@1+ (1,0) [0|18446744073709551615] "" Vector__XXX

BO_ 2566066944 VDMA_F313_High_Voltage_Energy_St: 8 Vector__XXX
 SG_ High_Voltage_Energy_Storage_Pack : 0|64@1+ (1,0) [0|18446744073709551615] "" Vector__XXX

BO_ 2566067200 VDMA_F314_High_Voltage_Energy_St: 8 Vector__XXX
 SG_ High_Voltage_Energy_Storage_Pack : 0|64@1+ (1,0) [0|18446744073709551615] "" Vector__XXX

BO_ 2566067456 VDMA_F315_High_Voltage_Energy_St: 8 Vector__XXX
 SG_ High_Voltage_Energy_Storage_Pack : 0|64@1+ (1,0) [0|18446744073709551615] "" Vector__XXX

BO_ 2566067712 VDMA_F316_High_Voltage_Energy_St: 8 Vector__XXX
 SG_ High_Voltage_Energy_Storage_Pack : 0|64@1+ (1,0) [0|18446744073709551615] "" Vector__XXX

BO_ 2566067968 VDMA_F317_High_Voltage_Energy_St: 8 Vector__XXX
 SG_ High_Voltage_Energy_Storage_Pack : 0|64@1+ (1,0) [0|18446744073709551615] "" Vector__XXX

BO_ 2566068224 VDMA_F318_High_Voltage_Energy_St: 8 Vector__XXX
 SG_ High_Voltage_Energy_Storage_Pack : 0|64@1+ (1,0) [0|18446744073709551615] "" Vector__XXX

BO_ 2566068480 VDMA_F319_High_Voltage_Energy_St: 8 Vector__XXX
 SG_ High_Voltage_Energy_Storage_Pack : 0|64@1+ (1,0) [0|18446744073709551615] "" Vector__XXX

BO_ 2566068736 VDMA_F31A_High_Voltage_Energy_St: 8 Vector__XXX
 SG_ High_Voltage_Energy_Storage_Pack : 0|64@1+ (1,0) [0|18446744073709551615] "" Vector__XXX

BO_ 2566068992 VDMA_F31B_High_Voltage_Energy_St: 8 Vector__XXX
 SG_ High_Voltage_Energy_Storage_Pack : 0|64@1+ (1,0) [0|18446744073709551615] "" Vector__XXX

BO_ 2566069248 VDMA_F31C_High_Voltage_Energy_St: 8 Vector__XXX
 SG_ High_Voltage_Energy_Storage_Pack : 0|64@1+ (1,0) [0|18446744073709551615] "" Vector__XXX

BO_ 2566069504 VDMA_F31D_High_Voltage_Energy_St: 8 Vector__XXX
 SG_ High_Voltage_Energy_Storage_Pack : 0|64@1+ (1,0) [0|18446744073709551615] "" Vector__XXX

BO_ 2566069760 VDMA_F31E_High_Voltage_Energy_St: 8 Vector__XXX
 SG_ High_Voltage_Energy_Storage_Pack : 0|64@1+ (1,0) [0|18446744073709551615] "" Vector__XXX

BO_ 2566070016 VDMA_F31F_High_Voltage_Energy_St: 8 Vector__XXX
 SG_ High_Voltage_Energy_Storage_Pack : 0|64@1+ (1,0) [0|18446744073709551615] "" Vector__XXX

BO_ 2566070272 VDMA_F320_High_Voltage_Energy_St: 8 Vector__XXX
 SG_ High_Voltage_Energy_Storage_Pack : 0|64@1+ (1,0) [0|18446744073709551615] "" Vector__XXX

BO_ 2566070528 VDMA_F321_High_Voltage_Energy_St: 8 Vector__XXX
 SG_ High_Voltage_Energy_Storage_Pack : 0|64@1+ (1,0) [0|18446744073709551615] "" Vector__XXX

BO_ 2566070784 VDMA_F322_High_Voltage_Energy_St: 8 Vector__XXX
 SG_ High_Voltage_Energy_Storage_Pack : 0|64@1+ (1,0) [0|18446744073709551615] "" Vector__XXX

BO_ 2566071040 VDMA_F323_High_Voltage_Energy_St: 8 Vector__XXX
 SG_ High_Voltage_Energy_Storage_Pack : 0|64@1+ (1,0) [0|18446744073709551615] "" Vector__XXX

BO_ 2566071296 VDMA_F324_High_Voltage_Energy_St: 8 Vector__XXX
 SG_ High_Voltage_Energy_Storage_Pack : 0|64@1+ (1,0) [0|18446744073709551615] "" Vector__XXX

BO_ 2566071552 VDMA_F325_High_Voltage_Energy_St: 8 Vector__XXX
 SG_ High_Voltage_Energy_Storage_Pack : 0|64@1+ (1,0) [0|18446744073709551615] "" Vector__XXX

BO_ 2566071808 VDMA_F326_High_Voltage_Energy_St: 8 Vector__XXX
 SG_ High_Voltage_Energy_Storage_Pack : 0|64@1+ (1,0) [0|18446744073709551615] "" Vector__XXX

BO_ 2566072064 VDMA_F327_High_Voltage_Energy_St: 8 Vector__XXX
 SG_ High_Voltage_Energy_Storage_Pack : 0|64@1+ (1,0) [0|18446744073709551615] "" Vector__XXX

BO_ 2566072320 VDMA_F328_High_Voltage_Energy_St: 8 Vector__XXX
 SG_ High_Voltage_Energy_Storage_Pack : 0|64@1+ (1,0) [0|18446744073709551615] "" Vector__XXX

BO_ 2566072576 VDMA_F329_High_Voltage_Energy_St: 8 Vector__XXX
 SG_ High_Voltage_Energy_Storage_Pack : 0|64@1+ (1,0) [0|18446744073709551615] "" Vector__XXX

BO_ 2566072832 VDMA_F32A_High_Voltage_Energy_St: 8 Vector__XXX
 SG_ High_Voltage_Energy_Storage_Pack : 0|64@1+ (1,0) [0|18446744073709551615] "" Vector__XXX

BO_ 2566073088 VDMA_F32B_High_Voltage_Energy_St: 8 Vector__XXX
 SG_ High_Voltage_Energy_Storage_Pack : 0|64@1+ (1,0) [0|18446744073709551615] "" Vector__XXX

BO_ 2566073344 VDMA_F32C_High_Voltage_Energy_St: 8 Vector__XXX
 SG_ High_Voltage_Energy_Storage_Pack : 0|64@1+ (1,0) [0|18446744073709551615] "" Vector__XXX

BO_ 2566073600 VDMA_F32D_High_Voltage_Energy_St: 8 Vector__XXX
 SG_ High_Voltage_Energy_Storage_Pack : 0|64@1+ (1,0) [0|18446744073709551615] "" Vector__XXX

BO_ 2566073856 VDMA_F32E_High_Voltage_Energy_St: 8 Vector__XXX
 SG_ High_Voltage_Energy_Storage_Pack : 0|64@1+ (1,0) [0|18446744073709551615] "" Vector__XXX

BO_ 2566074112 VDMA_F32F_High_Voltage_Energy_St: 8 Vector__XXX
 SG_ High_Voltage_Energy_Storage_Pack : 0|64@1+ (1,0) [0|18446744073709551615] "" Vector__XXX

BO_ 2566074368 VDMA_F330_High_Voltage_Energy_St: 8 Vector__XXX
 SG_ High_Voltage_Energy_Storage_Pack : 0|64@1+ (1,0) [0|18446744073709551615] "" Vector__XXX

BO_ 2566074624 VDMA_F331_High_Voltage_Energy_St: 8 Vector__XXX
 SG_ High_Voltage_Energy_Storage_Pack : 0|64@1+ (1,0) [0|18446744073709551615] "" Vector__XXX

BO_ 2566074880 VDMA_F332_High_Voltage_Energy_St: 8 Vector__XXX
 SG_ High_Voltage_Energy_Storage_Pack : 0|64@1+ (1,0) [0|18446744073709551615] "" Vector__XXX

BO_ 2566075136 VDMA_F333_High_Voltage_Energy_St: 8 Vector__XXX
 SG_ High_Voltage_Energy_Storage_Pack : 0|64@1+ (1,0) [0|18446744073709551615] "" Vector__XXX

BO_ 2566075392 VDMA_F334_High_Voltage_Energy_St: 8 Vector__XXX
 SG_ High_Voltage_Energy_Storage_Pack : 0|64@1+ (1,0) [0|18446744073709551615] "" Vector__XXX

BO_ 2566075648 VDMA_F335_High_Voltage_Energy_St: 8 Vector__XXX
 SG_ High_Voltage_Energy_Storage_Pack : 0|64@1+ (1,0) [0|18446744073709551615] "" Vector__XXX

BO_ 2566075904 VDMA_F336_High_Voltage_Energy_St: 8 Vector__XXX
 SG_ High_Voltage_Energy_Storage_Pack : 0|64@1+ (1,0) [0|18446744073709551615] "" Vector__XXX

BO_ 2566076160 VDMA_F337_High_Voltage_Energy_St: 8 Vector__XXX
 SG_ High_Voltage_Energy_Storage_Pack : 0|64@1+ (1,0) [0|18446744073709551615] "" Vector__XXX

BO_ 2566076416 VDMA_F338_High_Voltage_Energy_St: 8 Vector__XXX
 SG_ High_Voltage_Energy_Storage_Pack : 0|64@1+ (1,0) [0|18446744073709551615] "" Vector__XXX

BO_ 2566076672 VDMA_F339_High_Voltage_Energy_St: 8 Vector__XXX
 SG_ High_Voltage_Energy_Storage_Pack : 0|64@1+ (1,0) [0|18446744073709551615] "" Vector__XXX

BO_ 2566076928 VDMA_F33A_High_Voltage_Energy_St: 8 Vector__XXX
 SG_ High_Voltage_Energy_Storage_Pack : 0|64@1+ (1,0) [0|18446744073709551615] "" Vector__XXX

BO_ 2566077184 VDMA_F33B_High_Voltage_Energy_St: 8 Vector__XXX
 SG_ High_Voltage_Energy_Storage_Pack : 0|64@1+ (1,0) [0|18446744073709551615] "" Vector__XXX

BO_ 2566077440 VDMA_F33C_High_Voltage_Energy_St: 8 Vector__XXX
 SG_ High_Voltage_Energy_Storage_Pack : 0|64@1+ (1,0) [0|18446744073709551615] "" Vector__XXX

BO_ 2566077696 VDMA_F33D_High_Voltage_Energy_St: 8 Vector__XXX
 SG_ High_Voltage_Energy_Storage_Pack : 0|64@1+ (1,0) [0|18446744073709551615] "" Vector__XXX

BO_ 2566077952 VDMA_F33E_High_Voltage_Energy_St: 8 Vector__XXX
 SG_ High_Voltage_Energy_Storage_Pack : 0|64@1+ (1,0) [0|18446744073709551615] "" Vector__XXX

BO_ 2566078208 VDMA_F33F_High_Voltage_Energy_St: 8 Vector__XXX
 SG_ High_Voltage_Energy_Storage_Pack : 0|64@1+ (1,0) [0|18446744073709551615] "" Vector__XXX

BO_ 2566078464 VDMA_F340_High_Voltage_Energy_St: 8 Vector__XXX
 SG_ High_Voltage_Energy_Storage_Pack : 0|64@1+ (1,0) [0|18446744073709551615] "" Vector__XXX

BO_ 2566078720 VDMA_F341_External_Steering_Requ: 8 Vector__XXX
 SG_ External_Steering_Request_RawPay : 0|64@1+ (1,0) [0|18446744073709551615] "" Vector__XXX

BO_ 2566078976 VDMA_F342_Active_Steering_System: 8 Vector__XXX
 SG_ Active_Steering_System_Controlle : 0|64@1+ (1,0) [0|18446744073709551615] "" Vector__XXX

BO_ 2566079232 VDMA_F343_Electronic_Park_Brake_: 8 Vector__XXX
 SG_ Electronic_Park_Brake_Controller : 0|64@1+ (1,0) [0|18446744073709551615] "" Vector__XXX

BO_ 2566079488 VDMA_F344_Electronic_Park_Brake_: 8 Vector__XXX
 SG_ Electronic_Park_Brake_Controller : 0|64@1+ (1,0) [0|18446744073709551615] "" Vector__XXX

BO_ 2566079744 VDMA_F345_Genset_Frequency_Limit: 8 Vector__XXX
 SG_ Genset_Frequency_Limitation_RawP : 0|64@1+ (1,0) [0|18446744073709551615] "" Vector__XXX

BO_ 2566080000 VDMA_F346_Genset_Power_Limitatio: 8 Vector__XXX
 SG_ Genset_Power_Limitation_RawPaylo : 0|64@1+ (1,0) [0|18446744073709551615] "" Vector__XXX

BO_ 2566080256 VDMA_F347_Genset_Real_Power_Cont: 8 Vector__XXX
 SG_ Genset_Real_Power_Control_RawPay : 0|64@1+ (1,0) [0|18446744073709551615] "" Vector__XXX

BO_ 2566080512 VDMA_F348_Genset_Reactive_Power: 8 Vector__XXX
 SG_ Genset_Reactive_Power_RawPayload : 0|64@1+ (1,0) [0|18446744073709551615] "" Vector__XXX

BO_ 2566080768 VDMA_F349_Fuel_Cell_Compartment_: 8 Vector__XXX
 SG_ Fuel_Cell_Compartment_Informatio : 0|64@1+ (1,0) [0|18446744073709551615] "" Vector__XXX

BO_ 2566081024 VDMA_F34A_Genset_Real_Power_Setp: 8 Vector__XXX
 SG_ Genset_Real_Power_Setpoint_Deman : 0|64@1+ (1,0) [0|18446744073709551615] "" Vector__XXX

BO_ 2566081280 VDMA_F34B_Genset_Real_Power_Cont: 8 Vector__XXX
 SG_ Genset_Real_Power_Control_2_RawP : 0|64@1+ (1,0) [0|18446744073709551615] "" Vector__XXX

BO_ 2566081536 VDMA_F34C_High_Voltage_Energy_St: 8 Vector__XXX
 SG_ High_Voltage_Energy_Storage_Pack : 0|64@1+ (1,0) [0|18446744073709551615] "" Vector__XXX

BO_ 2566081792 VDMA_F34D_High_Voltage_Energy_St: 8 Vector__XXX
 SG_ High_Voltage_Energy_Storage_Pack : 0|64@1+ (1,0) [0|18446744073709551615] "" Vector__XXX

BO_ 2566082048 VDMA_F34E_High_Voltage_Energy_St: 8 Vector__XXX
 SG_ High_Voltage_Energy_Storage_Pack : 0|64@1+ (1,0) [0|18446744073709551615] "" Vector__XXX

BO_ 2566082304 VDMA_F34F_High_Voltage_Energy_St: 8 Vector__XXX
 SG_ High_Voltage_Energy_Storage_Pack : 0|64@1+ (1,0) [0|18446744073709551615] "" Vector__XXX

BO_ 2566082560 VDMA_F350_High_Voltage_Energy_St: 8 Vector__XXX
 SG_ High_Voltage_Energy_Storage_Pack : 0|64@1+ (1,0) [0|18446744073709551615] "" Vector__XXX

BO_ 2566082816 VDMA_F351_High_Voltage_Energy_St: 8 Vector__XXX
 SG_ High_Voltage_Energy_Storage_Pack : 0|64@1+ (1,0) [0|18446744073709551615] "" Vector__XXX

BO_ 2566083072 VDMA_F352_High_Voltage_Energy_St: 8 Vector__XXX
 SG_ High_Voltage_Energy_Storage_Pack : 0|64@1+ (1,0) [0|18446744073709551615] "" Vector__XXX

BO_ 2566083328 VDMA_F353_High_Voltage_Energy_St: 8 Vector__XXX
 SG_ High_Voltage_Energy_Storage_Pack : 0|64@1+ (1,0) [0|18446744073709551615] "" Vector__XXX

BO_ 2566083584 VDMA_F354_High_Voltage_Energy_St: 8 Vector__XXX
 SG_ High_Voltage_Energy_Storage_Pack : 0|64@1+ (1,0) [0|18446744073709551615] "" Vector__XXX

BO_ 2566083840 VDMA_F355_High_Voltage_Energy_St: 8 Vector__XXX
 SG_ High_Voltage_Energy_Storage_Pack : 0|64@1+ (1,0) [0|18446744073709551615] "" Vector__XXX

BO_ 2566084096 VDMA_F356_High_Voltage_Energy_St: 8 Vector__XXX
 SG_ High_Voltage_Energy_Storage_Pack : 0|64@1+ (1,0) [0|18446744073709551615] "" Vector__XXX

BO_ 2566084352 VDMA_F357_High_Voltage_Energy_St: 8 Vector__XXX
 SG_ High_Voltage_Energy_Storage_Pack : 0|64@1+ (1,0) [0|18446744073709551615] "" Vector__XXX

BO_ 2566084608 VDMA_F358_High_Voltage_Energy_St: 8 Vector__XXX
 SG_ High_Voltage_Energy_Storage_Pack : 0|64@1+ (1,0) [0|18446744073709551615] "" Vector__XXX

BO_ 2566084864 VDMA_F359_High_Voltage_Energy_St: 8 Vector__XXX
 SG_ High_Voltage_Energy_Storage_Pack : 0|64@1+ (1,0) [0|18446744073709551615] "" Vector__XXX

BO_ 2566085120 VDMA_F35A_High_Voltage_Energy_St: 8 Vector__XXX
 SG_ High_Voltage_Energy_Storage_Pack : 0|64@1+ (1,0) [0|18446744073709551615] "" Vector__XXX

BO_ 2566085376 VDMA_F35B_High_Voltage_Energy_St: 8 Vector__XXX
 SG_ High_Voltage_Energy_Storage_Pack : 0|64@1+ (1,0) [0|18446744073709551615] "" Vector__XXX

BO_ 2566085632 VDMA_F35C_High_Voltage_Energy_St: 8 Vector__XXX
 SG_ High_Voltage_Energy_Storage_Pack : 0|64@1+ (1,0) [0|18446744073709551615] "" Vector__XXX

BO_ 2566085888 VDMA_F35D_High_Voltage_Energy_St: 8 Vector__XXX
 SG_ High_Voltage_Energy_Storage_Pack : 0|64@1+ (1,0) [0|18446744073709551615] "" Vector__XXX

BO_ 2566086144 VDMA_F35E_High_Voltage_Energy_St: 8 Vector__XXX
 SG_ High_Voltage_Energy_Storage_Pack : 0|64@1+ (1,0) [0|18446744073709551615] "" Vector__XXX

BO_ 2566086400 VDMA_F35F_High_Voltage_Energy_St: 8 Vector__XXX
 SG_ High_Voltage_Energy_Storage_Pack : 0|64@1+ (1,0) [0|18446744073709551615] "" Vector__XXX

BO_ 2566086656 VDMA_F360_High_Voltage_Energy_St: 8 Vector__XXX
 SG_ High_Voltage_Energy_Storage_Pack : 0|64@1+ (1,0) [0|18446744073709551615] "" Vector__XXX

BO_ 2566086912 VDMA_F361_High_Voltage_Energy_St: 8 Vector__XXX
 SG_ High_Voltage_Energy_Storage_Pack : 0|64@1+ (1,0) [0|18446744073709551615] "" Vector__XXX

BO_ 2566087168 VDMA_F362_High_Voltage_Energy_St: 8 Vector__XXX
 SG_ High_Voltage_Energy_Storage_Pack : 0|64@1+ (1,0) [0|18446744073709551615] "" Vector__XXX

BO_ 2566087424 VDMA_F363_High_Voltage_Energy_St: 8 Vector__XXX
 SG_ High_Voltage_Energy_Storage_Pack : 0|64@1+ (1,0) [0|18446744073709551615] "" Vector__XXX

BO_ 2566087680 VDMA_F364_Tracked_Vehicle_Data: 8 Vector__XXX
 SG_ Tracked_Vehicle_Data_RawPayload : 0|64@1+ (1,0) [0|18446744073709551615] "" Vector__XXX

BO_ 2566087936 VDMA_F365_Electrified_Accessory_: 8 Vector__XXX
 SG_ Electrified_Accessory_Propulsion : 0|64@1+ (1,0) [0|18446744073709551615] "" Vector__XXX

BO_ 2566088192 VDMA_F366_Electrified_Accessory_: 8 Vector__XXX
 SG_ Electrified_Accessory_Propulsion : 0|64@1+ (1,0) [0|18446744073709551615] "" Vector__XXX

BO_ 2566088448 VDMA_F367_Electrified_Accessory_: 8 Vector__XXX
 SG_ Electrified_Accessory_Propulsion : 0|64@1+ (1,0) [0|18446744073709551615] "" Vector__XXX

BO_ 2566088704 VDMA_F368_Electrified_Accessory_: 8 Vector__XXX
 SG_ Electrified_Accessory_Power_Elec : 0|64@1+ (1,0) [0|18446744073709551615] "" Vector__XXX

BO_ 2566088960 VDMA_F369_Electrified_Accessory_: 8 Vector__XXX
 SG_ Electrified_Accessory_Power_Elec : 0|64@1+ (1,0) [0|18446744073709551615] "" Vector__XXX

BO_ 2566089216 VDMA_F36A_Electrified_Accessory_: 8 Vector__XXX
 SG_ Electrified_Accessory_Power_Elec : 0|64@1+ (1,0) [0|18446744073709551615] "" Vector__XXX

BO_ 2566089472 VDMA_F36B_Electrified_Accessory_: 8 Vector__XXX
 SG_ Electrified_Accessory_Propulsion : 0|64@1+ (1,0) [0|18446744073709551615] "" Vector__XXX

BO_ 2566089728 VDMA_F36C_Electrified_Accessory_: 8 Vector__XXX
 SG_ Electrified_Accessory_Propulsion : 0|64@1+ (1,0) [0|18446744073709551615] "" Vector__XXX

BO_ 2566089984 VDMA_F36D_Electrified_Accessory_: 8 Vector__XXX
 SG_ Electrified_Accessory_Power_Elec : 0|64@1+ (1,0) [0|18446744073709551615] "" Vector__XXX

BO_ 2566090240 VDMA_F36E_Electrified_Accessory_: 8 Vector__XXX
 SG_ Electrified_Accessory_Generator_ : 0|64@1+ (1,0) [0|18446744073709551615] "" Vector__XXX

BO_ 2566090496 VDMA_F36F_Electrified_Accessory_: 8 Vector__XXX
 SG_ Electrified_Accessory_Generator_ : 0|64@1+ (1,0) [0|18446744073709551615] "" Vector__XXX

BO_ 2566090752 VDMA_F370_Electrified_Accessory_: 8 Vector__XXX
 SG_ Electrified_Accessory_Motor_Stat : 0|64@1+ (1,0) [0|18446744073709551615] "" Vector__XXX

BO_ 2566091008 VDMA_F371_Fuel_Cell_System_Contr: 8 Vector__XXX
 SG_ Fuel_Cell_System_Controller_Info : 0|64@1+ (1,0) [0|18446744073709551615] "" Vector__XXX

BO_ 2566091264 VDMA_F372_Fuel_Cell_System_Minim: 8 Vector__XXX
 SG_ Fuel_Cell_System_Minimum_Power_I : 0|64@1+ (1,0) [0|18446744073709551615] "" Vector__XXX

BO_ 2566091520 VDMA_F373_Fuel_Cell_System_Maxim: 8 Vector__XXX
 SG_ Fuel_Cell_System_Maximum_Power_I : 0|64@1+ (1,0) [0|18446744073709551615] "" Vector__XXX

BO_ 2566091776 VDMA_F374_Fuel_Cell_System_Minim: 8 Vector__XXX
 SG_ Fuel_Cell_System_Minimum_Current : 0|64@1+ (1,0) [0|18446744073709551615] "" Vector__XXX

BO_ 2566092032 VDMA_F375_Fuel_Cell_System_Maxim: 8 Vector__XXX
 SG_ Fuel_Cell_System_Maximum_Current : 0|64@1+ (1,0) [0|18446744073709551615] "" Vector__XXX

BO_ 2566092288 VDMA_F376_Hydrogen_Storage_Syste: 8 Vector__XXX
 SG_ Hydrogen_Storage_System_Informat : 0|64@1+ (1,0) [0|18446744073709551615] "" Vector__XXX

CM_ BO_ 2566005248  "Source: isobus.net VDMA Data Dictionary (https://www.isobus.net/isobus/pGNAndSPN/5185?type=PGN)";
CM_ BO_ 2566005504  "Source: isobus.net VDMA Data Dictionary (https://www.isobus.net/isobus/pGNAndSPN/5197?type=PGN)";
CM_ BO_ 2566005760  "Source: isobus.net VDMA Data Dictionary (https://www.isobus.net/isobus/pGNAndSPN/5201?type=PGN)";
CM_ BO_ 2566006016  "Source: isobus.net VDMA Data Dictionary (https://www.isobus.net/isobus/pGNAndSPN/5205?type=PGN)";
CM_ BO_ 2566006272  "Source: isobus.net VDMA Data Dictionary (https://www.isobus.net/isobus/pGNAndSPN/5209?type=PGN)";
CM_ BO_ 2566006528  "Source: isobus.net VDMA Data Dictionary (https://www.isobus.net/isobus/pGNAndSPN/5212?type=PGN)";
CM_ BO_ 2566006784  "Source: isobus.net VDMA Data Dictionary (https://www.isobus.net/isobus/pGNAndSPN/5216?type=PGN)";
CM_ BO_ 2566007040  "Source: isobus.net VDMA Data Dictionary (https://www.isobus.net/isobus/pGNAndSPN/5222?type=PGN)";
CM_ BO_ 2566007296  "Source: isobus.net VDMA Data Dictionary (https://www.isobus.net/isobus/pGNAndSPN/5239?type=PGN)";
CM_ BO_ 2566007552  "Source: isobus.net VDMA Data Dictionary (https://www.isobus.net/isobus/pGNAndSPN/5242?type=PGN)";
CM_ BO_ 2566007808  "Source: isobus.net VDMA Data Dictionary (https://www.isobus.net/isobus/pGNAndSPN/5274?type=PGN)";
CM_ BO_ 2566008064  "Source: isobus.net VDMA Data Dictionary (https://www.isobus.net/isobus/pGNAndSPN/5282?type=PGN)";
CM_ BO_ 2566008320  "Source: isobus.net VDMA Data Dictionary (https://www.isobus.net/isobus/pGNAndSPN/5287?type=PGN)";
CM_ BO_ 2566008576  "Source: isobus.net VDMA Data Dictionary (https://www.isobus.net/isobus/pGNAndSPN/5295?type=PGN)";
CM_ BO_ 2566008832  "Source: isobus.net VDMA Data Dictionary (https://www.isobus.net/isobus/pGNAndSPN/5301?type=PGN)";
CM_ BO_ 2566009088  "Source: isobus.net VDMA Data Dictionary (https://www.isobus.net/isobus/pGNAndSPN/5304?type=PGN)";
CM_ BO_ 2566009344  "Source: isobus.net VDMA Data Dictionary (https://www.isobus.net/isobus/pGNAndSPN/5316?type=PGN)";
CM_ BO_ 2566009600  "Source: isobus.net VDMA Data Dictionary (https://www.isobus.net/isobus/pGNAndSPN/5320?type=PGN)";
CM_ BO_ 2566009856  "Source: isobus.net VDMA Data Dictionary (https://www.isobus.net/isobus/pGNAndSPN/5324?type=PGN)";
CM_ BO_ 2566010112  "Source: isobus.net VDMA Data Dictionary (https://www.isobus.net/isobus/pGNAndSPN/5328?type=PGN)";
CM_ BO_ 2566010368  "Source: isobus.net VDMA Data Dictionary (https://www.isobus.net/isobus/pGNAndSPN/5331?type=PGN)";
CM_ BO_ 2566010624  "Source: isobus.net VDMA Data Dictionary (https://www.isobus.net/isobus/pGNAndSPN/5335?type=PGN)";
CM_ BO_ 2566010880  "Source: isobus.net VDMA Data Dictionary (https://www.isobus.net/isobus/pGNAndSPN/5341?type=PGN)";
CM_ BO_ 2566011136  "Source: isobus.net VDMA Data Dictionary (https://www.isobus.net/isobus/pGNAndSPN/5358?type=PGN)";
CM_ BO_ 2566011392  "Source: isobus.net VDMA Data Dictionary (https://www.isobus.net/isobus/pGNAndSPN/5361?type=PGN)";
CM_ BO_ 2566011648  "Source: isobus.net VDMA Data Dictionary (https://www.isobus.net/isobus/pGNAndSPN/5393?type=PGN)";
CM_ BO_ 2566011904  "Source: isobus.net VDMA Data Dictionary (https://www.isobus.net/isobus/pGNAndSPN/5401?type=PGN)";
CM_ BO_ 2566012160  "Source: isobus.net VDMA Data Dictionary (https://www.isobus.net/isobus/pGNAndSPN/5406?type=PGN)";
CM_ BO_ 2566012416  "Source: isobus.net VDMA Data Dictionary (https://www.isobus.net/isobus/pGNAndSPN/5414?type=PGN)";
CM_ BO_ 2566012672  "Source: isobus.net VDMA Data Dictionary (https://www.isobus.net/isobus/pGNAndSPN/5420?type=PGN)";
CM_ BO_ 2566012928  "Source: isobus.net VDMA Data Dictionary (https://www.isobus.net/isobus/pGNAndSPN/5423?type=PGN)";
CM_ BO_ 2566013184  "Source: isobus.net VDMA Data Dictionary (https://www.isobus.net/isobus/pGNAndSPN/5435?type=PGN)";
CM_ BO_ 2566013440  "Source: isobus.net VDMA Data Dictionary (https://www.isobus.net/isobus/pGNAndSPN/5439?type=PGN)";
CM_ BO_ 2566013696  "Source: isobus.net VDMA Data Dictionary (https://www.isobus.net/isobus/pGNAndSPN/5443?type=PGN)";
CM_ BO_ 2566013952  "Source: isobus.net VDMA Data Dictionary (https://www.isobus.net/isobus/pGNAndSPN/5447?type=PGN)";
CM_ BO_ 2566014208  "Source: isobus.net VDMA Data Dictionary (https://www.isobus.net/isobus/pGNAndSPN/5450?type=PGN)";
CM_ BO_ 2566014464  "Source: isobus.net VDMA Data Dictionary (https://www.isobus.net/isobus/pGNAndSPN/5454?type=PGN)";
CM_ BO_ 2566014720  "Source: isobus.net VDMA Data Dictionary (https://www.isobus.net/isobus/pGNAndSPN/5460?type=PGN)";
CM_ BO_ 2566014976  "Source: isobus.net VDMA Data Dictionary (https://www.isobus.net/isobus/pGNAndSPN/5477?type=PGN)";
CM_ BO_ 2566015232  "Source: isobus.net VDMA Data Dictionary (https://www.isobus.net/isobus/pGNAndSPN/5480?type=PGN)";
CM_ BO_ 2566015488  "Source: isobus.net VDMA Data Dictionary (https://www.isobus.net/isobus/pGNAndSPN/5512?type=PGN)";
CM_ BO_ 2566015744  "Source: isobus.net VDMA Data Dictionary (https://www.isobus.net/isobus/pGNAndSPN/5520?type=PGN)";
CM_ BO_ 2566016000  "Source: isobus.net VDMA Data Dictionary (https://www.isobus.net/isobus/pGNAndSPN/5525?type=PGN)";
CM_ BO_ 2566016256  "Source: isobus.net VDMA Data Dictionary (https://www.isobus.net/isobus/pGNAndSPN/5533?type=PGN)";
CM_ BO_ 2566016512  "Source: isobus.net VDMA Data Dictionary (https://www.isobus.net/isobus/pGNAndSPN/5539?type=PGN)";
CM_ BO_ 2566016768  "Source: isobus.net VDMA Data Dictionary (https://www.isobus.net/isobus/pGNAndSPN/5542?type=PGN)";
CM_ BO_ 2566017024  "Source: isobus.net VDMA Data Dictionary (https://www.isobus.net/isobus/pGNAndSPN/5543?type=PGN)";
CM_ BO_ 2566017280  "Source: isobus.net VDMA Data Dictionary (https://www.isobus.net/isobus/pGNAndSPN/5555?type=PGN)";
CM_ BO_ 2566017536  "Source: isobus.net VDMA Data Dictionary (https://www.isobus.net/isobus/pGNAndSPN/5559?type=PGN)";
CM_ BO_ 2566017792  "Source: isobus.net VDMA Data Dictionary (https://www.isobus.net/isobus/pGNAndSPN/5563?type=PGN)";
CM_ BO_ 2566018048  "Source: isobus.net VDMA Data Dictionary (https://www.isobus.net/isobus/pGNAndSPN/5567?type=PGN)";
CM_ BO_ 2566018304  "Source: isobus.net VDMA Data Dictionary (https://www.isobus.net/isobus/pGNAndSPN/5570?type=PGN)";
CM_ BO_ 2566018560  "Source: isobus.net VDMA Data Dictionary (https://www.isobus.net/isobus/pGNAndSPN/5574?type=PGN)";
CM_ BO_ 2566018816  "Source: isobus.net VDMA Data Dictionary (https://www.isobus.net/isobus/pGNAndSPN/5580?type=PGN)";
CM_ BO_ 2566019072  "Source: isobus.net VDMA Data Dictionary (https://www.isobus.net/isobus/pGNAndSPN/5597?type=PGN)";
CM_ BO_ 2566019328  "Source: isobus.net VDMA Data Dictionary (https://www.isobus.net/isobus/pGNAndSPN/5600?type=PGN)";
CM_ BO_ 2566019584  "Source: isobus.net VDMA Data Dictionary (https://www.isobus.net/isobus/pGNAndSPN/5632?type=PGN)";
CM_ BO_ 2566019840  "Source: isobus.net VDMA Data Dictionary (https://www.isobus.net/isobus/pGNAndSPN/5640?type=PGN)";
CM_ BO_ 2566020096  "Source: isobus.net VDMA Data Dictionary (https://www.isobus.net/isobus/pGNAndSPN/5645?type=PGN)";
CM_ BO_ 2566020352  "Source: isobus.net VDMA Data Dictionary (https://www.isobus.net/isobus/pGNAndSPN/5653?type=PGN)";
CM_ BO_ 2566020608  "Source: isobus.net VDMA Data Dictionary (https://www.isobus.net/isobus/pGNAndSPN/5659?type=PGN)";
CM_ BO_ 2566020864  "Source: isobus.net VDMA Data Dictionary (https://www.isobus.net/isobus/pGNAndSPN/5662?type=PGN)";
CM_ BO_ 2566021120  "Source: isobus.net VDMA Data Dictionary (https://www.isobus.net/isobus/pGNAndSPN/5674?type=PGN)";
CM_ BO_ 2566021376  "Source: isobus.net VDMA Data Dictionary (https://www.isobus.net/isobus/pGNAndSPN/5678?type=PGN)";
CM_ BO_ 2566021632  "Source: isobus.net VDMA Data Dictionary (https://www.isobus.net/isobus/pGNAndSPN/5682?type=PGN)";
CM_ BO_ 2566021888  "Source: isobus.net VDMA Data Dictionary (https://www.isobus.net/isobus/pGNAndSPN/5686?type=PGN)";
CM_ BO_ 2566022144  "Source: isobus.net VDMA Data Dictionary (https://www.isobus.net/isobus/pGNAndSPN/5689?type=PGN)";
CM_ BO_ 2566022400  "Source: isobus.net VDMA Data Dictionary (https://www.isobus.net/isobus/pGNAndSPN/5693?type=PGN)";
CM_ BO_ 2566022656  "Source: isobus.net VDMA Data Dictionary (https://www.isobus.net/isobus/pGNAndSPN/5699?type=PGN)";
CM_ BO_ 2566022912  "Source: isobus.net VDMA Data Dictionary (https://www.isobus.net/isobus/pGNAndSPN/5716?type=PGN)";
CM_ BO_ 2566023168  "Source: isobus.net VDMA Data Dictionary (https://www.isobus.net/isobus/pGNAndSPN/5719?type=PGN)";
CM_ BO_ 2566023424  "Source: isobus.net VDMA Data Dictionary (https://www.isobus.net/isobus/pGNAndSPN/5751?type=PGN)";
CM_ BO_ 2566023680  "Source: isobus.net VDMA Data Dictionary (https://www.isobus.net/isobus/pGNAndSPN/5759?type=PGN)";
CM_ BO_ 2566023936  "Source: isobus.net VDMA Data Dictionary (https://www.isobus.net/isobus/pGNAndSPN/5764?type=PGN)";
CM_ BO_ 2566024192  "Source: isobus.net VDMA Data Dictionary (https://www.isobus.net/isobus/pGNAndSPN/5772?type=PGN)";
CM_ BO_ 2566024448  "Source: isobus.net VDMA Data Dictionary (https://www.isobus.net/isobus/pGNAndSPN/5778?type=PGN)";
CM_ BO_ 2566024704  "Source: isobus.net VDMA Data Dictionary (https://www.isobus.net/isobus/pGNAndSPN/5781?type=PGN)";
CM_ BO_ 2566024960  "Source: isobus.net VDMA Data Dictionary (https://www.isobus.net/isobus/pGNAndSPN/5793?type=PGN)";
CM_ BO_ 2566025216  "Source: isobus.net VDMA Data Dictionary (https://www.isobus.net/isobus/pGNAndSPN/5797?type=PGN)";
CM_ BO_ 2566025472  "Source: isobus.net VDMA Data Dictionary (https://www.isobus.net/isobus/pGNAndSPN/5801?type=PGN)";
CM_ BO_ 2566025728  "Source: isobus.net VDMA Data Dictionary (https://www.isobus.net/isobus/pGNAndSPN/5805?type=PGN)";
CM_ BO_ 2566025984  "Source: isobus.net VDMA Data Dictionary (https://www.isobus.net/isobus/pGNAndSPN/5808?type=PGN)";
CM_ BO_ 2566026240  "Source: isobus.net VDMA Data Dictionary (https://www.isobus.net/isobus/pGNAndSPN/5812?type=PGN)";
CM_ BO_ 2566026496  "Source: isobus.net VDMA Data Dictionary (https://www.isobus.net/isobus/pGNAndSPN/5818?type=PGN)";
CM_ BO_ 2566026752  "Source: isobus.net VDMA Data Dictionary (https://www.isobus.net/isobus/pGNAndSPN/5835?type=PGN)";
CM_ BO_ 2566027008  "Source: isobus.net VDMA Data Dictionary (https://www.isobus.net/isobus/pGNAndSPN/5838?type=PGN)";
CM_ BO_ 2566027264  "Source: isobus.net VDMA Data Dictionary (https://www.isobus.net/isobus/pGNAndSPN/5870?type=PGN)";
CM_ BO_ 2566027520  "Source: isobus.net VDMA Data Dictionary (https://www.isobus.net/isobus/pGNAndSPN/5878?type=PGN)";
CM_ BO_ 2566027776  "Source: isobus.net VDMA Data Dictionary (https://www.isobus.net/isobus/pGNAndSPN/5883?type=PGN)";
CM_ BO_ 2566028032  "Source: isobus.net VDMA Data Dictionary (https://www.isobus.net/isobus/pGNAndSPN/5891?type=PGN)";
CM_ BO_ 2566028288  "Source: isobus.net VDMA Data Dictionary (https://www.isobus.net/isobus/pGNAndSPN/5897?type=PGN)";
CM_ BO_ 2566028544  "Source: isobus.net VDMA Data Dictionary (https://www.isobus.net/isobus/pGNAndSPN/5900?type=PGN)";
CM_ BO_ 2566028800  "Source: isobus.net VDMA Data Dictionary (https://www.isobus.net/isobus/pGNAndSPN/5912?type=PGN)";
CM_ BO_ 2566029056  "Source: isobus.net VDMA Data Dictionary (https://www.isobus.net/isobus/pGNAndSPN/5916?type=PGN)";
CM_ BO_ 2566029312  "Source: isobus.net VDMA Data Dictionary (https://www.isobus.net/isobus/pGNAndSPN/5920?type=PGN)";
CM_ BO_ 2566029568  "Source: isobus.net VDMA Data Dictionary (https://www.isobus.net/isobus/pGNAndSPN/5924?type=PGN)";
CM_ BO_ 2566029824  "Source: isobus.net VDMA Data Dictionary (https://www.isobus.net/isobus/pGNAndSPN/5927?type=PGN)";
CM_ BO_ 2566030080  "Source: isobus.net VDMA Data Dictionary (https://www.isobus.net/isobus/pGNAndSPN/5931?type=PGN)";
CM_ BO_ 2566030336  "Source: isobus.net VDMA Data Dictionary (https://www.isobus.net/isobus/pGNAndSPN/5937?type=PGN)";
CM_ BO_ 2566030592  "Source: isobus.net VDMA Data Dictionary (https://www.isobus.net/isobus/pGNAndSPN/5954?type=PGN)";
CM_ BO_ 2566030848  "Source: isobus.net VDMA Data Dictionary (https://www.isobus.net/isobus/pGNAndSPN/5957?type=PGN)";
CM_ BO_ 2566031104  "Source: isobus.net VDMA Data Dictionary (https://www.isobus.net/isobus/pGNAndSPN/5989?type=PGN)";
CM_ BO_ 2566031360  "Source: isobus.net VDMA Data Dictionary (https://www.isobus.net/isobus/pGNAndSPN/5997?type=PGN)";
CM_ BO_ 2566031616  "Source: isobus.net VDMA Data Dictionary (https://www.isobus.net/isobus/pGNAndSPN/6002?type=PGN)";
CM_ BO_ 2566031872  "Source: isobus.net VDMA Data Dictionary (https://www.isobus.net/isobus/pGNAndSPN/6010?type=PGN)";
CM_ BO_ 2566032128  "Source: isobus.net VDMA Data Dictionary (https://www.isobus.net/isobus/pGNAndSPN/6016?type=PGN)";
CM_ BO_ 2566032384  "Source: isobus.net VDMA Data Dictionary (https://www.isobus.net/isobus/pGNAndSPN/6019?type=PGN)";
CM_ BO_ 2566032640  "Source: isobus.net VDMA Data Dictionary (https://www.isobus.net/isobus/pGNAndSPN/6031?type=PGN)";
CM_ BO_ 2566032896  "Source: isobus.net VDMA Data Dictionary (https://www.isobus.net/isobus/pGNAndSPN/6035?type=PGN)";
CM_ BO_ 2566033152  "Source: isobus.net VDMA Data Dictionary (https://www.isobus.net/isobus/pGNAndSPN/6039?type=PGN)";
CM_ BO_ 2566033408  "Source: isobus.net VDMA Data Dictionary (https://www.isobus.net/isobus/pGNAndSPN/6043?type=PGN)";
CM_ BO_ 2566033664  "Source: isobus.net VDMA Data Dictionary (https://www.isobus.net/isobus/pGNAndSPN/6046?type=PGN)";
CM_ BO_ 2566033920  "Source: isobus.net VDMA Data Dictionary (https://www.isobus.net/isobus/pGNAndSPN/6050?type=PGN)";
CM_ BO_ 2566034176  "Source: isobus.net VDMA Data Dictionary (https://www.isobus.net/isobus/pGNAndSPN/6056?type=PGN)";
CM_ BO_ 2566034432  "Source: isobus.net VDMA Data Dictionary (https://www.isobus.net/isobus/pGNAndSPN/6073?type=PGN)";
CM_ BO_ 2566034688  "Source: isobus.net VDMA Data Dictionary (https://www.isobus.net/isobus/pGNAndSPN/6076?type=PGN)";
CM_ BO_ 2566034944  "Source: isobus.net VDMA Data Dictionary (https://www.isobus.net/isobus/pGNAndSPN/6108?type=PGN)";
CM_ BO_ 2566035200  "Source: isobus.net VDMA Data Dictionary (https://www.isobus.net/isobus/pGNAndSPN/6116?type=PGN)";
CM_ BO_ 2566035456  "Source: isobus.net VDMA Data Dictionary (https://www.isobus.net/isobus/pGNAndSPN/6121?type=PGN)";
CM_ BO_ 2566035712  "Source: isobus.net VDMA Data Dictionary (https://www.isobus.net/isobus/pGNAndSPN/6129?type=PGN)";
CM_ BO_ 2566035968  "Source: isobus.net VDMA Data Dictionary (https://www.isobus.net/isobus/pGNAndSPN/6135?type=PGN)";
CM_ BO_ 2566036224  "Source: isobus.net VDMA Data Dictionary (https://www.isobus.net/isobus/pGNAndSPN/6138?type=PGN)";
CM_ BO_ 2566036480  "Source: isobus.net VDMA Data Dictionary (https://www.isobus.net/isobus/pGNAndSPN/6150?type=PGN)";
CM_ BO_ 2566036736  "Source: isobus.net VDMA Data Dictionary (https://www.isobus.net/isobus/pGNAndSPN/6154?type=PGN)";
CM_ BO_ 2566036992  "Source: isobus.net VDMA Data Dictionary (https://www.isobus.net/isobus/pGNAndSPN/6158?type=PGN)";
CM_ BO_ 2566037248  "Source: isobus.net VDMA Data Dictionary (https://www.isobus.net/isobus/pGNAndSPN/6162?type=PGN)";
CM_ BO_ 2566037504  "Source: isobus.net VDMA Data Dictionary (https://www.isobus.net/isobus/pGNAndSPN/6165?type=PGN)";
CM_ BO_ 2566037760  "Source: isobus.net VDMA Data Dictionary (https://www.isobus.net/isobus/pGNAndSPN/6169?type=PGN)";
CM_ BO_ 2566038016  "Source: isobus.net VDMA Data Dictionary (https://www.isobus.net/isobus/pGNAndSPN/6175?type=PGN)";
CM_ BO_ 2566038272  "Source: isobus.net VDMA Data Dictionary (https://www.isobus.net/isobus/pGNAndSPN/6192?type=PGN)";
CM_ BO_ 2566038528  "Source: isobus.net VDMA Data Dictionary (https://www.isobus.net/isobus/pGNAndSPN/6195?type=PGN)";
CM_ BO_ 2566038784  "Source: isobus.net VDMA Data Dictionary (https://www.isobus.net/isobus/pGNAndSPN/6227?type=PGN)";
CM_ BO_ 2566039040  "Source: isobus.net VDMA Data Dictionary (https://www.isobus.net/isobus/pGNAndSPN/6235?type=PGN)";
CM_ BO_ 2566039296  "Source: isobus.net VDMA Data Dictionary (https://www.isobus.net/isobus/pGNAndSPN/6240?type=PGN)";
CM_ BO_ 2566039552  "Source: isobus.net VDMA Data Dictionary (https://www.isobus.net/isobus/pGNAndSPN/6248?type=PGN)";
CM_ BO_ 2566039808  "Source: isobus.net VDMA Data Dictionary (https://www.isobus.net/isobus/pGNAndSPN/6254?type=PGN)";
CM_ BO_ 2566040064  "Source: isobus.net VDMA Data Dictionary (https://www.isobus.net/isobus/pGNAndSPN/6257?type=PGN)";
CM_ BO_ 2566040320  "Source: isobus.net VDMA Data Dictionary (https://www.isobus.net/isobus/pGNAndSPN/6269?type=PGN)";
CM_ BO_ 2566040576  "Source: isobus.net VDMA Data Dictionary (https://www.isobus.net/isobus/pGNAndSPN/6273?type=PGN)";
CM_ BO_ 2566040832  "Source: isobus.net VDMA Data Dictionary (https://www.isobus.net/isobus/pGNAndSPN/6277?type=PGN)";
CM_ BO_ 2566041088  "Source: isobus.net VDMA Data Dictionary (https://www.isobus.net/isobus/pGNAndSPN/6281?type=PGN)";
CM_ BO_ 2566041344  "Source: isobus.net VDMA Data Dictionary (https://www.isobus.net/isobus/pGNAndSPN/6284?type=PGN)";
CM_ BO_ 2566041600  "Source: isobus.net VDMA Data Dictionary (https://www.isobus.net/isobus/pGNAndSPN/6288?type=PGN)";
CM_ BO_ 2566041856  "Source: isobus.net VDMA Data Dictionary (https://www.isobus.net/isobus/pGNAndSPN/6294?type=PGN)";
CM_ BO_ 2566042112  "Source: isobus.net VDMA Data Dictionary (https://www.isobus.net/isobus/pGNAndSPN/6311?type=PGN)";
CM_ BO_ 2566042368  "Source: isobus.net VDMA Data Dictionary (https://www.isobus.net/isobus/pGNAndSPN/6314?type=PGN)";
CM_ BO_ 2566042624  "Source: isobus.net VDMA Data Dictionary (https://www.isobus.net/isobus/pGNAndSPN/6346?type=PGN)";
CM_ BO_ 2566042880  "Source: isobus.net VDMA Data Dictionary (https://www.isobus.net/isobus/pGNAndSPN/6354?type=PGN)";
CM_ BO_ 2566043136  "Source: isobus.net VDMA Data Dictionary (https://www.isobus.net/isobus/pGNAndSPN/6359?type=PGN)";
CM_ BO_ 2566043392  "Source: isobus.net VDMA Data Dictionary (https://www.isobus.net/isobus/pGNAndSPN/6367?type=PGN)";
CM_ BO_ 2566043648  "Source: isobus.net VDMA Data Dictionary (https://www.isobus.net/isobus/pGNAndSPN/6373?type=PGN)";
CM_ BO_ 2566043904  "Source: isobus.net VDMA Data Dictionary (https://www.isobus.net/isobus/pGNAndSPN/6376?type=PGN)";
CM_ BO_ 2566044160  "Source: isobus.net VDMA Data Dictionary (https://www.isobus.net/isobus/pGNAndSPN/6388?type=PGN)";
CM_ BO_ 2566044416  "Source: isobus.net VDMA Data Dictionary (https://www.isobus.net/isobus/pGNAndSPN/6392?type=PGN)";
CM_ BO_ 2566044672  "Source: isobus.net VDMA Data Dictionary (https://www.isobus.net/isobus/pGNAndSPN/6396?type=PGN)";
CM_ BO_ 2566044928  "Source: isobus.net VDMA Data Dictionary (https://www.isobus.net/isobus/pGNAndSPN/6400?type=PGN)";
CM_ BO_ 2566045184  "Source: isobus.net VDMA Data Dictionary (https://www.isobus.net/isobus/pGNAndSPN/6403?type=PGN)";
CM_ BO_ 2566045440  "Source: isobus.net VDMA Data Dictionary (https://www.isobus.net/isobus/pGNAndSPN/6407?type=PGN)";
CM_ BO_ 2566045696  "Source: isobus.net VDMA Data Dictionary (https://www.isobus.net/isobus/pGNAndSPN/6413?type=PGN)";
CM_ BO_ 2566045952  "Source: isobus.net VDMA Data Dictionary (https://www.isobus.net/isobus/pGNAndSPN/6430?type=PGN)";
CM_ BO_ 2566046208  "Source: isobus.net VDMA Data Dictionary (https://www.isobus.net/isobus/pGNAndSPN/6433?type=PGN)";
CM_ BO_ 2566046464  "Source: isobus.net VDMA Data Dictionary (https://www.isobus.net/isobus/pGNAndSPN/6465?type=PGN)";
CM_ BO_ 2566046720  "Source: isobus.net VDMA Data Dictionary (https://www.isobus.net/isobus/pGNAndSPN/6473?type=PGN)";
CM_ BO_ 2566046976  "Source: isobus.net VDMA Data Dictionary (https://www.isobus.net/isobus/pGNAndSPN/6478?type=PGN)";
CM_ BO_ 2566047232  "Source: isobus.net VDMA Data Dictionary (https://www.isobus.net/isobus/pGNAndSPN/6486?type=PGN)";
CM_ BO_ 2566047488  "Source: isobus.net VDMA Data Dictionary (https://www.isobus.net/isobus/pGNAndSPN/6492?type=PGN)";
CM_ BO_ 2566047744  "Source: isobus.net VDMA Data Dictionary (https://www.isobus.net/isobus/pGNAndSPN/6495?type=PGN)";
CM_ BO_ 2566048000  "Source: isobus.net VDMA Data Dictionary (https://www.isobus.net/isobus/pGNAndSPN/6507?type=PGN)";
CM_ BO_ 2566048256  "Source: isobus.net VDMA Data Dictionary (https://www.isobus.net/isobus/pGNAndSPN/6511?type=PGN)";
CM_ BO_ 2566048512  "Source: isobus.net VDMA Data Dictionary (https://www.isobus.net/isobus/pGNAndSPN/6515?type=PGN)";
CM_ BO_ 2566048768  "Source: isobus.net VDMA Data Dictionary (https://www.isobus.net/isobus/pGNAndSPN/6519?type=PGN)";
CM_ BO_ 2566049024  "Source: isobus.net VDMA Data Dictionary (https://www.isobus.net/isobus/pGNAndSPN/6522?type=PGN)";
CM_ BO_ 2566049280  "Source: isobus.net VDMA Data Dictionary (https://www.isobus.net/isobus/pGNAndSPN/6526?type=PGN)";
CM_ BO_ 2566049536  "Source: isobus.net VDMA Data Dictionary (https://www.isobus.net/isobus/pGNAndSPN/6532?type=PGN)";
CM_ BO_ 2566049792  "Source: isobus.net VDMA Data Dictionary (https://www.isobus.net/isobus/pGNAndSPN/6549?type=PGN)";
CM_ BO_ 2566050048  "Source: isobus.net VDMA Data Dictionary (https://www.isobus.net/isobus/pGNAndSPN/6552?type=PGN)";
CM_ BO_ 2566050304  "Source: isobus.net VDMA Data Dictionary (https://www.isobus.net/isobus/pGNAndSPN/6584?type=PGN)";
CM_ BO_ 2566050560  "Source: isobus.net VDMA Data Dictionary (https://www.isobus.net/isobus/pGNAndSPN/6592?type=PGN)";
CM_ BO_ 2566050816  "Source: isobus.net VDMA Data Dictionary (https://www.isobus.net/isobus/pGNAndSPN/6597?type=PGN)";
CM_ BO_ 2566051072  "Source: isobus.net VDMA Data Dictionary (https://www.isobus.net/isobus/pGNAndSPN/6605?type=PGN)";
CM_ BO_ 2566051328  "Source: isobus.net VDMA Data Dictionary (https://www.isobus.net/isobus/pGNAndSPN/6611?type=PGN)";
CM_ BO_ 2566051584  "Source: isobus.net VDMA Data Dictionary (https://www.isobus.net/isobus/pGNAndSPN/6614?type=PGN)";
CM_ BO_ 2566051840  "Source: isobus.net VDMA Data Dictionary (https://www.isobus.net/isobus/pGNAndSPN/6626?type=PGN)";
CM_ BO_ 2566052096  "Source: isobus.net VDMA Data Dictionary (https://www.isobus.net/isobus/pGNAndSPN/6630?type=PGN)";
CM_ BO_ 2566052352  "Source: isobus.net VDMA Data Dictionary (https://www.isobus.net/isobus/pGNAndSPN/6634?type=PGN)";
CM_ BO_ 2566052608  "Source: isobus.net VDMA Data Dictionary (https://www.isobus.net/isobus/pGNAndSPN/6638?type=PGN)";
CM_ BO_ 2566052864  "Source: isobus.net VDMA Data Dictionary (https://www.isobus.net/isobus/pGNAndSPN/6641?type=PGN)";
CM_ BO_ 2566053120  "Source: isobus.net VDMA Data Dictionary (https://www.isobus.net/isobus/pGNAndSPN/6645?type=PGN)";
CM_ BO_ 2566053376  "Source: isobus.net VDMA Data Dictionary (https://www.isobus.net/isobus/pGNAndSPN/6651?type=PGN)";
CM_ BO_ 2566053632  "Source: isobus.net VDMA Data Dictionary (https://www.isobus.net/isobus/pGNAndSPN/6668?type=PGN)";
CM_ BO_ 2566053888  "Source: isobus.net VDMA Data Dictionary (https://www.isobus.net/isobus/pGNAndSPN/6671?type=PGN)";
CM_ BO_ 2566054144  "Source: isobus.net VDMA Data Dictionary (https://www.isobus.net/isobus/pGNAndSPN/6703?type=PGN)";
CM_ BO_ 2566054400  "Source: isobus.net VDMA Data Dictionary (https://www.isobus.net/isobus/pGNAndSPN/6711?type=PGN)";
CM_ BO_ 2566054656  "Source: isobus.net VDMA Data Dictionary (https://www.isobus.net/isobus/pGNAndSPN/6716?type=PGN)";
CM_ BO_ 2566054912  "Source: isobus.net VDMA Data Dictionary (https://www.isobus.net/isobus/pGNAndSPN/6724?type=PGN)";
CM_ BO_ 2566055168  "Source: isobus.net VDMA Data Dictionary (https://www.isobus.net/isobus/pGNAndSPN/6730?type=PGN)";
CM_ BO_ 2566055424  "Source: isobus.net VDMA Data Dictionary (https://www.isobus.net/isobus/pGNAndSPN/6733?type=PGN)";
CM_ BO_ 2566055680  "Source: isobus.net VDMA Data Dictionary (https://www.isobus.net/isobus/pGNAndSPN/6745?type=PGN)";
CM_ BO_ 2566055936  "Source: isobus.net VDMA Data Dictionary (https://www.isobus.net/isobus/pGNAndSPN/6749?type=PGN)";
CM_ BO_ 2566056192  "Source: isobus.net VDMA Data Dictionary (https://www.isobus.net/isobus/pGNAndSPN/6753?type=PGN)";
CM_ BO_ 2566056448  "Source: isobus.net VDMA Data Dictionary (https://www.isobus.net/isobus/pGNAndSPN/6757?type=PGN)";
CM_ BO_ 2566056704  "Source: isobus.net VDMA Data Dictionary (https://www.isobus.net/isobus/pGNAndSPN/6760?type=PGN)";
CM_ BO_ 2566056960  "Source: isobus.net VDMA Data Dictionary (https://www.isobus.net/isobus/pGNAndSPN/6764?type=PGN)";
CM_ BO_ 2566057216  "Source: isobus.net VDMA Data Dictionary (https://www.isobus.net/isobus/pGNAndSPN/6770?type=PGN)";
CM_ BO_ 2566057472  "Source: isobus.net VDMA Data Dictionary (https://www.isobus.net/isobus/pGNAndSPN/6787?type=PGN)";
CM_ BO_ 2566057728  "Source: isobus.net VDMA Data Dictionary (https://www.isobus.net/isobus/pGNAndSPN/6790?type=PGN)";
CM_ BO_ 2566057984  "Source: isobus.net VDMA Data Dictionary (https://www.isobus.net/isobus/pGNAndSPN/6822?type=PGN)";
CM_ BO_ 2566058240  "Source: isobus.net VDMA Data Dictionary (https://www.isobus.net/isobus/pGNAndSPN/6830?type=PGN)";
CM_ BO_ 2566058496  "Source: isobus.net VDMA Data Dictionary (https://www.isobus.net/isobus/pGNAndSPN/6835?type=PGN)";
CM_ BO_ 2566058752  "Source: isobus.net VDMA Data Dictionary (https://www.isobus.net/isobus/pGNAndSPN/6843?type=PGN)";
CM_ BO_ 2566059008  "Source: isobus.net VDMA Data Dictionary (https://www.isobus.net/isobus/pGNAndSPN/6849?type=PGN)";
CM_ BO_ 2566059264  "Source: isobus.net VDMA Data Dictionary (https://www.isobus.net/isobus/pGNAndSPN/6852?type=PGN)";
CM_ BO_ 2566059520  "Source: isobus.net VDMA Data Dictionary (https://www.isobus.net/isobus/pGNAndSPN/6864?type=PGN)";
CM_ BO_ 2566059776  "Source: isobus.net VDMA Data Dictionary (https://www.isobus.net/isobus/pGNAndSPN/6868?type=PGN)";
CM_ BO_ 2566060032  "Source: isobus.net VDMA Data Dictionary (https://www.isobus.net/isobus/pGNAndSPN/6872?type=PGN)";
CM_ BO_ 2566060288  "Source: isobus.net VDMA Data Dictionary (https://www.isobus.net/isobus/pGNAndSPN/6876?type=PGN)";
CM_ BO_ 2566060544  "Source: isobus.net VDMA Data Dictionary (https://www.isobus.net/isobus/pGNAndSPN/6879?type=PGN)";
CM_ BO_ 2566060800  "Source: isobus.net VDMA Data Dictionary (https://www.isobus.net/isobus/pGNAndSPN/6883?type=PGN)";
CM_ BO_ 2566061056  "Source: isobus.net VDMA Data Dictionary (https://www.isobus.net/isobus/pGNAndSPN/6889?type=PGN)";
CM_ BO_ 2566061312  "Source: isobus.net VDMA Data Dictionary (https://www.isobus.net/isobus/pGNAndSPN/6906?type=PGN)";
CM_ BO_ 2566061568  "Source: isobus.net VDMA Data Dictionary (https://www.isobus.net/isobus/pGNAndSPN/6909?type=PGN)";
CM_ BO_ 2566061824  "Source: isobus.net VDMA Data Dictionary (https://www.isobus.net/isobus/pGNAndSPN/6941?type=PGN)";
CM_ BO_ 2566062080  "Source: isobus.net VDMA Data Dictionary (https://www.isobus.net/isobus/pGNAndSPN/6949?type=PGN)";
CM_ BO_ 2566062336  "Source: isobus.net VDMA Data Dictionary (https://www.isobus.net/isobus/pGNAndSPN/6954?type=PGN)";
CM_ BO_ 2566062592  "Source: isobus.net VDMA Data Dictionary (https://www.isobus.net/isobus/pGNAndSPN/6962?type=PGN)";
CM_ BO_ 2566062848  "Source: isobus.net VDMA Data Dictionary (https://www.isobus.net/isobus/pGNAndSPN/6968?type=PGN)";
CM_ BO_ 2566063104  "Source: isobus.net VDMA Data Dictionary (https://www.isobus.net/isobus/pGNAndSPN/6971?type=PGN)";
CM_ BO_ 2566063360  "Source: isobus.net VDMA Data Dictionary (https://www.isobus.net/isobus/pGNAndSPN/6983?type=PGN)";
CM_ BO_ 2566063616  "Source: isobus.net VDMA Data Dictionary (https://www.isobus.net/isobus/pGNAndSPN/6987?type=PGN)";
CM_ BO_ 2566063872  "Source: isobus.net VDMA Data Dictionary (https://www.isobus.net/isobus/pGNAndSPN/6991?type=PGN)";
CM_ BO_ 2566064128  "Source: isobus.net VDMA Data Dictionary (https://www.isobus.net/isobus/pGNAndSPN/6995?type=PGN)";
CM_ BO_ 2566064384  "Source: isobus.net VDMA Data Dictionary (https://www.isobus.net/isobus/pGNAndSPN/6998?type=PGN)";
CM_ BO_ 2566064640  "Source: isobus.net VDMA Data Dictionary (https://www.isobus.net/isobus/pGNAndSPN/7002?type=PGN)";
CM_ BO_ 2566064896  "Source: isobus.net VDMA Data Dictionary (https://www.isobus.net/isobus/pGNAndSPN/7008?type=PGN)";
CM_ BO_ 2566065152  "Source: isobus.net VDMA Data Dictionary (https://www.isobus.net/isobus/pGNAndSPN/7025?type=PGN)";
CM_ BO_ 2566065408  "Source: isobus.net VDMA Data Dictionary (https://www.isobus.net/isobus/pGNAndSPN/7028?type=PGN)";
CM_ BO_ 2566065664  "Source: isobus.net VDMA Data Dictionary (https://www.isobus.net/isobus/pGNAndSPN/7060?type=PGN)";
CM_ BO_ 2566065920  "Source: isobus.net VDMA Data Dictionary (https://www.isobus.net/isobus/pGNAndSPN/7068?type=PGN)";
CM_ BO_ 2566066176  "Source: isobus.net VDMA Data Dictionary (https://www.isobus.net/isobus/pGNAndSPN/7073?type=PGN)";
CM_ BO_ 2566066432  "Source: isobus.net VDMA Data Dictionary (https://www.isobus.net/isobus/pGNAndSPN/7081?type=PGN)";
CM_ BO_ 2566066688  "Source: isobus.net VDMA Data Dictionary (https://www.isobus.net/isobus/pGNAndSPN/7087?type=PGN)";
CM_ BO_ 2566066944  "Source: isobus.net VDMA Data Dictionary (https://www.isobus.net/isobus/pGNAndSPN/7090?type=PGN)";
CM_ BO_ 2566067200  "Source: isobus.net VDMA Data Dictionary (https://www.isobus.net/isobus/pGNAndSPN/7102?type=PGN)";
CM_ BO_ 2566067456  "Source: isobus.net VDMA Data Dictionary (https://www.isobus.net/isobus/pGNAndSPN/7106?type=PGN)";
CM_ BO_ 2566067712  "Source: isobus.net VDMA Data Dictionary (https://www.isobus.net/isobus/pGNAndSPN/7110?type=PGN)";
CM_ BO_ 2566067968  "Source: isobus.net VDMA Data Dictionary (https://www.isobus.net/isobus/pGNAndSPN/7114?type=PGN)";
CM_ BO_ 2566068224  "Source: isobus.net VDMA Data Dictionary (https://www.isobus.net/isobus/pGNAndSPN/7117?type=PGN)";
CM_ BO_ 2566068480  "Source: isobus.net VDMA Data Dictionary (https://www.isobus.net/isobus/pGNAndSPN/7121?type=PGN)";
CM_ BO_ 2566068736  "Source: isobus.net VDMA Data Dictionary (https://www.isobus.net/isobus/pGNAndSPN/7127?type=PGN)";
CM_ BO_ 2566068992  "Source: isobus.net VDMA Data Dictionary (https://www.isobus.net/isobus/pGNAndSPN/7144?type=PGN)";
CM_ BO_ 2566069248  "Source: isobus.net VDMA Data Dictionary (https://www.isobus.net/isobus/pGNAndSPN/7147?type=PGN)";
CM_ BO_ 2566069504  "Source: isobus.net VDMA Data Dictionary (https://www.isobus.net/isobus/pGNAndSPN/7179?type=PGN)";
CM_ BO_ 2566069760  "Source: isobus.net VDMA Data Dictionary (https://www.isobus.net/isobus/pGNAndSPN/7187?type=PGN)";
CM_ BO_ 2566070016  "Source: isobus.net VDMA Data Dictionary (https://www.isobus.net/isobus/pGNAndSPN/7192?type=PGN)";
CM_ BO_ 2566070272  "Source: isobus.net VDMA Data Dictionary (https://www.isobus.net/isobus/pGNAndSPN/7200?type=PGN)";
CM_ BO_ 2566070528  "Source: isobus.net VDMA Data Dictionary (https://www.isobus.net/isobus/pGNAndSPN/7206?type=PGN)";
CM_ BO_ 2566070784  "Source: isobus.net VDMA Data Dictionary (https://www.isobus.net/isobus/pGNAndSPN/7209?type=PGN)";
CM_ BO_ 2566071040  "Source: isobus.net VDMA Data Dictionary (https://www.isobus.net/isobus/pGNAndSPN/7221?type=PGN)";
CM_ BO_ 2566071296  "Source: isobus.net VDMA Data Dictionary (https://www.isobus.net/isobus/pGNAndSPN/7225?type=PGN)";
CM_ BO_ 2566071552  "Source: isobus.net VDMA Data Dictionary (https://www.isobus.net/isobus/pGNAndSPN/7229?type=PGN)";
CM_ BO_ 2566071808  "Source: isobus.net VDMA Data Dictionary (https://www.isobus.net/isobus/pGNAndSPN/7233?type=PGN)";
CM_ BO_ 2566072064  "Source: isobus.net VDMA Data Dictionary (https://www.isobus.net/isobus/pGNAndSPN/7236?type=PGN)";
CM_ BO_ 2566072320  "Source: isobus.net VDMA Data Dictionary (https://www.isobus.net/isobus/pGNAndSPN/7240?type=PGN)";
CM_ BO_ 2566072576  "Source: isobus.net VDMA Data Dictionary (https://www.isobus.net/isobus/pGNAndSPN/7246?type=PGN)";
CM_ BO_ 2566072832  "Source: isobus.net VDMA Data Dictionary (https://www.isobus.net/isobus/pGNAndSPN/7263?type=PGN)";
CM_ BO_ 2566073088  "Source: isobus.net VDMA Data Dictionary (https://www.isobus.net/isobus/pGNAndSPN/7266?type=PGN)";
CM_ BO_ 2566073344  "Source: isobus.net VDMA Data Dictionary (https://www.isobus.net/isobus/pGNAndSPN/7298?type=PGN)";
CM_ BO_ 2566073600  "Source: isobus.net VDMA Data Dictionary (https://www.isobus.net/isobus/pGNAndSPN/7306?type=PGN)";
CM_ BO_ 2566073856  "Source: isobus.net VDMA Data Dictionary (https://www.isobus.net/isobus/pGNAndSPN/7311?type=PGN)";
CM_ BO_ 2566074112  "Source: isobus.net VDMA Data Dictionary (https://www.isobus.net/isobus/pGNAndSPN/7319?type=PGN)";
CM_ BO_ 2566074368  "Source: isobus.net VDMA Data Dictionary (https://www.isobus.net/isobus/pGNAndSPN/7325?type=PGN)";
CM_ BO_ 2566074624  "Source: isobus.net VDMA Data Dictionary (https://www.isobus.net/isobus/pGNAndSPN/7328?type=PGN)";
CM_ BO_ 2566074880  "Source: isobus.net VDMA Data Dictionary (https://www.isobus.net/isobus/pGNAndSPN/7340?type=PGN)";
CM_ BO_ 2566075136  "Source: isobus.net VDMA Data Dictionary (https://www.isobus.net/isobus/pGNAndSPN/7344?type=PGN)";
CM_ BO_ 2566075392  "Source: isobus.net VDMA Data Dictionary (https://www.isobus.net/isobus/pGNAndSPN/7348?type=PGN)";
CM_ BO_ 2566075648  "Source: isobus.net VDMA Data Dictionary (https://www.isobus.net/isobus/pGNAndSPN/7352?type=PGN)";
CM_ BO_ 2566075904  "Source: isobus.net VDMA Data Dictionary (https://www.isobus.net/isobus/pGNAndSPN/7355?type=PGN)";
CM_ BO_ 2566076160  "Source: isobus.net VDMA Data Dictionary (https://www.isobus.net/isobus/pGNAndSPN/7359?type=PGN)";
CM_ BO_ 2566076416  "Source: isobus.net VDMA Data Dictionary (https://www.isobus.net/isobus/pGNAndSPN/7365?type=PGN)";
CM_ BO_ 2566076672  "Source: isobus.net VDMA Data Dictionary (https://www.isobus.net/isobus/pGNAndSPN/7382?type=PGN)";
CM_ BO_ 2566076928  "Source: isobus.net VDMA Data Dictionary (https://www.isobus.net/isobus/pGNAndSPN/7385?type=PGN)";
CM_ BO_ 2566077184  "Source: isobus.net VDMA Data Dictionary (https://www.isobus.net/isobus/pGNAndSPN/7417?type=PGN)";
CM_ BO_ 2566077440  "Source: isobus.net VDMA Data Dictionary (https://www.isobus.net/isobus/pGNAndSPN/7425?type=PGN)";
CM_ BO_ 2566077696  "Source: isobus.net VDMA Data Dictionary (https://www.isobus.net/isobus/pGNAndSPN/7430?type=PGN)";
CM_ BO_ 2566077952  "Source: isobus.net VDMA Data Dictionary (https://www.isobus.net/isobus/pGNAndSPN/7438?type=PGN)";
CM_ BO_ 2566078208  "Source: isobus.net VDMA Data Dictionary (https://www.isobus.net/isobus/pGNAndSPN/7444?type=PGN)";
CM_ BO_ 2566078464  "Source: isobus.net VDMA Data Dictionary (https://www.isobus.net/isobus/pGNAndSPN/7447?type=PGN)";
CM_ BO_ 2566078720  "Source: isobus.net VDMA Data Dictionary (https://www.isobus.net/isobus/pGNAndSPN/7453?type=PGN)";
CM_ BO_ 2566078976  "Source: isobus.net VDMA Data Dictionary (https://www.isobus.net/isobus/pGNAndSPN/7463?type=PGN)";
CM_ BO_ 2566079232  "Source: isobus.net VDMA Data Dictionary (https://www.isobus.net/isobus/pGNAndSPN/7479?type=PGN)";
CM_ BO_ 2566079488  "Source: isobus.net VDMA Data Dictionary (https://www.isobus.net/isobus/pGNAndSPN/7493?type=PGN)";
CM_ BO_ 2566079744  "Source: isobus.net VDMA Data Dictionary (https://www.isobus.net/isobus/pGNAndSPN/7502?type=PGN)";
CM_ BO_ 2566080000  "Source: isobus.net VDMA Data Dictionary (https://www.isobus.net/isobus/pGNAndSPN/7512?type=PGN)";
CM_ BO_ 2566080256  "Source: isobus.net VDMA Data Dictionary (https://www.isobus.net/isobus/pGNAndSPN/7520?type=PGN)";
CM_ BO_ 2566080512  "Source: isobus.net VDMA Data Dictionary (https://www.isobus.net/isobus/pGNAndSPN/7532?type=PGN)";
CM_ BO_ 2566080768  "Source: isobus.net VDMA Data Dictionary (https://www.isobus.net/isobus/pGNAndSPN/7535?type=PGN)";
CM_ BO_ 2566081024  "Source: isobus.net VDMA Data Dictionary (https://www.isobus.net/isobus/pGNAndSPN/7542?type=PGN)";
CM_ BO_ 2566081280  "Source: isobus.net VDMA Data Dictionary (https://www.isobus.net/isobus/pGNAndSPN/7553?type=PGN)";
CM_ BO_ 2566081536  "Source: isobus.net VDMA Data Dictionary (https://www.isobus.net/isobus/pGNAndSPN/7557?type=PGN)";
CM_ BO_ 2566081792  "Source: isobus.net VDMA Data Dictionary (https://www.isobus.net/isobus/pGNAndSPN/7561?type=PGN)";
CM_ BO_ 2566082048  "Source: isobus.net VDMA Data Dictionary (https://www.isobus.net/isobus/pGNAndSPN/7565?type=PGN)";
CM_ BO_ 2566082304  "Source: isobus.net VDMA Data Dictionary (https://www.isobus.net/isobus/pGNAndSPN/7569?type=PGN)";
CM_ BO_ 2566082560  "Source: isobus.net VDMA Data Dictionary (https://www.isobus.net/isobus/pGNAndSPN/7573?type=PGN)";
CM_ BO_ 2566082816  "Source: isobus.net VDMA Data Dictionary (https://www.isobus.net/isobus/pGNAndSPN/7577?type=PGN)";
CM_ BO_ 2566083072  "Source: isobus.net VDMA Data Dictionary (https://www.isobus.net/isobus/pGNAndSPN/7581?type=PGN)";
CM_ BO_ 2566083328  "Source: isobus.net VDMA Data Dictionary (https://www.isobus.net/isobus/pGNAndSPN/7585?type=PGN)";
CM_ BO_ 2566083584  "Source: isobus.net VDMA Data Dictionary (https://www.isobus.net/isobus/pGNAndSPN/7589?type=PGN)";
CM_ BO_ 2566083840  "Source: isobus.net VDMA Data Dictionary (https://www.isobus.net/isobus/pGNAndSPN/7593?type=PGN)";
CM_ BO_ 2566084096  "Source: isobus.net VDMA Data Dictionary (https://www.isobus.net/isobus/pGNAndSPN/7597?type=PGN)";
CM_ BO_ 2566084352  "Source: isobus.net VDMA Data Dictionary (https://www.isobus.net/isobus/pGNAndSPN/7601?type=PGN)";
CM_ BO_ 2566084608  "Source: isobus.net VDMA Data Dictionary (https://www.isobus.net/isobus/pGNAndSPN/7605?type=PGN)";
CM_ BO_ 2566084864  "Source: isobus.net VDMA Data Dictionary (https://www.isobus.net/isobus/pGNAndSPN/7609?type=PGN)";
CM_ BO_ 2566085120  "Source: isobus.net VDMA Data Dictionary (https://www.isobus.net/isobus/pGNAndSPN/7613?type=PGN)";
CM_ BO_ 2566085376  "Source: isobus.net VDMA Data Dictionary (https://www.isobus.net/isobus/pGNAndSPN/7617?type=PGN)";
CM_ BO_ 2566085632  "Source: isobus.net VDMA Data Dictionary (https://www.isobus.net/isobus/pGNAndSPN/7621?type=PGN)";
CM_ BO_ 2566085888  "Source: isobus.net VDMA Data Dictionary (https://www.isobus.net/isobus/pGNAndSPN/7625?type=PGN)";
CM_ BO_ 2566086144  "Source: isobus.net VDMA Data Dictionary (https://www.isobus.net/isobus/pGNAndSPN/7629?type=PGN)";
CM_ BO_ 2566086400  "Source: isobus.net VDMA Data Dictionary (https://www.isobus.net/isobus/pGNAndSPN/7633?type=PGN)";
CM_ BO_ 2566086656  "Source: isobus.net VDMA Data Dictionary (https://www.isobus.net/isobus/pGNAndSPN/7637?type=PGN)";
CM_ BO_ 2566086912  "Source: isobus.net VDMA Data Dictionary (https://www.isobus.net/isobus/pGNAndSPN/7641?type=PGN)";
CM_ BO_ 2566087168  "Source: isobus.net VDMA Data Dictionary (https://www.isobus.net/isobus/pGNAndSPN/7645?type=PGN)";
CM_ BO_ 2566087424  "Source: isobus.net VDMA Data Dictionary (https://www.isobus.net/isobus/pGNAndSPN/7649?type=PGN)";
CM_ BO_ 2566087680  "Source: isobus.net VDMA Data Dictionary (https://www.isobus.net/isobus/pGNAndSPN/7651?type=PGN)";
CM_ BO_ 2566087936  "Source: isobus.net VDMA Data Dictionary (https://www.isobus.net/isobus/pGNAndSPN/7656?type=PGN)";
CM_ BO_ 2566088192  "Source: isobus.net VDMA Data Dictionary (https://www.isobus.net/isobus/pGNAndSPN/7661?type=PGN)";
CM_ BO_ 2566088448  "Source: isobus.net VDMA Data Dictionary (https://www.isobus.net/isobus/pGNAndSPN/7666?type=PGN)";
CM_ BO_ 2566088704  "Source: isobus.net VDMA Data Dictionary (https://www.isobus.net/isobus/pGNAndSPN/7671?type=PGN)";
CM_ BO_ 2566088960  "Source: isobus.net VDMA Data Dictionary (https://www.isobus.net/isobus/pGNAndSPN/7676?type=PGN)";
CM_ BO_ 2566089216  "Source: isobus.net VDMA Data Dictionary (https://www.isobus.net/isobus/pGNAndSPN/7681?type=PGN)";
CM_ BO_ 2566089472  "Source: isobus.net VDMA Data Dictionary (https://www.isobus.net/isobus/pGNAndSPN/7686?type=PGN)";
CM_ BO_ 2566089728  "Source: isobus.net VDMA Data Dictionary (https://www.isobus.net/isobus/pGNAndSPN/7691?type=PGN)";
CM_ BO_ 2566089984  "Source: isobus.net VDMA Data Dictionary (https://www.isobus.net/isobus/pGNAndSPN/7696?type=PGN)";
CM_ BO_ 2566090240  "Source: isobus.net VDMA Data Dictionary (https://www.isobus.net/isobus/pGNAndSPN/7701?type=PGN)";
CM_ BO_ 2566090496  "Source: isobus.net VDMA Data Dictionary (https://www.isobus.net/isobus/pGNAndSPN/7706?type=PGN)";
CM_ BO_ 2566090752  "Source: isobus.net VDMA Data Dictionary (https://www.isobus.net/isobus/pGNAndSPN/7712?type=PGN)";
CM_ BO_ 2566091008  "Source: isobus.net VDMA Data Dictionary (https://www.isobus.net/isobus/pGNAndSPN/7717?type=PGN)";
CM_ BO_ 2566091264  "Source: isobus.net VDMA Data Dictionary (https://www.isobus.net/isobus/pGNAndSPN/7722?type=PGN)";
CM_ BO_ 2566091520  "Source: isobus.net VDMA Data Dictionary (https://www.isobus.net/isobus/pGNAndSPN/7727?type=PGN)";
CM_ BO_ 2566091776  "Source: isobus.net VDMA Data Dictionary (https://www.isobus.net/isobus/pGNAndSPN/7732?type=PGN)";
CM_ BO_ 2566092032  "Source: isobus.net VDMA Data Dictionary (https://www.isobus.net/isobus/pGNAndSPN/7737?type=PGN)";
CM_ BO_ 2566092288  "Source: isobus.net VDMA Data Dictionary (https://www.isobus.net/isobus/pGNAndSPN/7740?type=PGN)";
CM_ SG_ 2566005248 High_Voltage_Energy_Storage_Pack "Generic 8-byte raw payload. Detail page: https://www.isobus.net/isobus/pGNAndSPN/5185?type=PGN. Signal-level enrichment via PR welcome  see CONTRIBUTING.md.";
CM_ SG_ 2566005504 High_Voltage_Energy_Storage_Pack "Generic 8-byte raw payload. Detail page: https://www.isobus.net/isobus/pGNAndSPN/5197?type=PGN. Signal-level enrichment via PR welcome  see CONTRIBUTING.md.";
CM_ SG_ 2566005760 High_Voltage_Energy_Storage_Pack "Generic 8-byte raw payload. Detail page: https://www.isobus.net/isobus/pGNAndSPN/5201?type=PGN. Signal-level enrichment via PR welcome  see CONTRIBUTING.md.";
CM_ SG_ 2566006016 High_Voltage_Energy_Storage_Pack "Generic 8-byte raw payload. Detail page: https://www.isobus.net/isobus/pGNAndSPN/5205?type=PGN. Signal-level enrichment via PR welcome  see CONTRIBUTING.md.";
CM_ SG_ 2566006272 High_Voltage_Energy_Storage_Pack "Generic 8-byte raw payload. Detail page: https://www.isobus.net/isobus/pGNAndSPN/5209?type=PGN. Signal-level enrichment via PR welcome  see CONTRIBUTING.md.";
CM_ SG_ 2566006528 High_Voltage_Energy_Storage_Pack "Generic 8-byte raw payload. Detail page: https://www.isobus.net/isobus/pGNAndSPN/5212?type=PGN. Signal-level enrichment via PR welcome  see CONTRIBUTING.md.";
CM_ SG_ 2566006784 High_Voltage_Energy_Storage_Pack "Generic 8-byte raw payload. Detail page: https://www.isobus.net/isobus/pGNAndSPN/5216?type=PGN. Signal-level enrichment via PR welcome  see CONTRIBUTING.md.";
CM_ SG_ 2566007040 High_Voltage_Energy_Storage_Pack "Generic 8-byte raw payload. Detail page: https://www.isobus.net/isobus/pGNAndSPN/5222?type=PGN. Signal-level enrichment via PR welcome  see CONTRIBUTING.md.";
CM_ SG_ 2566007296 High_Voltage_Energy_Storage_Pack "Generic 8-byte raw payload. Detail page: https://www.isobus.net/isobus/pGNAndSPN/5239?type=PGN. Signal-level enrichment via PR welcome  see CONTRIBUTING.md.";
CM_ SG_ 2566007552 High_Voltage_Energy_Storage_Pack "Generic 8-byte raw payload. Detail page: https://www.isobus.net/isobus/pGNAndSPN/5242?type=PGN. Signal-level enrichment via PR welcome  see CONTRIBUTING.md.";
CM_ SG_ 2566007808 High_Voltage_Energy_Storage_Pack "Generic 8-byte raw payload. Detail page: https://www.isobus.net/isobus/pGNAndSPN/5274?type=PGN. Signal-level enrichment via PR welcome  see CONTRIBUTING.md.";
CM_ SG_ 2566008064 High_Voltage_Energy_Storage_Pack "Generic 8-byte raw payload. Detail page: https://www.isobus.net/isobus/pGNAndSPN/5282?type=PGN. Signal-level enrichment via PR welcome  see CONTRIBUTING.md.";
CM_ SG_ 2566008320 High_Voltage_Energy_Storage_Pack "Generic 8-byte raw payload. Detail page: https://www.isobus.net/isobus/pGNAndSPN/5287?type=PGN. Signal-level enrichment via PR welcome  see CONTRIBUTING.md.";
CM_ SG_ 2566008576 High_Voltage_Energy_Storage_Pack "Generic 8-byte raw payload. Detail page: https://www.isobus.net/isobus/pGNAndSPN/5295?type=PGN. Signal-level enrichment via PR welcome  see CONTRIBUTING.md.";
CM_ SG_ 2566008832 High_Voltage_Energy_Storage_Pack "Generic 8-byte raw payload. Detail page: https://www.isobus.net/isobus/pGNAndSPN/5301?type=PGN. Signal-level enrichment via PR welcome  see CONTRIBUTING.md.";
CM_ SG_ 2566009088 High_Voltage_Energy_Storage_Pack "Generic 8-byte raw payload. Detail page: https://www.isobus.net/isobus/pGNAndSPN/5304?type=PGN. Signal-level enrichment via PR welcome  see CONTRIBUTING.md.";
CM_ SG_ 2566009344 High_Voltage_Energy_Storage_Pack "Generic 8-byte raw payload. Detail page: https://www.isobus.net/isobus/pGNAndSPN/5316?type=PGN. Signal-level enrichment via PR welcome  see CONTRIBUTING.md.";
CM_ SG_ 2566009600 High_Voltage_Energy_Storage_Pack "Generic 8-byte raw payload. Detail page: https://www.isobus.net/isobus/pGNAndSPN/5320?type=PGN. Signal-level enrichment via PR welcome  see CONTRIBUTING.md.";
CM_ SG_ 2566009856 High_Voltage_Energy_Storage_Pack "Generic 8-byte raw payload. Detail page: https://www.isobus.net/isobus/pGNAndSPN/5324?type=PGN. Signal-level enrichment via PR welcome  see CONTRIBUTING.md.";
CM_ SG_ 2566010112 High_Voltage_Energy_Storage_Pack "Generic 8-byte raw payload. Detail page: https://www.isobus.net/isobus/pGNAndSPN/5328?type=PGN. Signal-level enrichment via PR welcome  see CONTRIBUTING.md.";
CM_ SG_ 2566010368 High_Voltage_Energy_Storage_Pack "Generic 8-byte raw payload. Detail page: https://www.isobus.net/isobus/pGNAndSPN/5331?type=PGN. Signal-level enrichment via PR welcome  see CONTRIBUTING.md.";
CM_ SG_ 2566010624 High_Voltage_Energy_Storage_Pack "Generic 8-byte raw payload. Detail page: https://www.isobus.net/isobus/pGNAndSPN/5335?type=PGN. Signal-level enrichment via PR welcome  see CONTRIBUTING.md.";
CM_ SG_ 2566010880 High_Voltage_Energy_Storage_Pack "Generic 8-byte raw payload. Detail page: https://www.isobus.net/isobus/pGNAndSPN/5341?type=PGN. Signal-level enrichment via PR welcome  see CONTRIBUTING.md.";
CM_ SG_ 2566011136 High_Voltage_Energy_Storage_Pack "Generic 8-byte raw payload. Detail page: https://www.isobus.net/isobus/pGNAndSPN/5358?type=PGN. Signal-level enrichment via PR welcome  see CONTRIBUTING.md.";
CM_ SG_ 2566011392 High_Voltage_Energy_Storage_Pack "Generic 8-byte raw payload. Detail page: https://www.isobus.net/isobus/pGNAndSPN/5361?type=PGN. Signal-level enrichment via PR welcome  see CONTRIBUTING.md.";
CM_ SG_ 2566011648 High_Voltage_Energy_Storage_Pack "Generic 8-byte raw payload. Detail page: https://www.isobus.net/isobus/pGNAndSPN/5393?type=PGN. Signal-level enrichment via PR welcome  see CONTRIBUTING.md.";
CM_ SG_ 2566011904 High_Voltage_Energy_Storage_Pack "Generic 8-byte raw payload. Detail page: https://www.isobus.net/isobus/pGNAndSPN/5401?type=PGN. Signal-level enrichment via PR welcome  see CONTRIBUTING.md.";
CM_ SG_ 2566012160 High_Voltage_Energy_Storage_Pack "Generic 8-byte raw payload. Detail page: https://www.isobus.net/isobus/pGNAndSPN/5406?type=PGN. Signal-level enrichment via PR welcome  see CONTRIBUTING.md.";
CM_ SG_ 2566012416 High_Voltage_Energy_Storage_Pack "Generic 8-byte raw payload. Detail page: https://www.isobus.net/isobus/pGNAndSPN/5414?type=PGN. Signal-level enrichment via PR welcome  see CONTRIBUTING.md.";
CM_ SG_ 2566012672 High_Voltage_Energy_Storage_Pack "Generic 8-byte raw payload. Detail page: https://www.isobus.net/isobus/pGNAndSPN/5420?type=PGN. Signal-level enrichment via PR welcome  see CONTRIBUTING.md.";
CM_ SG_ 2566012928 High_Voltage_Energy_Storage_Pack "Generic 8-byte raw payload. Detail page: https://www.isobus.net/isobus/pGNAndSPN/5423?type=PGN. Signal-level enrichment via PR welcome  see CONTRIBUTING.md.";
CM_ SG_ 2566013184 High_Voltage_Energy_Storage_Pack "Generic 8-byte raw payload. Detail page: https://www.isobus.net/isobus/pGNAndSPN/5435?type=PGN. Signal-level enrichment via PR welcome  see CONTRIBUTING.md.";
CM_ SG_ 2566013440 High_Voltage_Energy_Storage_Pack "Generic 8-byte raw payload. Detail page: https://www.isobus.net/isobus/pGNAndSPN/5439?type=PGN. Signal-level enrichment via PR welcome  see CONTRIBUTING.md.";
CM_ SG_ 2566013696 High_Voltage_Energy_Storage_Pack "Generic 8-byte raw payload. Detail page: https://www.isobus.net/isobus/pGNAndSPN/5443?type=PGN. Signal-level enrichment via PR welcome  see CONTRIBUTING.md.";
CM_ SG_ 2566013952 High_Voltage_Energy_Storage_Pack "Generic 8-byte raw payload. Detail page: https://www.isobus.net/isobus/pGNAndSPN/5447?type=PGN. Signal-level enrichment via PR welcome  see CONTRIBUTING.md.";
CM_ SG_ 2566014208 High_Voltage_Energy_Storage_Pack "Generic 8-byte raw payload. Detail page: https://www.isobus.net/isobus/pGNAndSPN/5450?type=PGN. Signal-level enrichment via PR welcome  see CONTRIBUTING.md.";
CM_ SG_ 2566014464 High_Voltage_Energy_Storage_Pack "Generic 8-byte raw payload. Detail page: https://www.isobus.net/isobus/pGNAndSPN/5454?type=PGN. Signal-level enrichment via PR welcome  see CONTRIBUTING.md.";
CM_ SG_ 2566014720 High_Voltage_Energy_Storage_Pack "Generic 8-byte raw payload. Detail page: https://www.isobus.net/isobus/pGNAndSPN/5460?type=PGN. Signal-level enrichment via PR welcome  see CONTRIBUTING.md.";
CM_ SG_ 2566014976 High_Voltage_Energy_Storage_Pack "Generic 8-byte raw payload. Detail page: https://www.isobus.net/isobus/pGNAndSPN/5477?type=PGN. Signal-level enrichment via PR welcome  see CONTRIBUTING.md.";
CM_ SG_ 2566015232 High_Voltage_Energy_Storage_Pack "Generic 8-byte raw payload. Detail page: https://www.isobus.net/isobus/pGNAndSPN/5480?type=PGN. Signal-level enrichment via PR welcome  see CONTRIBUTING.md.";
CM_ SG_ 2566015488 High_Voltage_Energy_Storage_Pack "Generic 8-byte raw payload. Detail page: https://www.isobus.net/isobus/pGNAndSPN/5512?type=PGN. Signal-level enrichment via PR welcome  see CONTRIBUTING.md.";
CM_ SG_ 2566015744 High_Voltage_Energy_Storage_Pack "Generic 8-byte raw payload. Detail page: https://www.isobus.net/isobus/pGNAndSPN/5520?type=PGN. Signal-level enrichment via PR welcome  see CONTRIBUTING.md.";
CM_ SG_ 2566016000 High_Voltage_Energy_Storage_Pack "Generic 8-byte raw payload. Detail page: https://www.isobus.net/isobus/pGNAndSPN/5525?type=PGN. Signal-level enrichment via PR welcome  see CONTRIBUTING.md.";
CM_ SG_ 2566016256 High_Voltage_Energy_Storage_Pack "Generic 8-byte raw payload. Detail page: https://www.isobus.net/isobus/pGNAndSPN/5533?type=PGN. Signal-level enrichment via PR welcome  see CONTRIBUTING.md.";
CM_ SG_ 2566016512 High_Voltage_Energy_Storage_Pack "Generic 8-byte raw payload. Detail page: https://www.isobus.net/isobus/pGNAndSPN/5539?type=PGN. Signal-level enrichment via PR welcome  see CONTRIBUTING.md.";
CM_ SG_ 2566016768 High_Voltage_Energy_Storage_Pack "Generic 8-byte raw payload. Detail page: https://www.isobus.net/isobus/pGNAndSPN/5542?type=PGN. Signal-level enrichment via PR welcome  see CONTRIBUTING.md.";
CM_ SG_ 2566017024 Electronic_Auxiliary_Transmissio "Generic 8-byte raw payload. Detail page: https://www.isobus.net/isobus/pGNAndSPN/5543?type=PGN. Signal-level enrichment via PR welcome  see CONTRIBUTING.md.";
CM_ SG_ 2566017280 High_Voltage_Energy_Storage_Pack "Generic 8-byte raw payload. Detail page: https://www.isobus.net/isobus/pGNAndSPN/5555?type=PGN. Signal-level enrichment via PR welcome  see CONTRIBUTING.md.";
CM_ SG_ 2566017536 High_Voltage_Energy_Storage_Pack "Generic 8-byte raw payload. Detail page: https://www.isobus.net/isobus/pGNAndSPN/5559?type=PGN. Signal-level enrichment via PR welcome  see CONTRIBUTING.md.";
CM_ SG_ 2566017792 High_Voltage_Energy_Storage_Pack "Generic 8-byte raw payload. Detail page: https://www.isobus.net/isobus/pGNAndSPN/5563?type=PGN. Signal-level enrichment via PR welcome  see CONTRIBUTING.md.";
CM_ SG_ 2566018048 High_Voltage_Energy_Storage_Pack "Generic 8-byte raw payload. Detail page: https://www.isobus.net/isobus/pGNAndSPN/5567?type=PGN. Signal-level enrichment via PR welcome  see CONTRIBUTING.md.";
CM_ SG_ 2566018304 High_Voltage_Energy_Storage_Pack "Generic 8-byte raw payload. Detail page: https://www.isobus.net/isobus/pGNAndSPN/5570?type=PGN. Signal-level enrichment via PR welcome  see CONTRIBUTING.md.";
CM_ SG_ 2566018560 High_Voltage_Energy_Storage_Pack "Generic 8-byte raw payload. Detail page: https://www.isobus.net/isobus/pGNAndSPN/5574?type=PGN. Signal-level enrichment via PR welcome  see CONTRIBUTING.md.";
CM_ SG_ 2566018816 High_Voltage_Energy_Storage_Pack "Generic 8-byte raw payload. Detail page: https://www.isobus.net/isobus/pGNAndSPN/5580?type=PGN. Signal-level enrichment via PR welcome  see CONTRIBUTING.md.";
CM_ SG_ 2566019072 High_Voltage_Energy_Storage_Pack "Generic 8-byte raw payload. Detail page: https://www.isobus.net/isobus/pGNAndSPN/5597?type=PGN. Signal-level enrichment via PR welcome  see CONTRIBUTING.md.";
CM_ SG_ 2566019328 High_Voltage_Energy_Storage_Pack "Generic 8-byte raw payload. Detail page: https://www.isobus.net/isobus/pGNAndSPN/5600?type=PGN. Signal-level enrichment via PR welcome  see CONTRIBUTING.md.";
CM_ SG_ 2566019584 High_Voltage_Energy_Storage_Pack "Generic 8-byte raw payload. Detail page: https://www.isobus.net/isobus/pGNAndSPN/5632?type=PGN. Signal-level enrichment via PR welcome  see CONTRIBUTING.md.";
CM_ SG_ 2566019840 High_Voltage_Energy_Storage_Pack "Generic 8-byte raw payload. Detail page: https://www.isobus.net/isobus/pGNAndSPN/5640?type=PGN. Signal-level enrichment via PR welcome  see CONTRIBUTING.md.";
CM_ SG_ 2566020096 High_Voltage_Energy_Storage_Pack "Generic 8-byte raw payload. Detail page: https://www.isobus.net/isobus/pGNAndSPN/5645?type=PGN. Signal-level enrichment via PR welcome  see CONTRIBUTING.md.";
CM_ SG_ 2566020352 High_Voltage_Energy_Storage_Pack "Generic 8-byte raw payload. Detail page: https://www.isobus.net/isobus/pGNAndSPN/5653?type=PGN. Signal-level enrichment via PR welcome  see CONTRIBUTING.md.";
CM_ SG_ 2566020608 High_Voltage_Energy_Storage_Pack "Generic 8-byte raw payload. Detail page: https://www.isobus.net/isobus/pGNAndSPN/5659?type=PGN. Signal-level enrichment via PR welcome  see CONTRIBUTING.md.";
CM_ SG_ 2566020864 High_Voltage_Energy_Storage_Pack "Generic 8-byte raw payload. Detail page: https://www.isobus.net/isobus/pGNAndSPN/5662?type=PGN. Signal-level enrichment via PR welcome  see CONTRIBUTING.md.";
CM_ SG_ 2566021120 High_Voltage_Energy_Storage_Pack "Generic 8-byte raw payload. Detail page: https://www.isobus.net/isobus/pGNAndSPN/5674?type=PGN. Signal-level enrichment via PR welcome  see CONTRIBUTING.md.";
CM_ SG_ 2566021376 High_Voltage_Energy_Storage_Pack "Generic 8-byte raw payload. Detail page: https://www.isobus.net/isobus/pGNAndSPN/5678?type=PGN. Signal-level enrichment via PR welcome  see CONTRIBUTING.md.";
CM_ SG_ 2566021632 High_Voltage_Energy_Storage_Pack "Generic 8-byte raw payload. Detail page: https://www.isobus.net/isobus/pGNAndSPN/5682?type=PGN. Signal-level enrichment via PR welcome  see CONTRIBUTING.md.";
CM_ SG_ 2566021888 High_Voltage_Energy_Storage_Pack "Generic 8-byte raw payload. Detail page: https://www.isobus.net/isobus/pGNAndSPN/5686?type=PGN. Signal-level enrichment via PR welcome  see CONTRIBUTING.md.";
CM_ SG_ 2566022144 High_Voltage_Energy_Storage_Pack "Generic 8-byte raw payload. Detail page: https://www.isobus.net/isobus/pGNAndSPN/5689?type=PGN. Signal-level enrichment via PR welcome  see CONTRIBUTING.md.";
CM_ SG_ 2566022400 High_Voltage_Energy_Storage_Pack "Generic 8-byte raw payload. Detail page: https://www.isobus.net/isobus/pGNAndSPN/5693?type=PGN. Signal-level enrichment via PR welcome  see CONTRIBUTING.md.";
CM_ SG_ 2566022656 High_Voltage_Energy_Storage_Pack "Generic 8-byte raw payload. Detail page: https://www.isobus.net/isobus/pGNAndSPN/5699?type=PGN. Signal-level enrichment via PR welcome  see CONTRIBUTING.md.";
CM_ SG_ 2566022912 High_Voltage_Energy_Storage_Pack "Generic 8-byte raw payload. Detail page: https://www.isobus.net/isobus/pGNAndSPN/5716?type=PGN. Signal-level enrichment via PR welcome  see CONTRIBUTING.md.";
CM_ SG_ 2566023168 High_Voltage_Energy_Storage_Pack "Generic 8-byte raw payload. Detail page: https://www.isobus.net/isobus/pGNAndSPN/5719?type=PGN. Signal-level enrichment via PR welcome  see CONTRIBUTING.md.";
CM_ SG_ 2566023424 High_Voltage_Energy_Storage_Pack "Generic 8-byte raw payload. Detail page: https://www.isobus.net/isobus/pGNAndSPN/5751?type=PGN. Signal-level enrichment via PR welcome  see CONTRIBUTING.md.";
CM_ SG_ 2566023680 High_Voltage_Energy_Storage_Pack "Generic 8-byte raw payload. Detail page: https://www.isobus.net/isobus/pGNAndSPN/5759?type=PGN. Signal-level enrichment via PR welcome  see CONTRIBUTING.md.";
CM_ SG_ 2566023936 High_Voltage_Energy_Storage_Pack "Generic 8-byte raw payload. Detail page: https://www.isobus.net/isobus/pGNAndSPN/5764?type=PGN. Signal-level enrichment via PR welcome  see CONTRIBUTING.md.";
CM_ SG_ 2566024192 High_Voltage_Energy_Storage_Pack "Generic 8-byte raw payload. Detail page: https://www.isobus.net/isobus/pGNAndSPN/5772?type=PGN. Signal-level enrichment via PR welcome  see CONTRIBUTING.md.";
CM_ SG_ 2566024448 High_Voltage_Energy_Storage_Pack "Generic 8-byte raw payload. Detail page: https://www.isobus.net/isobus/pGNAndSPN/5778?type=PGN. Signal-level enrichment via PR welcome  see CONTRIBUTING.md.";
CM_ SG_ 2566024704 High_Voltage_Energy_Storage_Pack "Generic 8-byte raw payload. Detail page: https://www.isobus.net/isobus/pGNAndSPN/5781?type=PGN. Signal-level enrichment via PR welcome  see CONTRIBUTING.md.";
CM_ SG_ 2566024960 High_Voltage_Energy_Storage_Pack "Generic 8-byte raw payload. Detail page: https://www.isobus.net/isobus/pGNAndSPN/5793?type=PGN. Signal-level enrichment via PR welcome  see CONTRIBUTING.md.";
CM_ SG_ 2566025216 High_Voltage_Energy_Storage_Pack "Generic 8-byte raw payload. Detail page: https://www.isobus.net/isobus/pGNAndSPN/5797?type=PGN. Signal-level enrichment via PR welcome  see CONTRIBUTING.md.";
CM_ SG_ 2566025472 High_Voltage_Energy_Storage_Pack "Generic 8-byte raw payload. Detail page: https://www.isobus.net/isobus/pGNAndSPN/5801?type=PGN. Signal-level enrichment via PR welcome  see CONTRIBUTING.md.";
CM_ SG_ 2566025728 High_Voltage_Energy_Storage_Pack "Generic 8-byte raw payload. Detail page: https://www.isobus.net/isobus/pGNAndSPN/5805?type=PGN. Signal-level enrichment via PR welcome  see CONTRIBUTING.md.";
CM_ SG_ 2566025984 High_Voltage_Energy_Storage_Pack "Generic 8-byte raw payload. Detail page: https://www.isobus.net/isobus/pGNAndSPN/5808?type=PGN. Signal-level enrichment via PR welcome  see CONTRIBUTING.md.";
CM_ SG_ 2566026240 High_Voltage_Energy_Storage_Pack "Generic 8-byte raw payload. Detail page: https://www.isobus.net/isobus/pGNAndSPN/5812?type=PGN. Signal-level enrichment via PR welcome  see CONTRIBUTING.md.";
CM_ SG_ 2566026496 High_Voltage_Energy_Storage_Pack "Generic 8-byte raw payload. Detail page: https://www.isobus.net/isobus/pGNAndSPN/5818?type=PGN. Signal-level enrichment via PR welcome  see CONTRIBUTING.md.";
CM_ SG_ 2566026752 High_Voltage_Energy_Storage_Pack "Generic 8-byte raw payload. Detail page: https://www.isobus.net/isobus/pGNAndSPN/5835?type=PGN. Signal-level enrichment via PR welcome  see CONTRIBUTING.md.";
CM_ SG_ 2566027008 High_Voltage_Energy_Storage_Pack "Generic 8-byte raw payload. Detail page: https://www.isobus.net/isobus/pGNAndSPN/5838?type=PGN. Signal-level enrichment via PR welcome  see CONTRIBUTING.md.";
CM_ SG_ 2566027264 High_Voltage_Energy_Storage_Pack "Generic 8-byte raw payload. Detail page: https://www.isobus.net/isobus/pGNAndSPN/5870?type=PGN. Signal-level enrichment via PR welcome  see CONTRIBUTING.md.";
CM_ SG_ 2566027520 High_Voltage_Energy_Storage_Pack "Generic 8-byte raw payload. Detail page: https://www.isobus.net/isobus/pGNAndSPN/5878?type=PGN. Signal-level enrichment via PR welcome  see CONTRIBUTING.md.";
CM_ SG_ 2566027776 High_Voltage_Energy_Storage_Pack "Generic 8-byte raw payload. Detail page: https://www.isobus.net/isobus/pGNAndSPN/5883?type=PGN. Signal-level enrichment via PR welcome  see CONTRIBUTING.md.";
CM_ SG_ 2566028032 High_Voltage_Energy_Storage_Pack "Generic 8-byte raw payload. Detail page: https://www.isobus.net/isobus/pGNAndSPN/5891?type=PGN. Signal-level enrichment via PR welcome  see CONTRIBUTING.md.";
CM_ SG_ 2566028288 High_Voltage_Energy_Storage_Pack "Generic 8-byte raw payload. Detail page: https://www.isobus.net/isobus/pGNAndSPN/5897?type=PGN. Signal-level enrichment via PR welcome  see CONTRIBUTING.md.";
CM_ SG_ 2566028544 High_Voltage_Energy_Storage_Pack "Generic 8-byte raw payload. Detail page: https://www.isobus.net/isobus/pGNAndSPN/5900?type=PGN. Signal-level enrichment via PR welcome  see CONTRIBUTING.md.";
CM_ SG_ 2566028800 High_Voltage_Energy_Storage_Pack "Generic 8-byte raw payload. Detail page: https://www.isobus.net/isobus/pGNAndSPN/5912?type=PGN. Signal-level enrichment via PR welcome  see CONTRIBUTING.md.";
CM_ SG_ 2566029056 High_Voltage_Energy_Storage_Pack "Generic 8-byte raw payload. Detail page: https://www.isobus.net/isobus/pGNAndSPN/5916?type=PGN. Signal-level enrichment via PR welcome  see CONTRIBUTING.md.";
CM_ SG_ 2566029312 High_Voltage_Energy_Storage_Pack "Generic 8-byte raw payload. Detail page: https://www.isobus.net/isobus/pGNAndSPN/5920?type=PGN. Signal-level enrichment via PR welcome  see CONTRIBUTING.md.";
CM_ SG_ 2566029568 High_Voltage_Energy_Storage_Pack "Generic 8-byte raw payload. Detail page: https://www.isobus.net/isobus/pGNAndSPN/5924?type=PGN. Signal-level enrichment via PR welcome  see CONTRIBUTING.md.";
CM_ SG_ 2566029824 High_Voltage_Energy_Storage_Pack "Generic 8-byte raw payload. Detail page: https://www.isobus.net/isobus/pGNAndSPN/5927?type=PGN. Signal-level enrichment via PR welcome  see CONTRIBUTING.md.";
CM_ SG_ 2566030080 High_Voltage_Energy_Storage_Pack "Generic 8-byte raw payload. Detail page: https://www.isobus.net/isobus/pGNAndSPN/5931?type=PGN. Signal-level enrichment via PR welcome  see CONTRIBUTING.md.";
CM_ SG_ 2566030336 High_Voltage_Energy_Storage_Pack "Generic 8-byte raw payload. Detail page: https://www.isobus.net/isobus/pGNAndSPN/5937?type=PGN. Signal-level enrichment via PR welcome  see CONTRIBUTING.md.";
CM_ SG_ 2566030592 High_Voltage_Energy_Storage_Pack "Generic 8-byte raw payload. Detail page: https://www.isobus.net/isobus/pGNAndSPN/5954?type=PGN. Signal-level enrichment via PR welcome  see CONTRIBUTING.md.";
CM_ SG_ 2566030848 High_Voltage_Energy_Storage_Pack "Generic 8-byte raw payload. Detail page: https://www.isobus.net/isobus/pGNAndSPN/5957?type=PGN. Signal-level enrichment via PR welcome  see CONTRIBUTING.md.";
CM_ SG_ 2566031104 High_Voltage_Energy_Storage_Pack "Generic 8-byte raw payload. Detail page: https://www.isobus.net/isobus/pGNAndSPN/5989?type=PGN. Signal-level enrichment via PR welcome  see CONTRIBUTING.md.";
CM_ SG_ 2566031360 High_Voltage_Energy_Storage_Pack "Generic 8-byte raw payload. Detail page: https://www.isobus.net/isobus/pGNAndSPN/5997?type=PGN. Signal-level enrichment via PR welcome  see CONTRIBUTING.md.";
CM_ SG_ 2566031616 High_Voltage_Energy_Storage_Pack "Generic 8-byte raw payload. Detail page: https://www.isobus.net/isobus/pGNAndSPN/6002?type=PGN. Signal-level enrichment via PR welcome  see CONTRIBUTING.md.";
CM_ SG_ 2566031872 High_Voltage_Energy_Storage_Pack "Generic 8-byte raw payload. Detail page: https://www.isobus.net/isobus/pGNAndSPN/6010?type=PGN. Signal-level enrichment via PR welcome  see CONTRIBUTING.md.";
CM_ SG_ 2566032128 High_Voltage_Energy_Storage_Pack "Generic 8-byte raw payload. Detail page: https://www.isobus.net/isobus/pGNAndSPN/6016?type=PGN. Signal-level enrichment via PR welcome  see CONTRIBUTING.md.";
CM_ SG_ 2566032384 High_Voltage_Energy_Storage_Pack "Generic 8-byte raw payload. Detail page: https://www.isobus.net/isobus/pGNAndSPN/6019?type=PGN. Signal-level enrichment via PR welcome  see CONTRIBUTING.md.";
CM_ SG_ 2566032640 High_Voltage_Energy_Storage_Pack "Generic 8-byte raw payload. Detail page: https://www.isobus.net/isobus/pGNAndSPN/6031?type=PGN. Signal-level enrichment via PR welcome  see CONTRIBUTING.md.";
CM_ SG_ 2566032896 High_Voltage_Energy_Storage_Pack "Generic 8-byte raw payload. Detail page: https://www.isobus.net/isobus/pGNAndSPN/6035?type=PGN. Signal-level enrichment via PR welcome  see CONTRIBUTING.md.";
CM_ SG_ 2566033152 High_Voltage_Energy_Storage_Pack "Generic 8-byte raw payload. Detail page: https://www.isobus.net/isobus/pGNAndSPN/6039?type=PGN. Signal-level enrichment via PR welcome  see CONTRIBUTING.md.";
CM_ SG_ 2566033408 High_Voltage_Energy_Storage_Pack "Generic 8-byte raw payload. Detail page: https://www.isobus.net/isobus/pGNAndSPN/6043?type=PGN. Signal-level enrichment via PR welcome  see CONTRIBUTING.md.";
CM_ SG_ 2566033664 High_Voltage_Energy_Storage_Pack "Generic 8-byte raw payload. Detail page: https://www.isobus.net/isobus/pGNAndSPN/6046?type=PGN. Signal-level enrichment via PR welcome  see CONTRIBUTING.md.";
CM_ SG_ 2566033920 High_Voltage_Energy_Storage_Pack "Generic 8-byte raw payload. Detail page: https://www.isobus.net/isobus/pGNAndSPN/6050?type=PGN. Signal-level enrichment via PR welcome  see CONTRIBUTING.md.";
CM_ SG_ 2566034176 High_Voltage_Energy_Storage_Pack "Generic 8-byte raw payload. Detail page: https://www.isobus.net/isobus/pGNAndSPN/6056?type=PGN. Signal-level enrichment via PR welcome  see CONTRIBUTING.md.";
CM_ SG_ 2566034432 High_Voltage_Energy_Storage_Pack "Generic 8-byte raw payload. Detail page: https://www.isobus.net/isobus/pGNAndSPN/6073?type=PGN. Signal-level enrichment via PR welcome  see CONTRIBUTING.md.";
CM_ SG_ 2566034688 High_Voltage_Energy_Storage_Pack "Generic 8-byte raw payload. Detail page: https://www.isobus.net/isobus/pGNAndSPN/6076?type=PGN. Signal-level enrichment via PR welcome  see CONTRIBUTING.md.";
CM_ SG_ 2566034944 High_Voltage_Energy_Storage_Pack "Generic 8-byte raw payload. Detail page: https://www.isobus.net/isobus/pGNAndSPN/6108?type=PGN. Signal-level enrichment via PR welcome  see CONTRIBUTING.md.";
CM_ SG_ 2566035200 High_Voltage_Energy_Storage_Pack "Generic 8-byte raw payload. Detail page: https://www.isobus.net/isobus/pGNAndSPN/6116?type=PGN. Signal-level enrichment via PR welcome  see CONTRIBUTING.md.";
CM_ SG_ 2566035456 High_Voltage_Energy_Storage_Pack "Generic 8-byte raw payload. Detail page: https://www.isobus.net/isobus/pGNAndSPN/6121?type=PGN. Signal-level enrichment via PR welcome  see CONTRIBUTING.md.";
CM_ SG_ 2566035712 High_Voltage_Energy_Storage_Pack "Generic 8-byte raw payload. Detail page: https://www.isobus.net/isobus/pGNAndSPN/6129?type=PGN. Signal-level enrichment via PR welcome  see CONTRIBUTING.md.";
CM_ SG_ 2566035968 High_Voltage_Energy_Storage_Pack "Generic 8-byte raw payload. Detail page: https://www.isobus.net/isobus/pGNAndSPN/6135?type=PGN. Signal-level enrichment via PR welcome  see CONTRIBUTING.md.";
CM_ SG_ 2566036224 High_Voltage_Energy_Storage_Pack "Generic 8-byte raw payload. Detail page: https://www.isobus.net/isobus/pGNAndSPN/6138?type=PGN. Signal-level enrichment via PR welcome  see CONTRIBUTING.md.";
CM_ SG_ 2566036480 High_Voltage_Energy_Storage_Pack "Generic 8-byte raw payload. Detail page: https://www.isobus.net/isobus/pGNAndSPN/6150?type=PGN. Signal-level enrichment via PR welcome  see CONTRIBUTING.md.";
CM_ SG_ 2566036736 High_Voltage_Energy_Storage_Pack "Generic 8-byte raw payload. Detail page: https://www.isobus.net/isobus/pGNAndSPN/6154?type=PGN. Signal-level enrichment via PR welcome  see CONTRIBUTING.md.";
CM_ SG_ 2566036992 High_Voltage_Energy_Storage_Pack "Generic 8-byte raw payload. Detail page: https://www.isobus.net/isobus/pGNAndSPN/6158?type=PGN. Signal-level enrichment via PR welcome  see CONTRIBUTING.md.";
CM_ SG_ 2566037248 High_Voltage_Energy_Storage_Pack "Generic 8-byte raw payload. Detail page: https://www.isobus.net/isobus/pGNAndSPN/6162?type=PGN. Signal-level enrichment via PR welcome  see CONTRIBUTING.md.";
CM_ SG_ 2566037504 High_Voltage_Energy_Storage_Pack "Generic 8-byte raw payload. Detail page: https://www.isobus.net/isobus/pGNAndSPN/6165?type=PGN. Signal-level enrichment via PR welcome  see CONTRIBUTING.md.";
CM_ SG_ 2566037760 High_Voltage_Energy_Storage_Pack "Generic 8-byte raw payload. Detail page: https://www.isobus.net/isobus/pGNAndSPN/6169?type=PGN. Signal-level enrichment via PR welcome  see CONTRIBUTING.md.";
CM_ SG_ 2566038016 High_Voltage_Energy_Storage_Pack "Generic 8-byte raw payload. Detail page: https://www.isobus.net/isobus/pGNAndSPN/6175?type=PGN. Signal-level enrichment via PR welcome  see CONTRIBUTING.md.";
CM_ SG_ 2566038272 High_Voltage_Energy_Storage_Pack "Generic 8-byte raw payload. Detail page: https://www.isobus.net/isobus/pGNAndSPN/6192?type=PGN. Signal-level enrichment via PR welcome  see CONTRIBUTING.md.";
CM_ SG_ 2566038528 High_Voltage_Energy_Storage_Pack "Generic 8-byte raw payload. Detail page: https://www.isobus.net/isobus/pGNAndSPN/6195?type=PGN. Signal-level enrichment via PR welcome  see CONTRIBUTING.md.";
CM_ SG_ 2566038784 High_Voltage_Energy_Storage_Pack "Generic 8-byte raw payload. Detail page: https://www.isobus.net/isobus/pGNAndSPN/6227?type=PGN. Signal-level enrichment via PR welcome  see CONTRIBUTING.md.";
CM_ SG_ 2566039040 High_Voltage_Energy_Storage_Pack "Generic 8-byte raw payload. Detail page: https://www.isobus.net/isobus/pGNAndSPN/6235?type=PGN. Signal-level enrichment via PR welcome  see CONTRIBUTING.md.";
CM_ SG_ 2566039296 High_Voltage_Energy_Storage_Pack "Generic 8-byte raw payload. Detail page: https://www.isobus.net/isobus/pGNAndSPN/6240?type=PGN. Signal-level enrichment via PR welcome  see CONTRIBUTING.md.";
CM_ SG_ 2566039552 High_Voltage_Energy_Storage_Pack "Generic 8-byte raw payload. Detail page: https://www.isobus.net/isobus/pGNAndSPN/6248?type=PGN. Signal-level enrichment via PR welcome  see CONTRIBUTING.md.";
CM_ SG_ 2566039808 High_Voltage_Energy_Storage_Pack "Generic 8-byte raw payload. Detail page: https://www.isobus.net/isobus/pGNAndSPN/6254?type=PGN. Signal-level enrichment via PR welcome  see CONTRIBUTING.md.";
CM_ SG_ 2566040064 High_Voltage_Energy_Storage_Pack "Generic 8-byte raw payload. Detail page: https://www.isobus.net/isobus/pGNAndSPN/6257?type=PGN. Signal-level enrichment via PR welcome  see CONTRIBUTING.md.";
CM_ SG_ 2566040320 High_Voltage_Energy_Storage_Pack "Generic 8-byte raw payload. Detail page: https://www.isobus.net/isobus/pGNAndSPN/6269?type=PGN. Signal-level enrichment via PR welcome  see CONTRIBUTING.md.";
CM_ SG_ 2566040576 High_Voltage_Energy_Storage_Pack "Generic 8-byte raw payload. Detail page: https://www.isobus.net/isobus/pGNAndSPN/6273?type=PGN. Signal-level enrichment via PR welcome  see CONTRIBUTING.md.";
CM_ SG_ 2566040832 High_Voltage_Energy_Storage_Pack "Generic 8-byte raw payload. Detail page: https://www.isobus.net/isobus/pGNAndSPN/6277?type=PGN. Signal-level enrichment via PR welcome  see CONTRIBUTING.md.";
CM_ SG_ 2566041088 High_Voltage_Energy_Storage_Pack "Generic 8-byte raw payload. Detail page: https://www.isobus.net/isobus/pGNAndSPN/6281?type=PGN. Signal-level enrichment via PR welcome  see CONTRIBUTING.md.";
CM_ SG_ 2566041344 High_Voltage_Energy_Storage_Pack "Generic 8-byte raw payload. Detail page: https://www.isobus.net/isobus/pGNAndSPN/6284?type=PGN. Signal-level enrichment via PR welcome  see CONTRIBUTING.md.";
CM_ SG_ 2566041600 High_Voltage_Energy_Storage_Pack "Generic 8-byte raw payload. Detail page: https://www.isobus.net/isobus/pGNAndSPN/6288?type=PGN. Signal-level enrichment via PR welcome  see CONTRIBUTING.md.";
CM_ SG_ 2566041856 High_Voltage_Energy_Storage_Pack "Generic 8-byte raw payload. Detail page: https://www.isobus.net/isobus/pGNAndSPN/6294?type=PGN. Signal-level enrichment via PR welcome  see CONTRIBUTING.md.";
CM_ SG_ 2566042112 High_Voltage_Energy_Storage_Pack "Generic 8-byte raw payload. Detail page: https://www.isobus.net/isobus/pGNAndSPN/6311?type=PGN. Signal-level enrichment via PR welcome  see CONTRIBUTING.md.";
CM_ SG_ 2566042368 High_Voltage_Energy_Storage_Pack "Generic 8-byte raw payload. Detail page: https://www.isobus.net/isobus/pGNAndSPN/6314?type=PGN. Signal-level enrichment via PR welcome  see CONTRIBUTING.md.";
CM_ SG_ 2566042624 High_Voltage_Energy_Storage_Pack "Generic 8-byte raw payload. Detail page: https://www.isobus.net/isobus/pGNAndSPN/6346?type=PGN. Signal-level enrichment via PR welcome  see CONTRIBUTING.md.";
CM_ SG_ 2566042880 High_Voltage_Energy_Storage_Pack "Generic 8-byte raw payload. Detail page: https://www.isobus.net/isobus/pGNAndSPN/6354?type=PGN. Signal-level enrichment via PR welcome  see CONTRIBUTING.md.";
CM_ SG_ 2566043136 High_Voltage_Energy_Storage_Pack "Generic 8-byte raw payload. Detail page: https://www.isobus.net/isobus/pGNAndSPN/6359?type=PGN. Signal-level enrichment via PR welcome  see CONTRIBUTING.md.";
CM_ SG_ 2566043392 High_Voltage_Energy_Storage_Pack "Generic 8-byte raw payload. Detail page: https://www.isobus.net/isobus/pGNAndSPN/6367?type=PGN. Signal-level enrichment via PR welcome  see CONTRIBUTING.md.";
CM_ SG_ 2566043648 High_Voltage_Energy_Storage_Pack "Generic 8-byte raw payload. Detail page: https://www.isobus.net/isobus/pGNAndSPN/6373?type=PGN. Signal-level enrichment via PR welcome  see CONTRIBUTING.md.";
CM_ SG_ 2566043904 High_Voltage_Energy_Storage_Pack "Generic 8-byte raw payload. Detail page: https://www.isobus.net/isobus/pGNAndSPN/6376?type=PGN. Signal-level enrichment via PR welcome  see CONTRIBUTING.md.";
CM_ SG_ 2566044160 High_Voltage_Energy_Storage_Pack "Generic 8-byte raw payload. Detail page: https://www.isobus.net/isobus/pGNAndSPN/6388?type=PGN. Signal-level enrichment via PR welcome  see CONTRIBUTING.md.";
CM_ SG_ 2566044416 High_Voltage_Energy_Storage_Pack "Generic 8-byte raw payload. Detail page: https://www.isobus.net/isobus/pGNAndSPN/6392?type=PGN. Signal-level enrichment via PR welcome  see CONTRIBUTING.md.";
CM_ SG_ 2566044672 High_Voltage_Energy_Storage_Pack "Generic 8-byte raw payload. Detail page: https://www.isobus.net/isobus/pGNAndSPN/6396?type=PGN. Signal-level enrichment via PR welcome  see CONTRIBUTING.md.";
CM_ SG_ 2566044928 High_Voltage_Energy_Storage_Pack "Generic 8-byte raw payload. Detail page: https://www.isobus.net/isobus/pGNAndSPN/6400?type=PGN. Signal-level enrichment via PR welcome  see CONTRIBUTING.md.";
CM_ SG_ 2566045184 High_Voltage_Energy_Storage_Pack "Generic 8-byte raw payload. Detail page: https://www.isobus.net/isobus/pGNAndSPN/6403?type=PGN. Signal-level enrichment via PR welcome  see CONTRIBUTING.md.";
CM_ SG_ 2566045440 High_Voltage_Energy_Storage_Pack "Generic 8-byte raw payload. Detail page: https://www.isobus.net/isobus/pGNAndSPN/6407?type=PGN. Signal-level enrichment via PR welcome  see CONTRIBUTING.md.";
CM_ SG_ 2566045696 High_Voltage_Energy_Storage_Pack "Generic 8-byte raw payload. Detail page: https://www.isobus.net/isobus/pGNAndSPN/6413?type=PGN. Signal-level enrichment via PR welcome  see CONTRIBUTING.md.";
CM_ SG_ 2566045952 High_Voltage_Energy_Storage_Pack "Generic 8-byte raw payload. Detail page: https://www.isobus.net/isobus/pGNAndSPN/6430?type=PGN. Signal-level enrichment via PR welcome  see CONTRIBUTING.md.";
CM_ SG_ 2566046208 High_Voltage_Energy_Storage_Pack "Generic 8-byte raw payload. Detail page: https://www.isobus.net/isobus/pGNAndSPN/6433?type=PGN. Signal-level enrichment via PR welcome  see CONTRIBUTING.md.";
CM_ SG_ 2566046464 High_Voltage_Energy_Storage_Pack "Generic 8-byte raw payload. Detail page: https://www.isobus.net/isobus/pGNAndSPN/6465?type=PGN. Signal-level enrichment via PR welcome  see CONTRIBUTING.md.";
CM_ SG_ 2566046720 High_Voltage_Energy_Storage_Pack "Generic 8-byte raw payload. Detail page: https://www.isobus.net/isobus/pGNAndSPN/6473?type=PGN. Signal-level enrichment via PR welcome  see CONTRIBUTING.md.";
CM_ SG_ 2566046976 High_Voltage_Energy_Storage_Pack "Generic 8-byte raw payload. Detail page: https://www.isobus.net/isobus/pGNAndSPN/6478?type=PGN. Signal-level enrichment via PR welcome  see CONTRIBUTING.md.";
CM_ SG_ 2566047232 High_Voltage_Energy_Storage_Pack "Generic 8-byte raw payload. Detail page: https://www.isobus.net/isobus/pGNAndSPN/6486?type=PGN. Signal-level enrichment via PR welcome  see CONTRIBUTING.md.";
CM_ SG_ 2566047488 High_Voltage_Energy_Storage_Pack "Generic 8-byte raw payload. Detail page: https://www.isobus.net/isobus/pGNAndSPN/6492?type=PGN. Signal-level enrichment via PR welcome  see CONTRIBUTING.md.";
CM_ SG_ 2566047744 High_Voltage_Energy_Storage_Pack "Generic 8-byte raw payload. Detail page: https://www.isobus.net/isobus/pGNAndSPN/6495?type=PGN. Signal-level enrichment via PR welcome  see CONTRIBUTING.md.";
CM_ SG_ 2566048000 High_Voltage_Energy_Storage_Pack "Generic 8-byte raw payload. Detail page: https://www.isobus.net/isobus/pGNAndSPN/6507?type=PGN. Signal-level enrichment via PR welcome  see CONTRIBUTING.md.";
CM_ SG_ 2566048256 High_Voltage_Energy_Storage_Pack "Generic 8-byte raw payload. Detail page: https://www.isobus.net/isobus/pGNAndSPN/6511?type=PGN. Signal-level enrichment via PR welcome  see CONTRIBUTING.md.";
CM_ SG_ 2566048512 High_Voltage_Energy_Storage_Pack "Generic 8-byte raw payload. Detail page: https://www.isobus.net/isobus/pGNAndSPN/6515?type=PGN. Signal-level enrichment via PR welcome  see CONTRIBUTING.md.";
CM_ SG_ 2566048768 High_Voltage_Energy_Storage_Pack "Generic 8-byte raw payload. Detail page: https://www.isobus.net/isobus/pGNAndSPN/6519?type=PGN. Signal-level enrichment via PR welcome  see CONTRIBUTING.md.";
CM_ SG_ 2566049024 High_Voltage_Energy_Storage_Pack "Generic 8-byte raw payload. Detail page: https://www.isobus.net/isobus/pGNAndSPN/6522?type=PGN. Signal-level enrichment via PR welcome  see CONTRIBUTING.md.";
CM_ SG_ 2566049280 High_Voltage_Energy_Storage_Pack "Generic 8-byte raw payload. Detail page: https://www.isobus.net/isobus/pGNAndSPN/6526?type=PGN. Signal-level enrichment via PR welcome  see CONTRIBUTING.md.";
CM_ SG_ 2566049536 High_Voltage_Energy_Storage_Pack "Generic 8-byte raw payload. Detail page: https://www.isobus.net/isobus/pGNAndSPN/6532?type=PGN. Signal-level enrichment via PR welcome  see CONTRIBUTING.md.";
CM_ SG_ 2566049792 High_Voltage_Energy_Storage_Pack "Generic 8-byte raw payload. Detail page: https://www.isobus.net/isobus/pGNAndSPN/6549?type=PGN. Signal-level enrichment via PR welcome  see CONTRIBUTING.md.";
CM_ SG_ 2566050048 High_Voltage_Energy_Storage_Pack "Generic 8-byte raw payload. Detail page: https://www.isobus.net/isobus/pGNAndSPN/6552?type=PGN. Signal-level enrichment via PR welcome  see CONTRIBUTING.md.";
CM_ SG_ 2566050304 High_Voltage_Energy_Storage_Pack "Generic 8-byte raw payload. Detail page: https://www.isobus.net/isobus/pGNAndSPN/6584?type=PGN. Signal-level enrichment via PR welcome  see CONTRIBUTING.md.";
CM_ SG_ 2566050560 High_Voltage_Energy_Storage_Pack "Generic 8-byte raw payload. Detail page: https://www.isobus.net/isobus/pGNAndSPN/6592?type=PGN. Signal-level enrichment via PR welcome  see CONTRIBUTING.md.";
CM_ SG_ 2566050816 High_Voltage_Energy_Storage_Pack "Generic 8-byte raw payload. Detail page: https://www.isobus.net/isobus/pGNAndSPN/6597?type=PGN. Signal-level enrichment via PR welcome  see CONTRIBUTING.md.";
CM_ SG_ 2566051072 High_Voltage_Energy_Storage_Pack "Generic 8-byte raw payload. Detail page: https://www.isobus.net/isobus/pGNAndSPN/6605?type=PGN. Signal-level enrichment via PR welcome  see CONTRIBUTING.md.";
CM_ SG_ 2566051328 High_Voltage_Energy_Storage_Pack "Generic 8-byte raw payload. Detail page: https://www.isobus.net/isobus/pGNAndSPN/6611?type=PGN. Signal-level enrichment via PR welcome  see CONTRIBUTING.md.";
CM_ SG_ 2566051584 High_Voltage_Energy_Storage_Pack "Generic 8-byte raw payload. Detail page: https://www.isobus.net/isobus/pGNAndSPN/6614?type=PGN. Signal-level enrichment via PR welcome  see CONTRIBUTING.md.";
CM_ SG_ 2566051840 High_Voltage_Energy_Storage_Pack "Generic 8-byte raw payload. Detail page: https://www.isobus.net/isobus/pGNAndSPN/6626?type=PGN. Signal-level enrichment via PR welcome  see CONTRIBUTING.md.";
CM_ SG_ 2566052096 High_Voltage_Energy_Storage_Pack "Generic 8-byte raw payload. Detail page: https://www.isobus.net/isobus/pGNAndSPN/6630?type=PGN. Signal-level enrichment via PR welcome  see CONTRIBUTING.md.";
CM_ SG_ 2566052352 High_Voltage_Energy_Storage_Pack "Generic 8-byte raw payload. Detail page: https://www.isobus.net/isobus/pGNAndSPN/6634?type=PGN. Signal-level enrichment via PR welcome  see CONTRIBUTING.md.";
CM_ SG_ 2566052608 High_Voltage_Energy_Storage_Pack "Generic 8-byte raw payload. Detail page: https://www.isobus.net/isobus/pGNAndSPN/6638?type=PGN. Signal-level enrichment via PR welcome  see CONTRIBUTING.md.";
CM_ SG_ 2566052864 High_Voltage_Energy_Storage_Pack "Generic 8-byte raw payload. Detail page: https://www.isobus.net/isobus/pGNAndSPN/6641?type=PGN. Signal-level enrichment via PR welcome  see CONTRIBUTING.md.";
CM_ SG_ 2566053120 High_Voltage_Energy_Storage_Pack "Generic 8-byte raw payload. Detail page: https://www.isobus.net/isobus/pGNAndSPN/6645?type=PGN. Signal-level enrichment via PR welcome  see CONTRIBUTING.md.";
CM_ SG_ 2566053376 High_Voltage_Energy_Storage_Pack "Generic 8-byte raw payload. Detail page: https://www.isobus.net/isobus/pGNAndSPN/6651?type=PGN. Signal-level enrichment via PR welcome  see CONTRIBUTING.md.";
CM_ SG_ 2566053632 High_Voltage_Energy_Storage_Pack "Generic 8-byte raw payload. Detail page: https://www.isobus.net/isobus/pGNAndSPN/6668?type=PGN. Signal-level enrichment via PR welcome  see CONTRIBUTING.md.";
CM_ SG_ 2566053888 High_Voltage_Energy_Storage_Pack "Generic 8-byte raw payload. Detail page: https://www.isobus.net/isobus/pGNAndSPN/6671?type=PGN. Signal-level enrichment via PR welcome  see CONTRIBUTING.md.";
CM_ SG_ 2566054144 High_Voltage_Energy_Storage_Pack "Generic 8-byte raw payload. Detail page: https://www.isobus.net/isobus/pGNAndSPN/6703?type=PGN. Signal-level enrichment via PR welcome  see CONTRIBUTING.md.";
CM_ SG_ 2566054400 High_Voltage_Energy_Storage_Pack "Generic 8-byte raw payload. Detail page: https://www.isobus.net/isobus/pGNAndSPN/6711?type=PGN. Signal-level enrichment via PR welcome  see CONTRIBUTING.md.";
CM_ SG_ 2566054656 High_Voltage_Energy_Storage_Pack "Generic 8-byte raw payload. Detail page: https://www.isobus.net/isobus/pGNAndSPN/6716?type=PGN. Signal-level enrichment via PR welcome  see CONTRIBUTING.md.";
CM_ SG_ 2566054912 High_Voltage_Energy_Storage_Pack "Generic 8-byte raw payload. Detail page: https://www.isobus.net/isobus/pGNAndSPN/6724?type=PGN. Signal-level enrichment via PR welcome  see CONTRIBUTING.md.";
CM_ SG_ 2566055168 High_Voltage_Energy_Storage_Pack "Generic 8-byte raw payload. Detail page: https://www.isobus.net/isobus/pGNAndSPN/6730?type=PGN. Signal-level enrichment via PR welcome  see CONTRIBUTING.md.";
CM_ SG_ 2566055424 High_Voltage_Energy_Storage_Pack "Generic 8-byte raw payload. Detail page: https://www.isobus.net/isobus/pGNAndSPN/6733?type=PGN. Signal-level enrichment via PR welcome  see CONTRIBUTING.md.";
CM_ SG_ 2566055680 High_Voltage_Energy_Storage_Pack "Generic 8-byte raw payload. Detail page: https://www.isobus.net/isobus/pGNAndSPN/6745?type=PGN. Signal-level enrichment via PR welcome  see CONTRIBUTING.md.";
CM_ SG_ 2566055936 High_Voltage_Energy_Storage_Pack "Generic 8-byte raw payload. Detail page: https://www.isobus.net/isobus/pGNAndSPN/6749?type=PGN. Signal-level enrichment via PR welcome  see CONTRIBUTING.md.";
CM_ SG_ 2566056192 High_Voltage_Energy_Storage_Pack "Generic 8-byte raw payload. Detail page: https://www.isobus.net/isobus/pGNAndSPN/6753?type=PGN. Signal-level enrichment via PR welcome  see CONTRIBUTING.md.";
CM_ SG_ 2566056448 High_Voltage_Energy_Storage_Pack "Generic 8-byte raw payload. Detail page: https://www.isobus.net/isobus/pGNAndSPN/6757?type=PGN. Signal-level enrichment via PR welcome  see CONTRIBUTING.md.";
CM_ SG_ 2566056704 High_Voltage_Energy_Storage_Pack "Generic 8-byte raw payload. Detail page: https://www.isobus.net/isobus/pGNAndSPN/6760?type=PGN. Signal-level enrichment via PR welcome  see CONTRIBUTING.md.";
CM_ SG_ 2566056960 High_Voltage_Energy_Storage_Pack "Generic 8-byte raw payload. Detail page: https://www.isobus.net/isobus/pGNAndSPN/6764?type=PGN. Signal-level enrichment via PR welcome  see CONTRIBUTING.md.";
CM_ SG_ 2566057216 High_Voltage_Energy_Storage_Pack "Generic 8-byte raw payload. Detail page: https://www.isobus.net/isobus/pGNAndSPN/6770?type=PGN. Signal-level enrichment via PR welcome  see CONTRIBUTING.md.";
CM_ SG_ 2566057472 High_Voltage_Energy_Storage_Pack "Generic 8-byte raw payload. Detail page: https://www.isobus.net/isobus/pGNAndSPN/6787?type=PGN. Signal-level enrichment via PR welcome  see CONTRIBUTING.md.";
CM_ SG_ 2566057728 High_Voltage_Energy_Storage_Pack "Generic 8-byte raw payload. Detail page: https://www.isobus.net/isobus/pGNAndSPN/6790?type=PGN. Signal-level enrichment via PR welcome  see CONTRIBUTING.md.";
CM_ SG_ 2566057984 High_Voltage_Energy_Storage_Pack "Generic 8-byte raw payload. Detail page: https://www.isobus.net/isobus/pGNAndSPN/6822?type=PGN. Signal-level enrichment via PR welcome  see CONTRIBUTING.md.";
CM_ SG_ 2566058240 High_Voltage_Energy_Storage_Pack "Generic 8-byte raw payload. Detail page: https://www.isobus.net/isobus/pGNAndSPN/6830?type=PGN. Signal-level enrichment via PR welcome  see CONTRIBUTING.md.";
CM_ SG_ 2566058496 High_Voltage_Energy_Storage_Pack "Generic 8-byte raw payload. Detail page: https://www.isobus.net/isobus/pGNAndSPN/6835?type=PGN. Signal-level enrichment via PR welcome  see CONTRIBUTING.md.";
CM_ SG_ 2566058752 High_Voltage_Energy_Storage_Pack "Generic 8-byte raw payload. Detail page: https://www.isobus.net/isobus/pGNAndSPN/6843?type=PGN. Signal-level enrichment via PR welcome  see CONTRIBUTING.md.";
CM_ SG_ 2566059008 High_Voltage_Energy_Storage_Pack "Generic 8-byte raw payload. Detail page: https://www.isobus.net/isobus/pGNAndSPN/6849?type=PGN. Signal-level enrichment via PR welcome  see CONTRIBUTING.md.";
CM_ SG_ 2566059264 High_Voltage_Energy_Storage_Pack "Generic 8-byte raw payload. Detail page: https://www.isobus.net/isobus/pGNAndSPN/6852?type=PGN. Signal-level enrichment via PR welcome  see CONTRIBUTING.md.";
CM_ SG_ 2566059520 High_Voltage_Energy_Storage_Pack "Generic 8-byte raw payload. Detail page: https://www.isobus.net/isobus/pGNAndSPN/6864?type=PGN. Signal-level enrichment via PR welcome  see CONTRIBUTING.md.";
CM_ SG_ 2566059776 High_Voltage_Energy_Storage_Pack "Generic 8-byte raw payload. Detail page: https://www.isobus.net/isobus/pGNAndSPN/6868?type=PGN. Signal-level enrichment via PR welcome  see CONTRIBUTING.md.";
CM_ SG_ 2566060032 High_Voltage_Energy_Storage_Pack "Generic 8-byte raw payload. Detail page: https://www.isobus.net/isobus/pGNAndSPN/6872?type=PGN. Signal-level enrichment via PR welcome  see CONTRIBUTING.md.";
CM_ SG_ 2566060288 High_Voltage_Energy_Storage_Pack "Generic 8-byte raw payload. Detail page: https://www.isobus.net/isobus/pGNAndSPN/6876?type=PGN. Signal-level enrichment via PR welcome  see CONTRIBUTING.md.";
CM_ SG_ 2566060544 High_Voltage_Energy_Storage_Pack "Generic 8-byte raw payload. Detail page: https://www.isobus.net/isobus/pGNAndSPN/6879?type=PGN. Signal-level enrichment via PR welcome  see CONTRIBUTING.md.";
CM_ SG_ 2566060800 High_Voltage_Energy_Storage_Pack "Generic 8-byte raw payload. Detail page: https://www.isobus.net/isobus/pGNAndSPN/6883?type=PGN. Signal-level enrichment via PR welcome  see CONTRIBUTING.md.";
CM_ SG_ 2566061056 High_Voltage_Energy_Storage_Pack "Generic 8-byte raw payload. Detail page: https://www.isobus.net/isobus/pGNAndSPN/6889?type=PGN. Signal-level enrichment via PR welcome  see CONTRIBUTING.md.";
CM_ SG_ 2566061312 High_Voltage_Energy_Storage_Pack "Generic 8-byte raw payload. Detail page: https://www.isobus.net/isobus/pGNAndSPN/6906?type=PGN. Signal-level enrichment via PR welcome  see CONTRIBUTING.md.";
CM_ SG_ 2566061568 High_Voltage_Energy_Storage_Pack "Generic 8-byte raw payload. Detail page: https://www.isobus.net/isobus/pGNAndSPN/6909?type=PGN. Signal-level enrichment via PR welcome  see CONTRIBUTING.md.";
CM_ SG_ 2566061824 High_Voltage_Energy_Storage_Pack "Generic 8-byte raw payload. Detail page: https://www.isobus.net/isobus/pGNAndSPN/6941?type=PGN. Signal-level enrichment via PR welcome  see CONTRIBUTING.md.";
CM_ SG_ 2566062080 High_Voltage_Energy_Storage_Pack "Generic 8-byte raw payload. Detail page: https://www.isobus.net/isobus/pGNAndSPN/6949?type=PGN. Signal-level enrichment via PR welcome  see CONTRIBUTING.md.";
CM_ SG_ 2566062336 High_Voltage_Energy_Storage_Pack "Generic 8-byte raw payload. Detail page: https://www.isobus.net/isobus/pGNAndSPN/6954?type=PGN. Signal-level enrichment via PR welcome  see CONTRIBUTING.md.";
CM_ SG_ 2566062592 High_Voltage_Energy_Storage_Pack "Generic 8-byte raw payload. Detail page: https://www.isobus.net/isobus/pGNAndSPN/6962?type=PGN. Signal-level enrichment via PR welcome  see CONTRIBUTING.md.";
CM_ SG_ 2566062848 High_Voltage_Energy_Storage_Pack "Generic 8-byte raw payload. Detail page: https://www.isobus.net/isobus/pGNAndSPN/6968?type=PGN. Signal-level enrichment via PR welcome  see CONTRIBUTING.md.";
CM_ SG_ 2566063104 High_Voltage_Energy_Storage_Pack "Generic 8-byte raw payload. Detail page: https://www.isobus.net/isobus/pGNAndSPN/6971?type=PGN. Signal-level enrichment via PR welcome  see CONTRIBUTING.md.";
CM_ SG_ 2566063360 High_Voltage_Energy_Storage_Pack "Generic 8-byte raw payload. Detail page: https://www.isobus.net/isobus/pGNAndSPN/6983?type=PGN. Signal-level enrichment via PR welcome  see CONTRIBUTING.md.";
CM_ SG_ 2566063616 High_Voltage_Energy_Storage_Pack "Generic 8-byte raw payload. Detail page: https://www.isobus.net/isobus/pGNAndSPN/6987?type=PGN. Signal-level enrichment via PR welcome  see CONTRIBUTING.md.";
CM_ SG_ 2566063872 High_Voltage_Energy_Storage_Pack "Generic 8-byte raw payload. Detail page: https://www.isobus.net/isobus/pGNAndSPN/6991?type=PGN. Signal-level enrichment via PR welcome  see CONTRIBUTING.md.";
CM_ SG_ 2566064128 High_Voltage_Energy_Storage_Pack "Generic 8-byte raw payload. Detail page: https://www.isobus.net/isobus/pGNAndSPN/6995?type=PGN. Signal-level enrichment via PR welcome  see CONTRIBUTING.md.";
CM_ SG_ 2566064384 High_Voltage_Energy_Storage_Pack "Generic 8-byte raw payload. Detail page: https://www.isobus.net/isobus/pGNAndSPN/6998?type=PGN. Signal-level enrichment via PR welcome  see CONTRIBUTING.md.";
CM_ SG_ 2566064640 High_Voltage_Energy_Storage_Pack "Generic 8-byte raw payload. Detail page: https://www.isobus.net/isobus/pGNAndSPN/7002?type=PGN. Signal-level enrichment via PR welcome  see CONTRIBUTING.md.";
CM_ SG_ 2566064896 High_Voltage_Energy_Storage_Pack "Generic 8-byte raw payload. Detail page: https://www.isobus.net/isobus/pGNAndSPN/7008?type=PGN. Signal-level enrichment via PR welcome  see CONTRIBUTING.md.";
CM_ SG_ 2566065152 High_Voltage_Energy_Storage_Pack "Generic 8-byte raw payload. Detail page: https://www.isobus.net/isobus/pGNAndSPN/7025?type=PGN. Signal-level enrichment via PR welcome  see CONTRIBUTING.md.";
CM_ SG_ 2566065408 High_Voltage_Energy_Storage_Pack "Generic 8-byte raw payload. Detail page: https://www.isobus.net/isobus/pGNAndSPN/7028?type=PGN. Signal-level enrichment via PR welcome  see CONTRIBUTING.md.";
CM_ SG_ 2566065664 High_Voltage_Energy_Storage_Pack "Generic 8-byte raw payload. Detail page: https://www.isobus.net/isobus/pGNAndSPN/7060?type=PGN. Signal-level enrichment via PR welcome  see CONTRIBUTING.md.";
CM_ SG_ 2566065920 High_Voltage_Energy_Storage_Pack "Generic 8-byte raw payload. Detail page: https://www.isobus.net/isobus/pGNAndSPN/7068?type=PGN. Signal-level enrichment via PR welcome  see CONTRIBUTING.md.";
CM_ SG_ 2566066176 High_Voltage_Energy_Storage_Pack "Generic 8-byte raw payload. Detail page: https://www.isobus.net/isobus/pGNAndSPN/7073?type=PGN. Signal-level enrichment via PR welcome  see CONTRIBUTING.md.";
CM_ SG_ 2566066432 High_Voltage_Energy_Storage_Pack "Generic 8-byte raw payload. Detail page: https://www.isobus.net/isobus/pGNAndSPN/7081?type=PGN. Signal-level enrichment via PR welcome  see CONTRIBUTING.md.";
CM_ SG_ 2566066688 High_Voltage_Energy_Storage_Pack "Generic 8-byte raw payload. Detail page: https://www.isobus.net/isobus/pGNAndSPN/7087?type=PGN. Signal-level enrichment via PR welcome  see CONTRIBUTING.md.";
CM_ SG_ 2566066944 High_Voltage_Energy_Storage_Pack "Generic 8-byte raw payload. Detail page: https://www.isobus.net/isobus/pGNAndSPN/7090?type=PGN. Signal-level enrichment via PR welcome  see CONTRIBUTING.md.";
CM_ SG_ 2566067200 High_Voltage_Energy_Storage_Pack "Generic 8-byte raw payload. Detail page: https://www.isobus.net/isobus/pGNAndSPN/7102?type=PGN. Signal-level enrichment via PR welcome  see CONTRIBUTING.md.";
CM_ SG_ 2566067456 High_Voltage_Energy_Storage_Pack "Generic 8-byte raw payload. Detail page: https://www.isobus.net/isobus/pGNAndSPN/7106?type=PGN. Signal-level enrichment via PR welcome  see CONTRIBUTING.md.";
CM_ SG_ 2566067712 High_Voltage_Energy_Storage_Pack "Generic 8-byte raw payload. Detail page: https://www.isobus.net/isobus/pGNAndSPN/7110?type=PGN. Signal-level enrichment via PR welcome  see CONTRIBUTING.md.";
CM_ SG_ 2566067968 High_Voltage_Energy_Storage_Pack "Generic 8-byte raw payload. Detail page: https://www.isobus.net/isobus/pGNAndSPN/7114?type=PGN. Signal-level enrichment via PR welcome  see CONTRIBUTING.md.";
CM_ SG_ 2566068224 High_Voltage_Energy_Storage_Pack "Generic 8-byte raw payload. Detail page: https://www.isobus.net/isobus/pGNAndSPN/7117?type=PGN. Signal-level enrichment via PR welcome  see CONTRIBUTING.md.";
CM_ SG_ 2566068480 High_Voltage_Energy_Storage_Pack "Generic 8-byte raw payload. Detail page: https://www.isobus.net/isobus/pGNAndSPN/7121?type=PGN. Signal-level enrichment via PR welcome  see CONTRIBUTING.md.";
CM_ SG_ 2566068736 High_Voltage_Energy_Storage_Pack "Generic 8-byte raw payload. Detail page: https://www.isobus.net/isobus/pGNAndSPN/7127?type=PGN. Signal-level enrichment via PR welcome  see CONTRIBUTING.md.";
CM_ SG_ 2566068992 High_Voltage_Energy_Storage_Pack "Generic 8-byte raw payload. Detail page: https://www.isobus.net/isobus/pGNAndSPN/7144?type=PGN. Signal-level enrichment via PR welcome  see CONTRIBUTING.md.";
CM_ SG_ 2566069248 High_Voltage_Energy_Storage_Pack "Generic 8-byte raw payload. Detail page: https://www.isobus.net/isobus/pGNAndSPN/7147?type=PGN. Signal-level enrichment via PR welcome  see CONTRIBUTING.md.";
CM_ SG_ 2566069504 High_Voltage_Energy_Storage_Pack "Generic 8-byte raw payload. Detail page: https://www.isobus.net/isobus/pGNAndSPN/7179?type=PGN. Signal-level enrichment via PR welcome  see CONTRIBUTING.md.";
CM_ SG_ 2566069760 High_Voltage_Energy_Storage_Pack "Generic 8-byte raw payload. Detail page: https://www.isobus.net/isobus/pGNAndSPN/7187?type=PGN. Signal-level enrichment via PR welcome  see CONTRIBUTING.md.";
CM_ SG_ 2566070016 High_Voltage_Energy_Storage_Pack "Generic 8-byte raw payload. Detail page: https://www.isobus.net/isobus/pGNAndSPN/7192?type=PGN. Signal-level enrichment via PR welcome  see CONTRIBUTING.md.";
CM_ SG_ 2566070272 High_Voltage_Energy_Storage_Pack "Generic 8-byte raw payload. Detail page: https://www.isobus.net/isobus/pGNAndSPN/7200?type=PGN. Signal-level enrichment via PR welcome  see CONTRIBUTING.md.";
CM_ SG_ 2566070528 High_Voltage_Energy_Storage_Pack "Generic 8-byte raw payload. Detail page: https://www.isobus.net/isobus/pGNAndSPN/7206?type=PGN. Signal-level enrichment via PR welcome  see CONTRIBUTING.md.";
CM_ SG_ 2566070784 High_Voltage_Energy_Storage_Pack "Generic 8-byte raw payload. Detail page: https://www.isobus.net/isobus/pGNAndSPN/7209?type=PGN. Signal-level enrichment via PR welcome  see CONTRIBUTING.md.";
CM_ SG_ 2566071040 High_Voltage_Energy_Storage_Pack "Generic 8-byte raw payload. Detail page: https://www.isobus.net/isobus/pGNAndSPN/7221?type=PGN. Signal-level enrichment via PR welcome  see CONTRIBUTING.md.";
CM_ SG_ 2566071296 High_Voltage_Energy_Storage_Pack "Generic 8-byte raw payload. Detail page: https://www.isobus.net/isobus/pGNAndSPN/7225?type=PGN. Signal-level enrichment via PR welcome  see CONTRIBUTING.md.";
CM_ SG_ 2566071552 High_Voltage_Energy_Storage_Pack "Generic 8-byte raw payload. Detail page: https://www.isobus.net/isobus/pGNAndSPN/7229?type=PGN. Signal-level enrichment via PR welcome  see CONTRIBUTING.md.";
CM_ SG_ 2566071808 High_Voltage_Energy_Storage_Pack "Generic 8-byte raw payload. Detail page: https://www.isobus.net/isobus/pGNAndSPN/7233?type=PGN. Signal-level enrichment via PR welcome  see CONTRIBUTING.md.";
CM_ SG_ 2566072064 High_Voltage_Energy_Storage_Pack "Generic 8-byte raw payload. Detail page: https://www.isobus.net/isobus/pGNAndSPN/7236?type=PGN. Signal-level enrichment via PR welcome  see CONTRIBUTING.md.";
CM_ SG_ 2566072320 High_Voltage_Energy_Storage_Pack "Generic 8-byte raw payload. Detail page: https://www.isobus.net/isobus/pGNAndSPN/7240?type=PGN. Signal-level enrichment via PR welcome  see CONTRIBUTING.md.";
CM_ SG_ 2566072576 High_Voltage_Energy_Storage_Pack "Generic 8-byte raw payload. Detail page: https://www.isobus.net/isobus/pGNAndSPN/7246?type=PGN. Signal-level enrichment via PR welcome  see CONTRIBUTING.md.";
CM_ SG_ 2566072832 High_Voltage_Energy_Storage_Pack "Generic 8-byte raw payload. Detail page: https://www.isobus.net/isobus/pGNAndSPN/7263?type=PGN. Signal-level enrichment via PR welcome  see CONTRIBUTING.md.";
CM_ SG_ 2566073088 High_Voltage_Energy_Storage_Pack "Generic 8-byte raw payload. Detail page: https://www.isobus.net/isobus/pGNAndSPN/7266?type=PGN. Signal-level enrichment via PR welcome  see CONTRIBUTING.md.";
CM_ SG_ 2566073344 High_Voltage_Energy_Storage_Pack "Generic 8-byte raw payload. Detail page: https://www.isobus.net/isobus/pGNAndSPN/7298?type=PGN. Signal-level enrichment via PR welcome  see CONTRIBUTING.md.";
CM_ SG_ 2566073600 High_Voltage_Energy_Storage_Pack "Generic 8-byte raw payload. Detail page: https://www.isobus.net/isobus/pGNAndSPN/7306?type=PGN. Signal-level enrichment via PR welcome  see CONTRIBUTING.md.";
CM_ SG_ 2566073856 High_Voltage_Energy_Storage_Pack "Generic 8-byte raw payload. Detail page: https://www.isobus.net/isobus/pGNAndSPN/7311?type=PGN. Signal-level enrichment via PR welcome  see CONTRIBUTING.md.";
CM_ SG_ 2566074112 High_Voltage_Energy_Storage_Pack "Generic 8-byte raw payload. Detail page: https://www.isobus.net/isobus/pGNAndSPN/7319?type=PGN. Signal-level enrichment via PR welcome  see CONTRIBUTING.md.";
CM_ SG_ 2566074368 High_Voltage_Energy_Storage_Pack "Generic 8-byte raw payload. Detail page: https://www.isobus.net/isobus/pGNAndSPN/7325?type=PGN. Signal-level enrichment via PR welcome  see CONTRIBUTING.md.";
CM_ SG_ 2566074624 High_Voltage_Energy_Storage_Pack "Generic 8-byte raw payload. Detail page: https://www.isobus.net/isobus/pGNAndSPN/7328?type=PGN. Signal-level enrichment via PR welcome  see CONTRIBUTING.md.";
CM_ SG_ 2566074880 High_Voltage_Energy_Storage_Pack "Generic 8-byte raw payload. Detail page: https://www.isobus.net/isobus/pGNAndSPN/7340?type=PGN. Signal-level enrichment via PR welcome  see CONTRIBUTING.md.";
CM_ SG_ 2566075136 High_Voltage_Energy_Storage_Pack "Generic 8-byte raw payload. Detail page: https://www.isobus.net/isobus/pGNAndSPN/7344?type=PGN. Signal-level enrichment via PR welcome  see CONTRIBUTING.md.";
CM_ SG_ 2566075392 High_Voltage_Energy_Storage_Pack "Generic 8-byte raw payload. Detail page: https://www.isobus.net/isobus/pGNAndSPN/7348?type=PGN. Signal-level enrichment via PR welcome  see CONTRIBUTING.md.";
CM_ SG_ 2566075648 High_Voltage_Energy_Storage_Pack "Generic 8-byte raw payload. Detail page: https://www.isobus.net/isobus/pGNAndSPN/7352?type=PGN. Signal-level enrichment via PR welcome  see CONTRIBUTING.md.";
CM_ SG_ 2566075904 High_Voltage_Energy_Storage_Pack "Generic 8-byte raw payload. Detail page: https://www.isobus.net/isobus/pGNAndSPN/7355?type=PGN. Signal-level enrichment via PR welcome  see CONTRIBUTING.md.";
CM_ SG_ 2566076160 High_Voltage_Energy_Storage_Pack "Generic 8-byte raw payload. Detail page: https://www.isobus.net/isobus/pGNAndSPN/7359?type=PGN. Signal-level enrichment via PR welcome  see CONTRIBUTING.md.";
CM_ SG_ 2566076416 High_Voltage_Energy_Storage_Pack "Generic 8-byte raw payload. Detail page: https://www.isobus.net/isobus/pGNAndSPN/7365?type=PGN. Signal-level enrichment via PR welcome  see CONTRIBUTING.md.";
CM_ SG_ 2566076672 High_Voltage_Energy_Storage_Pack "Generic 8-byte raw payload. Detail page: https://www.isobus.net/isobus/pGNAndSPN/7382?type=PGN. Signal-level enrichment via PR welcome  see CONTRIBUTING.md.";
CM_ SG_ 2566076928 High_Voltage_Energy_Storage_Pack "Generic 8-byte raw payload. Detail page: https://www.isobus.net/isobus/pGNAndSPN/7385?type=PGN. Signal-level enrichment via PR welcome  see CONTRIBUTING.md.";
CM_ SG_ 2566077184 High_Voltage_Energy_Storage_Pack "Generic 8-byte raw payload. Detail page: https://www.isobus.net/isobus/pGNAndSPN/7417?type=PGN. Signal-level enrichment via PR welcome  see CONTRIBUTING.md.";
CM_ SG_ 2566077440 High_Voltage_Energy_Storage_Pack "Generic 8-byte raw payload. Detail page: https://www.isobus.net/isobus/pGNAndSPN/7425?type=PGN. Signal-level enrichment via PR welcome  see CONTRIBUTING.md.";
CM_ SG_ 2566077696 High_Voltage_Energy_Storage_Pack "Generic 8-byte raw payload. Detail page: https://www.isobus.net/isobus/pGNAndSPN/7430?type=PGN. Signal-level enrichment via PR welcome  see CONTRIBUTING.md.";
CM_ SG_ 2566077952 High_Voltage_Energy_Storage_Pack "Generic 8-byte raw payload. Detail page: https://www.isobus.net/isobus/pGNAndSPN/7438?type=PGN. Signal-level enrichment via PR welcome  see CONTRIBUTING.md.";
CM_ SG_ 2566078208 High_Voltage_Energy_Storage_Pack "Generic 8-byte raw payload. Detail page: https://www.isobus.net/isobus/pGNAndSPN/7444?type=PGN. Signal-level enrichment via PR welcome  see CONTRIBUTING.md.";
CM_ SG_ 2566078464 High_Voltage_Energy_Storage_Pack "Generic 8-byte raw payload. Detail page: https://www.isobus.net/isobus/pGNAndSPN/7447?type=PGN. Signal-level enrichment via PR welcome  see CONTRIBUTING.md.";
CM_ SG_ 2566078720 External_Steering_Request_RawPay "Generic 8-byte raw payload. Detail page: https://www.isobus.net/isobus/pGNAndSPN/7453?type=PGN. Signal-level enrichment via PR welcome  see CONTRIBUTING.md.";
CM_ SG_ 2566078976 Active_Steering_System_Controlle "Generic 8-byte raw payload. Detail page: https://www.isobus.net/isobus/pGNAndSPN/7463?type=PGN. Signal-level enrichment via PR welcome  see CONTRIBUTING.md.";
CM_ SG_ 2566079232 Electronic_Park_Brake_Controller "Generic 8-byte raw payload. Detail page: https://www.isobus.net/isobus/pGNAndSPN/7479?type=PGN. Signal-level enrichment via PR welcome  see CONTRIBUTING.md.";
CM_ SG_ 2566079488 Electronic_Park_Brake_Controller "Generic 8-byte raw payload. Detail page: https://www.isobus.net/isobus/pGNAndSPN/7493?type=PGN. Signal-level enrichment via PR welcome  see CONTRIBUTING.md.";
CM_ SG_ 2566079744 Genset_Frequency_Limitation_RawP "Generic 8-byte raw payload. Detail page: https://www.isobus.net/isobus/pGNAndSPN/7502?type=PGN. Signal-level enrichment via PR welcome  see CONTRIBUTING.md.";
CM_ SG_ 2566080000 Genset_Power_Limitation_RawPaylo "Generic 8-byte raw payload. Detail page: https://www.isobus.net/isobus/pGNAndSPN/7512?type=PGN. Signal-level enrichment via PR welcome  see CONTRIBUTING.md.";
CM_ SG_ 2566080256 Genset_Real_Power_Control_RawPay "Generic 8-byte raw payload. Detail page: https://www.isobus.net/isobus/pGNAndSPN/7520?type=PGN. Signal-level enrichment via PR welcome  see CONTRIBUTING.md.";
CM_ SG_ 2566080512 Genset_Reactive_Power_RawPayload "Generic 8-byte raw payload. Detail page: https://www.isobus.net/isobus/pGNAndSPN/7532?type=PGN. Signal-level enrichment via PR welcome  see CONTRIBUTING.md.";
CM_ SG_ 2566080768 Fuel_Cell_Compartment_Informatio "Generic 8-byte raw payload. Detail page: https://www.isobus.net/isobus/pGNAndSPN/7535?type=PGN. Signal-level enrichment via PR welcome  see CONTRIBUTING.md.";
CM_ SG_ 2566081024 Genset_Real_Power_Setpoint_Deman "Generic 8-byte raw payload. Detail page: https://www.isobus.net/isobus/pGNAndSPN/7542?type=PGN. Signal-level enrichment via PR welcome  see CONTRIBUTING.md.";
CM_ SG_ 2566081280 Genset_Real_Power_Control_2_RawP "Generic 8-byte raw payload. Detail page: https://www.isobus.net/isobus/pGNAndSPN/7553?type=PGN. Signal-level enrichment via PR welcome  see CONTRIBUTING.md.";
CM_ SG_ 2566081536 High_Voltage_Energy_Storage_Pack "Generic 8-byte raw payload. Detail page: https://www.isobus.net/isobus/pGNAndSPN/7557?type=PGN. Signal-level enrichment via PR welcome  see CONTRIBUTING.md.";
CM_ SG_ 2566081792 High_Voltage_Energy_Storage_Pack "Generic 8-byte raw payload. Detail page: https://www.isobus.net/isobus/pGNAndSPN/7561?type=PGN. Signal-level enrichment via PR welcome  see CONTRIBUTING.md.";
CM_ SG_ 2566082048 High_Voltage_Energy_Storage_Pack "Generic 8-byte raw payload. Detail page: https://www.isobus.net/isobus/pGNAndSPN/7565?type=PGN. Signal-level enrichment via PR welcome  see CONTRIBUTING.md.";
CM_ SG_ 2566082304 High_Voltage_Energy_Storage_Pack "Generic 8-byte raw payload. Detail page: https://www.isobus.net/isobus/pGNAndSPN/7569?type=PGN. Signal-level enrichment via PR welcome  see CONTRIBUTING.md.";
CM_ SG_ 2566082560 High_Voltage_Energy_Storage_Pack "Generic 8-byte raw payload. Detail page: https://www.isobus.net/isobus/pGNAndSPN/7573?type=PGN. Signal-level enrichment via PR welcome  see CONTRIBUTING.md.";
CM_ SG_ 2566082816 High_Voltage_Energy_Storage_Pack "Generic 8-byte raw payload. Detail page: https://www.isobus.net/isobus/pGNAndSPN/7577?type=PGN. Signal-level enrichment via PR welcome  see CONTRIBUTING.md.";
CM_ SG_ 2566083072 High_Voltage_Energy_Storage_Pack "Generic 8-byte raw payload. Detail page: https://www.isobus.net/isobus/pGNAndSPN/7581?type=PGN. Signal-level enrichment via PR welcome  see CONTRIBUTING.md.";
CM_ SG_ 2566083328 High_Voltage_Energy_Storage_Pack "Generic 8-byte raw payload. Detail page: https://www.isobus.net/isobus/pGNAndSPN/7585?type=PGN. Signal-level enrichment via PR welcome  see CONTRIBUTING.md.";
CM_ SG_ 2566083584 High_Voltage_Energy_Storage_Pack "Generic 8-byte raw payload. Detail page: https://www.isobus.net/isobus/pGNAndSPN/7589?type=PGN. Signal-level enrichment via PR welcome  see CONTRIBUTING.md.";
CM_ SG_ 2566083840 High_Voltage_Energy_Storage_Pack "Generic 8-byte raw payload. Detail page: https://www.isobus.net/isobus/pGNAndSPN/7593?type=PGN. Signal-level enrichment via PR welcome  see CONTRIBUTING.md.";
CM_ SG_ 2566084096 High_Voltage_Energy_Storage_Pack "Generic 8-byte raw payload. Detail page: https://www.isobus.net/isobus/pGNAndSPN/7597?type=PGN. Signal-level enrichment via PR welcome  see CONTRIBUTING.md.";
CM_ SG_ 2566084352 High_Voltage_Energy_Storage_Pack "Generic 8-byte raw payload. Detail page: https://www.isobus.net/isobus/pGNAndSPN/7601?type=PGN. Signal-level enrichment via PR welcome  see CONTRIBUTING.md.";
CM_ SG_ 2566084608 High_Voltage_Energy_Storage_Pack "Generic 8-byte raw payload. Detail page: https://www.isobus.net/isobus/pGNAndSPN/7605?type=PGN. Signal-level enrichment via PR welcome  see CONTRIBUTING.md.";
CM_ SG_ 2566084864 High_Voltage_Energy_Storage_Pack "Generic 8-byte raw payload. Detail page: https://www.isobus.net/isobus/pGNAndSPN/7609?type=PGN. Signal-level enrichment via PR welcome  see CONTRIBUTING.md.";
CM_ SG_ 2566085120 High_Voltage_Energy_Storage_Pack "Generic 8-byte raw payload. Detail page: https://www.isobus.net/isobus/pGNAndSPN/7613?type=PGN. Signal-level enrichment via PR welcome  see CONTRIBUTING.md.";
CM_ SG_ 2566085376 High_Voltage_Energy_Storage_Pack "Generic 8-byte raw payload. Detail page: https://www.isobus.net/isobus/pGNAndSPN/7617?type=PGN. Signal-level enrichment via PR welcome  see CONTRIBUTING.md.";
CM_ SG_ 2566085632 High_Voltage_Energy_Storage_Pack "Generic 8-byte raw payload. Detail page: https://www.isobus.net/isobus/pGNAndSPN/7621?type=PGN. Signal-level enrichment via PR welcome  see CONTRIBUTING.md.";
CM_ SG_ 2566085888 High_Voltage_Energy_Storage_Pack "Generic 8-byte raw payload. Detail page: https://www.isobus.net/isobus/pGNAndSPN/7625?type=PGN. Signal-level enrichment via PR welcome  see CONTRIBUTING.md.";
CM_ SG_ 2566086144 High_Voltage_Energy_Storage_Pack "Generic 8-byte raw payload. Detail page: https://www.isobus.net/isobus/pGNAndSPN/7629?type=PGN. Signal-level enrichment via PR welcome  see CONTRIBUTING.md.";
CM_ SG_ 2566086400 High_Voltage_Energy_Storage_Pack "Generic 8-byte raw payload. Detail page: https://www.isobus.net/isobus/pGNAndSPN/7633?type=PGN. Signal-level enrichment via PR welcome  see CONTRIBUTING.md.";
CM_ SG_ 2566086656 High_Voltage_Energy_Storage_Pack "Generic 8-byte raw payload. Detail page: https://www.isobus.net/isobus/pGNAndSPN/7637?type=PGN. Signal-level enrichment via PR welcome  see CONTRIBUTING.md.";
CM_ SG_ 2566086912 High_Voltage_Energy_Storage_Pack "Generic 8-byte raw payload. Detail page: https://www.isobus.net/isobus/pGNAndSPN/7641?type=PGN. Signal-level enrichment via PR welcome  see CONTRIBUTING.md.";
CM_ SG_ 2566087168 High_Voltage_Energy_Storage_Pack "Generic 8-byte raw payload. Detail page: https://www.isobus.net/isobus/pGNAndSPN/7645?type=PGN. Signal-level enrichment via PR welcome  see CONTRIBUTING.md.";
CM_ SG_ 2566087424 High_Voltage_Energy_Storage_Pack "Generic 8-byte raw payload. Detail page: https://www.isobus.net/isobus/pGNAndSPN/7649?type=PGN. Signal-level enrichment via PR welcome  see CONTRIBUTING.md.";
CM_ SG_ 2566087680 Tracked_Vehicle_Data_RawPayload "Generic 8-byte raw payload. Detail page: https://www.isobus.net/isobus/pGNAndSPN/7651?type=PGN. Signal-level enrichment via PR welcome  see CONTRIBUTING.md.";
CM_ SG_ 2566087936 Electrified_Accessory_Propulsion "Generic 8-byte raw payload. Detail page: https://www.isobus.net/isobus/pGNAndSPN/7656?type=PGN. Signal-level enrichment via PR welcome  see CONTRIBUTING.md.";
CM_ SG_ 2566088192 Electrified_Accessory_Propulsion "Generic 8-byte raw payload. Detail page: https://www.isobus.net/isobus/pGNAndSPN/7661?type=PGN. Signal-level enrichment via PR welcome  see CONTRIBUTING.md.";
CM_ SG_ 2566088448 Electrified_Accessory_Propulsion "Generic 8-byte raw payload. Detail page: https://www.isobus.net/isobus/pGNAndSPN/7666?type=PGN. Signal-level enrichment via PR welcome  see CONTRIBUTING.md.";
CM_ SG_ 2566088704 Electrified_Accessory_Power_Elec "Generic 8-byte raw payload. Detail page: https://www.isobus.net/isobus/pGNAndSPN/7671?type=PGN. Signal-level enrichment via PR welcome  see CONTRIBUTING.md.";
CM_ SG_ 2566088960 Electrified_Accessory_Power_Elec "Generic 8-byte raw payload. Detail page: https://www.isobus.net/isobus/pGNAndSPN/7676?type=PGN. Signal-level enrichment via PR welcome  see CONTRIBUTING.md.";
CM_ SG_ 2566089216 Electrified_Accessory_Power_Elec "Generic 8-byte raw payload. Detail page: https://www.isobus.net/isobus/pGNAndSPN/7681?type=PGN. Signal-level enrichment via PR welcome  see CONTRIBUTING.md.";
CM_ SG_ 2566089472 Electrified_Accessory_Propulsion "Generic 8-byte raw payload. Detail page: https://www.isobus.net/isobus/pGNAndSPN/7686?type=PGN. Signal-level enrichment via PR welcome  see CONTRIBUTING.md.";
CM_ SG_ 2566089728 Electrified_Accessory_Propulsion "Generic 8-byte raw payload. Detail page: https://www.isobus.net/isobus/pGNAndSPN/7691?type=PGN. Signal-level enrichment via PR welcome  see CONTRIBUTING.md.";
CM_ SG_ 2566089984 Electrified_Accessory_Power_Elec "Generic 8-byte raw payload. Detail page: https://www.isobus.net/isobus/pGNAndSPN/7696?type=PGN. Signal-level enrichment via PR welcome  see CONTRIBUTING.md.";
CM_ SG_ 2566090240 Electrified_Accessory_Generator_ "Generic 8-byte raw payload. Detail page: https://www.isobus.net/isobus/pGNAndSPN/7701?type=PGN. Signal-level enrichment via PR welcome  see CONTRIBUTING.md.";
CM_ SG_ 2566090496 Electrified_Accessory_Generator_ "Generic 8-byte raw payload. Detail page: https://www.isobus.net/isobus/pGNAndSPN/7706?type=PGN. Signal-level enrichment via PR welcome  see CONTRIBUTING.md.";
CM_ SG_ 2566090752 Electrified_Accessory_Motor_Stat "Generic 8-byte raw payload. Detail page: https://www.isobus.net/isobus/pGNAndSPN/7712?type=PGN. Signal-level enrichment via PR welcome  see CONTRIBUTING.md.";
CM_ SG_ 2566091008 Fuel_Cell_System_Controller_Info "Generic 8-byte raw payload. Detail page: https://www.isobus.net/isobus/pGNAndSPN/7717?type=PGN. Signal-level enrichment via PR welcome  see CONTRIBUTING.md.";
CM_ SG_ 2566091264 Fuel_Cell_System_Minimum_Power_I "Generic 8-byte raw payload. Detail page: https://www.isobus.net/isobus/pGNAndSPN/7722?type=PGN. Signal-level enrichment via PR welcome  see CONTRIBUTING.md.";
CM_ SG_ 2566091520 Fuel_Cell_System_Maximum_Power_I "Generic 8-byte raw payload. Detail page: https://www.isobus.net/isobus/pGNAndSPN/7727?type=PGN. Signal-level enrichment via PR welcome  see CONTRIBUTING.md.";
CM_ SG_ 2566091776 Fuel_Cell_System_Minimum_Current "Generic 8-byte raw payload. Detail page: https://www.isobus.net/isobus/pGNAndSPN/7732?type=PGN. Signal-level enrichment via PR welcome  see CONTRIBUTING.md.";
CM_ SG_ 2566092032 Fuel_Cell_System_Maximum_Current "Generic 8-byte raw payload. Detail page: https://www.isobus.net/isobus/pGNAndSPN/7737?type=PGN. Signal-level enrichment via PR welcome  see CONTRIBUTING.md.";
CM_ SG_ 2566092288 Hydrogen_Storage_System_Informat "Generic 8-byte raw payload. Detail page: https://www.isobus.net/isobus/pGNAndSPN/7740?type=PGN. Signal-level enrichment via PR welcome  see CONTRIBUTING.md.";

BA_DEF_ BO_ "SystemMessageLongSymbol" STRING;
BA_DEF_ SG_ "SystemSignalLongSymbol" STRING;
BA_ "SystemMessageLongSymbol" BO_ 2566005248 "VDMA_F222_High_Voltage_Energy_Storage_Pack";
BA_ "SystemMessageLongSymbol" BO_ 2566005504 "VDMA_F223_High_Voltage_Energy_Storage_Pack";
BA_ "SystemMessageLongSymbol" BO_ 2566005760 "VDMA_F224_High_Voltage_Energy_Storage_Pack";
BA_ "SystemMessageLongSymbol" BO_ 2566006016 "VDMA_F225_High_Voltage_Energy_Storage_Pack";
BA_ "SystemMessageLongSymbol" BO_ 2566006272 "VDMA_F226_High_Voltage_Energy_Storage_Pack";
BA_ "SystemMessageLongSymbol" BO_ 2566006528 "VDMA_F227_High_Voltage_Energy_Storage_Pack";
BA_ "SystemMessageLongSymbol" BO_ 2566006784 "VDMA_F228_High_Voltage_Energy_Storage_Pack";
BA_ "SystemMessageLongSymbol" BO_ 2566007040 "VDMA_F229_High_Voltage_Energy_Storage_Pack";
BA_ "SystemMessageLongSymbol" BO_ 2566007296 "VDMA_F22A_High_Voltage_Energy_Storage_Pack";
BA_ "SystemMessageLongSymbol" BO_ 2566007552 "VDMA_F22B_High_Voltage_Energy_Storage_Pack";
BA_ "SystemMessageLongSymbol" BO_ 2566007808 "VDMA_F22C_High_Voltage_Energy_Storage_Pack";
BA_ "SystemMessageLongSymbol" BO_ 2566008064 "VDMA_F22D_High_Voltage_Energy_Storage_Pack";
BA_ "SystemMessageLongSymbol" BO_ 2566008320 "VDMA_F22E_High_Voltage_Energy_Storage_Pack";
BA_ "SystemMessageLongSymbol" BO_ 2566008576 "VDMA_F22F_High_Voltage_Energy_Storage_Pack";
BA_ "SystemMessageLongSymbol" BO_ 2566008832 "VDMA_F230_High_Voltage_Energy_Storage_Pack";
BA_ "SystemMessageLongSymbol" BO_ 2566009088 "VDMA_F231_High_Voltage_Energy_Storage_Pack";
BA_ "SystemMessageLongSymbol" BO_ 2566009344 "VDMA_F232_High_Voltage_Energy_Storage_Pack";
BA_ "SystemMessageLongSymbol" BO_ 2566009600 "VDMA_F233_High_Voltage_Energy_Storage_Pack";
BA_ "SystemMessageLongSymbol" BO_ 2566009856 "VDMA_F234_High_Voltage_Energy_Storage_Pack";
BA_ "SystemMessageLongSymbol" BO_ 2566010112 "VDMA_F235_High_Voltage_Energy_Storage_Pack";
BA_ "SystemMessageLongSymbol" BO_ 2566010368 "VDMA_F236_High_Voltage_Energy_Storage_Pack";
BA_ "SystemMessageLongSymbol" BO_ 2566010624 "VDMA_F237_High_Voltage_Energy_Storage_Pack";
BA_ "SystemMessageLongSymbol" BO_ 2566010880 "VDMA_F238_High_Voltage_Energy_Storage_Pack";
BA_ "SystemMessageLongSymbol" BO_ 2566011136 "VDMA_F239_High_Voltage_Energy_Storage_Pack";
BA_ "SystemMessageLongSymbol" BO_ 2566011392 "VDMA_F23A_High_Voltage_Energy_Storage_Pack";
BA_ "SystemMessageLongSymbol" BO_ 2566011648 "VDMA_F23B_High_Voltage_Energy_Storage_Pack";
BA_ "SystemMessageLongSymbol" BO_ 2566011904 "VDMA_F23C_High_Voltage_Energy_Storage_Pack";
BA_ "SystemMessageLongSymbol" BO_ 2566012160 "VDMA_F23D_High_Voltage_Energy_Storage_Pack";
BA_ "SystemMessageLongSymbol" BO_ 2566012416 "VDMA_F23E_High_Voltage_Energy_Storage_Pack";
BA_ "SystemMessageLongSymbol" BO_ 2566012672 "VDMA_F23F_High_Voltage_Energy_Storage_Pack";
BA_ "SystemMessageLongSymbol" BO_ 2566012928 "VDMA_F240_High_Voltage_Energy_Storage_Pack";
BA_ "SystemMessageLongSymbol" BO_ 2566013184 "VDMA_F241_High_Voltage_Energy_Storage_Pack";
BA_ "SystemMessageLongSymbol" BO_ 2566013440 "VDMA_F242_High_Voltage_Energy_Storage_Pack";
BA_ "SystemMessageLongSymbol" BO_ 2566013696 "VDMA_F243_High_Voltage_Energy_Storage_Pack";
BA_ "SystemMessageLongSymbol" BO_ 2566013952 "VDMA_F244_High_Voltage_Energy_Storage_Pack";
BA_ "SystemMessageLongSymbol" BO_ 2566014208 "VDMA_F245_High_Voltage_Energy_Storage_Pack";
BA_ "SystemMessageLongSymbol" BO_ 2566014464 "VDMA_F246_High_Voltage_Energy_Storage_Pack";
BA_ "SystemMessageLongSymbol" BO_ 2566014720 "VDMA_F247_High_Voltage_Energy_Storage_Pack";
BA_ "SystemMessageLongSymbol" BO_ 2566014976 "VDMA_F248_High_Voltage_Energy_Storage_Pack";
BA_ "SystemMessageLongSymbol" BO_ 2566015232 "VDMA_F249_High_Voltage_Energy_Storage_Pack";
BA_ "SystemMessageLongSymbol" BO_ 2566015488 "VDMA_F24A_High_Voltage_Energy_Storage_Pack";
BA_ "SystemMessageLongSymbol" BO_ 2566015744 "VDMA_F24B_High_Voltage_Energy_Storage_Pack";
BA_ "SystemMessageLongSymbol" BO_ 2566016000 "VDMA_F24C_High_Voltage_Energy_Storage_Pack";
BA_ "SystemMessageLongSymbol" BO_ 2566016256 "VDMA_F24D_High_Voltage_Energy_Storage_Pack";
BA_ "SystemMessageLongSymbol" BO_ 2566016512 "VDMA_F24E_High_Voltage_Energy_Storage_Pack";
BA_ "SystemMessageLongSymbol" BO_ 2566016768 "VDMA_F24F_High_Voltage_Energy_Storage_Pack";
BA_ "SystemMessageLongSymbol" BO_ 2566017024 "VDMA_F250_Electronic_Auxiliary_Transmissio";
BA_ "SystemMessageLongSymbol" BO_ 2566017280 "VDMA_F251_High_Voltage_Energy_Storage_Pack";
BA_ "SystemMessageLongSymbol" BO_ 2566017536 "VDMA_F252_High_Voltage_Energy_Storage_Pack";
BA_ "SystemMessageLongSymbol" BO_ 2566017792 "VDMA_F253_High_Voltage_Energy_Storage_Pack";
BA_ "SystemMessageLongSymbol" BO_ 2566018048 "VDMA_F254_High_Voltage_Energy_Storage_Pack";
BA_ "SystemMessageLongSymbol" BO_ 2566018304 "VDMA_F255_High_Voltage_Energy_Storage_Pack";
BA_ "SystemMessageLongSymbol" BO_ 2566018560 "VDMA_F256_High_Voltage_Energy_Storage_Pack";
BA_ "SystemMessageLongSymbol" BO_ 2566018816 "VDMA_F257_High_Voltage_Energy_Storage_Pack";
BA_ "SystemMessageLongSymbol" BO_ 2566019072 "VDMA_F258_High_Voltage_Energy_Storage_Pack";
BA_ "SystemMessageLongSymbol" BO_ 2566019328 "VDMA_F259_High_Voltage_Energy_Storage_Pack";
BA_ "SystemMessageLongSymbol" BO_ 2566019584 "VDMA_F25A_High_Voltage_Energy_Storage_Pack";
BA_ "SystemMessageLongSymbol" BO_ 2566019840 "VDMA_F25B_High_Voltage_Energy_Storage_Pack";
BA_ "SystemMessageLongSymbol" BO_ 2566020096 "VDMA_F25C_High_Voltage_Energy_Storage_Pack";
BA_ "SystemMessageLongSymbol" BO_ 2566020352 "VDMA_F25D_High_Voltage_Energy_Storage_Pack";
BA_ "SystemMessageLongSymbol" BO_ 2566020608 "VDMA_F25E_High_Voltage_Energy_Storage_Pack";
BA_ "SystemMessageLongSymbol" BO_ 2566020864 "VDMA_F25F_High_Voltage_Energy_Storage_Pack";
BA_ "SystemMessageLongSymbol" BO_ 2566021120 "VDMA_F260_High_Voltage_Energy_Storage_Pack";
BA_ "SystemMessageLongSymbol" BO_ 2566021376 "VDMA_F261_High_Voltage_Energy_Storage_Pack";
BA_ "SystemMessageLongSymbol" BO_ 2566021632 "VDMA_F262_High_Voltage_Energy_Storage_Pack";
BA_ "SystemMessageLongSymbol" BO_ 2566021888 "VDMA_F263_High_Voltage_Energy_Storage_Pack";
BA_ "SystemMessageLongSymbol" BO_ 2566022144 "VDMA_F264_High_Voltage_Energy_Storage_Pack";
BA_ "SystemMessageLongSymbol" BO_ 2566022400 "VDMA_F265_High_Voltage_Energy_Storage_Pack";
BA_ "SystemMessageLongSymbol" BO_ 2566022656 "VDMA_F266_High_Voltage_Energy_Storage_Pack";
BA_ "SystemMessageLongSymbol" BO_ 2566022912 "VDMA_F267_High_Voltage_Energy_Storage_Pack";
BA_ "SystemMessageLongSymbol" BO_ 2566023168 "VDMA_F268_High_Voltage_Energy_Storage_Pack";
BA_ "SystemMessageLongSymbol" BO_ 2566023424 "VDMA_F269_High_Voltage_Energy_Storage_Pack";
BA_ "SystemMessageLongSymbol" BO_ 2566023680 "VDMA_F26A_High_Voltage_Energy_Storage_Pack";
BA_ "SystemMessageLongSymbol" BO_ 2566023936 "VDMA_F26B_High_Voltage_Energy_Storage_Pack";
BA_ "SystemMessageLongSymbol" BO_ 2566024192 "VDMA_F26C_High_Voltage_Energy_Storage_Pack";
BA_ "SystemMessageLongSymbol" BO_ 2566024448 "VDMA_F26D_High_Voltage_Energy_Storage_Pack";
BA_ "SystemMessageLongSymbol" BO_ 2566024704 "VDMA_F26E_High_Voltage_Energy_Storage_Pack";
BA_ "SystemMessageLongSymbol" BO_ 2566024960 "VDMA_F26F_High_Voltage_Energy_Storage_Pack";
BA_ "SystemMessageLongSymbol" BO_ 2566025216 "VDMA_F270_High_Voltage_Energy_Storage_Pack";
BA_ "SystemMessageLongSymbol" BO_ 2566025472 "VDMA_F271_High_Voltage_Energy_Storage_Pack";
BA_ "SystemMessageLongSymbol" BO_ 2566025728 "VDMA_F272_High_Voltage_Energy_Storage_Pack";
BA_ "SystemMessageLongSymbol" BO_ 2566025984 "VDMA_F273_High_Voltage_Energy_Storage_Pack";
BA_ "SystemMessageLongSymbol" BO_ 2566026240 "VDMA_F274_High_Voltage_Energy_Storage_Pack";
BA_ "SystemMessageLongSymbol" BO_ 2566026496 "VDMA_F275_High_Voltage_Energy_Storage_Pack";
BA_ "SystemMessageLongSymbol" BO_ 2566026752 "VDMA_F276_High_Voltage_Energy_Storage_Pack";
BA_ "SystemMessageLongSymbol" BO_ 2566027008 "VDMA_F277_High_Voltage_Energy_Storage_Pack";
BA_ "SystemMessageLongSymbol" BO_ 2566027264 "VDMA_F278_High_Voltage_Energy_Storage_Pack";
BA_ "SystemMessageLongSymbol" BO_ 2566027520 "VDMA_F279_High_Voltage_Energy_Storage_Pack";
BA_ "SystemMessageLongSymbol" BO_ 2566027776 "VDMA_F27A_High_Voltage_Energy_Storage_Pack";
BA_ "SystemMessageLongSymbol" BO_ 2566028032 "VDMA_F27B_High_Voltage_Energy_Storage_Pack";
BA_ "SystemMessageLongSymbol" BO_ 2566028288 "VDMA_F27C_High_Voltage_Energy_Storage_Pack";
BA_ "SystemMessageLongSymbol" BO_ 2566028544 "VDMA_F27D_High_Voltage_Energy_Storage_Pack";
BA_ "SystemMessageLongSymbol" BO_ 2566028800 "VDMA_F27E_High_Voltage_Energy_Storage_Pack";
BA_ "SystemMessageLongSymbol" BO_ 2566029056 "VDMA_F27F_High_Voltage_Energy_Storage_Pack";
BA_ "SystemMessageLongSymbol" BO_ 2566029312 "VDMA_F280_High_Voltage_Energy_Storage_Pack";
BA_ "SystemMessageLongSymbol" BO_ 2566029568 "VDMA_F281_High_Voltage_Energy_Storage_Pack";
BA_ "SystemMessageLongSymbol" BO_ 2566029824 "VDMA_F282_High_Voltage_Energy_Storage_Pack";
BA_ "SystemMessageLongSymbol" BO_ 2566030080 "VDMA_F283_High_Voltage_Energy_Storage_Pack";
BA_ "SystemMessageLongSymbol" BO_ 2566030336 "VDMA_F284_High_Voltage_Energy_Storage_Pack";
BA_ "SystemMessageLongSymbol" BO_ 2566030592 "VDMA_F285_High_Voltage_Energy_Storage_Pack";
BA_ "SystemMessageLongSymbol" BO_ 2566030848 "VDMA_F286_High_Voltage_Energy_Storage_Pack";
BA_ "SystemMessageLongSymbol" BO_ 2566031104 "VDMA_F287_High_Voltage_Energy_Storage_Pack";
BA_ "SystemMessageLongSymbol" BO_ 2566031360 "VDMA_F288_High_Voltage_Energy_Storage_Pack";
BA_ "SystemMessageLongSymbol" BO_ 2566031616 "VDMA_F289_High_Voltage_Energy_Storage_Pack";
BA_ "SystemMessageLongSymbol" BO_ 2566031872 "VDMA_F28A_High_Voltage_Energy_Storage_Pack";
BA_ "SystemMessageLongSymbol" BO_ 2566032128 "VDMA_F28B_High_Voltage_Energy_Storage_Pack";
BA_ "SystemMessageLongSymbol" BO_ 2566032384 "VDMA_F28C_High_Voltage_Energy_Storage_Pack";
BA_ "SystemMessageLongSymbol" BO_ 2566032640 "VDMA_F28D_High_Voltage_Energy_Storage_Pack";
BA_ "SystemMessageLongSymbol" BO_ 2566032896 "VDMA_F28E_High_Voltage_Energy_Storage_Pack";
BA_ "SystemMessageLongSymbol" BO_ 2566033152 "VDMA_F28F_High_Voltage_Energy_Storage_Pack";
BA_ "SystemMessageLongSymbol" BO_ 2566033408 "VDMA_F290_High_Voltage_Energy_Storage_Pack";
BA_ "SystemMessageLongSymbol" BO_ 2566033664 "VDMA_F291_High_Voltage_Energy_Storage_Pack";
BA_ "SystemMessageLongSymbol" BO_ 2566033920 "VDMA_F292_High_Voltage_Energy_Storage_Pack";
BA_ "SystemMessageLongSymbol" BO_ 2566034176 "VDMA_F293_High_Voltage_Energy_Storage_Pack";
BA_ "SystemMessageLongSymbol" BO_ 2566034432 "VDMA_F294_High_Voltage_Energy_Storage_Pack";
BA_ "SystemMessageLongSymbol" BO_ 2566034688 "VDMA_F295_High_Voltage_Energy_Storage_Pack";
BA_ "SystemMessageLongSymbol" BO_ 2566034944 "VDMA_F296_High_Voltage_Energy_Storage_Pack";
BA_ "SystemMessageLongSymbol" BO_ 2566035200 "VDMA_F297_High_Voltage_Energy_Storage_Pack";
BA_ "SystemMessageLongSymbol" BO_ 2566035456 "VDMA_F298_High_Voltage_Energy_Storage_Pack";
BA_ "SystemMessageLongSymbol" BO_ 2566035712 "VDMA_F299_High_Voltage_Energy_Storage_Pack";
BA_ "SystemMessageLongSymbol" BO_ 2566035968 "VDMA_F29A_High_Voltage_Energy_Storage_Pack";
BA_ "SystemMessageLongSymbol" BO_ 2566036224 "VDMA_F29B_High_Voltage_Energy_Storage_Pack";
BA_ "SystemMessageLongSymbol" BO_ 2566036480 "VDMA_F29C_High_Voltage_Energy_Storage_Pack";
BA_ "SystemMessageLongSymbol" BO_ 2566036736 "VDMA_F29D_High_Voltage_Energy_Storage_Pack";
BA_ "SystemMessageLongSymbol" BO_ 2566036992 "VDMA_F29E_High_Voltage_Energy_Storage_Pack";
BA_ "SystemMessageLongSymbol" BO_ 2566037248 "VDMA_F29F_High_Voltage_Energy_Storage_Pack";
BA_ "SystemMessageLongSymbol" BO_ 2566037504 "VDMA_F2A0_High_Voltage_Energy_Storage_Pack";
BA_ "SystemMessageLongSymbol" BO_ 2566037760 "VDMA_F2A1_High_Voltage_Energy_Storage_Pack";
BA_ "SystemMessageLongSymbol" BO_ 2566038016 "VDMA_F2A2_High_Voltage_Energy_Storage_Pack";
BA_ "SystemMessageLongSymbol" BO_ 2566038272 "VDMA_F2A3_High_Voltage_Energy_Storage_Pack";
BA_ "SystemMessageLongSymbol" BO_ 2566038528 "VDMA_F2A4_High_Voltage_Energy_Storage_Pack";
BA_ "SystemMessageLongSymbol" BO_ 2566038784 "VDMA_F2A5_High_Voltage_Energy_Storage_Pack";
BA_ "SystemMessageLongSymbol" BO_ 2566039040 "VDMA_F2A6_High_Voltage_Energy_Storage_Pack";
BA_ "SystemMessageLongSymbol" BO_ 2566039296 "VDMA_F2A7_High_Voltage_Energy_Storage_Pack";
BA_ "SystemMessageLongSymbol" BO_ 2566039552 "VDMA_F2A8_High_Voltage_Energy_Storage_Pack";
BA_ "SystemMessageLongSymbol" BO_ 2566039808 "VDMA_F2A9_High_Voltage_Energy_Storage_Pack";
BA_ "SystemMessageLongSymbol" BO_ 2566040064 "VDMA_F2AA_High_Voltage_Energy_Storage_Pack";
BA_ "SystemMessageLongSymbol" BO_ 2566040320 "VDMA_F2AB_High_Voltage_Energy_Storage_Pack";
BA_ "SystemMessageLongSymbol" BO_ 2566040576 "VDMA_F2AC_High_Voltage_Energy_Storage_Pack";
BA_ "SystemMessageLongSymbol" BO_ 2566040832 "VDMA_F2AD_High_Voltage_Energy_Storage_Pack";
BA_ "SystemMessageLongSymbol" BO_ 2566041088 "VDMA_F2AE_High_Voltage_Energy_Storage_Pack";
BA_ "SystemMessageLongSymbol" BO_ 2566041344 "VDMA_F2AF_High_Voltage_Energy_Storage_Pack";
BA_ "SystemMessageLongSymbol" BO_ 2566041600 "VDMA_F2B0_High_Voltage_Energy_Storage_Pack";
BA_ "SystemMessageLongSymbol" BO_ 2566041856 "VDMA_F2B1_High_Voltage_Energy_Storage_Pack";
BA_ "SystemMessageLongSymbol" BO_ 2566042112 "VDMA_F2B2_High_Voltage_Energy_Storage_Pack";
BA_ "SystemMessageLongSymbol" BO_ 2566042368 "VDMA_F2B3_High_Voltage_Energy_Storage_Pack";
BA_ "SystemMessageLongSymbol" BO_ 2566042624 "VDMA_F2B4_High_Voltage_Energy_Storage_Pack";
BA_ "SystemMessageLongSymbol" BO_ 2566042880 "VDMA_F2B5_High_Voltage_Energy_Storage_Pack";
BA_ "SystemMessageLongSymbol" BO_ 2566043136 "VDMA_F2B6_High_Voltage_Energy_Storage_Pack";
BA_ "SystemMessageLongSymbol" BO_ 2566043392 "VDMA_F2B7_High_Voltage_Energy_Storage_Pack";
BA_ "SystemMessageLongSymbol" BO_ 2566043648 "VDMA_F2B8_High_Voltage_Energy_Storage_Pack";
BA_ "SystemMessageLongSymbol" BO_ 2566043904 "VDMA_F2B9_High_Voltage_Energy_Storage_Pack";
BA_ "SystemMessageLongSymbol" BO_ 2566044160 "VDMA_F2BA_High_Voltage_Energy_Storage_Pack";
BA_ "SystemMessageLongSymbol" BO_ 2566044416 "VDMA_F2BB_High_Voltage_Energy_Storage_Pack";
BA_ "SystemMessageLongSymbol" BO_ 2566044672 "VDMA_F2BC_High_Voltage_Energy_Storage_Pack";
BA_ "SystemMessageLongSymbol" BO_ 2566044928 "VDMA_F2BD_High_Voltage_Energy_Storage_Pack";
BA_ "SystemMessageLongSymbol" BO_ 2566045184 "VDMA_F2BE_High_Voltage_Energy_Storage_Pack";
BA_ "SystemMessageLongSymbol" BO_ 2566045440 "VDMA_F2BF_High_Voltage_Energy_Storage_Pack";
BA_ "SystemMessageLongSymbol" BO_ 2566045696 "VDMA_F2C0_High_Voltage_Energy_Storage_Pack";
BA_ "SystemMessageLongSymbol" BO_ 2566045952 "VDMA_F2C1_High_Voltage_Energy_Storage_Pack";
BA_ "SystemMessageLongSymbol" BO_ 2566046208 "VDMA_F2C2_High_Voltage_Energy_Storage_Pack";
BA_ "SystemMessageLongSymbol" BO_ 2566046464 "VDMA_F2C3_High_Voltage_Energy_Storage_Pack";
BA_ "SystemMessageLongSymbol" BO_ 2566046720 "VDMA_F2C4_High_Voltage_Energy_Storage_Pack";
BA_ "SystemMessageLongSymbol" BO_ 2566046976 "VDMA_F2C5_High_Voltage_Energy_Storage_Pack";
BA_ "SystemMessageLongSymbol" BO_ 2566047232 "VDMA_F2C6_High_Voltage_Energy_Storage_Pack";
BA_ "SystemMessageLongSymbol" BO_ 2566047488 "VDMA_F2C7_High_Voltage_Energy_Storage_Pack";
BA_ "SystemMessageLongSymbol" BO_ 2566047744 "VDMA_F2C8_High_Voltage_Energy_Storage_Pack";
BA_ "SystemMessageLongSymbol" BO_ 2566048000 "VDMA_F2C9_High_Voltage_Energy_Storage_Pack";
BA_ "SystemMessageLongSymbol" BO_ 2566048256 "VDMA_F2CA_High_Voltage_Energy_Storage_Pack";
BA_ "SystemMessageLongSymbol" BO_ 2566048512 "VDMA_F2CB_High_Voltage_Energy_Storage_Pack";
BA_ "SystemMessageLongSymbol" BO_ 2566048768 "VDMA_F2CC_High_Voltage_Energy_Storage_Pack";
BA_ "SystemMessageLongSymbol" BO_ 2566049024 "VDMA_F2CD_High_Voltage_Energy_Storage_Pack";
BA_ "SystemMessageLongSymbol" BO_ 2566049280 "VDMA_F2CE_High_Voltage_Energy_Storage_Pack";
BA_ "SystemMessageLongSymbol" BO_ 2566049536 "VDMA_F2CF_High_Voltage_Energy_Storage_Pack";
BA_ "SystemMessageLongSymbol" BO_ 2566049792 "VDMA_F2D0_High_Voltage_Energy_Storage_Pack";
BA_ "SystemMessageLongSymbol" BO_ 2566050048 "VDMA_F2D1_High_Voltage_Energy_Storage_Pack";
BA_ "SystemMessageLongSymbol" BO_ 2566050304 "VDMA_F2D2_High_Voltage_Energy_Storage_Pack";
BA_ "SystemMessageLongSymbol" BO_ 2566050560 "VDMA_F2D3_High_Voltage_Energy_Storage_Pack";
BA_ "SystemMessageLongSymbol" BO_ 2566050816 "VDMA_F2D4_High_Voltage_Energy_Storage_Pack";
BA_ "SystemMessageLongSymbol" BO_ 2566051072 "VDMA_F2D5_High_Voltage_Energy_Storage_Pack";
BA_ "SystemMessageLongSymbol" BO_ 2566051328 "VDMA_F2D6_High_Voltage_Energy_Storage_Pack";
BA_ "SystemMessageLongSymbol" BO_ 2566051584 "VDMA_F2D7_High_Voltage_Energy_Storage_Pack";
BA_ "SystemMessageLongSymbol" BO_ 2566051840 "VDMA_F2D8_High_Voltage_Energy_Storage_Pack";
BA_ "SystemMessageLongSymbol" BO_ 2566052096 "VDMA_F2D9_High_Voltage_Energy_Storage_Pack";
BA_ "SystemMessageLongSymbol" BO_ 2566052352 "VDMA_F2DA_High_Voltage_Energy_Storage_Pack";
BA_ "SystemMessageLongSymbol" BO_ 2566052608 "VDMA_F2DB_High_Voltage_Energy_Storage_Pack";
BA_ "SystemMessageLongSymbol" BO_ 2566052864 "VDMA_F2DC_High_Voltage_Energy_Storage_Pack";
BA_ "SystemMessageLongSymbol" BO_ 2566053120 "VDMA_F2DD_High_Voltage_Energy_Storage_Pack";
BA_ "SystemMessageLongSymbol" BO_ 2566053376 "VDMA_F2DE_High_Voltage_Energy_Storage_Pack";
BA_ "SystemMessageLongSymbol" BO_ 2566053632 "VDMA_F2DF_High_Voltage_Energy_Storage_Pack";
BA_ "SystemMessageLongSymbol" BO_ 2566053888 "VDMA_F2E0_High_Voltage_Energy_Storage_Pack";
BA_ "SystemMessageLongSymbol" BO_ 2566054144 "VDMA_F2E1_High_Voltage_Energy_Storage_Pack";
BA_ "SystemMessageLongSymbol" BO_ 2566054400 "VDMA_F2E2_High_Voltage_Energy_Storage_Pack";
BA_ "SystemMessageLongSymbol" BO_ 2566054656 "VDMA_F2E3_High_Voltage_Energy_Storage_Pack";
BA_ "SystemMessageLongSymbol" BO_ 2566054912 "VDMA_F2E4_High_Voltage_Energy_Storage_Pack";
BA_ "SystemMessageLongSymbol" BO_ 2566055168 "VDMA_F2E5_High_Voltage_Energy_Storage_Pack";
BA_ "SystemMessageLongSymbol" BO_ 2566055424 "VDMA_F2E6_High_Voltage_Energy_Storage_Pack";
BA_ "SystemMessageLongSymbol" BO_ 2566055680 "VDMA_F2E7_High_Voltage_Energy_Storage_Pack";
BA_ "SystemMessageLongSymbol" BO_ 2566055936 "VDMA_F2E8_High_Voltage_Energy_Storage_Pack";
BA_ "SystemMessageLongSymbol" BO_ 2566056192 "VDMA_F2E9_High_Voltage_Energy_Storage_Pack";
BA_ "SystemMessageLongSymbol" BO_ 2566056448 "VDMA_F2EA_High_Voltage_Energy_Storage_Pack";
BA_ "SystemMessageLongSymbol" BO_ 2566056704 "VDMA_F2EB_High_Voltage_Energy_Storage_Pack";
BA_ "SystemMessageLongSymbol" BO_ 2566056960 "VDMA_F2EC_High_Voltage_Energy_Storage_Pack";
BA_ "SystemMessageLongSymbol" BO_ 2566057216 "VDMA_F2ED_High_Voltage_Energy_Storage_Pack";
BA_ "SystemMessageLongSymbol" BO_ 2566057472 "VDMA_F2EE_High_Voltage_Energy_Storage_Pack";
BA_ "SystemMessageLongSymbol" BO_ 2566057728 "VDMA_F2EF_High_Voltage_Energy_Storage_Pack";
BA_ "SystemMessageLongSymbol" BO_ 2566057984 "VDMA_F2F0_High_Voltage_Energy_Storage_Pack";
BA_ "SystemMessageLongSymbol" BO_ 2566058240 "VDMA_F2F1_High_Voltage_Energy_Storage_Pack";
BA_ "SystemMessageLongSymbol" BO_ 2566058496 "VDMA_F2F2_High_Voltage_Energy_Storage_Pack";
BA_ "SystemMessageLongSymbol" BO_ 2566058752 "VDMA_F2F3_High_Voltage_Energy_Storage_Pack";
BA_ "SystemMessageLongSymbol" BO_ 2566059008 "VDMA_F2F4_High_Voltage_Energy_Storage_Pack";
BA_ "SystemMessageLongSymbol" BO_ 2566059264 "VDMA_F2F5_High_Voltage_Energy_Storage_Pack";
BA_ "SystemMessageLongSymbol" BO_ 2566059520 "VDMA_F2F6_High_Voltage_Energy_Storage_Pack";
BA_ "SystemMessageLongSymbol" BO_ 2566059776 "VDMA_F2F7_High_Voltage_Energy_Storage_Pack";
BA_ "SystemMessageLongSymbol" BO_ 2566060032 "VDMA_F2F8_High_Voltage_Energy_Storage_Pack";
BA_ "SystemMessageLongSymbol" BO_ 2566060288 "VDMA_F2F9_High_Voltage_Energy_Storage_Pack";
BA_ "SystemMessageLongSymbol" BO_ 2566060544 "VDMA_F2FA_High_Voltage_Energy_Storage_Pack";
BA_ "SystemMessageLongSymbol" BO_ 2566060800 "VDMA_F2FB_High_Voltage_Energy_Storage_Pack";
BA_ "SystemMessageLongSymbol" BO_ 2566061056 "VDMA_F2FC_High_Voltage_Energy_Storage_Pack";
BA_ "SystemMessageLongSymbol" BO_ 2566061312 "VDMA_F2FD_High_Voltage_Energy_Storage_Pack";
BA_ "SystemMessageLongSymbol" BO_ 2566061568 "VDMA_F2FE_High_Voltage_Energy_Storage_Pack";
BA_ "SystemMessageLongSymbol" BO_ 2566061824 "VDMA_F2FF_High_Voltage_Energy_Storage_Pack";
BA_ "SystemMessageLongSymbol" BO_ 2566062080 "VDMA_F300_High_Voltage_Energy_Storage_Pack";
BA_ "SystemMessageLongSymbol" BO_ 2566062336 "VDMA_F301_High_Voltage_Energy_Storage_Pack";
BA_ "SystemMessageLongSymbol" BO_ 2566062592 "VDMA_F302_High_Voltage_Energy_Storage_Pack";
BA_ "SystemMessageLongSymbol" BO_ 2566062848 "VDMA_F303_High_Voltage_Energy_Storage_Pack";
BA_ "SystemMessageLongSymbol" BO_ 2566063104 "VDMA_F304_High_Voltage_Energy_Storage_Pack";
BA_ "SystemMessageLongSymbol" BO_ 2566063360 "VDMA_F305_High_Voltage_Energy_Storage_Pack";
BA_ "SystemMessageLongSymbol" BO_ 2566063616 "VDMA_F306_High_Voltage_Energy_Storage_Pack";
BA_ "SystemMessageLongSymbol" BO_ 2566063872 "VDMA_F307_High_Voltage_Energy_Storage_Pack";
BA_ "SystemMessageLongSymbol" BO_ 2566064128 "VDMA_F308_High_Voltage_Energy_Storage_Pack";
BA_ "SystemMessageLongSymbol" BO_ 2566064384 "VDMA_F309_High_Voltage_Energy_Storage_Pack";
BA_ "SystemMessageLongSymbol" BO_ 2566064640 "VDMA_F30A_High_Voltage_Energy_Storage_Pack";
BA_ "SystemMessageLongSymbol" BO_ 2566064896 "VDMA_F30B_High_Voltage_Energy_Storage_Pack";
BA_ "SystemMessageLongSymbol" BO_ 2566065152 "VDMA_F30C_High_Voltage_Energy_Storage_Pack";
BA_ "SystemMessageLongSymbol" BO_ 2566065408 "VDMA_F30D_High_Voltage_Energy_Storage_Pack";
BA_ "SystemMessageLongSymbol" BO_ 2566065664 "VDMA_F30E_High_Voltage_Energy_Storage_Pack";
BA_ "SystemMessageLongSymbol" BO_ 2566065920 "VDMA_F30F_High_Voltage_Energy_Storage_Pack";
BA_ "SystemMessageLongSymbol" BO_ 2566066176 "VDMA_F310_High_Voltage_Energy_Storage_Pack";
BA_ "SystemMessageLongSymbol" BO_ 2566066432 "VDMA_F311_High_Voltage_Energy_Storage_Pack";
BA_ "SystemMessageLongSymbol" BO_ 2566066688 "VDMA_F312_High_Voltage_Energy_Storage_Pack";
BA_ "SystemMessageLongSymbol" BO_ 2566066944 "VDMA_F313_High_Voltage_Energy_Storage_Pack";
BA_ "SystemMessageLongSymbol" BO_ 2566067200 "VDMA_F314_High_Voltage_Energy_Storage_Pack";
BA_ "SystemMessageLongSymbol" BO_ 2566067456 "VDMA_F315_High_Voltage_Energy_Storage_Pack";
BA_ "SystemMessageLongSymbol" BO_ 2566067712 "VDMA_F316_High_Voltage_Energy_Storage_Pack";
BA_ "SystemMessageLongSymbol" BO_ 2566067968 "VDMA_F317_High_Voltage_Energy_Storage_Pack";
BA_ "SystemMessageLongSymbol" BO_ 2566068224 "VDMA_F318_High_Voltage_Energy_Storage_Pack";
BA_ "SystemMessageLongSymbol" BO_ 2566068480 "VDMA_F319_High_Voltage_Energy_Storage_Pack";
BA_ "SystemMessageLongSymbol" BO_ 2566068736 "VDMA_F31A_High_Voltage_Energy_Storage_Pack";
BA_ "SystemMessageLongSymbol" BO_ 2566068992 "VDMA_F31B_High_Voltage_Energy_Storage_Pack";
BA_ "SystemMessageLongSymbol" BO_ 2566069248 "VDMA_F31C_High_Voltage_Energy_Storage_Pack";
BA_ "SystemMessageLongSymbol" BO_ 2566069504 "VDMA_F31D_High_Voltage_Energy_Storage_Pack";
BA_ "SystemMessageLongSymbol" BO_ 2566069760 "VDMA_F31E_High_Voltage_Energy_Storage_Pack";
BA_ "SystemMessageLongSymbol" BO_ 2566070016 "VDMA_F31F_High_Voltage_Energy_Storage_Pack";
BA_ "SystemMessageLongSymbol" BO_ 2566070272 "VDMA_F320_High_Voltage_Energy_Storage_Pack";
BA_ "SystemMessageLongSymbol" BO_ 2566070528 "VDMA_F321_High_Voltage_Energy_Storage_Pack";
BA_ "SystemMessageLongSymbol" BO_ 2566070784 "VDMA_F322_High_Voltage_Energy_Storage_Pack";
BA_ "SystemMessageLongSymbol" BO_ 2566071040 "VDMA_F323_High_Voltage_Energy_Storage_Pack";
BA_ "SystemMessageLongSymbol" BO_ 2566071296 "VDMA_F324_High_Voltage_Energy_Storage_Pack";
BA_ "SystemMessageLongSymbol" BO_ 2566071552 "VDMA_F325_High_Voltage_Energy_Storage_Pack";
BA_ "SystemMessageLongSymbol" BO_ 2566071808 "VDMA_F326_High_Voltage_Energy_Storage_Pack";
BA_ "SystemMessageLongSymbol" BO_ 2566072064 "VDMA_F327_High_Voltage_Energy_Storage_Pack";
BA_ "SystemMessageLongSymbol" BO_ 2566072320 "VDMA_F328_High_Voltage_Energy_Storage_Pack";
BA_ "SystemMessageLongSymbol" BO_ 2566072576 "VDMA_F329_High_Voltage_Energy_Storage_Pack";
BA_ "SystemMessageLongSymbol" BO_ 2566072832 "VDMA_F32A_High_Voltage_Energy_Storage_Pack";
BA_ "SystemMessageLongSymbol" BO_ 2566073088 "VDMA_F32B_High_Voltage_Energy_Storage_Pack";
BA_ "SystemMessageLongSymbol" BO_ 2566073344 "VDMA_F32C_High_Voltage_Energy_Storage_Pack";
BA_ "SystemMessageLongSymbol" BO_ 2566073600 "VDMA_F32D_High_Voltage_Energy_Storage_Pack";
BA_ "SystemMessageLongSymbol" BO_ 2566073856 "VDMA_F32E_High_Voltage_Energy_Storage_Pack";
BA_ "SystemMessageLongSymbol" BO_ 2566074112 "VDMA_F32F_High_Voltage_Energy_Storage_Pack";
BA_ "SystemMessageLongSymbol" BO_ 2566074368 "VDMA_F330_High_Voltage_Energy_Storage_Pack";
BA_ "SystemMessageLongSymbol" BO_ 2566074624 "VDMA_F331_High_Voltage_Energy_Storage_Pack";
BA_ "SystemMessageLongSymbol" BO_ 2566074880 "VDMA_F332_High_Voltage_Energy_Storage_Pack";
BA_ "SystemMessageLongSymbol" BO_ 2566075136 "VDMA_F333_High_Voltage_Energy_Storage_Pack";
BA_ "SystemMessageLongSymbol" BO_ 2566075392 "VDMA_F334_High_Voltage_Energy_Storage_Pack";
BA_ "SystemMessageLongSymbol" BO_ 2566075648 "VDMA_F335_High_Voltage_Energy_Storage_Pack";
BA_ "SystemMessageLongSymbol" BO_ 2566075904 "VDMA_F336_High_Voltage_Energy_Storage_Pack";
BA_ "SystemMessageLongSymbol" BO_ 2566076160 "VDMA_F337_High_Voltage_Energy_Storage_Pack";
BA_ "SystemMessageLongSymbol" BO_ 2566076416 "VDMA_F338_High_Voltage_Energy_Storage_Pack";
BA_ "SystemMessageLongSymbol" BO_ 2566076672 "VDMA_F339_High_Voltage_Energy_Storage_Pack";
BA_ "SystemMessageLongSymbol" BO_ 2566076928 "VDMA_F33A_High_Voltage_Energy_Storage_Pack";
BA_ "SystemMessageLongSymbol" BO_ 2566077184 "VDMA_F33B_High_Voltage_Energy_Storage_Pack";
BA_ "SystemMessageLongSymbol" BO_ 2566077440 "VDMA_F33C_High_Voltage_Energy_Storage_Pack";
BA_ "SystemMessageLongSymbol" BO_ 2566077696 "VDMA_F33D_High_Voltage_Energy_Storage_Pack";
BA_ "SystemMessageLongSymbol" BO_ 2566077952 "VDMA_F33E_High_Voltage_Energy_Storage_Pack";
BA_ "SystemMessageLongSymbol" BO_ 2566078208 "VDMA_F33F_High_Voltage_Energy_Storage_Pack";
BA_ "SystemMessageLongSymbol" BO_ 2566078464 "VDMA_F340_High_Voltage_Energy_Storage_Pack";
BA_ "SystemMessageLongSymbol" BO_ 2566078720 "VDMA_F341_External_Steering_Request";
BA_ "SystemMessageLongSymbol" BO_ 2566078976 "VDMA_F342_Active_Steering_System_Controlle";
BA_ "SystemMessageLongSymbol" BO_ 2566079232 "VDMA_F343_Electronic_Park_Brake_Controller";
BA_ "SystemMessageLongSymbol" BO_ 2566079488 "VDMA_F344_Electronic_Park_Brake_Controller";
BA_ "SystemMessageLongSymbol" BO_ 2566079744 "VDMA_F345_Genset_Frequency_Limitation";
BA_ "SystemMessageLongSymbol" BO_ 2566080000 "VDMA_F346_Genset_Power_Limitation";
BA_ "SystemMessageLongSymbol" BO_ 2566080256 "VDMA_F347_Genset_Real_Power_Control";
BA_ "SystemMessageLongSymbol" BO_ 2566080768 "VDMA_F349_Fuel_Cell_Compartment_Informatio";
BA_ "SystemMessageLongSymbol" BO_ 2566081024 "VDMA_F34A_Genset_Real_Power_Setpoint_Deman";
BA_ "SystemMessageLongSymbol" BO_ 2566081280 "VDMA_F34B_Genset_Real_Power_Control_2";
BA_ "SystemMessageLongSymbol" BO_ 2566081536 "VDMA_F34C_High_Voltage_Energy_Storage_Pack";
BA_ "SystemMessageLongSymbol" BO_ 2566081792 "VDMA_F34D_High_Voltage_Energy_Storage_Pack";
BA_ "SystemMessageLongSymbol" BO_ 2566082048 "VDMA_F34E_High_Voltage_Energy_Storage_Pack";
BA_ "SystemMessageLongSymbol" BO_ 2566082304 "VDMA_F34F_High_Voltage_Energy_Storage_Pack";
BA_ "SystemMessageLongSymbol" BO_ 2566082560 "VDMA_F350_High_Voltage_Energy_Storage_Pack";
BA_ "SystemMessageLongSymbol" BO_ 2566082816 "VDMA_F351_High_Voltage_Energy_Storage_Pack";
BA_ "SystemMessageLongSymbol" BO_ 2566083072 "VDMA_F352_High_Voltage_Energy_Storage_Pack";
BA_ "SystemMessageLongSymbol" BO_ 2566083328 "VDMA_F353_High_Voltage_Energy_Storage_Pack";
BA_ "SystemMessageLongSymbol" BO_ 2566083584 "VDMA_F354_High_Voltage_Energy_Storage_Pack";
BA_ "SystemMessageLongSymbol" BO_ 2566083840 "VDMA_F355_High_Voltage_Energy_Storage_Pack";
BA_ "SystemMessageLongSymbol" BO_ 2566084096 "VDMA_F356_High_Voltage_Energy_Storage_Pack";
BA_ "SystemMessageLongSymbol" BO_ 2566084352 "VDMA_F357_High_Voltage_Energy_Storage_Pack";
BA_ "SystemMessageLongSymbol" BO_ 2566084608 "VDMA_F358_High_Voltage_Energy_Storage_Pack";
BA_ "SystemMessageLongSymbol" BO_ 2566084864 "VDMA_F359_High_Voltage_Energy_Storage_Pack";
BA_ "SystemMessageLongSymbol" BO_ 2566085120 "VDMA_F35A_High_Voltage_Energy_Storage_Pack";
BA_ "SystemMessageLongSymbol" BO_ 2566085376 "VDMA_F35B_High_Voltage_Energy_Storage_Pack";
BA_ "SystemMessageLongSymbol" BO_ 2566085632 "VDMA_F35C_High_Voltage_Energy_Storage_Pack";
BA_ "SystemMessageLongSymbol" BO_ 2566085888 "VDMA_F35D_High_Voltage_Energy_Storage_Pack";
BA_ "SystemMessageLongSymbol" BO_ 2566086144 "VDMA_F35E_High_Voltage_Energy_Storage_Pack";
BA_ "SystemMessageLongSymbol" BO_ 2566086400 "VDMA_F35F_High_Voltage_Energy_Storage_Pack";
BA_ "SystemMessageLongSymbol" BO_ 2566086656 "VDMA_F360_High_Voltage_Energy_Storage_Pack";
BA_ "SystemMessageLongSymbol" BO_ 2566086912 "VDMA_F361_High_Voltage_Energy_Storage_Pack";
BA_ "SystemMessageLongSymbol" BO_ 2566087168 "VDMA_F362_High_Voltage_Energy_Storage_Pack";
BA_ "SystemMessageLongSymbol" BO_ 2566087424 "VDMA_F363_High_Voltage_Energy_Storage_Pack";
BA_ "SystemMessageLongSymbol" BO_ 2566087936 "VDMA_F365_Electrified_Accessory_Propulsion";
BA_ "SystemMessageLongSymbol" BO_ 2566088192 "VDMA_F366_Electrified_Accessory_Propulsion";
BA_ "SystemMessageLongSymbol" BO_ 2566088448 "VDMA_F367_Electrified_Accessory_Propulsion";
BA_ "SystemMessageLongSymbol" BO_ 2566088704 "VDMA_F368_Electrified_Accessory_Power_Elec";
BA_ "SystemMessageLongSymbol" BO_ 2566088960 "VDMA_F369_Electrified_Accessory_Power_Elec";
BA_ "SystemMessageLongSymbol" BO_ 2566089216 "VDMA_F36A_Electrified_Accessory_Power_Elec";
BA_ "SystemMessageLongSymbol" BO_ 2566089472 "VDMA_F36B_Electrified_Accessory_Propulsion";
BA_ "SystemMessageLongSymbol" BO_ 2566089728 "VDMA_F36C_Electrified_Accessory_Propulsion";
BA_ "SystemMessageLongSymbol" BO_ 2566089984 "VDMA_F36D_Electrified_Accessory_Power_Elec";
BA_ "SystemMessageLongSymbol" BO_ 2566090240 "VDMA_F36E_Electrified_Accessory_Generator_";
BA_ "SystemMessageLongSymbol" BO_ 2566090496 "VDMA_F36F_Electrified_Accessory_Generator_";
BA_ "SystemMessageLongSymbol" BO_ 2566090752 "VDMA_F370_Electrified_Accessory_Motor_Stat";
BA_ "SystemMessageLongSymbol" BO_ 2566091008 "VDMA_F371_Fuel_Cell_System_Controller_Info";
BA_ "SystemMessageLongSymbol" BO_ 2566091264 "VDMA_F372_Fuel_Cell_System_Minimum_Power_I";
BA_ "SystemMessageLongSymbol" BO_ 2566091520 "VDMA_F373_Fuel_Cell_System_Maximum_Power_I";
BA_ "SystemMessageLongSymbol" BO_ 2566091776 "VDMA_F374_Fuel_Cell_System_Minimum_Current";
BA_ "SystemMessageLongSymbol" BO_ 2566092032 "VDMA_F375_Fuel_Cell_System_Maximum_Current";
BA_ "SystemMessageLongSymbol" BO_ 2566092288 "VDMA_F376_Hydrogen_Storage_System_Informat";
