VERSION "created by canmatrix"

NS_ :

BS_:

BU_:

BA_DEF_ BO_ "SystemMessageLongSymbol" STRING;
BA_DEF_ SG_ "GenSigStartValue" FLOAT 0 100000000000;
BA_DEF_ SG_ "SystemSignalLongSymbol" STRING;

VERSION "created by canmatrix"

NS_ :

BS_:

BU_:

BA_DEF_ BO_ "SystemMessageLongSymbol" STRING;
BA_DEF_ SG_ "GenSigStartValue" FLOAT 0 100000000000;
BA_DEF_ SG_ "SystemSignalLongSymbol" STRING;

VERSION "created by canmatrix"

NS_ :

BS_:

BU_:

BO_ 2566601472 VDMA_FB3B_Motor_Generator_5_Inve: 8 Vector__XXX
 SG_ Motor_Generator_5_Inverter_Isola : 0|64@1+ (1,0) [0|18446744073709551615] "" Vector__XXX

BO_ 2566601728 VDMA_FB3C_Motor_Generator_5_Inve: 8 Vector__XXX
 SG_ Motor_Generator_5_Inverter_Activ : 0|64@1+ (1,0) [0|18446744073709551615] "" Vector__XXX

BO_ 2566601984 VDMA_FB3D_Motor_Generator_4_Inve: 8 Vector__XXX
 SG_ Motor_Generator_4_Inverter_Refer : 0|64@1+ (1,0) [0|18446744073709551615] "" Vector__XXX

BO_ 2566602240 VDMA_FB3E_Motor_Generator_4_Inve: 8 Vector__XXX
 SG_ Motor_Generator_4_Inverter_Statu : 0|64@1+ (1,0) [0|18446744073709551615] "" Vector__XXX

BO_ 2566602496 VDMA_FB3F_Motor_Generator_4_Inve: 8 Vector__XXX
 SG_ Motor_Generator_4_Inverter_Refer : 0|64@1+ (1,0) [0|18446744073709551615] "" Vector__XXX

BO_ 2566602752 VDMA_FB40_Motor_Generator_4_Inve: 8 Vector__XXX
 SG_ Motor_Generator_4_Inverter_Tempe : 0|64@1+ (1,0) [0|18446744073709551615] "" Vector__XXX

BO_ 2566603008 VDMA_FB41_Motor_Generator_4_Inve: 8 Vector__XXX
 SG_ Motor_Generator_4_Inverter_Motor : 0|64@1+ (1,0) [0|18446744073709551615] "" Vector__XXX

BO_ 2566603264 VDMA_FB42_Motor_Generator_4_Inve: 8 Vector__XXX
 SG_ Motor_Generator_4_Inverter_Isola : 0|64@1+ (1,0) [0|18446744073709551615] "" Vector__XXX

BO_ 2566603520 VDMA_FB43_Motor_Generator_4_Inve: 8 Vector__XXX
 SG_ Motor_Generator_4_Inverter_Activ : 0|64@1+ (1,0) [0|18446744073709551615] "" Vector__XXX

BO_ 2566603776 VDMA_FB44_Motor_Generator_3_Inve: 8 Vector__XXX
 SG_ Motor_Generator_3_Inverter_Refer : 0|64@1+ (1,0) [0|18446744073709551615] "" Vector__XXX

BO_ 2566604032 VDMA_FB45_Motor_Generator_3_Inve: 8 Vector__XXX
 SG_ Motor_Generator_3_Inverter_Statu : 0|64@1+ (1,0) [0|18446744073709551615] "" Vector__XXX

BO_ 2566604288 VDMA_FB46_Motor_Generator_3_Inve: 8 Vector__XXX
 SG_ Motor_Generator_3_Inverter_Refer : 0|64@1+ (1,0) [0|18446744073709551615] "" Vector__XXX

BO_ 2566604544 VDMA_FB47_Motor_Generator_3_Inve: 8 Vector__XXX
 SG_ Motor_Generator_3_Inverter_Tempe : 0|64@1+ (1,0) [0|18446744073709551615] "" Vector__XXX

BO_ 2566604800 VDMA_FB48_Motor_Generator_3_Inve: 8 Vector__XXX
 SG_ Motor_Generator_3_Inverter_Motor : 0|64@1+ (1,0) [0|18446744073709551615] "" Vector__XXX

BO_ 2566605056 VDMA_FB49_Motor_Generator_3_Inve: 8 Vector__XXX
 SG_ Motor_Generator_3_Inverter_Isola : 0|64@1+ (1,0) [0|18446744073709551615] "" Vector__XXX

BO_ 2566605312 VDMA_FB4A_Motor_Generator_3_Inve: 8 Vector__XXX
 SG_ Motor_Generator_3_Inverter_Activ : 0|64@1+ (1,0) [0|18446744073709551615] "" Vector__XXX

BO_ 2566605568 VDMA_FB4B_Automated_Driving_Syst: 8 Vector__XXX
 SG_ Automated_Driving_System_Status_ : 0|64@1+ (1,0) [0|18446744073709551615] "" Vector__XXX

BO_ 2566605824 VDMA_FB4C_Cab_Climate_System_Inf: 8 Vector__XXX
 SG_ Cab_Climate_System_Information_2 : 0|64@1+ (1,0) [0|18446744073709551615] "" Vector__XXX

BO_ 2566606080 VDMA_FB4D_Maintenance_Informatio: 8 Vector__XXX
 SG_ Maintenance_Information_1_RawPay : 0|64@1+ (1,0) [0|18446744073709551615] "" Vector__XXX

BO_ 2566606336 VDMA_FB4E_Hoist_Control_Informat: 8 Vector__XXX
 SG_ Hoist_Control_Information_RawPay : 0|64@1+ (1,0) [0|18446744073709551615] "" Vector__XXX

BO_ 2566606592 VDMA_FB4F_High_Voltage_Energy_St: 8 Vector__XXX
 SG_ High_Voltage_Energy_Storage_Pack : 0|64@1+ (1,0) [0|18446744073709551615] "" Vector__XXX

BO_ 2566606848 VDMA_FB50_High_Voltage_Energy_St: 8 Vector__XXX
 SG_ High_Voltage_Energy_Storage_Pack : 0|64@1+ (1,0) [0|18446744073709551615] "" Vector__XXX

BO_ 2566607104 VDMA_FB51_High_Voltage_Energy_St: 8 Vector__XXX
 SG_ High_Voltage_Energy_Storage_Pack : 0|64@1+ (1,0) [0|18446744073709551615] "" Vector__XXX

BO_ 2566607360 VDMA_FB52_High_Voltage_Energy_St: 8 Vector__XXX
 SG_ High_Voltage_Energy_Storage_Pack : 0|64@1+ (1,0) [0|18446744073709551615] "" Vector__XXX

BO_ 2566607616 VDMA_FB53_High_Voltage_Energy_St: 8 Vector__XXX
 SG_ High_Voltage_Energy_Storage_Pack : 0|64@1+ (1,0) [0|18446744073709551615] "" Vector__XXX

BO_ 2566607872 VDMA_FB54_High_Voltage_Energy_St: 8 Vector__XXX
 SG_ High_Voltage_Energy_Storage_Pack : 0|64@1+ (1,0) [0|18446744073709551615] "" Vector__XXX

BO_ 2566608128 VDMA_FB55_High_Voltage_Energy_St: 8 Vector__XXX
 SG_ High_Voltage_Energy_Storage_Pack : 0|64@1+ (1,0) [0|18446744073709551615] "" Vector__XXX

BO_ 2566608384 VDMA_FB56_High_Voltage_Energy_St: 8 Vector__XXX
 SG_ High_Voltage_Energy_Storage_Pack : 0|64@1+ (1,0) [0|18446744073709551615] "" Vector__XXX

BO_ 2566608640 VDMA_FB57_High_Voltage_Energy_St: 8 Vector__XXX
 SG_ High_Voltage_Energy_Storage_Pack : 0|64@1+ (1,0) [0|18446744073709551615] "" Vector__XXX

BO_ 2566608896 VDMA_FB58_High_Voltage_Energy_St: 8 Vector__XXX
 SG_ High_Voltage_Energy_Storage_Pack : 0|64@1+ (1,0) [0|18446744073709551615] "" Vector__XXX

BO_ 2566609152 VDMA_FB59_High_Voltage_Energy_St: 8 Vector__XXX
 SG_ High_Voltage_Energy_Storage_Pack : 0|64@1+ (1,0) [0|18446744073709551615] "" Vector__XXX

BO_ 2566609408 VDMA_FB5A_High_Voltage_Energy_St: 8 Vector__XXX
 SG_ High_Voltage_Energy_Storage_Pack : 0|64@1+ (1,0) [0|18446744073709551615] "" Vector__XXX

BO_ 2566609664 VDMA_FB5B_Vehicle_Fire_Suppressi: 8 Vector__XXX
 SG_ Vehicle_Fire_Suppression_System_ : 0|64@1+ (1,0) [0|18446744073709551615] "" Vector__XXX

BO_ 2566609920 VDMA_FB5C_Vehicle_Fire_Suppressi: 8 Vector__XXX
 SG_ Vehicle_Fire_Suppression_System_ : 0|64@1+ (1,0) [0|18446744073709551615] "" Vector__XXX

BO_ 2566610176 VDMA_FB5D_Vehicle_Fire_Suppressi: 8 Vector__XXX
 SG_ Vehicle_Fire_Suppression_System_ : 0|64@1+ (1,0) [0|18446744073709551615] "" Vector__XXX

BO_ 2566610432 VDMA_FB5E_Vehicle_Fire_Suppressi: 8 Vector__XXX
 SG_ Vehicle_Fire_Suppression_System_ : 0|64@1+ (1,0) [0|18446744073709551615] "" Vector__XXX

BO_ 2566610688 VDMA_FB5F_Vehicle_Fire_Suppressi: 8 Vector__XXX
 SG_ Vehicle_Fire_Suppression_System_ : 0|64@1+ (1,0) [0|18446744073709551615] "" Vector__XXX

BO_ 2566610944 VDMA_FB60_Vehicle_Fire_Suppressi: 8 Vector__XXX
 SG_ Vehicle_Fire_Suppression_System_ : 0|64@1+ (1,0) [0|18446744073709551615] "" Vector__XXX

BO_ 2566611200 VDMA_FB61_Vehicle_Fire_Suppressi: 8 Vector__XXX
 SG_ Vehicle_Fire_Suppression_System_ : 0|64@1+ (1,0) [0|18446744073709551615] "" Vector__XXX

BO_ 2566611456 VDMA_FB62_Vehicle_Fire_Suppressi: 8 Vector__XXX
 SG_ Vehicle_Fire_Suppression_System_ : 0|64@1+ (1,0) [0|18446744073709551615] "" Vector__XXX

BO_ 2566611712 VDMA_FB63_Vehicle_Fire_Suppressi: 8 Vector__XXX
 SG_ Vehicle_Fire_Suppression_System_ : 0|64@1+ (1,0) [0|18446744073709551615] "" Vector__XXX

BO_ 2566611968 VDMA_FB64_Vehicle_Fire_Suppressi: 8 Vector__XXX
 SG_ Vehicle_Fire_Suppression_System_ : 0|64@1+ (1,0) [0|18446744073709551615] "" Vector__XXX

BO_ 2566612224 VDMA_FB65_Vehicle_Fire_Suppressi: 8 Vector__XXX
 SG_ Vehicle_Fire_Suppression_System_ : 0|64@1+ (1,0) [0|18446744073709551615] "" Vector__XXX

BO_ 2566612480 VDMA_FB66_Vehicle_Fire_Suppressi: 8 Vector__XXX
 SG_ Vehicle_Fire_Suppression_System_ : 0|64@1+ (1,0) [0|18446744073709551615] "" Vector__XXX

BO_ 2566612736 VDMA_FB67_Motor_Generator_2_Inve: 8 Vector__XXX
 SG_ Motor_Generator_2_Inverter_Activ : 0|64@1+ (1,0) [0|18446744073709551615] "" Vector__XXX

BO_ 2566612992 VDMA_FB68_Motor_Generator_2_Inve: 8 Vector__XXX
 SG_ Motor_Generator_2_Inverter_Isola : 0|64@1+ (1,0) [0|18446744073709551615] "" Vector__XXX

BO_ 2566613248 VDMA_FB69_Motor_Generator_1_Inve: 8 Vector__XXX
 SG_ Motor_Generator_1_Inverter_Activ : 0|64@1+ (1,0) [0|18446744073709551615] "" Vector__XXX

BO_ 2566613504 VDMA_FB6A_Motor_Generator_1_Inve: 8 Vector__XXX
 SG_ Motor_Generator_1_Inverter_Isola : 0|64@1+ (1,0) [0|18446744073709551615] "" Vector__XXX

BO_ 2566613760 VDMA_FB6B_High_Voltage_Bus_Infor: 8 Vector__XXX
 SG_ High_Voltage_Bus_Information_Raw : 0|64@1+ (1,0) [0|18446744073709551615] "" Vector__XXX

BO_ 2566614016 VDMA_FB6C_Motor_Generator_2_Inve: 8 Vector__XXX
 SG_ Motor_Generator_2_Inverter_Refer : 0|64@1+ (1,0) [0|18446744073709551615] "" Vector__XXX

BO_ 2566614272 VDMA_FB6D_Motor_Generator_2_Inve: 8 Vector__XXX
 SG_ Motor_Generator_2_Inverter_Statu : 0|64@1+ (1,0) [0|18446744073709551615] "" Vector__XXX

BO_ 2566614528 VDMA_FB6E_Motor_Generator_2_Inve: 8 Vector__XXX
 SG_ Motor_Generator_2_Inverter_Refer : 0|64@1+ (1,0) [0|18446744073709551615] "" Vector__XXX

BO_ 2566614784 VDMA_FB6F_Motor_Generator_2_Inve: 8 Vector__XXX
 SG_ Motor_Generator_2_Inverter_Tempe : 0|64@1+ (1,0) [0|18446744073709551615] "" Vector__XXX

BO_ 2566615040 VDMA_FB70_Motor_Generator_2_Inve: 8 Vector__XXX
 SG_ Motor_Generator_2_Inverter_Motor : 0|64@1+ (1,0) [0|18446744073709551615] "" Vector__XXX

BO_ 2566615296 VDMA_FB71_Motor_Generator_1_Inve: 8 Vector__XXX
 SG_ Motor_Generator_1_Inverter_Motor : 0|64@1+ (1,0) [0|18446744073709551615] "" Vector__XXX

BO_ 2566615552 VDMA_FB72_Motor_Generator_1_Inve: 8 Vector__XXX
 SG_ Motor_Generator_1_Inverter_Tempe : 0|64@1+ (1,0) [0|18446744073709551615] "" Vector__XXX

BO_ 2566615808 VDMA_FB73_Motor_Generator_1_Inve: 8 Vector__XXX
 SG_ Motor_Generator_1_Inverter_Refer : 0|64@1+ (1,0) [0|18446744073709551615] "" Vector__XXX

BO_ 2566616064 VDMA_FB74_Motor_Generator_1_Inve: 8 Vector__XXX
 SG_ Motor_Generator_1_Inverter_Statu : 0|64@1+ (1,0) [0|18446744073709551615] "" Vector__XXX

BO_ 2566616320 VDMA_FB75_Motor_Generator_1_Inve: 8 Vector__XXX
 SG_ Motor_Generator_1_Inverter_Refer : 0|64@1+ (1,0) [0|18446744073709551615] "" Vector__XXX

BO_ 2566616576 VDMA_FB76_Personnel_Detect_Statu: 8 Vector__XXX
 SG_ Personnel_Detect_Status_RawPaylo : 0|64@1+ (1,0) [0|18446744073709551615] "" Vector__XXX

BO_ 2566616832 VDMA_FB77_Engine_Cylinder_Pressu: 8 Vector__XXX
 SG_ Engine_Cylinder_Pressure_Gamma_1 : 0|64@1+ (1,0) [0|18446744073709551615] "" Vector__XXX

BO_ 2566617088 VDMA_FB78_Engine_Cylinder_Pressu: 8 Vector__XXX
 SG_ Engine_Cylinder_Pressure_Gamma_2 : 0|64@1+ (1,0) [0|18446744073709551615] "" Vector__XXX

BO_ 2566617344 VDMA_FB79_Engine_Cylinder_Pressu: 8 Vector__XXX
 SG_ Engine_Cylinder_Pressure_Gamma_3 : 0|64@1+ (1,0) [0|18446744073709551615] "" Vector__XXX

BO_ 2566617600 VDMA_FB7A_Engine_Cylinder_Pressu: 8 Vector__XXX
 SG_ Engine_Cylinder_Pressure_Gamma_4 : 0|64@1+ (1,0) [0|18446744073709551615] "" Vector__XXX

BO_ 2566617856 VDMA_FB7B_Engine_Cylinder_Pressu: 8 Vector__XXX
 SG_ Engine_Cylinder_Pressure_Gamma_5 : 0|64@1+ (1,0) [0|18446744073709551615] "" Vector__XXX

BO_ 2566618112 VDMA_FB7C_Wake_Up_and_Sleep: 8 Vector__XXX
 SG_ Wake_Up_and_Sleep_RawPayload : 0|64@1+ (1,0) [0|18446744073709551615] "" Vector__XXX

BO_ 2566618368 VDMA_FB7D_Electrified_Accessory_: 8 Vector__XXX
 SG_ Electrified_Accessory_Generator_ : 0|64@1+ (1,0) [0|18446744073709551615] "" Vector__XXX

BO_ 2566618624 VDMA_FB7E_Electrified_Accessory_: 8 Vector__XXX
 SG_ Electrified_Accessory_Generator_ : 0|64@1+ (1,0) [0|18446744073709551615] "" Vector__XXX

BO_ 2566618880 VDMA_FB7F_Well_Stimulation_Pump_: 8 Vector__XXX
 SG_ Well_Stimulation_Pump_System_Fil : 0|64@1+ (1,0) [0|18446744073709551615] "" Vector__XXX

BO_ 2566619136 VDMA_FB80_PTO_Governor_Configura: 8 Vector__XXX
 SG_ PTO_Governor_Configuration_RawPa : 0|64@1+ (1,0) [0|18446744073709551615] "" Vector__XXX

BO_ 2566619392 VDMA_FB81_On_Board_Programming_2: 8 Vector__XXX
 SG_ On_Board_Programming_2_RawPayloa : 0|64@1+ (1,0) [0|18446744073709551615] "" Vector__XXX

BO_ 2566619648 VDMA_FB82_Primary_or_Rear_Hitch_: 8 Vector__XXX
 SG_ Primary_or_Rear_Hitch_Yaw_RawPay : 0|64@1+ (1,0) [0|18446744073709551615] "" Vector__XXX

BO_ 2566619904 VDMA_FB83_Secondary_or_Front_Hit: 8 Vector__XXX
 SG_ Secondary_or_Front_Hitch_Yaw_Raw : 0|64@1+ (1,0) [0|18446744073709551615] "" Vector__XXX

BO_ 2566620160 VDMA_FB84_Operator_Status: 8 Vector__XXX
 SG_ Operator_Status_RawPayload : 0|64@1+ (1,0) [0|18446744073709551615] "" Vector__XXX

BO_ 2566620416 VDMA_FB85_Engine_Idle_Management: 8 Vector__XXX
 SG_ Engine_Idle_Management_Informati : 0|64@1+ (1,0) [0|18446744073709551615] "" Vector__XXX

BO_ 2566620672 VDMA_FB86_Alcohol_Interlock_To_V: 8 Vector__XXX
 SG_ Alcohol_Interlock_To_Vehicle_Raw : 0|64@1+ (1,0) [0|18446744073709551615] "" Vector__XXX

BO_ 2566620928 VDMA_FB87_Vehicle_To_Alcohol_Int: 8 Vector__XXX
 SG_ Vehicle_To_Alcohol_Interlock_Raw : 0|64@1+ (1,0) [0|18446744073709551615] "" Vector__XXX

BO_ 2566621184 VDMA_FB88_Marine_Control_Informa: 8 Vector__XXX
 SG_ Marine_Control_Information_3_Raw : 0|64@1+ (1,0) [0|18446744073709551615] "" Vector__XXX

BO_ 2566621440 VDMA_FB89_Engine_Fluid_Level_Pre: 8 Vector__XXX
 SG_ Engine_Fluid_Level_Pressure_13_R : 0|64@1+ (1,0) [0|18446744073709551615] "" Vector__XXX

BO_ 2566621696 VDMA_FB8A_High_Voltage_Energy_St: 8 Vector__XXX
 SG_ High_Voltage_Energy_Storage_Syst : 0|64@1+ (1,0) [0|18446744073709551615] "" Vector__XXX

BO_ 2566621952 VDMA_FB8B_Economy_Mode_Inactive_: 8 Vector__XXX
 SG_ Economy_Mode_Inactive_Hours_RawP : 0|64@1+ (1,0) [0|18446744073709551615] "" Vector__XXX

BO_ 2566622208 VDMA_FB8C_Economy_Mode_Estimated: 8 Vector__XXX
 SG_ Economy_Mode_Estimated_Instantan : 0|64@1+ (1,0) [0|18446744073709551615] "" Vector__XXX

BO_ 2566622464 VDMA_FB8D_Economy_Mode_Active_Ho: 8 Vector__XXX
 SG_ Economy_Mode_Active_Hours_RawPay : 0|64@1+ (1,0) [0|18446744073709551615] "" Vector__XXX

BO_ 2566622720 VDMA_FB8E_Economy_Mode_Fuel_Used: 8 Vector__XXX
 SG_ Economy_Mode_Fuel_Used_RawPayloa : 0|64@1+ (1,0) [0|18446744073709551615] "" Vector__XXX

BO_ 2566622976 VDMA_FB8F_Economy_Mode_Estimated: 8 Vector__XXX
 SG_ Economy_Mode_Estimated_Fuel_Savi : 0|64@1+ (1,0) [0|18446744073709551615] "" Vector__XXX

BO_ 2566623232 VDMA_FB90_DC_DC_Converter_4_Volt: 8 Vector__XXX
 SG_ DC_DC_Converter_4_Voltage_RawPay : 0|64@1+ (1,0) [0|18446744073709551615] "" Vector__XXX

BO_ 2566623488 VDMA_FB91_DC_DC_Converter_3_Volt: 8 Vector__XXX
 SG_ DC_DC_Converter_3_Voltage_RawPay : 0|64@1+ (1,0) [0|18446744073709551615] "" Vector__XXX

BO_ 2566623744 VDMA_FB92_DC_DC_Converter_2_Volt: 8 Vector__XXX
 SG_ DC_DC_Converter_2_Voltage_RawPay : 0|64@1+ (1,0) [0|18446744073709551615] "" Vector__XXX

BO_ 2566624000 VDMA_FB93_DC_DC_Converter_1_Volt: 8 Vector__XXX
 SG_ DC_DC_Converter_1_Voltage_RawPay : 0|64@1+ (1,0) [0|18446744073709551615] "" Vector__XXX

BO_ 2566624256 VDMA_FB94_Electronic_Engine_Cont: 8 Vector__XXX
 SG_ Electronic_Engine_Controller_22_ : 0|64@1+ (1,0) [0|18446744073709551615] "" Vector__XXX

BO_ 2566624512 VDMA_FB95_Engine_Hours_2: 8 Vector__XXX
 SG_ Engine_Hours_2_RawPayload : 0|64@1+ (1,0) [0|18446744073709551615] "" Vector__XXX

BO_ 2566624768 VDMA_FB96_Engine_Information_3: 8 Vector__XXX
 SG_ Engine_Information_3_RawPayload : 0|64@1+ (1,0) [0|18446744073709551615] "" Vector__XXX

BO_ 2566625024 VDMA_FB97_Vehicle_Electrical_Pow: 8 Vector__XXX
 SG_ Vehicle_Electrical_Power_15_RawP : 0|64@1+ (1,0) [0|18446744073709551615] "" Vector__XXX

BO_ 2566625280 VDMA_FB98_Exhaust_Oxygen_2: 8 Vector__XXX
 SG_ Exhaust_Oxygen_2_RawPayload : 0|64@1+ (1,0) [0|18446744073709551615] "" Vector__XXX

BO_ 2566625536 VDMA_FB99_DC_AC_Accessory_Invert: 8 Vector__XXX
 SG_ DC_AC_Accessory_Inverter_1_Tempe : 0|64@1+ (1,0) [0|18446744073709551615] "" Vector__XXX

BO_ 2566625792 VDMA_FB9A_DC_AC_Accessory_Invert: 8 Vector__XXX
 SG_ DC_AC_Accessory_Inverter_1_DC_Si : 0|64@1+ (1,0) [0|18446744073709551615] "" Vector__XXX

BO_ 2566626048 VDMA_FB9B_DC_AC_Accessory_Invert: 8 Vector__XXX
 SG_ DC_AC_Accessory_Inverter_1_AC_Si : 0|64@1+ (1,0) [0|18446744073709551615] "" Vector__XXX

BO_ 2566626304 VDMA_FB9C_DC_AC_Accessory_Invert: 8 Vector__XXX
 SG_ DC_AC_Accessory_Inverter_1_Confi : 0|64@1+ (1,0) [0|18446744073709551615] "" Vector__XXX

BO_ 2566626560 VDMA_FB9D_DC_AC_Accessory_Invert: 8 Vector__XXX
 SG_ DC_AC_Accessory_Inverter_1_Lifet : 0|64@1+ (1,0) [0|18446744073709551615] "" Vector__XXX

BO_ 2566626816 VDMA_FB9E_DC_AC_Accessory_Invert: 8 Vector__XXX
 SG_ DC_AC_Accessory_Inverter_2_Tempe : 0|64@1+ (1,0) [0|18446744073709551615] "" Vector__XXX

BO_ 2566627072 VDMA_FB9F_DC_AC_Accessory_Invert: 8 Vector__XXX
 SG_ DC_AC_Accessory_Inverter_2_DC_Si : 0|64@1+ (1,0) [0|18446744073709551615] "" Vector__XXX

BO_ 2566627328 VDMA_FBA0_DC_AC_Accessory_Invert: 8 Vector__XXX
 SG_ DC_AC_Accessory_Inverter_2_AC_Si : 0|64@1+ (1,0) [0|18446744073709551615] "" Vector__XXX

BO_ 2566627584 VDMA_FBA1_DC_AC_Accessory_Invert: 8 Vector__XXX
 SG_ DC_AC_Accessory_Inverter_2_Confi : 0|64@1+ (1,0) [0|18446744073709551615] "" Vector__XXX

BO_ 2566627840 VDMA_FBA2_DC_AC_Accessory_Invert: 8 Vector__XXX
 SG_ DC_AC_Accessory_Inverter_2_Lifet : 0|64@1+ (1,0) [0|18446744073709551615] "" Vector__XXX

BO_ 2566628096 VDMA_FBA3_DC_AC_Accessory_Invert: 8 Vector__XXX
 SG_ DC_AC_Accessory_Inverter_3_Tempe : 0|64@1+ (1,0) [0|18446744073709551615] "" Vector__XXX

BO_ 2566628352 VDMA_FBA4_DC_AC_Accessory_Invert: 8 Vector__XXX
 SG_ DC_AC_Accessory_Inverter_3_DC_Si : 0|64@1+ (1,0) [0|18446744073709551615] "" Vector__XXX

BO_ 2566628608 VDMA_FBA5_DC_AC_Accessory_Invert: 8 Vector__XXX
 SG_ DC_AC_Accessory_Inverter_3_AC_Si : 0|64@1+ (1,0) [0|18446744073709551615] "" Vector__XXX

BO_ 2566628864 VDMA_FBA6_DC_AC_Accessory_Invert: 8 Vector__XXX
 SG_ DC_AC_Accessory_Inverter_3_Confi : 0|64@1+ (1,0) [0|18446744073709551615] "" Vector__XXX

BO_ 2566629120 VDMA_FBA7_DC_AC_Accessory_Invert: 8 Vector__XXX
 SG_ DC_AC_Accessory_Inverter_3_Lifet : 0|64@1+ (1,0) [0|18446744073709551615] "" Vector__XXX

BO_ 2566629376 VDMA_FBA8_DC_AC_Accessory_Invert: 8 Vector__XXX
 SG_ DC_AC_Accessory_Inverter_4_Tempe : 0|64@1+ (1,0) [0|18446744073709551615] "" Vector__XXX

BO_ 2566629632 VDMA_FBA9_DC_AC_Accessory_Invert: 8 Vector__XXX
 SG_ DC_AC_Accessory_Inverter_4_DC_Si : 0|64@1+ (1,0) [0|18446744073709551615] "" Vector__XXX

BO_ 2566629888 VDMA_FBAA_DC_AC_Accessory_Invert: 8 Vector__XXX
 SG_ DC_AC_Accessory_Inverter_4_AC_Si : 0|64@1+ (1,0) [0|18446744073709551615] "" Vector__XXX

BO_ 2566630144 VDMA_FBAB_DC_AC_Accessory_Invert: 8 Vector__XXX
 SG_ DC_AC_Accessory_Inverter_4_Confi : 0|64@1+ (1,0) [0|18446744073709551615] "" Vector__XXX

BO_ 2566630400 VDMA_FBAC_DC_AC_Accessory_Invert: 8 Vector__XXX
 SG_ DC_AC_Accessory_Inverter_4_Lifet : 0|64@1+ (1,0) [0|18446744073709551615] "" Vector__XXX

BO_ 2566630656 VDMA_FBAD_DC_AC_Accessory_Invert: 8 Vector__XXX
 SG_ DC_AC_Accessory_Inverter_5_Tempe : 0|64@1+ (1,0) [0|18446744073709551615] "" Vector__XXX

BO_ 2566630912 VDMA_FBAE_DC_AC_Accessory_Invert: 8 Vector__XXX
 SG_ DC_AC_Accessory_Inverter_5_DC_Si : 0|64@1+ (1,0) [0|18446744073709551615] "" Vector__XXX

BO_ 2566631168 VDMA_FBAF_DC_AC_Accessory_Invert: 8 Vector__XXX
 SG_ DC_AC_Accessory_Inverter_5_AC_Si : 0|64@1+ (1,0) [0|18446744073709551615] "" Vector__XXX

BO_ 2566631424 VDMA_FBB0_DC_AC_Accessory_Invert: 8 Vector__XXX
 SG_ DC_AC_Accessory_Inverter_5_Confi : 0|64@1+ (1,0) [0|18446744073709551615] "" Vector__XXX

BO_ 2566631680 VDMA_FBB1_DC_AC_Accessory_Invert: 8 Vector__XXX
 SG_ DC_AC_Accessory_Inverter_5_Lifet : 0|64@1+ (1,0) [0|18446744073709551615] "" Vector__XXX

BO_ 2566631936 VDMA_FBB2_Well_Stimulation_Pump_: 8 Vector__XXX
 SG_ Well_Stimulation_Pump_Sensor_Cal : 0|64@1+ (1,0) [0|18446744073709551615] "" Vector__XXX

BO_ 2566632192 VDMA_FBB3_Well_Stimulation_Pump_: 8 Vector__XXX
 SG_ Well_Stimulation_Pump_Fluid_Volu : 0|64@1+ (1,0) [0|18446744073709551615] "" Vector__XXX

BO_ 2566632448 VDMA_FBB4_Well_Stimulation_Pump_: 8 Vector__XXX
 SG_ Well_Stimulation_Pump_Serial_Num : 0|64@1+ (1,0) [0|18446744073709551615] "" Vector__XXX

BO_ 2566632704 VDMA_FBB5_Well_Stimulation_Pump_: 8 Vector__XXX
 SG_ Well_Stimulation_Pump_Trip_Hours : 0|64@1+ (1,0) [0|18446744073709551615] "" Vector__XXX

BO_ 2566632960 VDMA_FBB6_Aftertreatment_1_Outle: 8 Vector__XXX
 SG_ Aftertreatment_1_Outlet_Gas_4_Ra : 0|64@1+ (1,0) [0|18446744073709551615] "" Vector__XXX

BO_ 2566633216 VDMA_FBB7_Aftertreatment_1_Intak: 8 Vector__XXX
 SG_ Aftertreatment_1_Intake_Gas_4_Ra : 0|64@1+ (1,0) [0|18446744073709551615] "" Vector__XXX

BO_ 2566633472 VDMA_FBB8_DC_DC_Converter_4_Life: 8 Vector__XXX
 SG_ DC_DC_Converter_4_Lifetime_Data_ : 0|64@1+ (1,0) [0|18446744073709551615] "" Vector__XXX

BO_ 2566633728 VDMA_FBB9_DC_DC_Converter_4_Conf: 8 Vector__XXX
 SG_ DC_DC_Converter_4_Configuration_ : 0|64@1+ (1,0) [0|18446744073709551615] "" Vector__XXX

BO_ 2566633984 VDMA_FBBA_DC_DC_Converter_4_SLI_: 8 Vector__XXX
 SG_ DC_DC_Converter_4_SLI_Battery_Li : 0|64@1+ (1,0) [0|18446744073709551615] "" Vector__XXX

BO_ 2566634240 VDMA_FBBB_DC_DC_Converter_4_Temp: 8 Vector__XXX
 SG_ DC_DC_Converter_4_Temperatures_R : 0|64@1+ (1,0) [0|18446744073709551615] "" Vector__XXX

BO_ 2566634496 VDMA_FBBC_DC_DC_Converter_4_Low_: 8 Vector__XXX
 SG_ DC_DC_Converter_4_Low_Side_Limit : 0|64@1+ (1,0) [0|18446744073709551615] "" Vector__XXX

BO_ 2566634752 VDMA_FBBD_DC_DC_Converter_4_High: 8 Vector__XXX
 SG_ DC_DC_Converter_4_High_Side_Limi : 0|64@1+ (1,0) [0|18446744073709551615] "" Vector__XXX

BO_ 2566635008 VDMA_FBBE_DC_DC_Converter_3_Life: 8 Vector__XXX
 SG_ DC_DC_Converter_3_Lifetime_Data_ : 0|64@1+ (1,0) [0|18446744073709551615] "" Vector__XXX

BO_ 2566635264 VDMA_FBBF_DC_DC_Converter_3_Conf: 8 Vector__XXX
 SG_ DC_DC_Converter_3_Configuration_ : 0|64@1+ (1,0) [0|18446744073709551615] "" Vector__XXX

BO_ 2566635520 VDMA_FBC0_DC_DC_Converter_3_SLI_: 8 Vector__XXX
 SG_ DC_DC_Converter_3_SLI_Battery_Li : 0|64@1+ (1,0) [0|18446744073709551615] "" Vector__XXX

BO_ 2566635776 VDMA_FBC1_DC_DC_Converter_3_Temp: 8 Vector__XXX
 SG_ DC_DC_Converter_3_Temperatures_R : 0|64@1+ (1,0) [0|18446744073709551615] "" Vector__XXX

BO_ 2566636032 VDMA_FBC2_DC_DC_Converter_3_Low_: 8 Vector__XXX
 SG_ DC_DC_Converter_3_Low_Side_Limit : 0|64@1+ (1,0) [0|18446744073709551615] "" Vector__XXX

BO_ 2566636288 VDMA_FBC3_DC_DC_Converter_3_High: 8 Vector__XXX
 SG_ DC_DC_Converter_3_High_Side_Limi : 0|64@1+ (1,0) [0|18446744073709551615] "" Vector__XXX

BO_ 2566636544 VDMA_FBC4_DC_DC_Converter_2_Life: 8 Vector__XXX
 SG_ DC_DC_Converter_2_Lifetime_Data_ : 0|64@1+ (1,0) [0|18446744073709551615] "" Vector__XXX

BO_ 2566636800 VDMA_FBC5_DC_DC_Converter_2_Conf: 8 Vector__XXX
 SG_ DC_DC_Converter_2_Configuration_ : 0|64@1+ (1,0) [0|18446744073709551615] "" Vector__XXX

BO_ 2566637056 VDMA_FBC6_DC_DC_Converter_2_SLI_: 8 Vector__XXX
 SG_ DC_DC_Converter_2_SLI_Battery_Li : 0|64@1+ (1,0) [0|18446744073709551615] "" Vector__XXX

BO_ 2566637312 VDMA_FBC7_DC_DC_Converter_2_Temp: 8 Vector__XXX
 SG_ DC_DC_Converter_2_Temperatures_R : 0|64@1+ (1,0) [0|18446744073709551615] "" Vector__XXX

BO_ 2566637568 VDMA_FBC8_DC_DC_Converter_2_Low_: 8 Vector__XXX
 SG_ DC_DC_Converter_2_Low_Side_Limit : 0|64@1+ (1,0) [0|18446744073709551615] "" Vector__XXX

BO_ 2566637824 VDMA_FBC9_DC_DC_Converter_2_High: 8 Vector__XXX
 SG_ DC_DC_Converter_2_High_Side_Limi : 0|64@1+ (1,0) [0|18446744073709551615] "" Vector__XXX

BO_ 2566638080 VDMA_FBCA_CiA_602_2_AUTOSAR_CAN_: 8 Vector__XXX
 SG_ CiA_602_2_AUTOSAR_CAN_NM_Obsolet : 0|64@1+ (1,0) [0|18446744073709551615] "" Vector__XXX

BO_ 2566638336 VDMA_FBCB_Engine_Exhaust_Particu: 8 Vector__XXX
 SG_ Engine_Exhaust_Particulate_Contr : 0|64@1+ (1,0) [0|18446744073709551615] "" Vector__XXX

BO_ 2566638592 VDMA_FBCC_Well_Stimulation_Pump_: 8 Vector__XXX
 SG_ Well_Stimulation_Pump_Hours_RawP : 0|64@1+ (1,0) [0|18446744073709551615] "" Vector__XXX

BO_ 2566638848 VDMA_FBCD_Well_Stimulation_Pump_: 8 Vector__XXX
 SG_ Well_Stimulation_Pump_System_Con : 0|64@1+ (1,0) [0|18446744073709551615] "" Vector__XXX

BO_ 2566639104 VDMA_FBCE_Configurable_Receive_S: 8 Vector__XXX
 SG_ Configurable_Receive_SPNs_Status : 0|64@1+ (1,0) [0|18446744073709551615] "" Vector__XXX

BO_ 2566639360 VDMA_FBCF_DC_DC_Converter_1_Life: 8 Vector__XXX
 SG_ DC_DC_Converter_1_Lifetime_Data_ : 0|64@1+ (1,0) [0|18446744073709551615] "" Vector__XXX

BO_ 2566639616 VDMA_FBD0_DC_DC_Converter_1_Conf: 8 Vector__XXX
 SG_ DC_DC_Converter_1_Configuration_ : 0|64@1+ (1,0) [0|18446744073709551615] "" Vector__XXX

BO_ 2566639872 VDMA_FBD1_DC_DC_Converter_1_SLI_: 8 Vector__XXX
 SG_ DC_DC_Converter_1_SLI_Battery_Li : 0|64@1+ (1,0) [0|18446744073709551615] "" Vector__XXX

BO_ 2566640128 VDMA_FBD2_Pump_Oil_Message: 8 Vector__XXX
 SG_ Pump_Oil_Message_RawPayload : 0|64@1+ (1,0) [0|18446744073709551615] "" Vector__XXX

BO_ 2566640384 VDMA_FBD3_Well_Stimulation_Pump_: 8 Vector__XXX
 SG_ Well_Stimulation_Pump_System_Lif : 0|64@1+ (1,0) [0|18446744073709551615] "" Vector__XXX

BO_ 2566640640 VDMA_FBD4_Well_Stimulation_Pump_: 8 Vector__XXX
 SG_ Well_Stimulation_Pump_System_Con : 0|64@1+ (1,0) [0|18446744073709551615] "" Vector__XXX

BO_ 2566640896 VDMA_FBD5_Aftercooler_and_Oil_Co: 8 Vector__XXX
 SG_ Aftercooler_and_Oil_Cooler_Fluid : 0|64@1+ (1,0) [0|18446744073709551615] "" Vector__XXX

BO_ 2566641152 VDMA_FBD6_Electronic_Engine_Cont: 8 Vector__XXX
 SG_ Electronic_Engine_Controller_21_ : 0|64@1+ (1,0) [0|18446744073709551615] "" Vector__XXX

BO_ 2566641408 VDMA_FBD7_Configurable_Transmit_: 8 Vector__XXX
 SG_ Configurable_Transmit_PGNs_Statu : 0|64@1+ (1,0) [0|18446744073709551615] "" Vector__XXX

BO_ 2566641664 VDMA_FBD8_DC_DC_Converter_1_Temp: 8 Vector__XXX
 SG_ DC_DC_Converter_1_Temperatures_R : 0|64@1+ (1,0) [0|18446744073709551615] "" Vector__XXX

BO_ 2566641920 VDMA_FBD9_DC_DC_Converter_1_Low_: 8 Vector__XXX
 SG_ DC_DC_Converter_1_Low_Side_Limit : 0|64@1+ (1,0) [0|18446744073709551615] "" Vector__XXX

BO_ 2566642176 VDMA_FBDA_DC_DC_Converter_1_High: 8 Vector__XXX
 SG_ DC_DC_Converter_1_High_Side_Limi : 0|64@1+ (1,0) [0|18446744073709551615] "" Vector__XXX

BO_ 2566642688 VDMA_FBDC_Door_Control_4: 8 Vector__XXX
 SG_ Door_Control_4_RawPayload : 0|64@1+ (1,0) [0|18446744073709551615] "" Vector__XXX

BO_ 2566642944 VDMA_FBDD_Door_Control_3: 8 Vector__XXX
 SG_ Door_Control_3_RawPayload : 0|64@1+ (1,0) [0|18446744073709551615] "" Vector__XXX

BO_ 2566643200 VDMA_FBDE_Engine_Temperature_6: 8 Vector__XXX
 SG_ Engine_Temperature_6_RawPayload : 0|64@1+ (1,0) [0|18446744073709551615] "" Vector__XXX

BO_ 2566643456 VDMA_FBDF_Intake_Exhaust_Conditi: 8 Vector__XXX
 SG_ Intake_Exhaust_Conditions_3_RawP : 0|64@1+ (1,0) [0|18446744073709551615] "" Vector__XXX

BO_ 2566643712 VDMA_FBE0_Aftercooler_and_Oil_Co: 8 Vector__XXX
 SG_ Aftercooler_and_Oil_Cooler_Fluid : 0|64@1+ (1,0) [0|18446744073709551615] "" Vector__XXX

BO_ 2566643968 VDMA_FBE1_Diode_Temperature_2: 8 Vector__XXX
 SG_ Diode_Temperature_2_RawPayload : 0|64@1+ (1,0) [0|18446744073709551615] "" Vector__XXX

BO_ 2566644224 VDMA_FBE2_Diode_Temperature_1: 8 Vector__XXX
 SG_ Diode_Temperature_1_RawPayload : 0|64@1+ (1,0) [0|18446744073709551615] "" Vector__XXX

BO_ 2566644480 VDMA_FBE3_Alternator_Temperature: 8 Vector__XXX
 SG_ Alternator_Temperature_2_RawPayl : 0|64@1+ (1,0) [0|18446744073709551615] "" Vector__XXX

BO_ 2566644736 VDMA_FBE4_Fuel_Information_7_Gas: 8 Vector__XXX
 SG_ Fuel_Information_7_Gaseous_RawPa : 0|64@1+ (1,0) [0|18446744073709551615] "" Vector__XXX

BO_ 2566644992 VDMA_FBE5_High_Voltage_Energy_St: 8 Vector__XXX
 SG_ High_Voltage_Energy_Storage_Syst : 0|64@1+ (1,0) [0|18446744073709551615] "" Vector__XXX

BO_ 2566645248 VDMA_FBE6_High_Voltage_Energy_St: 8 Vector__XXX
 SG_ High_Voltage_Energy_Storage_Syst : 0|64@1+ (1,0) [0|18446744073709551615] "" Vector__XXX

BO_ 2566645504 VDMA_FBE7_SCR_Operator_Inducemen: 8 Vector__XXX
 SG_ SCR_Operator_Inducement_Informat : 0|64@1+ (1,0) [0|18446744073709551615] "" Vector__XXX

BO_ 2566645760 VDMA_FBE8_Aftertreatment_System_: 8 Vector__XXX
 SG_ Aftertreatment_System_Informatio : 0|64@1+ (1,0) [0|18446744073709551615] "" Vector__XXX

BO_ 2566646016 VDMA_FBE9_Ethernet_1_Connection_: 8 Vector__XXX
 SG_ Ethernet_1_Connection_Informatio : 0|64@1+ (1,0) [0|18446744073709551615] "" Vector__XXX

BO_ 2566646272 VDMA_FBEA_Ethernet_1_Connection_: 8 Vector__XXX
 SG_ Ethernet_1_Connection_Informatio : 0|64@1+ (1,0) [0|18446744073709551615] "" Vector__XXX

BO_ 2566646528 VDMA_FBEB_Oil_Debris_Monitor_Cou: 8 Vector__XXX
 SG_ Oil_Debris_Monitor_Counts_Ferrou : 0|64@1+ (1,0) [0|18446744073709551615] "" Vector__XXX

BO_ 2566646784 VDMA_FBEC_Oil_Debris_Monitor_Cou: 8 Vector__XXX
 SG_ Oil_Debris_Monitor_Counts_Ferrou : 0|64@1+ (1,0) [0|18446744073709551615] "" Vector__XXX

BO_ 2566647040 VDMA_FBED_Oil_Debris_Monitor_Cou: 8 Vector__XXX
 SG_ Oil_Debris_Monitor_Counts_Ferrou : 0|64@1+ (1,0) [0|18446744073709551615] "" Vector__XXX

BO_ 2566647296 VDMA_FBEE_Oil_Debris_Monitor_Cou: 8 Vector__XXX
 SG_ Oil_Debris_Monitor_Counts_Non_Fe : 0|64@1+ (1,0) [0|18446744073709551615] "" Vector__XXX

BO_ 2566647552 VDMA_FBEF_Oil_Debris_Monitor_Cou: 8 Vector__XXX
 SG_ Oil_Debris_Monitor_Counts_Non_Fe : 0|64@1+ (1,0) [0|18446744073709551615] "" Vector__XXX

BO_ 2566647808 VDMA_FBF0_Oil_Debris_Monitor_Cou: 8 Vector__XXX
 SG_ Oil_Debris_Monitor_Counts_Non_Fe : 0|64@1+ (1,0) [0|18446744073709551615] "" Vector__XXX

BO_ 2566648064 VDMA_FBF1_Oil_Debris_Monitoring_: 8 Vector__XXX
 SG_ Oil_Debris_Monitoring_System_Sta : 0|64@1+ (1,0) [0|18446744073709551615] "" Vector__XXX

BO_ 2566648320 VDMA_FBF2_Engine_Fuel_Lube_Syste: 8 Vector__XXX
 SG_ Engine_Fuel_Lube_Systems_3_RawPa : 0|64@1+ (1,0) [0|18446744073709551615] "" Vector__XXX

BO_ 2566648576 VDMA_FBF3_Cruise_Control_Vehicle: 8 Vector__XXX
 SG_ Cruise_Control_Vehicle_Speed_5_R : 0|64@1+ (1,0) [0|18446744073709551615] "" Vector__XXX

BO_ 2566648832 VDMA_FBF4_Aftertreatment_2_Diese: 8 Vector__XXX
 SG_ Aftertreatment_2_Diesel_Oxidatio : 0|64@1+ (1,0) [0|18446744073709551615] "" Vector__XXX

BO_ 2566649088 VDMA_FBF5_Aftertreatment_1_Diese: 8 Vector__XXX
 SG_ Aftertreatment_1_Diesel_Oxidatio : 0|64@1+ (1,0) [0|18446744073709551615] "" Vector__XXX

BO_ 2566649344 VDMA_FBF6_Vehicle_Position_2: 8 Vector__XXX
 SG_ Vehicle_Position_2_RawPayload : 0|64@1+ (1,0) [0|18446744073709551615] "" Vector__XXX

BO_ 2566649600 VDMA_FBF7_Electrified_Accessory_: 8 Vector__XXX
 SG_ Electrified_Accessory_Propulsion : 0|64@1+ (1,0) [0|18446744073709551615] "" Vector__XXX

BO_ 2566649856 VDMA_FBF8_Electrified_Accessory_: 8 Vector__XXX
 SG_ Electrified_Accessory_Propulsion : 0|64@1+ (1,0) [0|18446744073709551615] "" Vector__XXX

BO_ 2566650112 VDMA_FBF9_Electrified_Accessory_: 8 Vector__XXX
 SG_ Electrified_Accessory_Propulsion : 0|64@1+ (1,0) [0|18446744073709551615] "" Vector__XXX

BO_ 2566650368 VDMA_FBFA_Electrified_Accessory_: 8 Vector__XXX
 SG_ Electrified_Accessory_Power_Elec : 0|64@1+ (1,0) [0|18446744073709551615] "" Vector__XXX

BO_ 2566650624 VDMA_FBFB_Electrified_Accessory_: 8 Vector__XXX
 SG_ Electrified_Accessory_Power_Elec : 0|64@1+ (1,0) [0|18446744073709551615] "" Vector__XXX

BO_ 2566650880 VDMA_FBFC_Electrified_Accessory_: 8 Vector__XXX
 SG_ Electrified_Accessory_Power_Elec : 0|64@1+ (1,0) [0|18446744073709551615] "" Vector__XXX

BO_ 2566651136 VDMA_FBFD_Electrified_Accessory_: 8 Vector__XXX
 SG_ Electrified_Accessory_Propulsion : 0|64@1+ (1,0) [0|18446744073709551615] "" Vector__XXX

BO_ 2566651392 VDMA_FBFE_Electrified_Accessory_: 8 Vector__XXX
 SG_ Electrified_Accessory_Propulsion : 0|64@1+ (1,0) [0|18446744073709551615] "" Vector__XXX

BO_ 2566651648 VDMA_FBFF_Electrified_Accessory_: 8 Vector__XXX
 SG_ Electrified_Accessory_Power_Elec : 0|64@1+ (1,0) [0|18446744073709551615] "" Vector__XXX

BO_ 2566651904 VDMA_FC00_Trailer_Wheel_Brake_We: 8 Vector__XXX
 SG_ Trailer_Wheel_Brake_Wear_Life_Re : 0|64@1+ (1,0) [0|18446744073709551615] "" Vector__XXX

BO_ 2566652160 VDMA_FC01_Electrified_Accessory_: 8 Vector__XXX
 SG_ Electrified_Accessory_Motor_Stat : 0|64@1+ (1,0) [0|18446744073709551615] "" Vector__XXX

BO_ 2566652416 VDMA_FC02_SCR_System_Information: 8 Vector__XXX
 SG_ SCR_System_Information_RawPayloa : 0|64@1+ (1,0) [0|18446744073709551615] "" Vector__XXX

BO_ 2566652672 VDMA_FC03_Vehicle_Electrical_Pow: 8 Vector__XXX
 SG_ Vehicle_Electrical_Power_14_RawP : 0|64@1+ (1,0) [0|18446744073709551615] "" Vector__XXX

BO_ 2566652928 VDMA_FC04_Vehicle_Electrical_Pow: 8 Vector__XXX
 SG_ Vehicle_Electrical_Power_13_RawP : 0|64@1+ (1,0) [0|18446744073709551615] "" Vector__XXX

BO_ 2566653184 VDMA_FC05_Vehicle_Electrical_Pow: 8 Vector__XXX
 SG_ Vehicle_Electrical_Power_12_RawP : 0|64@1+ (1,0) [0|18446744073709551615] "" Vector__XXX

BO_ 2566653440 VDMA_FC06_Vehicle_Electrical_Pow: 8 Vector__XXX
 SG_ Vehicle_Electrical_Power_11_RawP : 0|64@1+ (1,0) [0|18446744073709551615] "" Vector__XXX

BO_ 2566653696 VDMA_FC07_Vehicle_Electrical_Pow: 8 Vector__XXX
 SG_ Vehicle_Electrical_Power_10_RawP : 0|64@1+ (1,0) [0|18446744073709551615] "" Vector__XXX

BO_ 2566653952 VDMA_FC08_Vehicle_Electrical_Pow: 8 Vector__XXX
 SG_ Vehicle_Electrical_Power_9_RawPa : 0|64@1+ (1,0) [0|18446744073709551615] "" Vector__XXX

BO_ 2566654208 VDMA_FC09_Vehicle_Electrical_Pow: 8 Vector__XXX
 SG_ Vehicle_Electrical_Power_8_RawPa : 0|64@1+ (1,0) [0|18446744073709551615] "" Vector__XXX

BO_ 2566654464 VDMA_FC0A_Vehicle_Electrical_Pow: 8 Vector__XXX
 SG_ Vehicle_Electrical_Power_7_RawPa : 0|64@1+ (1,0) [0|18446744073709551615] "" Vector__XXX

BO_ 2566654720 VDMA_FC0B_Electronic_Engine_Cont: 8 Vector__XXX
 SG_ Electronic_Engine_Controller_20_ : 0|64@1+ (1,0) [0|18446744073709551615] "" Vector__XXX

BO_ 2566654976 VDMA_FC0C_Evaporative_Systems: 8 Vector__XXX
 SG_ Evaporative_Systems_RawPayload : 0|64@1+ (1,0) [0|18446744073709551615] "" Vector__XXX

BO_ 2566655232 VDMA_FC0D_Fire_Pump_Statistics_1: 8 Vector__XXX
 SG_ Fire_Pump_Statistics_1_RawPayloa : 0|64@1+ (1,0) [0|18446744073709551615] "" Vector__XXX

BO_ 2566655488 VDMA_FC0E_Primary_or_Rear_Hitch_: 8 Vector__XXX
 SG_ Primary_or_Rear_Hitch_Roll_and_P : 0|64@1+ (1,0) [0|18446744073709551615] "" Vector__XXX

BO_ 2566655744 VDMA_FC0F_Secondary_or_Front_Hit: 8 Vector__XXX
 SG_ Secondary_or_Front_Hitch_Roll_an : 0|64@1+ (1,0) [0|18446744073709551615] "" Vector__XXX

BO_ 2566656000 VDMA_FC10_Ambient_Conditions_3: 8 Vector__XXX
 SG_ Ambient_Conditions_3_RawPayload : 0|64@1+ (1,0) [0|18446744073709551615] "" Vector__XXX

BO_ 2566656256 VDMA_FC11_Total_Gaseous_Fuel_Inf: 8 Vector__XXX
 SG_ Total_Gaseous_Fuel_Information_R : 0|64@1+ (1,0) [0|18446744073709551615] "" Vector__XXX

BO_ 2566656512 VDMA_FC12_Cab_Door_Control_1: 8 Vector__XXX
 SG_ Cab_Door_Control_1_RawPayload : 0|64@1+ (1,0) [0|18446744073709551615] "" Vector__XXX

BO_ 2566656768 VDMA_FC13_Door_Latch_Status: 8 Vector__XXX
 SG_ Door_Latch_Status_RawPayload : 0|64@1+ (1,0) [0|18446744073709551615] "" Vector__XXX

BO_ 2566657024 VDMA_FC14_Vehicle_Electrical_Pow: 8 Vector__XXX
 SG_ Vehicle_Electrical_Power_3_obsol : 0|64@1+ (1,0) [0|18446744073709551615] "" Vector__XXX

BO_ 2566657280 VDMA_FC15_Vehicle_Electrical_Pow: 8 Vector__XXX
 SG_ Vehicle_Electrical_Power_6_RawPa : 0|64@1+ (1,0) [0|18446744073709551615] "" Vector__XXX

BO_ 2566657536 VDMA_FC16_Payload_Temperature_2: 8 Vector__XXX
 SG_ Payload_Temperature_2_RawPayload : 0|64@1+ (1,0) [0|18446744073709551615] "" Vector__XXX

BO_ 2566657792 VDMA_FC17_Payload_Temperature_1: 8 Vector__XXX
 SG_ Payload_Temperature_1_RawPayload : 0|64@1+ (1,0) [0|18446744073709551615] "" Vector__XXX

BO_ 2566658048 VDMA_FC18_Payload_System_Totals_: 8 Vector__XXX
 SG_ Payload_System_Totals_2_RawPaylo : 0|64@1+ (1,0) [0|18446744073709551615] "" Vector__XXX

BO_ 2566658304 VDMA_FC19_Payload_System_Totals_: 8 Vector__XXX
 SG_ Payload_System_Totals_1_RawPaylo : 0|64@1+ (1,0) [0|18446744073709551615] "" Vector__XXX

BO_ 2566658560 VDMA_FC1A_HVESS_Thermal_Manageme: 8 Vector__XXX
 SG_ HVESS_Thermal_Management_System_ : 0|64@1+ (1,0) [0|18446744073709551615] "" Vector__XXX

BO_ 2566658816 VDMA_FC1B_HVESS_Thermal_Manageme: 8 Vector__XXX
 SG_ HVESS_Thermal_Management_System_ : 0|64@1+ (1,0) [0|18446744073709551615] "" Vector__XXX

BO_ 2566659072 VDMA_FC1C_Refrigeration_Compartm: 8 Vector__XXX
 SG_ Refrigeration_Compartment_Inform : 0|64@1+ (1,0) [0|18446744073709551615] "" Vector__XXX

BO_ 2566659328 VDMA_FC1D_Refrigeration_Compartm: 8 Vector__XXX
 SG_ Refrigeration_Compartment_Inform : 0|64@1+ (1,0) [0|18446744073709551615] "" Vector__XXX

BO_ 2566659584 VDMA_FC1E_Vehicle_Electrical_Pow: 8 Vector__XXX
 SG_ Vehicle_Electrical_Power_16_RawP : 0|64@1+ (1,0) [0|18446744073709551615] "" Vector__XXX

BO_ 2566659840 VDMA_FC1F_Vehicle_Electrical_Pow: 8 Vector__XXX
 SG_ Vehicle_Electrical_Power_17_RawP : 0|64@1+ (1,0) [0|18446744073709551615] "" Vector__XXX

BO_ 2566660096 VDMA_FC20_High_Voltage_Energy_St: 8 Vector__XXX
 SG_ High_Voltage_Energy_Storage_Syst : 0|64@1+ (1,0) [0|18446744073709551615] "" Vector__XXX

BO_ 2566660352 VDMA_FC21_High_Voltage_Energy_St: 8 Vector__XXX
 SG_ High_Voltage_Energy_Storage_Syst : 0|64@1+ (1,0) [0|18446744073709551615] "" Vector__XXX

BO_ 2566660608 VDMA_FC22_Electronic_Engine_Cont: 8 Vector__XXX
 SG_ Electronic_Engine_Controller_19_ : 0|64@1+ (1,0) [0|18446744073709551615] "" Vector__XXX

BO_ 2566660864 VDMA_FC23_Fuel_Consumption_Liqui: 8 Vector__XXX
 SG_ Fuel_Consumption_Liquid_2_RawPay : 0|64@1+ (1,0) [0|18446744073709551615] "" Vector__XXX

BO_ 2566661120 VDMA_FC24_Aftertreatment_2_Diese: 8 Vector__XXX
 SG_ Aftertreatment_2_Diesel_Exhaust_ : 0|64@1+ (1,0) [0|18446744073709551615] "" Vector__XXX

BO_ 2566661376 VDMA_FC25_Aftertreatment_1_Diese: 8 Vector__XXX
 SG_ Aftertreatment_1_Diesel_Exhaust_ : 0|64@1+ (1,0) [0|18446744073709551615] "" Vector__XXX

BO_ 2566661632 VDMA_FC26_Aftertreatment_2_Diese: 8 Vector__XXX
 SG_ Aftertreatment_2_Diesel_Exhaust_ : 0|64@1+ (1,0) [0|18446744073709551615] "" Vector__XXX

BO_ 2566661888 VDMA_FC27_Aftertreatment_1_Diese: 8 Vector__XXX
 SG_ Aftertreatment_1_Diesel_Exhaust_ : 0|64@1+ (1,0) [0|18446744073709551615] "" Vector__XXX

BO_ 2566662144 VDMA_FC28_Cruise_Control_Vehicle: 8 Vector__XXX
 SG_ Cruise_Control_Vehicle_Speed_6_R : 0|64@1+ (1,0) [0|18446744073709551615] "" Vector__XXX

BO_ 2566662400 VDMA_FC29_Forward_Lane_Image_3: 8 Vector__XXX
 SG_ Forward_Lane_Image_3_RawPayload : 0|64@1+ (1,0) [0|18446744073709551615] "" Vector__XXX

BO_ 2566662656 VDMA_FC2A_Operator_Inducement_In: 8 Vector__XXX
 SG_ Operator_Inducement_Information_ : 0|64@1+ (1,0) [0|18446744073709551615] "" Vector__XXX

BO_ 2566662912 VDMA_FC2B_Cruise_Control_Vehicle: 8 Vector__XXX
 SG_ Cruise_Control_Vehicle_Speed_4_R : 0|64@1+ (1,0) [0|18446744073709551615] "" Vector__XXX

BO_ 2566663168 VDMA_FC2C_Brake_Caliper_Lining_C: 8 Vector__XXX
 SG_ Brake_Caliper_Lining_Clearance_R : 0|64@1+ (1,0) [0|18446744073709551615] "" Vector__XXX

BO_ 2566663424 VDMA_FC2D_Alternate_Fuel_5: 8 Vector__XXX
 SG_ Alternate_Fuel_5_RawPayload : 0|64@1+ (1,0) [0|18446744073709551615] "" Vector__XXX

BO_ 2566663680 VDMA_FC2E_Engine_Turbocharger_Co: 8 Vector__XXX
 SG_ Engine_Turbocharger_Control_3_Ra : 0|64@1+ (1,0) [0|18446744073709551615] "" Vector__XXX

BO_ 2566663936 VDMA_FC2F_Fire_Suppression_Agent: 8 Vector__XXX
 SG_ Fire_Suppression_Agent_Status_Ra : 0|64@1+ (1,0) [0|18446744073709551615] "" Vector__XXX

BO_ 2566664192 VDMA_FC30_SCR_Operator_Inducemen: 8 Vector__XXX
 SG_ SCR_Operator_Inducement_Informat : 0|64@1+ (1,0) [0|18446744073709551615] "" Vector__XXX

BO_ 2566664448 VDMA_FC31_Aftertreatment_System_: 8 Vector__XXX
 SG_ Aftertreatment_System_Informatio : 0|64@1+ (1,0) [0|18446744073709551615] "" Vector__XXX

BO_ 2566664704 VDMA_FC32_Aftertreatment_1_Parti: 8 Vector__XXX
 SG_ Aftertreatment_1_Particulate_Sen : 0|64@1+ (1,0) [0|18446744073709551615] "" Vector__XXX

BO_ 2566664960 VDMA_FC33_Engine_Fuel_Injector_M: 8 Vector__XXX
 SG_ Engine_Fuel_Injector_Metering_Ra : 0|64@1+ (1,0) [0|18446744073709551615] "" Vector__XXX

BO_ 2566665216 VDMA_FC34_Engine_Fuel_Injector_M: 8 Vector__XXX
 SG_ Engine_Fuel_Injector_Metering_Ra : 0|64@1+ (1,0) [0|18446744073709551615] "" Vector__XXX

BO_ 2566665472 VDMA_FC35_Aftertreatment_2_Diese: 8 Vector__XXX
 SG_ Aftertreatment_2_Diesel_Exhaust_ : 0|64@1+ (1,0) [0|18446744073709551615] "" Vector__XXX

BO_ 2566665728 VDMA_FC36_Gaseous_Fuel_Supply_Va: 8 Vector__XXX
 SG_ Gaseous_Fuel_Supply_Valve_Inform : 0|64@1+ (1,0) [0|18446744073709551615] "" Vector__XXX

BO_ 2566665984 VDMA_FC37_Engine_Oil_Mist_Detect: 8 Vector__XXX
 SG_ Engine_Oil_Mist_Detection_Inform : 0|64@1+ (1,0) [0|18446744073709551615] "" Vector__XXX

BO_ 2566666240 VDMA_FC38_Engine_Oil_Mist_Detect: 8 Vector__XXX
 SG_ Engine_Oil_Mist_Detection_Inform : 0|64@1+ (1,0) [0|18446744073709551615] "" Vector__XXX

BO_ 2566666496 VDMA_FC39_Gaseous_Fuel_Supply_Pr: 8 Vector__XXX
 SG_ Gaseous_Fuel_Supply_Pressure_2_R : 0|64@1+ (1,0) [0|18446744073709551615] "" Vector__XXX

BO_ 2566666752 VDMA_FC3A_Gaseous_Fuel_Supply_Pr: 8 Vector__XXX
 SG_ Gaseous_Fuel_Supply_Pressure_1_R : 0|64@1+ (1,0) [0|18446744073709551615] "" Vector__XXX

BO_ 2566667008 VDMA_FC3B_Engine_End_Bearing_Tem: 8 Vector__XXX
 SG_ Engine_End_Bearing_Temperature_3 : 0|64@1+ (1,0) [0|18446744073709551615] "" Vector__XXX

BO_ 2566667264 VDMA_FC3C_Engine_End_Bearing_Tem: 8 Vector__XXX
 SG_ Engine_End_Bearing_Temperature_2 : 0|64@1+ (1,0) [0|18446744073709551615] "" Vector__XXX

BO_ 2566667520 VDMA_FC3D_Engine_End_Bearing_Tem: 8 Vector__XXX
 SG_ Engine_End_Bearing_Temperature_1 : 0|64@1+ (1,0) [0|18446744073709551615] "" Vector__XXX

BO_ 2566667776 VDMA_FC3E_Heat_Exchanger_Debris_: 8 Vector__XXX
 SG_ Heat_Exchanger_Debris_Purge_Info : 0|64@1+ (1,0) [0|18446744073709551615] "" Vector__XXX

BO_ 2566668032 VDMA_FC3F_Engine_Turbocharger_Co: 8 Vector__XXX
 SG_ Engine_Turbocharger_Control_2_Ra : 0|64@1+ (1,0) [0|18446744073709551615] "" Vector__XXX

BO_ 2566668288 VDMA_FC40_Engine_Hydraulic_Fuel_: 8 Vector__XXX
 SG_ Engine_Hydraulic_Fuel_2_Pump_Sta : 0|64@1+ (1,0) [0|18446744073709551615] "" Vector__XXX

BO_ 2566668544 VDMA_FC41_Alternate_Fuel_4: 8 Vector__XXX
 SG_ Alternate_Fuel_4_RawPayload : 0|64@1+ (1,0) [0|18446744073709551615] "" Vector__XXX

BO_ 2566668800 VDMA_FC42_Tire_Condition_Message: 8 Vector__XXX
 SG_ Tire_Condition_Message_2_RawPayl : 0|64@1+ (1,0) [0|18446744073709551615] "" Vector__XXX

BO_ 2566669056 VDMA_FC43_Tire_Configuration_Sta: 8 Vector__XXX
 SG_ Tire_Configuration_Status_Inform : 0|64@1+ (1,0) [0|18446744073709551615] "" Vector__XXX

BO_ 2566669312 VDMA_FC44_High_Voltage_Energy_St: 8 Vector__XXX
 SG_ High_Voltage_Energy_Storage_Syst : 0|64@1+ (1,0) [0|18446744073709551615] "" Vector__XXX

BO_ 2566669568 VDMA_FC45_Tire_Wireless_Signal_S: 8 Vector__XXX
 SG_ Tire_Wireless_Signal_Strength_In : 0|64@1+ (1,0) [0|18446744073709551615] "" Vector__XXX

BO_ 2566669824 VDMA_FC46_Tire_Sensor_Identifica: 8 Vector__XXX
 SG_ Tire_Sensor_Identification_Statu : 0|64@1+ (1,0) [0|18446744073709551615] "" Vector__XXX

BO_ 2566670080 VDMA_FC47_Monitored_Tire_Informa: 8 Vector__XXX
 SG_ Monitored_Tire_Information_RawPa : 0|64@1+ (1,0) [0|18446744073709551615] "" Vector__XXX

BO_ 2566670336 VDMA_FC48_Aftertreatment_2_Histo: 8 Vector__XXX
 SG_ Aftertreatment_2_Historical_Info : 0|64@1+ (1,0) [0|18446744073709551615] "" Vector__XXX

BO_ 2566670592 VDMA_FC49_Aftertreatment_1_Histo: 8 Vector__XXX
 SG_ Aftertreatment_1_Historical_Info : 0|64@1+ (1,0) [0|18446744073709551615] "" Vector__XXX

BO_ 2566670848 VDMA_FC4A_SCR_System_Cleaning: 8 Vector__XXX
 SG_ SCR_System_Cleaning_RawPayload : 0|64@1+ (1,0) [0|18446744073709551615] "" Vector__XXX

BO_ 2566671104 VDMA_FC4B_Electronic_Engine_Cont: 8 Vector__XXX
 SG_ Electronic_Engine_Controller_17_ : 0|64@1+ (1,0) [0|18446744073709551615] "" Vector__XXX

BO_ 2566671360 VDMA_FC4C_SCR_Operator_Inducemen: 8 Vector__XXX
 SG_ SCR_Operator_Inducement_Informat : 0|64@1+ (1,0) [0|18446744073709551615] "" Vector__XXX

BO_ 2566671616 VDMA_FC4D_Aftertreatment_2_SCR_D: 8 Vector__XXX
 SG_ Aftertreatment_2_SCR_Dosing_Syst : 0|64@1+ (1,0) [0|18446744073709551615] "" Vector__XXX

BO_ 2566671872 VDMA_FC4E_Aftertreatment_1_SCR_D: 8 Vector__XXX
 SG_ Aftertreatment_1_SCR_Dosing_Syst : 0|64@1+ (1,0) [0|18446744073709551615] "" Vector__XXX

BO_ 2566672128 VDMA_FC4F_Payload_Weight_Sensor_: 8 Vector__XXX
 SG_ Payload_Weight_Sensor_Informatio : 0|64@1+ (1,0) [0|18446744073709551615] "" Vector__XXX

BO_ 2566672384 VDMA_FC50_Payload_System_Status: 8 Vector__XXX
 SG_ Payload_System_Status_RawPayload : 0|64@1+ (1,0) [0|18446744073709551615] "" Vector__XXX

BO_ 2566672640 VDMA_FC51_Air_Suspension_Control: 8 Vector__XXX
 SG_ Air_Suspension_Control_7_RawPayl : 0|64@1+ (1,0) [0|18446744073709551615] "" Vector__XXX

BO_ 2566672896 VDMA_FC52_Bin_Weight_and_Lift_Co: 8 Vector__XXX
 SG_ Bin_Weight_and_Lift_Count_RawPay : 0|64@1+ (1,0) [0|18446744073709551615] "" Vector__XXX

BO_ 2566673152 VDMA_FC53_Engine_Gaseous_Leakage: 8 Vector__XXX
 SG_ Engine_Gaseous_Leakage_Informati : 0|64@1+ (1,0) [0|18446744073709551615] "" Vector__XXX

BO_ 2566673408 VDMA_FC54_Driving_and_Rest_Times: 8 Vector__XXX
 SG_ Driving_and_Rest_Times_Driver_2_ : 0|64@1+ (1,0) [0|18446744073709551615] "" Vector__XXX

BO_ 2566673664 VDMA_FC55_Driving_and_Rest_Times: 8 Vector__XXX
 SG_ Driving_and_Rest_Times_Driver_1_ : 0|64@1+ (1,0) [0|18446744073709551615] "" Vector__XXX

BO_ 2566673920 VDMA_FC56_SCR_Operator_Inducemen: 8 Vector__XXX
 SG_ SCR_Operator_Inducement_Informat : 0|64@1+ (1,0) [0|18446744073709551615] "" Vector__XXX

BO_ 2566674176 VDMA_FC57_SCR_Operator_Inducemen: 8 Vector__XXX
 SG_ SCR_Operator_Inducement_Informat : 0|64@1+ (1,0) [0|18446744073709551615] "" Vector__XXX

BO_ 2566674432 VDMA_FC58_Turbocharger_Informati: 8 Vector__XXX
 SG_ Turbocharger_Information_7_RawPa : 0|64@1+ (1,0) [0|18446744073709551615] "" Vector__XXX

BO_ 2566674688 VDMA_FC59_Engine_Load_Sharing_In: 8 Vector__XXX
 SG_ Engine_Load_Sharing_Information_ : 0|64@1+ (1,0) [0|18446744073709551615] "" Vector__XXX

BO_ 2566674944 VDMA_FC5A_Synchronized_Service_D: 8 Vector__XXX
 SG_ Synchronized_Service_Distance_In : 0|64@1+ (1,0) [0|18446744073709551615] "" Vector__XXX

BO_ 2566675200 VDMA_FC5B_Synchronized_Service_D: 8 Vector__XXX
 SG_ Synchronized_Service_Delay_Opera : 0|64@1+ (1,0) [0|18446744073709551615] "" Vector__XXX

BO_ 2566675456 VDMA_FC5C_Synchronized_Service_D: 8 Vector__XXX
 SG_ Synchronized_Service_Delay_Calen : 0|64@1+ (1,0) [0|18446744073709551615] "" Vector__XXX

BO_ 2566675712 VDMA_FC5D_High_Voltage_Energy_St: 8 Vector__XXX
 SG_ High_Voltage_Energy_Storage_Syst : 0|64@1+ (1,0) [0|18446744073709551615] "" Vector__XXX

BO_ 2566675968 VDMA_FC5E_High_Voltage_Energy_St: 8 Vector__XXX
 SG_ High_Voltage_Energy_Storage_Syst : 0|64@1+ (1,0) [0|18446744073709551615] "" Vector__XXX

BO_ 2566676224 VDMA_FC5F_Encoder_Position: 8 Vector__XXX
 SG_ Encoder_Position_RawPayload : 0|64@1+ (1,0) [0|18446744073709551615] "" Vector__XXX

BO_ 2566676480 VDMA_FC60_Encoder_High_Resolutio: 8 Vector__XXX
 SG_ Encoder_High_Resolution_Position : 0|64@1+ (1,0) [0|18446744073709551615] "" Vector__XXX

BO_ 2566676736 VDMA_FC61_Encoder_Speed: 8 Vector__XXX
 SG_ Encoder_Speed_RawPayload : 0|64@1+ (1,0) [0|18446744073709551615] "" Vector__XXX

BO_ 2566676992 VDMA_FC62_Encoder_Acceleration: 8 Vector__XXX
 SG_ Encoder_Acceleration_RawPayload : 0|64@1+ (1,0) [0|18446744073709551615] "" Vector__XXX

BO_ 2566677248 VDMA_FC63_Encoder_Position_with_: 8 Vector__XXX
 SG_ Encoder_Position_with_Speed_and_ : 0|64@1+ (1,0) [0|18446744073709551615] "" Vector__XXX

BO_ 2566677504 VDMA_FC64_Inclinometer_Slope_Lon: 8 Vector__XXX
 SG_ Inclinometer_Slope_Longitudinal_ : 0|64@1+ (1,0) [0|18446744073709551615] "" Vector__XXX

BO_ 2566677760 VDMA_FC65_Inclinometer_Slope_Lon: 8 Vector__XXX
 SG_ Inclinometer_Slope_Longitudinal_ : 0|64@1+ (1,0) [0|18446744073709551615] "" Vector__XXX

BO_ 2566678016 VDMA_FC66_Inclinometer_Slope_Lat: 8 Vector__XXX
 SG_ Inclinometer_Slope_Lateral_16_bi : 0|64@1+ (1,0) [0|18446744073709551615] "" Vector__XXX

BO_ 2566678272 VDMA_FC67_Inclinometer_Slope_Lat: 8 Vector__XXX
 SG_ Inclinometer_Slope_Lateral_32_bi : 0|64@1+ (1,0) [0|18446744073709551615] "" Vector__XXX

BO_ 2566678528 VDMA_FC68_CANopen_Emergency_Mess: 8 Vector__XXX
 SG_ CANopen_Emergency_Message_RawPay : 0|64@1+ (1,0) [0|18446744073709551615] "" Vector__XXX

BO_ 2566678784 VDMA_FC69_EV_Operator_Indicators: 8 Vector__XXX
 SG_ EV_Operator_Indicators_1_RawPayl : 0|64@1+ (1,0) [0|18446744073709551615] "" Vector__XXX

BO_ 2566679040 VDMA_FC6A_System_Identification: 8 Vector__XXX
 SG_ System_Identification_RawPayload : 0|64@1+ (1,0) [0|18446744073709551615] "" Vector__XXX

BO_ 2566679296 VDMA_FC6B_Engine_Maximum_Net_Tor: 8 Vector__XXX
 SG_ Engine_Maximum_Net_Torque_Map_ob : 0|64@1+ (1,0) [0|18446744073709551615] "" Vector__XXX

BO_ 2566679552 VDMA_FC6C_Alarm: 8 Vector__XXX
 SG_ Alarm_RawPayload : 0|64@1+ (1,0) [0|18446744073709551615] "" Vector__XXX

BO_ 2566679808 VDMA_FC6D_Acoustic_Warning_Reque: 8 Vector__XXX
 SG_ Acoustic_Warning_Request_RawPayl : 0|64@1+ (1,0) [0|18446744073709551615] "" Vector__XXX

BO_ 2566680064 VDMA_FC6E_Acoustic_Warning_State: 8 Vector__XXX
 SG_ Acoustic_Warning_State_RawPayloa : 0|64@1+ (1,0) [0|18446744073709551615] "" Vector__XXX

BO_ 2566680320 VDMA_FC6F_Vehicle_Load: 8 Vector__XXX
 SG_ Vehicle_Load_RawPayload : 0|64@1+ (1,0) [0|18446744073709551615] "" Vector__XXX

BO_ 2566680576 VDMA_FC70_Body_Application_Unit_: 8 Vector__XXX
 SG_ Body_Application_Unit_1_RawPaylo : 0|64@1+ (1,0) [0|18446744073709551615] "" Vector__XXX

BO_ 2566680832 VDMA_FC71_Body_Application_Unit_: 8 Vector__XXX
 SG_ Body_Application_Unit_2_RawPaylo : 0|64@1+ (1,0) [0|18446744073709551615] "" Vector__XXX

BO_ 2566681088 VDMA_FC72_Body_Application_Unit_: 8 Vector__XXX
 SG_ Body_Application_Unit_3_RawPaylo : 0|64@1+ (1,0) [0|18446744073709551615] "" Vector__XXX

BO_ 2566681344 VDMA_FC73_Body_Application_Unit_: 8 Vector__XXX
 SG_ Body_Application_Unit_4_RawPaylo : 0|64@1+ (1,0) [0|18446744073709551615] "" Vector__XXX

BO_ 2566681600 VDMA_FC74_Body_Application_Unit_: 8 Vector__XXX
 SG_ Body_Application_Unit_5_RawPaylo : 0|64@1+ (1,0) [0|18446744073709551615] "" Vector__XXX

BO_ 2566681856 VDMA_FC75_Body_Application_Unit_: 8 Vector__XXX
 SG_ Body_Application_Unit_6_RawPaylo : 0|64@1+ (1,0) [0|18446744073709551615] "" Vector__XXX

BO_ 2566682112 VDMA_FC76_Body_Application_Unit_: 8 Vector__XXX
 SG_ Body_Application_Unit_7_RawPaylo : 0|64@1+ (1,0) [0|18446744073709551615] "" Vector__XXX

BO_ 2566682368 VDMA_FC77_Body_Application_Unit_: 8 Vector__XXX
 SG_ Body_Application_Unit_8_RawPaylo : 0|64@1+ (1,0) [0|18446744073709551615] "" Vector__XXX

BO_ 2566682624 VDMA_FC78_Electronic_Control_Uni: 8 Vector__XXX
 SG_ Electronic_Control_Unit_RawPaylo : 0|64@1+ (1,0) [0|18446744073709551615] "" Vector__XXX

BO_ 2566682880 VDMA_FC79_ECU_Power_Supply: 8 Vector__XXX
 SG_ ECU_Power_Supply_RawPayload : 0|64@1+ (1,0) [0|18446744073709551615] "" Vector__XXX

BO_ 2566683136 VDMA_FC7A_ECU_Temperature: 8 Vector__XXX
 SG_ ECU_Temperature_RawPayload : 0|64@1+ (1,0) [0|18446744073709551615] "" Vector__XXX

BO_ 2566683392 VDMA_FC7B_Error: 8 Vector__XXX
 SG_ Error_RawPayload : 0|64@1+ (1,0) [0|18446744073709551615] "" Vector__XXX

BO_ 2566683648 VDMA_FC7C_Heating_And_Refrigerat: 8 Vector__XXX
 SG_ Heating_And_Refrigerating_Unit_1 : 0|64@1+ (1,0) [0|18446744073709551615] "" Vector__XXX

CM_ BO_ 2566601472  "Source: isobus.net VDMA Data Dictionary (https://www.isobus.net/isobus/pGNAndSPN/11205?type=PGN)";
CM_ BO_ 2566601728  "Source: isobus.net VDMA Data Dictionary (https://www.isobus.net/isobus/pGNAndSPN/11224?type=PGN)";
CM_ BO_ 2566601984  "Source: isobus.net VDMA Data Dictionary (https://www.isobus.net/isobus/pGNAndSPN/11229?type=PGN)";
CM_ BO_ 2566602240  "Source: isobus.net VDMA Data Dictionary (https://www.isobus.net/isobus/pGNAndSPN/11235?type=PGN)";
CM_ BO_ 2566602496  "Source: isobus.net VDMA Data Dictionary (https://www.isobus.net/isobus/pGNAndSPN/11239?type=PGN)";
CM_ BO_ 2566602752  "Source: isobus.net VDMA Data Dictionary (https://www.isobus.net/isobus/pGNAndSPN/11244?type=PGN)";
CM_ BO_ 2566603008  "Source: isobus.net VDMA Data Dictionary (https://www.isobus.net/isobus/pGNAndSPN/11248?type=PGN)";
CM_ BO_ 2566603264  "Source: isobus.net VDMA Data Dictionary (https://www.isobus.net/isobus/pGNAndSPN/11255?type=PGN)";
CM_ BO_ 2566603520  "Source: isobus.net VDMA Data Dictionary (https://www.isobus.net/isobus/pGNAndSPN/11274?type=PGN)";
CM_ BO_ 2566603776  "Source: isobus.net VDMA Data Dictionary (https://www.isobus.net/isobus/pGNAndSPN/11279?type=PGN)";
CM_ BO_ 2566604032  "Source: isobus.net VDMA Data Dictionary (https://www.isobus.net/isobus/pGNAndSPN/11285?type=PGN)";
CM_ BO_ 2566604288  "Source: isobus.net VDMA Data Dictionary (https://www.isobus.net/isobus/pGNAndSPN/11289?type=PGN)";
CM_ BO_ 2566604544  "Source: isobus.net VDMA Data Dictionary (https://www.isobus.net/isobus/pGNAndSPN/11294?type=PGN)";
CM_ BO_ 2566604800  "Source: isobus.net VDMA Data Dictionary (https://www.isobus.net/isobus/pGNAndSPN/11298?type=PGN)";
CM_ BO_ 2566605056  "Source: isobus.net VDMA Data Dictionary (https://www.isobus.net/isobus/pGNAndSPN/11305?type=PGN)";
CM_ BO_ 2566605312  "Source: isobus.net VDMA Data Dictionary (https://www.isobus.net/isobus/pGNAndSPN/11324?type=PGN)";
CM_ BO_ 2566605568  "Source: isobus.net VDMA Data Dictionary (https://www.isobus.net/isobus/pGNAndSPN/11333?type=PGN)";
CM_ BO_ 2566605824  "Source: isobus.net VDMA Data Dictionary (https://www.isobus.net/isobus/pGNAndSPN/11335?type=PGN)";
CM_ BO_ 2566606080  "Source: isobus.net VDMA Data Dictionary (https://www.isobus.net/isobus/pGNAndSPN/11343?type=PGN)";
CM_ BO_ 2566606336  "Source: isobus.net VDMA Data Dictionary (https://www.isobus.net/isobus/pGNAndSPN/11345?type=PGN)";
CM_ BO_ 2566606592  "Source: isobus.net VDMA Data Dictionary (https://www.isobus.net/isobus/pGNAndSPN/11351?type=PGN)";
CM_ BO_ 2566606848  "Source: isobus.net VDMA Data Dictionary (https://www.isobus.net/isobus/pGNAndSPN/11361?type=PGN)";
CM_ BO_ 2566607104  "Source: isobus.net VDMA Data Dictionary (https://www.isobus.net/isobus/pGNAndSPN/11367?type=PGN)";
CM_ BO_ 2566607360  "Source: isobus.net VDMA Data Dictionary (https://www.isobus.net/isobus/pGNAndSPN/11377?type=PGN)";
CM_ BO_ 2566607616  "Source: isobus.net VDMA Data Dictionary (https://www.isobus.net/isobus/pGNAndSPN/11383?type=PGN)";
CM_ BO_ 2566607872  "Source: isobus.net VDMA Data Dictionary (https://www.isobus.net/isobus/pGNAndSPN/11393?type=PGN)";
CM_ BO_ 2566608128  "Source: isobus.net VDMA Data Dictionary (https://www.isobus.net/isobus/pGNAndSPN/11399?type=PGN)";
CM_ BO_ 2566608384  "Source: isobus.net VDMA Data Dictionary (https://www.isobus.net/isobus/pGNAndSPN/11409?type=PGN)";
CM_ BO_ 2566608640  "Source: isobus.net VDMA Data Dictionary (https://www.isobus.net/isobus/pGNAndSPN/11415?type=PGN)";
CM_ BO_ 2566608896  "Source: isobus.net VDMA Data Dictionary (https://www.isobus.net/isobus/pGNAndSPN/11425?type=PGN)";
CM_ BO_ 2566609152  "Source: isobus.net VDMA Data Dictionary (https://www.isobus.net/isobus/pGNAndSPN/11431?type=PGN)";
CM_ BO_ 2566609408  "Source: isobus.net VDMA Data Dictionary (https://www.isobus.net/isobus/pGNAndSPN/11441?type=PGN)";
CM_ BO_ 2566609664  "Source: isobus.net VDMA Data Dictionary (https://www.isobus.net/isobus/pGNAndSPN/11465?type=PGN)";
CM_ BO_ 2566609920  "Source: isobus.net VDMA Data Dictionary (https://www.isobus.net/isobus/pGNAndSPN/11489?type=PGN)";
CM_ BO_ 2566610176  "Source: isobus.net VDMA Data Dictionary (https://www.isobus.net/isobus/pGNAndSPN/11513?type=PGN)";
CM_ BO_ 2566610432  "Source: isobus.net VDMA Data Dictionary (https://www.isobus.net/isobus/pGNAndSPN/11537?type=PGN)";
CM_ BO_ 2566610688  "Source: isobus.net VDMA Data Dictionary (https://www.isobus.net/isobus/pGNAndSPN/11545?type=PGN)";
CM_ BO_ 2566610944  "Source: isobus.net VDMA Data Dictionary (https://www.isobus.net/isobus/pGNAndSPN/11553?type=PGN)";
CM_ BO_ 2566611200  "Source: isobus.net VDMA Data Dictionary (https://www.isobus.net/isobus/pGNAndSPN/11561?type=PGN)";
CM_ BO_ 2566611456  "Source: isobus.net VDMA Data Dictionary (https://www.isobus.net/isobus/pGNAndSPN/11569?type=PGN)";
CM_ BO_ 2566611712  "Source: isobus.net VDMA Data Dictionary (https://www.isobus.net/isobus/pGNAndSPN/11582?type=PGN)";
CM_ BO_ 2566611968  "Source: isobus.net VDMA Data Dictionary (https://www.isobus.net/isobus/pGNAndSPN/11595?type=PGN)";
CM_ BO_ 2566612224  "Source: isobus.net VDMA Data Dictionary (https://www.isobus.net/isobus/pGNAndSPN/11608?type=PGN)";
CM_ BO_ 2566612480  "Source: isobus.net VDMA Data Dictionary (https://www.isobus.net/isobus/pGNAndSPN/11621?type=PGN)";
CM_ BO_ 2566612736  "Source: isobus.net VDMA Data Dictionary (https://www.isobus.net/isobus/pGNAndSPN/11640?type=PGN)";
CM_ BO_ 2566612992  "Source: isobus.net VDMA Data Dictionary (https://www.isobus.net/isobus/pGNAndSPN/11647?type=PGN)";
CM_ BO_ 2566613248  "Source: isobus.net VDMA Data Dictionary (https://www.isobus.net/isobus/pGNAndSPN/11666?type=PGN)";
CM_ BO_ 2566613504  "Source: isobus.net VDMA Data Dictionary (https://www.isobus.net/isobus/pGNAndSPN/11673?type=PGN)";
CM_ BO_ 2566613760  "Source: isobus.net VDMA Data Dictionary (https://www.isobus.net/isobus/pGNAndSPN/11679?type=PGN)";
CM_ BO_ 2566614016  "Source: isobus.net VDMA Data Dictionary (https://www.isobus.net/isobus/pGNAndSPN/11684?type=PGN)";
CM_ BO_ 2566614272  "Source: isobus.net VDMA Data Dictionary (https://www.isobus.net/isobus/pGNAndSPN/11690?type=PGN)";
CM_ BO_ 2566614528  "Source: isobus.net VDMA Data Dictionary (https://www.isobus.net/isobus/pGNAndSPN/11694?type=PGN)";
CM_ BO_ 2566614784  "Source: isobus.net VDMA Data Dictionary (https://www.isobus.net/isobus/pGNAndSPN/11699?type=PGN)";
CM_ BO_ 2566615040  "Source: isobus.net VDMA Data Dictionary (https://www.isobus.net/isobus/pGNAndSPN/11703?type=PGN)";
CM_ BO_ 2566615296  "Source: isobus.net VDMA Data Dictionary (https://www.isobus.net/isobus/pGNAndSPN/11707?type=PGN)";
CM_ BO_ 2566615552  "Source: isobus.net VDMA Data Dictionary (https://www.isobus.net/isobus/pGNAndSPN/11712?type=PGN)";
CM_ BO_ 2566615808  "Source: isobus.net VDMA Data Dictionary (https://www.isobus.net/isobus/pGNAndSPN/11716?type=PGN)";
CM_ BO_ 2566616064  "Source: isobus.net VDMA Data Dictionary (https://www.isobus.net/isobus/pGNAndSPN/11722?type=PGN)";
CM_ BO_ 2566616320  "Source: isobus.net VDMA Data Dictionary (https://www.isobus.net/isobus/pGNAndSPN/11727?type=PGN)";
CM_ BO_ 2566616576  "Source: isobus.net VDMA Data Dictionary (https://www.isobus.net/isobus/pGNAndSPN/11737?type=PGN)";
CM_ BO_ 2566616832  "Source: isobus.net VDMA Data Dictionary (https://www.isobus.net/isobus/pGNAndSPN/11745?type=PGN)";
CM_ BO_ 2566617088  "Source: isobus.net VDMA Data Dictionary (https://www.isobus.net/isobus/pGNAndSPN/11753?type=PGN)";
CM_ BO_ 2566617344  "Source: isobus.net VDMA Data Dictionary (https://www.isobus.net/isobus/pGNAndSPN/11761?type=PGN)";
CM_ BO_ 2566617600  "Source: isobus.net VDMA Data Dictionary (https://www.isobus.net/isobus/pGNAndSPN/11769?type=PGN)";
CM_ BO_ 2566617856  "Source: isobus.net VDMA Data Dictionary (https://www.isobus.net/isobus/pGNAndSPN/11777?type=PGN)";
CM_ BO_ 2566618112  "Source: isobus.net VDMA Data Dictionary (https://www.isobus.net/isobus/pGNAndSPN/11779?type=PGN)";
CM_ BO_ 2566618368  "Source: isobus.net VDMA Data Dictionary (https://www.isobus.net/isobus/pGNAndSPN/11787?type=PGN)";
CM_ BO_ 2566618624  "Source: isobus.net VDMA Data Dictionary (https://www.isobus.net/isobus/pGNAndSPN/11795?type=PGN)";
CM_ BO_ 2566618880  "Source: isobus.net VDMA Data Dictionary (https://www.isobus.net/isobus/pGNAndSPN/11798?type=PGN)";
CM_ BO_ 2566619136  "Source: isobus.net VDMA Data Dictionary (https://www.isobus.net/isobus/pGNAndSPN/11809?type=PGN)";
CM_ BO_ 2566619392  "Source: isobus.net VDMA Data Dictionary (https://www.isobus.net/isobus/pGNAndSPN/11812?type=PGN)";
CM_ BO_ 2566619648  "Source: isobus.net VDMA Data Dictionary (https://www.isobus.net/isobus/pGNAndSPN/11817?type=PGN)";
CM_ BO_ 2566619904  "Source: isobus.net VDMA Data Dictionary (https://www.isobus.net/isobus/pGNAndSPN/11822?type=PGN)";
CM_ BO_ 2566620160  "Source: isobus.net VDMA Data Dictionary (https://www.isobus.net/isobus/pGNAndSPN/11826?type=PGN)";
CM_ BO_ 2566620416  "Source: isobus.net VDMA Data Dictionary (https://www.isobus.net/isobus/pGNAndSPN/11830?type=PGN)";
CM_ BO_ 2566620672  "Source: isobus.net VDMA Data Dictionary (https://www.isobus.net/isobus/pGNAndSPN/11831?type=PGN)";
CM_ BO_ 2566620928  "Source: isobus.net VDMA Data Dictionary (https://www.isobus.net/isobus/pGNAndSPN/11832?type=PGN)";
CM_ BO_ 2566621184  "Source: isobus.net VDMA Data Dictionary (https://www.isobus.net/isobus/pGNAndSPN/11845?type=PGN)";
CM_ BO_ 2566621440  "Source: isobus.net VDMA Data Dictionary (https://www.isobus.net/isobus/pGNAndSPN/11852?type=PGN)";
CM_ BO_ 2566621696  "Source: isobus.net VDMA Data Dictionary (https://www.isobus.net/isobus/pGNAndSPN/11857?type=PGN)";
CM_ BO_ 2566621952  "Source: isobus.net VDMA Data Dictionary (https://www.isobus.net/isobus/pGNAndSPN/11859?type=PGN)";
CM_ BO_ 2566622208  "Source: isobus.net VDMA Data Dictionary (https://www.isobus.net/isobus/pGNAndSPN/11861?type=PGN)";
CM_ BO_ 2566622464  "Source: isobus.net VDMA Data Dictionary (https://www.isobus.net/isobus/pGNAndSPN/11863?type=PGN)";
CM_ BO_ 2566622720  "Source: isobus.net VDMA Data Dictionary (https://www.isobus.net/isobus/pGNAndSPN/11865?type=PGN)";
CM_ BO_ 2566622976  "Source: isobus.net VDMA Data Dictionary (https://www.isobus.net/isobus/pGNAndSPN/11867?type=PGN)";
CM_ BO_ 2566623232  "Source: isobus.net VDMA Data Dictionary (https://www.isobus.net/isobus/pGNAndSPN/11869?type=PGN)";
CM_ BO_ 2566623488  "Source: isobus.net VDMA Data Dictionary (https://www.isobus.net/isobus/pGNAndSPN/11871?type=PGN)";
CM_ BO_ 2566623744  "Source: isobus.net VDMA Data Dictionary (https://www.isobus.net/isobus/pGNAndSPN/11873?type=PGN)";
CM_ BO_ 2566624000  "Source: isobus.net VDMA Data Dictionary (https://www.isobus.net/isobus/pGNAndSPN/11875?type=PGN)";
CM_ BO_ 2566624256  "Source: isobus.net VDMA Data Dictionary (https://www.isobus.net/isobus/pGNAndSPN/11877?type=PGN)";
CM_ BO_ 2566624512  "Source: isobus.net VDMA Data Dictionary (https://www.isobus.net/isobus/pGNAndSPN/11878?type=PGN)";
CM_ BO_ 2566624768  "Source: isobus.net VDMA Data Dictionary (https://www.isobus.net/isobus/pGNAndSPN/11881?type=PGN)";
CM_ BO_ 2566625024  "Source: isobus.net VDMA Data Dictionary (https://www.isobus.net/isobus/pGNAndSPN/11885?type=PGN)";
CM_ BO_ 2566625280  "Source: isobus.net VDMA Data Dictionary (https://www.isobus.net/isobus/pGNAndSPN/11886?type=PGN)";
CM_ BO_ 2566625536  "Source: isobus.net VDMA Data Dictionary (https://www.isobus.net/isobus/pGNAndSPN/11891?type=PGN)";
CM_ BO_ 2566625792  "Source: isobus.net VDMA Data Dictionary (https://www.isobus.net/isobus/pGNAndSPN/11895?type=PGN)";
CM_ BO_ 2566626048  "Source: isobus.net VDMA Data Dictionary (https://www.isobus.net/isobus/pGNAndSPN/11898?type=PGN)";
CM_ BO_ 2566626304  "Source: isobus.net VDMA Data Dictionary (https://www.isobus.net/isobus/pGNAndSPN/11905?type=PGN)";
CM_ BO_ 2566626560  "Source: isobus.net VDMA Data Dictionary (https://www.isobus.net/isobus/pGNAndSPN/11907?type=PGN)";
CM_ BO_ 2566626816  "Source: isobus.net VDMA Data Dictionary (https://www.isobus.net/isobus/pGNAndSPN/11912?type=PGN)";
CM_ BO_ 2566627072  "Source: isobus.net VDMA Data Dictionary (https://www.isobus.net/isobus/pGNAndSPN/11916?type=PGN)";
CM_ BO_ 2566627328  "Source: isobus.net VDMA Data Dictionary (https://www.isobus.net/isobus/pGNAndSPN/11919?type=PGN)";
CM_ BO_ 2566627584  "Source: isobus.net VDMA Data Dictionary (https://www.isobus.net/isobus/pGNAndSPN/11926?type=PGN)";
CM_ BO_ 2566627840  "Source: isobus.net VDMA Data Dictionary (https://www.isobus.net/isobus/pGNAndSPN/11928?type=PGN)";
CM_ BO_ 2566628096  "Source: isobus.net VDMA Data Dictionary (https://www.isobus.net/isobus/pGNAndSPN/11933?type=PGN)";
CM_ BO_ 2566628352  "Source: isobus.net VDMA Data Dictionary (https://www.isobus.net/isobus/pGNAndSPN/11937?type=PGN)";
CM_ BO_ 2566628608  "Source: isobus.net VDMA Data Dictionary (https://www.isobus.net/isobus/pGNAndSPN/11940?type=PGN)";
CM_ BO_ 2566628864  "Source: isobus.net VDMA Data Dictionary (https://www.isobus.net/isobus/pGNAndSPN/11947?type=PGN)";
CM_ BO_ 2566629120  "Source: isobus.net VDMA Data Dictionary (https://www.isobus.net/isobus/pGNAndSPN/11949?type=PGN)";
CM_ BO_ 2566629376  "Source: isobus.net VDMA Data Dictionary (https://www.isobus.net/isobus/pGNAndSPN/11954?type=PGN)";
CM_ BO_ 2566629632  "Source: isobus.net VDMA Data Dictionary (https://www.isobus.net/isobus/pGNAndSPN/11958?type=PGN)";
CM_ BO_ 2566629888  "Source: isobus.net VDMA Data Dictionary (https://www.isobus.net/isobus/pGNAndSPN/11961?type=PGN)";
CM_ BO_ 2566630144  "Source: isobus.net VDMA Data Dictionary (https://www.isobus.net/isobus/pGNAndSPN/11968?type=PGN)";
CM_ BO_ 2566630400  "Source: isobus.net VDMA Data Dictionary (https://www.isobus.net/isobus/pGNAndSPN/11970?type=PGN)";
CM_ BO_ 2566630656  "Source: isobus.net VDMA Data Dictionary (https://www.isobus.net/isobus/pGNAndSPN/11975?type=PGN)";
CM_ BO_ 2566630912  "Source: isobus.net VDMA Data Dictionary (https://www.isobus.net/isobus/pGNAndSPN/11979?type=PGN)";
CM_ BO_ 2566631168  "Source: isobus.net VDMA Data Dictionary (https://www.isobus.net/isobus/pGNAndSPN/11982?type=PGN)";
CM_ BO_ 2566631424  "Source: isobus.net VDMA Data Dictionary (https://www.isobus.net/isobus/pGNAndSPN/11989?type=PGN)";
CM_ BO_ 2566631680  "Source: isobus.net VDMA Data Dictionary (https://www.isobus.net/isobus/pGNAndSPN/11991?type=PGN)";
CM_ BO_ 2566631936  "Source: isobus.net VDMA Data Dictionary (https://www.isobus.net/isobus/pGNAndSPN/11995?type=PGN)";
CM_ BO_ 2566632192  "Source: isobus.net VDMA Data Dictionary (https://www.isobus.net/isobus/pGNAndSPN/11997?type=PGN)";
CM_ BO_ 2566632448  "Source: isobus.net VDMA Data Dictionary (https://www.isobus.net/isobus/pGNAndSPN/11999?type=PGN)";
CM_ BO_ 2566632704  "Source: isobus.net VDMA Data Dictionary (https://www.isobus.net/isobus/pGNAndSPN/12001?type=PGN)";
CM_ BO_ 2566632960  "Source: isobus.net VDMA Data Dictionary (https://www.isobus.net/isobus/pGNAndSPN/12003?type=PGN)";
CM_ BO_ 2566633216  "Source: isobus.net VDMA Data Dictionary (https://www.isobus.net/isobus/pGNAndSPN/12005?type=PGN)";
CM_ BO_ 2566633472  "Source: isobus.net VDMA Data Dictionary (https://www.isobus.net/isobus/pGNAndSPN/12009?type=PGN)";
CM_ BO_ 2566633728  "Source: isobus.net VDMA Data Dictionary (https://www.isobus.net/isobus/pGNAndSPN/12021?type=PGN)";
CM_ BO_ 2566633984  "Source: isobus.net VDMA Data Dictionary (https://www.isobus.net/isobus/pGNAndSPN/12024?type=PGN)";
CM_ BO_ 2566634240  "Source: isobus.net VDMA Data Dictionary (https://www.isobus.net/isobus/pGNAndSPN/12029?type=PGN)";
CM_ BO_ 2566634496  "Source: isobus.net VDMA Data Dictionary (https://www.isobus.net/isobus/pGNAndSPN/12033?type=PGN)";
CM_ BO_ 2566634752  "Source: isobus.net VDMA Data Dictionary (https://www.isobus.net/isobus/pGNAndSPN/12037?type=PGN)";
CM_ BO_ 2566635008  "Source: isobus.net VDMA Data Dictionary (https://www.isobus.net/isobus/pGNAndSPN/12041?type=PGN)";
CM_ BO_ 2566635264  "Source: isobus.net VDMA Data Dictionary (https://www.isobus.net/isobus/pGNAndSPN/12053?type=PGN)";
CM_ BO_ 2566635520  "Source: isobus.net VDMA Data Dictionary (https://www.isobus.net/isobus/pGNAndSPN/12056?type=PGN)";
CM_ BO_ 2566635776  "Source: isobus.net VDMA Data Dictionary (https://www.isobus.net/isobus/pGNAndSPN/12061?type=PGN)";
CM_ BO_ 2566636032  "Source: isobus.net VDMA Data Dictionary (https://www.isobus.net/isobus/pGNAndSPN/12065?type=PGN)";
CM_ BO_ 2566636288  "Source: isobus.net VDMA Data Dictionary (https://www.isobus.net/isobus/pGNAndSPN/12069?type=PGN)";
CM_ BO_ 2566636544  "Source: isobus.net VDMA Data Dictionary (https://www.isobus.net/isobus/pGNAndSPN/12073?type=PGN)";
CM_ BO_ 2566636800  "Source: isobus.net VDMA Data Dictionary (https://www.isobus.net/isobus/pGNAndSPN/12085?type=PGN)";
CM_ BO_ 2566637056  "Source: isobus.net VDMA Data Dictionary (https://www.isobus.net/isobus/pGNAndSPN/12088?type=PGN)";
CM_ BO_ 2566637312  "Source: isobus.net VDMA Data Dictionary (https://www.isobus.net/isobus/pGNAndSPN/12093?type=PGN)";
CM_ BO_ 2566637568  "Source: isobus.net VDMA Data Dictionary (https://www.isobus.net/isobus/pGNAndSPN/12097?type=PGN)";
CM_ BO_ 2566637824  "Source: isobus.net VDMA Data Dictionary (https://www.isobus.net/isobus/pGNAndSPN/12101?type=PGN)";
CM_ BO_ 2566638080  "Source: isobus.net VDMA Data Dictionary (https://www.isobus.net/isobus/pGNAndSPN/12102?type=PGN)";
CM_ BO_ 2566638336  "Source: isobus.net VDMA Data Dictionary (https://www.isobus.net/isobus/pGNAndSPN/12104?type=PGN)";
CM_ BO_ 2566638592  "Source: isobus.net VDMA Data Dictionary (https://www.isobus.net/isobus/pGNAndSPN/12108?type=PGN)";
CM_ BO_ 2566638848  "Source: isobus.net VDMA Data Dictionary (https://www.isobus.net/isobus/pGNAndSPN/12119?type=PGN)";
CM_ BO_ 2566639104  "Source: isobus.net VDMA Data Dictionary (https://www.isobus.net/isobus/pGNAndSPN/12126?type=PGN)";
CM_ BO_ 2566639360  "Source: isobus.net VDMA Data Dictionary (https://www.isobus.net/isobus/pGNAndSPN/12130?type=PGN)";
CM_ BO_ 2566639616  "Source: isobus.net VDMA Data Dictionary (https://www.isobus.net/isobus/pGNAndSPN/12142?type=PGN)";
CM_ BO_ 2566639872  "Source: isobus.net VDMA Data Dictionary (https://www.isobus.net/isobus/pGNAndSPN/12145?type=PGN)";
CM_ BO_ 2566640128  "Source: isobus.net VDMA Data Dictionary (https://www.isobus.net/isobus/pGNAndSPN/12149?type=PGN)";
CM_ BO_ 2566640384  "Source: isobus.net VDMA Data Dictionary (https://www.isobus.net/isobus/pGNAndSPN/12153?type=PGN)";
CM_ BO_ 2566640640  "Source: isobus.net VDMA Data Dictionary (https://www.isobus.net/isobus/pGNAndSPN/12157?type=PGN)";
CM_ BO_ 2566640896  "Source: isobus.net VDMA Data Dictionary (https://www.isobus.net/isobus/pGNAndSPN/12161?type=PGN)";
CM_ BO_ 2566641152  "Source: isobus.net VDMA Data Dictionary (https://www.isobus.net/isobus/pGNAndSPN/12163?type=PGN)";
CM_ BO_ 2566641408  "Source: isobus.net VDMA Data Dictionary (https://www.isobus.net/isobus/pGNAndSPN/12170?type=PGN)";
CM_ BO_ 2566641664  "Source: isobus.net VDMA Data Dictionary (https://www.isobus.net/isobus/pGNAndSPN/12175?type=PGN)";
CM_ BO_ 2566641920  "Source: isobus.net VDMA Data Dictionary (https://www.isobus.net/isobus/pGNAndSPN/12179?type=PGN)";
CM_ BO_ 2566642176  "Source: isobus.net VDMA Data Dictionary (https://www.isobus.net/isobus/pGNAndSPN/12183?type=PGN)";
CM_ BO_ 2566642688  "Source: isobus.net VDMA Data Dictionary (https://www.isobus.net/isobus/pGNAndSPN/12216?type=PGN)";
CM_ BO_ 2566642944  "Source: isobus.net VDMA Data Dictionary (https://www.isobus.net/isobus/pGNAndSPN/12246?type=PGN)";
CM_ BO_ 2566643200  "Source: isobus.net VDMA Data Dictionary (https://www.isobus.net/isobus/pGNAndSPN/12250?type=PGN)";
CM_ BO_ 2566643456  "Source: isobus.net VDMA Data Dictionary (https://www.isobus.net/isobus/pGNAndSPN/12254?type=PGN)";
CM_ BO_ 2566643712  "Source: isobus.net VDMA Data Dictionary (https://www.isobus.net/isobus/pGNAndSPN/12262?type=PGN)";
CM_ BO_ 2566643968  "Source: isobus.net VDMA Data Dictionary (https://www.isobus.net/isobus/pGNAndSPN/12266?type=PGN)";
CM_ BO_ 2566644224  "Source: isobus.net VDMA Data Dictionary (https://www.isobus.net/isobus/pGNAndSPN/12274?type=PGN)";
CM_ BO_ 2566644480  "Source: isobus.net VDMA Data Dictionary (https://www.isobus.net/isobus/pGNAndSPN/12282?type=PGN)";
CM_ BO_ 2566644736  "Source: isobus.net VDMA Data Dictionary (https://www.isobus.net/isobus/pGNAndSPN/12294?type=PGN)";
CM_ BO_ 2566644992  "Source: isobus.net VDMA Data Dictionary (https://www.isobus.net/isobus/pGNAndSPN/12303?type=PGN)";
CM_ BO_ 2566645248  "Source: isobus.net VDMA Data Dictionary (https://www.isobus.net/isobus/pGNAndSPN/12325?type=PGN)";
CM_ BO_ 2566645504  "Source: isobus.net VDMA Data Dictionary (https://www.isobus.net/isobus/pGNAndSPN/12327?type=PGN)";
CM_ BO_ 2566645760  "Source: isobus.net VDMA Data Dictionary (https://www.isobus.net/isobus/pGNAndSPN/12331?type=PGN)";
CM_ BO_ 2566646016  "Source: isobus.net VDMA Data Dictionary (https://www.isobus.net/isobus/pGNAndSPN/12332?type=PGN)";
CM_ BO_ 2566646272  "Source: isobus.net VDMA Data Dictionary (https://www.isobus.net/isobus/pGNAndSPN/12352?type=PGN)";
CM_ BO_ 2566646528  "Source: isobus.net VDMA Data Dictionary (https://www.isobus.net/isobus/pGNAndSPN/12355?type=PGN)";
CM_ BO_ 2566646784  "Source: isobus.net VDMA Data Dictionary (https://www.isobus.net/isobus/pGNAndSPN/12358?type=PGN)";
CM_ BO_ 2566647040  "Source: isobus.net VDMA Data Dictionary (https://www.isobus.net/isobus/pGNAndSPN/12361?type=PGN)";
CM_ BO_ 2566647296  "Source: isobus.net VDMA Data Dictionary (https://www.isobus.net/isobus/pGNAndSPN/12364?type=PGN)";
CM_ BO_ 2566647552  "Source: isobus.net VDMA Data Dictionary (https://www.isobus.net/isobus/pGNAndSPN/12367?type=PGN)";
CM_ BO_ 2566647808  "Source: isobus.net VDMA Data Dictionary (https://www.isobus.net/isobus/pGNAndSPN/12370?type=PGN)";
CM_ BO_ 2566648064  "Source: isobus.net VDMA Data Dictionary (https://www.isobus.net/isobus/pGNAndSPN/12376?type=PGN)";
CM_ BO_ 2566648320  "Source: isobus.net VDMA Data Dictionary (https://www.isobus.net/isobus/pGNAndSPN/12378?type=PGN)";
CM_ BO_ 2566648576  "Source: isobus.net VDMA Data Dictionary (https://www.isobus.net/isobus/pGNAndSPN/12379?type=PGN)";
CM_ BO_ 2566648832  "Source: isobus.net VDMA Data Dictionary (https://www.isobus.net/isobus/pGNAndSPN/12382?type=PGN)";
CM_ BO_ 2566649088  "Source: isobus.net VDMA Data Dictionary (https://www.isobus.net/isobus/pGNAndSPN/12385?type=PGN)";
CM_ BO_ 2566649344  "Source: isobus.net VDMA Data Dictionary (https://www.isobus.net/isobus/pGNAndSPN/12390?type=PGN)";
CM_ BO_ 2566649600  "Source: isobus.net VDMA Data Dictionary (https://www.isobus.net/isobus/pGNAndSPN/12398?type=PGN)";
CM_ BO_ 2566649856  "Source: isobus.net VDMA Data Dictionary (https://www.isobus.net/isobus/pGNAndSPN/12406?type=PGN)";
CM_ BO_ 2566650112  "Source: isobus.net VDMA Data Dictionary (https://www.isobus.net/isobus/pGNAndSPN/12414?type=PGN)";
CM_ BO_ 2566650368  "Source: isobus.net VDMA Data Dictionary (https://www.isobus.net/isobus/pGNAndSPN/12422?type=PGN)";
CM_ BO_ 2566650624  "Source: isobus.net VDMA Data Dictionary (https://www.isobus.net/isobus/pGNAndSPN/12430?type=PGN)";
CM_ BO_ 2566650880  "Source: isobus.net VDMA Data Dictionary (https://www.isobus.net/isobus/pGNAndSPN/12438?type=PGN)";
CM_ BO_ 2566651136  "Source: isobus.net VDMA Data Dictionary (https://www.isobus.net/isobus/pGNAndSPN/12446?type=PGN)";
CM_ BO_ 2566651392  "Source: isobus.net VDMA Data Dictionary (https://www.isobus.net/isobus/pGNAndSPN/12454?type=PGN)";
CM_ BO_ 2566651648  "Source: isobus.net VDMA Data Dictionary (https://www.isobus.net/isobus/pGNAndSPN/12462?type=PGN)";
CM_ BO_ 2566651904  "Source: isobus.net VDMA Data Dictionary (https://www.isobus.net/isobus/pGNAndSPN/12478?type=PGN)";
CM_ BO_ 2566652160  "Source: isobus.net VDMA Data Dictionary (https://www.isobus.net/isobus/pGNAndSPN/12487?type=PGN)";
CM_ BO_ 2566652416  "Source: isobus.net VDMA Data Dictionary (https://www.isobus.net/isobus/pGNAndSPN/12492?type=PGN)";
CM_ BO_ 2566652672  "Source: isobus.net VDMA Data Dictionary (https://www.isobus.net/isobus/pGNAndSPN/12497?type=PGN)";
CM_ BO_ 2566652928  "Source: isobus.net VDMA Data Dictionary (https://www.isobus.net/isobus/pGNAndSPN/12500?type=PGN)";
CM_ BO_ 2566653184  "Source: isobus.net VDMA Data Dictionary (https://www.isobus.net/isobus/pGNAndSPN/12505?type=PGN)";
CM_ BO_ 2566653440  "Source: isobus.net VDMA Data Dictionary (https://www.isobus.net/isobus/pGNAndSPN/12508?type=PGN)";
CM_ BO_ 2566653696  "Source: isobus.net VDMA Data Dictionary (https://www.isobus.net/isobus/pGNAndSPN/12513?type=PGN)";
CM_ BO_ 2566653952  "Source: isobus.net VDMA Data Dictionary (https://www.isobus.net/isobus/pGNAndSPN/12516?type=PGN)";
CM_ BO_ 2566654208  "Source: isobus.net VDMA Data Dictionary (https://www.isobus.net/isobus/pGNAndSPN/12521?type=PGN)";
CM_ BO_ 2566654464  "Source: isobus.net VDMA Data Dictionary (https://www.isobus.net/isobus/pGNAndSPN/12524?type=PGN)";
CM_ BO_ 2566654720  "Source: isobus.net VDMA Data Dictionary (https://www.isobus.net/isobus/pGNAndSPN/12528?type=PGN)";
CM_ BO_ 2566654976  "Source: isobus.net VDMA Data Dictionary (https://www.isobus.net/isobus/pGNAndSPN/12531?type=PGN)";
CM_ BO_ 2566655232  "Source: isobus.net VDMA Data Dictionary (https://www.isobus.net/isobus/pGNAndSPN/12533?type=PGN)";
CM_ BO_ 2566655488  "Source: isobus.net VDMA Data Dictionary (https://www.isobus.net/isobus/pGNAndSPN/12535?type=PGN)";
CM_ BO_ 2566655744  "Source: isobus.net VDMA Data Dictionary (https://www.isobus.net/isobus/pGNAndSPN/12537?type=PGN)";
CM_ BO_ 2566656000  "Source: isobus.net VDMA Data Dictionary (https://www.isobus.net/isobus/pGNAndSPN/12540?type=PGN)";
CM_ BO_ 2566656256  "Source: isobus.net VDMA Data Dictionary (https://www.isobus.net/isobus/pGNAndSPN/12542?type=PGN)";
CM_ BO_ 2566656512  "Source: isobus.net VDMA Data Dictionary (https://www.isobus.net/isobus/pGNAndSPN/12562?type=PGN)";
CM_ BO_ 2566656768  "Source: isobus.net VDMA Data Dictionary (https://www.isobus.net/isobus/pGNAndSPN/12566?type=PGN)";
CM_ BO_ 2566657024  "Source: isobus.net VDMA Data Dictionary (https://www.isobus.net/isobus/pGNAndSPN/12567?type=PGN)";
CM_ BO_ 2566657280  "Source: isobus.net VDMA Data Dictionary (https://www.isobus.net/isobus/pGNAndSPN/12571?type=PGN)";
CM_ BO_ 2566657536  "Source: isobus.net VDMA Data Dictionary (https://www.isobus.net/isobus/pGNAndSPN/12572?type=PGN)";
CM_ BO_ 2566657792  "Source: isobus.net VDMA Data Dictionary (https://www.isobus.net/isobus/pGNAndSPN/12576?type=PGN)";
CM_ BO_ 2566658048  "Source: isobus.net VDMA Data Dictionary (https://www.isobus.net/isobus/pGNAndSPN/12577?type=PGN)";
CM_ BO_ 2566658304  "Source: isobus.net VDMA Data Dictionary (https://www.isobus.net/isobus/pGNAndSPN/12579?type=PGN)";
CM_ BO_ 2566658560  "Source: isobus.net VDMA Data Dictionary (https://www.isobus.net/isobus/pGNAndSPN/12585?type=PGN)";
CM_ BO_ 2566658816  "Source: isobus.net VDMA Data Dictionary (https://www.isobus.net/isobus/pGNAndSPN/12589?type=PGN)";
CM_ BO_ 2566659072  "Source: isobus.net VDMA Data Dictionary (https://www.isobus.net/isobus/pGNAndSPN/12593?type=PGN)";
CM_ BO_ 2566659328  "Source: isobus.net VDMA Data Dictionary (https://www.isobus.net/isobus/pGNAndSPN/12595?type=PGN)";
CM_ BO_ 2566659584  "Source: isobus.net VDMA Data Dictionary (https://www.isobus.net/isobus/pGNAndSPN/12599?type=PGN)";
CM_ BO_ 2566659840  "Source: isobus.net VDMA Data Dictionary (https://www.isobus.net/isobus/pGNAndSPN/12603?type=PGN)";
CM_ BO_ 2566660096  "Source: isobus.net VDMA Data Dictionary (https://www.isobus.net/isobus/pGNAndSPN/12635?type=PGN)";
CM_ BO_ 2566660352  "Source: isobus.net VDMA Data Dictionary (https://www.isobus.net/isobus/pGNAndSPN/12667?type=PGN)";
CM_ BO_ 2566660608  "Source: isobus.net VDMA Data Dictionary (https://www.isobus.net/isobus/pGNAndSPN/12669?type=PGN)";
CM_ BO_ 2566660864  "Source: isobus.net VDMA Data Dictionary (https://www.isobus.net/isobus/pGNAndSPN/12670?type=PGN)";
CM_ BO_ 2566661120  "Source: isobus.net VDMA Data Dictionary (https://www.isobus.net/isobus/pGNAndSPN/12673?type=PGN)";
CM_ BO_ 2566661376  "Source: isobus.net VDMA Data Dictionary (https://www.isobus.net/isobus/pGNAndSPN/12676?type=PGN)";
CM_ BO_ 2566661632  "Source: isobus.net VDMA Data Dictionary (https://www.isobus.net/isobus/pGNAndSPN/12678?type=PGN)";
CM_ BO_ 2566661888  "Source: isobus.net VDMA Data Dictionary (https://www.isobus.net/isobus/pGNAndSPN/12680?type=PGN)";
CM_ BO_ 2566662144  "Source: isobus.net VDMA Data Dictionary (https://www.isobus.net/isobus/pGNAndSPN/12685?type=PGN)";
CM_ BO_ 2566662400  "Source: isobus.net VDMA Data Dictionary (https://www.isobus.net/isobus/pGNAndSPN/12694?type=PGN)";
CM_ BO_ 2566662656  "Source: isobus.net VDMA Data Dictionary (https://www.isobus.net/isobus/pGNAndSPN/12699?type=PGN)";
CM_ BO_ 2566662912  "Source: isobus.net VDMA Data Dictionary (https://www.isobus.net/isobus/pGNAndSPN/12703?type=PGN)";
CM_ BO_ 2566663168  "Source: isobus.net VDMA Data Dictionary (https://www.isobus.net/isobus/pGNAndSPN/12723?type=PGN)";
CM_ BO_ 2566663424  "Source: isobus.net VDMA Data Dictionary (https://www.isobus.net/isobus/pGNAndSPN/12727?type=PGN)";
CM_ BO_ 2566663680  "Source: isobus.net VDMA Data Dictionary (https://www.isobus.net/isobus/pGNAndSPN/12734?type=PGN)";
CM_ BO_ 2566663936  "Source: isobus.net VDMA Data Dictionary (https://www.isobus.net/isobus/pGNAndSPN/12738?type=PGN)";
CM_ BO_ 2566664192  "Source: isobus.net VDMA Data Dictionary (https://www.isobus.net/isobus/pGNAndSPN/12742?type=PGN)";
CM_ BO_ 2566664448  "Source: isobus.net VDMA Data Dictionary (https://www.isobus.net/isobus/pGNAndSPN/12755?type=PGN)";
CM_ BO_ 2566664704  "Source: isobus.net VDMA Data Dictionary (https://www.isobus.net/isobus/pGNAndSPN/12765?type=PGN)";
CM_ BO_ 2566664960  "Source: isobus.net VDMA Data Dictionary (https://www.isobus.net/isobus/pGNAndSPN/12767?type=PGN)";
CM_ BO_ 2566665216  "Source: isobus.net VDMA Data Dictionary (https://www.isobus.net/isobus/pGNAndSPN/12771?type=PGN)";
CM_ BO_ 2566665472  "Source: isobus.net VDMA Data Dictionary (https://www.isobus.net/isobus/pGNAndSPN/12773?type=PGN)";
CM_ BO_ 2566665728  "Source: isobus.net VDMA Data Dictionary (https://www.isobus.net/isobus/pGNAndSPN/12779?type=PGN)";
CM_ BO_ 2566665984  "Source: isobus.net VDMA Data Dictionary (https://www.isobus.net/isobus/pGNAndSPN/12781?type=PGN)";
CM_ BO_ 2566666240  "Source: isobus.net VDMA Data Dictionary (https://www.isobus.net/isobus/pGNAndSPN/12789?type=PGN)";
CM_ BO_ 2566666496  "Source: isobus.net VDMA Data Dictionary (https://www.isobus.net/isobus/pGNAndSPN/12791?type=PGN)";
CM_ BO_ 2566666752  "Source: isobus.net VDMA Data Dictionary (https://www.isobus.net/isobus/pGNAndSPN/12795?type=PGN)";
CM_ BO_ 2566667008  "Source: isobus.net VDMA Data Dictionary (https://www.isobus.net/isobus/pGNAndSPN/12799?type=PGN)";
CM_ BO_ 2566667264  "Source: isobus.net VDMA Data Dictionary (https://www.isobus.net/isobus/pGNAndSPN/12807?type=PGN)";
CM_ BO_ 2566667520  "Source: isobus.net VDMA Data Dictionary (https://www.isobus.net/isobus/pGNAndSPN/12815?type=PGN)";
CM_ BO_ 2566667776  "Source: isobus.net VDMA Data Dictionary (https://www.isobus.net/isobus/pGNAndSPN/12817?type=PGN)";
CM_ BO_ 2566668032  "Source: isobus.net VDMA Data Dictionary (https://www.isobus.net/isobus/pGNAndSPN/12819?type=PGN)";
CM_ BO_ 2566668288  "Source: isobus.net VDMA Data Dictionary (https://www.isobus.net/isobus/pGNAndSPN/12823?type=PGN)";
CM_ BO_ 2566668544  "Source: isobus.net VDMA Data Dictionary (https://www.isobus.net/isobus/pGNAndSPN/12828?type=PGN)";
CM_ BO_ 2566668800  "Source: isobus.net VDMA Data Dictionary (https://www.isobus.net/isobus/pGNAndSPN/12831?type=PGN)";
CM_ BO_ 2566669056  "Source: isobus.net VDMA Data Dictionary (https://www.isobus.net/isobus/pGNAndSPN/12837?type=PGN)";
CM_ BO_ 2566669312  "Source: isobus.net VDMA Data Dictionary (https://www.isobus.net/isobus/pGNAndSPN/12839?type=PGN)";
CM_ BO_ 2566669568  "Source: isobus.net VDMA Data Dictionary (https://www.isobus.net/isobus/pGNAndSPN/12845?type=PGN)";
CM_ BO_ 2566669824  "Source: isobus.net VDMA Data Dictionary (https://www.isobus.net/isobus/pGNAndSPN/12849?type=PGN)";
CM_ BO_ 2566670080  "Source: isobus.net VDMA Data Dictionary (https://www.isobus.net/isobus/pGNAndSPN/12863?type=PGN)";
CM_ BO_ 2566670336  "Source: isobus.net VDMA Data Dictionary (https://www.isobus.net/isobus/pGNAndSPN/12869?type=PGN)";
CM_ BO_ 2566670592  "Source: isobus.net VDMA Data Dictionary (https://www.isobus.net/isobus/pGNAndSPN/12876?type=PGN)";
CM_ BO_ 2566670848  "Source: isobus.net VDMA Data Dictionary (https://www.isobus.net/isobus/pGNAndSPN/12897?type=PGN)";
CM_ BO_ 2566671104  "Source: isobus.net VDMA Data Dictionary (https://www.isobus.net/isobus/pGNAndSPN/12901?type=PGN)";
CM_ BO_ 2566671360  "Source: isobus.net VDMA Data Dictionary (https://www.isobus.net/isobus/pGNAndSPN/12905?type=PGN)";
CM_ BO_ 2566671616  "Source: isobus.net VDMA Data Dictionary (https://www.isobus.net/isobus/pGNAndSPN/12910?type=PGN)";
CM_ BO_ 2566671872  "Source: isobus.net VDMA Data Dictionary (https://www.isobus.net/isobus/pGNAndSPN/12915?type=PGN)";
CM_ BO_ 2566672128  "Source: isobus.net VDMA Data Dictionary (https://www.isobus.net/isobus/pGNAndSPN/12923?type=PGN)";
CM_ BO_ 2566672384  "Source: isobus.net VDMA Data Dictionary (https://www.isobus.net/isobus/pGNAndSPN/12928?type=PGN)";
CM_ BO_ 2566672640  "Source: isobus.net VDMA Data Dictionary (https://www.isobus.net/isobus/pGNAndSPN/12932?type=PGN)";
CM_ BO_ 2566672896  "Source: isobus.net VDMA Data Dictionary (https://www.isobus.net/isobus/pGNAndSPN/12936?type=PGN)";
CM_ BO_ 2566673152  "Source: isobus.net VDMA Data Dictionary (https://www.isobus.net/isobus/pGNAndSPN/12942?type=PGN)";
CM_ BO_ 2566673408  "Source: isobus.net VDMA Data Dictionary (https://www.isobus.net/isobus/pGNAndSPN/12943?type=PGN)";
CM_ BO_ 2566673664  "Source: isobus.net VDMA Data Dictionary (https://www.isobus.net/isobus/pGNAndSPN/12944?type=PGN)";
CM_ BO_ 2566673920  "Source: isobus.net VDMA Data Dictionary (https://www.isobus.net/isobus/pGNAndSPN/12946?type=PGN)";
CM_ BO_ 2566674176  "Source: isobus.net VDMA Data Dictionary (https://www.isobus.net/isobus/pGNAndSPN/12948?type=PGN)";
CM_ BO_ 2566674432  "Source: isobus.net VDMA Data Dictionary (https://www.isobus.net/isobus/pGNAndSPN/12953?type=PGN)";
CM_ BO_ 2566674688  "Source: isobus.net VDMA Data Dictionary (https://www.isobus.net/isobus/pGNAndSPN/12956?type=PGN)";
CM_ BO_ 2566674944  "Source: isobus.net VDMA Data Dictionary (https://www.isobus.net/isobus/pGNAndSPN/12958?type=PGN)";
CM_ BO_ 2566675200  "Source: isobus.net VDMA Data Dictionary (https://www.isobus.net/isobus/pGNAndSPN/12960?type=PGN)";
CM_ BO_ 2566675456  "Source: isobus.net VDMA Data Dictionary (https://www.isobus.net/isobus/pGNAndSPN/12962?type=PGN)";
CM_ BO_ 2566675712  "Source: isobus.net VDMA Data Dictionary (https://www.isobus.net/isobus/pGNAndSPN/12973?type=PGN)";
CM_ BO_ 2566675968  "Source: isobus.net VDMA Data Dictionary (https://www.isobus.net/isobus/pGNAndSPN/12979?type=PGN)";
CM_ BO_ 2566676224  "Source: isobus.net VDMA Data Dictionary (https://www.isobus.net/isobus/pGNAndSPN/12980?type=PGN)";
CM_ BO_ 2566676480  "Source: isobus.net VDMA Data Dictionary (https://www.isobus.net/isobus/pGNAndSPN/12981?type=PGN)";
CM_ BO_ 2566676736  "Source: isobus.net VDMA Data Dictionary (https://www.isobus.net/isobus/pGNAndSPN/12982?type=PGN)";
CM_ BO_ 2566676992  "Source: isobus.net VDMA Data Dictionary (https://www.isobus.net/isobus/pGNAndSPN/12983?type=PGN)";
CM_ BO_ 2566677248  "Source: isobus.net VDMA Data Dictionary (https://www.isobus.net/isobus/pGNAndSPN/12984?type=PGN)";
CM_ BO_ 2566677504  "Source: isobus.net VDMA Data Dictionary (https://www.isobus.net/isobus/pGNAndSPN/12985?type=PGN)";
CM_ BO_ 2566677760  "Source: isobus.net VDMA Data Dictionary (https://www.isobus.net/isobus/pGNAndSPN/12986?type=PGN)";
CM_ BO_ 2566678016  "Source: isobus.net VDMA Data Dictionary (https://www.isobus.net/isobus/pGNAndSPN/12987?type=PGN)";
CM_ BO_ 2566678272  "Source: isobus.net VDMA Data Dictionary (https://www.isobus.net/isobus/pGNAndSPN/12988?type=PGN)";
CM_ BO_ 2566678528  "Source: isobus.net VDMA Data Dictionary (https://www.isobus.net/isobus/pGNAndSPN/12989?type=PGN)";
CM_ BO_ 2566678784  "Source: isobus.net VDMA Data Dictionary (https://www.isobus.net/isobus/pGNAndSPN/12990?type=PGN)";
CM_ BO_ 2566679040  "Source: isobus.net VDMA Data Dictionary (https://www.isobus.net/isobus/pGNAndSPN/12994?type=PGN)";
CM_ BO_ 2566679296  "Source: isobus.net VDMA Data Dictionary (https://www.isobus.net/isobus/pGNAndSPN/12995?type=PGN)";
CM_ BO_ 2566679552  "Source: isobus.net VDMA Data Dictionary (https://www.isobus.net/isobus/pGNAndSPN/12996?type=PGN)";
CM_ BO_ 2566679808  "Source: isobus.net VDMA Data Dictionary (https://www.isobus.net/isobus/pGNAndSPN/12997?type=PGN)";
CM_ BO_ 2566680064  "Source: isobus.net VDMA Data Dictionary (https://www.isobus.net/isobus/pGNAndSPN/12998?type=PGN)";
CM_ BO_ 2566680320  "Source: isobus.net VDMA Data Dictionary (https://www.isobus.net/isobus/pGNAndSPN/12999?type=PGN)";
CM_ BO_ 2566680576  "Source: isobus.net VDMA Data Dictionary (https://www.isobus.net/isobus/pGNAndSPN/13000?type=PGN)";
CM_ BO_ 2566680832  "Source: isobus.net VDMA Data Dictionary (https://www.isobus.net/isobus/pGNAndSPN/13001?type=PGN)";
CM_ BO_ 2566681088  "Source: isobus.net VDMA Data Dictionary (https://www.isobus.net/isobus/pGNAndSPN/13002?type=PGN)";
CM_ BO_ 2566681344  "Source: isobus.net VDMA Data Dictionary (https://www.isobus.net/isobus/pGNAndSPN/13003?type=PGN)";
CM_ BO_ 2566681600  "Source: isobus.net VDMA Data Dictionary (https://www.isobus.net/isobus/pGNAndSPN/13004?type=PGN)";
CM_ BO_ 2566681856  "Source: isobus.net VDMA Data Dictionary (https://www.isobus.net/isobus/pGNAndSPN/13005?type=PGN)";
CM_ BO_ 2566682112  "Source: isobus.net VDMA Data Dictionary (https://www.isobus.net/isobus/pGNAndSPN/13006?type=PGN)";
CM_ BO_ 2566682368  "Source: isobus.net VDMA Data Dictionary (https://www.isobus.net/isobus/pGNAndSPN/13007?type=PGN)";
CM_ BO_ 2566682624  "Source: isobus.net VDMA Data Dictionary (https://www.isobus.net/isobus/pGNAndSPN/13008?type=PGN)";
CM_ BO_ 2566682880  "Source: isobus.net VDMA Data Dictionary (https://www.isobus.net/isobus/pGNAndSPN/13009?type=PGN)";
CM_ BO_ 2566683136  "Source: isobus.net VDMA Data Dictionary (https://www.isobus.net/isobus/pGNAndSPN/13010?type=PGN)";
CM_ BO_ 2566683392  "Source: isobus.net VDMA Data Dictionary (https://www.isobus.net/isobus/pGNAndSPN/13011?type=PGN)";
CM_ BO_ 2566683648  "Source: isobus.net VDMA Data Dictionary (https://www.isobus.net/isobus/pGNAndSPN/13012?type=PGN)";
CM_ SG_ 2566601472 Motor_Generator_5_Inverter_Isola "Generic 8-byte raw payload. Detail page: https://www.isobus.net/isobus/pGNAndSPN/11205?type=PGN. Signal-level enrichment via PR welcome  see CONTRIBUTING.md.";
CM_ SG_ 2566601728 Motor_Generator_5_Inverter_Activ "Generic 8-byte raw payload. Detail page: https://www.isobus.net/isobus/pGNAndSPN/11224?type=PGN. Signal-level enrichment via PR welcome  see CONTRIBUTING.md.";
CM_ SG_ 2566601984 Motor_Generator_4_Inverter_Refer "Generic 8-byte raw payload. Detail page: https://www.isobus.net/isobus/pGNAndSPN/11229?type=PGN. Signal-level enrichment via PR welcome  see CONTRIBUTING.md.";
CM_ SG_ 2566602240 Motor_Generator_4_Inverter_Statu "Generic 8-byte raw payload. Detail page: https://www.isobus.net/isobus/pGNAndSPN/11235?type=PGN. Signal-level enrichment via PR welcome  see CONTRIBUTING.md.";
CM_ SG_ 2566602496 Motor_Generator_4_Inverter_Refer "Generic 8-byte raw payload. Detail page: https://www.isobus.net/isobus/pGNAndSPN/11239?type=PGN. Signal-level enrichment via PR welcome  see CONTRIBUTING.md.";
CM_ SG_ 2566602752 Motor_Generator_4_Inverter_Tempe "Generic 8-byte raw payload. Detail page: https://www.isobus.net/isobus/pGNAndSPN/11244?type=PGN. Signal-level enrichment via PR welcome  see CONTRIBUTING.md.";
CM_ SG_ 2566603008 Motor_Generator_4_Inverter_Motor "Generic 8-byte raw payload. Detail page: https://www.isobus.net/isobus/pGNAndSPN/11248?type=PGN. Signal-level enrichment via PR welcome  see CONTRIBUTING.md.";
CM_ SG_ 2566603264 Motor_Generator_4_Inverter_Isola "Generic 8-byte raw payload. Detail page: https://www.isobus.net/isobus/pGNAndSPN/11255?type=PGN. Signal-level enrichment via PR welcome  see CONTRIBUTING.md.";
CM_ SG_ 2566603520 Motor_Generator_4_Inverter_Activ "Generic 8-byte raw payload. Detail page: https://www.isobus.net/isobus/pGNAndSPN/11274?type=PGN. Signal-level enrichment via PR welcome  see CONTRIBUTING.md.";
CM_ SG_ 2566603776 Motor_Generator_3_Inverter_Refer "Generic 8-byte raw payload. Detail page: https://www.isobus.net/isobus/pGNAndSPN/11279?type=PGN. Signal-level enrichment via PR welcome  see CONTRIBUTING.md.";
CM_ SG_ 2566604032 Motor_Generator_3_Inverter_Statu "Generic 8-byte raw payload. Detail page: https://www.isobus.net/isobus/pGNAndSPN/11285?type=PGN. Signal-level enrichment via PR welcome  see CONTRIBUTING.md.";
CM_ SG_ 2566604288 Motor_Generator_3_Inverter_Refer "Generic 8-byte raw payload. Detail page: https://www.isobus.net/isobus/pGNAndSPN/11289?type=PGN. Signal-level enrichment via PR welcome  see CONTRIBUTING.md.";
CM_ SG_ 2566604544 Motor_Generator_3_Inverter_Tempe "Generic 8-byte raw payload. Detail page: https://www.isobus.net/isobus/pGNAndSPN/11294?type=PGN. Signal-level enrichment via PR welcome  see CONTRIBUTING.md.";
CM_ SG_ 2566604800 Motor_Generator_3_Inverter_Motor "Generic 8-byte raw payload. Detail page: https://www.isobus.net/isobus/pGNAndSPN/11298?type=PGN. Signal-level enrichment via PR welcome  see CONTRIBUTING.md.";
CM_ SG_ 2566605056 Motor_Generator_3_Inverter_Isola "Generic 8-byte raw payload. Detail page: https://www.isobus.net/isobus/pGNAndSPN/11305?type=PGN. Signal-level enrichment via PR welcome  see CONTRIBUTING.md.";
CM_ SG_ 2566605312 Motor_Generator_3_Inverter_Activ "Generic 8-byte raw payload. Detail page: https://www.isobus.net/isobus/pGNAndSPN/11324?type=PGN. Signal-level enrichment via PR welcome  see CONTRIBUTING.md.";
CM_ SG_ 2566605568 Automated_Driving_System_Status_ "Generic 8-byte raw payload. Detail page: https://www.isobus.net/isobus/pGNAndSPN/11333?type=PGN. Signal-level enrichment via PR welcome  see CONTRIBUTING.md.";
CM_ SG_ 2566605824 Cab_Climate_System_Information_2 "Generic 8-byte raw payload. Detail page: https://www.isobus.net/isobus/pGNAndSPN/11335?type=PGN. Signal-level enrichment via PR welcome  see CONTRIBUTING.md.";
CM_ SG_ 2566606080 Maintenance_Information_1_RawPay "Generic 8-byte raw payload. Detail page: https://www.isobus.net/isobus/pGNAndSPN/11343?type=PGN. Signal-level enrichment via PR welcome  see CONTRIBUTING.md.";
CM_ SG_ 2566606336 Hoist_Control_Information_RawPay "Generic 8-byte raw payload. Detail page: https://www.isobus.net/isobus/pGNAndSPN/11345?type=PGN. Signal-level enrichment via PR welcome  see CONTRIBUTING.md.";
CM_ SG_ 2566606592 High_Voltage_Energy_Storage_Pack "Generic 8-byte raw payload. Detail page: https://www.isobus.net/isobus/pGNAndSPN/11351?type=PGN. Signal-level enrichment via PR welcome  see CONTRIBUTING.md.";
CM_ SG_ 2566606848 High_Voltage_Energy_Storage_Pack "Generic 8-byte raw payload. Detail page: https://www.isobus.net/isobus/pGNAndSPN/11361?type=PGN. Signal-level enrichment via PR welcome  see CONTRIBUTING.md.";
CM_ SG_ 2566607104 High_Voltage_Energy_Storage_Pack "Generic 8-byte raw payload. Detail page: https://www.isobus.net/isobus/pGNAndSPN/11367?type=PGN. Signal-level enrichment via PR welcome  see CONTRIBUTING.md.";
CM_ SG_ 2566607360 High_Voltage_Energy_Storage_Pack "Generic 8-byte raw payload. Detail page: https://www.isobus.net/isobus/pGNAndSPN/11377?type=PGN. Signal-level enrichment via PR welcome  see CONTRIBUTING.md.";
CM_ SG_ 2566607616 High_Voltage_Energy_Storage_Pack "Generic 8-byte raw payload. Detail page: https://www.isobus.net/isobus/pGNAndSPN/11383?type=PGN. Signal-level enrichment via PR welcome  see CONTRIBUTING.md.";
CM_ SG_ 2566607872 High_Voltage_Energy_Storage_Pack "Generic 8-byte raw payload. Detail page: https://www.isobus.net/isobus/pGNAndSPN/11393?type=PGN. Signal-level enrichment via PR welcome  see CONTRIBUTING.md.";
CM_ SG_ 2566608128 High_Voltage_Energy_Storage_Pack "Generic 8-byte raw payload. Detail page: https://www.isobus.net/isobus/pGNAndSPN/11399?type=PGN. Signal-level enrichment via PR welcome  see CONTRIBUTING.md.";
CM_ SG_ 2566608384 High_Voltage_Energy_Storage_Pack "Generic 8-byte raw payload. Detail page: https://www.isobus.net/isobus/pGNAndSPN/11409?type=PGN. Signal-level enrichment via PR welcome  see CONTRIBUTING.md.";
CM_ SG_ 2566608640 High_Voltage_Energy_Storage_Pack "Generic 8-byte raw payload. Detail page: https://www.isobus.net/isobus/pGNAndSPN/11415?type=PGN. Signal-level enrichment via PR welcome  see CONTRIBUTING.md.";
CM_ SG_ 2566608896 High_Voltage_Energy_Storage_Pack "Generic 8-byte raw payload. Detail page: https://www.isobus.net/isobus/pGNAndSPN/11425?type=PGN. Signal-level enrichment via PR welcome  see CONTRIBUTING.md.";
CM_ SG_ 2566609152 High_Voltage_Energy_Storage_Pack "Generic 8-byte raw payload. Detail page: https://www.isobus.net/isobus/pGNAndSPN/11431?type=PGN. Signal-level enrichment via PR welcome  see CONTRIBUTING.md.";
CM_ SG_ 2566609408 High_Voltage_Energy_Storage_Pack "Generic 8-byte raw payload. Detail page: https://www.isobus.net/isobus/pGNAndSPN/11441?type=PGN. Signal-level enrichment via PR welcome  see CONTRIBUTING.md.";
CM_ SG_ 2566609664 Vehicle_Fire_Suppression_System_ "Generic 8-byte raw payload. Detail page: https://www.isobus.net/isobus/pGNAndSPN/11465?type=PGN. Signal-level enrichment via PR welcome  see CONTRIBUTING.md.";
CM_ SG_ 2566609920 Vehicle_Fire_Suppression_System_ "Generic 8-byte raw payload. Detail page: https://www.isobus.net/isobus/pGNAndSPN/11489?type=PGN. Signal-level enrichment via PR welcome  see CONTRIBUTING.md.";
CM_ SG_ 2566610176 Vehicle_Fire_Suppression_System_ "Generic 8-byte raw payload. Detail page: https://www.isobus.net/isobus/pGNAndSPN/11513?type=PGN. Signal-level enrichment via PR welcome  see CONTRIBUTING.md.";
CM_ SG_ 2566610432 Vehicle_Fire_Suppression_System_ "Generic 8-byte raw payload. Detail page: https://www.isobus.net/isobus/pGNAndSPN/11537?type=PGN. Signal-level enrichment via PR welcome  see CONTRIBUTING.md.";
CM_ SG_ 2566610688 Vehicle_Fire_Suppression_System_ "Generic 8-byte raw payload. Detail page: https://www.isobus.net/isobus/pGNAndSPN/11545?type=PGN. Signal-level enrichment via PR welcome  see CONTRIBUTING.md.";
CM_ SG_ 2566610944 Vehicle_Fire_Suppression_System_ "Generic 8-byte raw payload. Detail page: https://www.isobus.net/isobus/pGNAndSPN/11553?type=PGN. Signal-level enrichment via PR welcome  see CONTRIBUTING.md.";
CM_ SG_ 2566611200 Vehicle_Fire_Suppression_System_ "Generic 8-byte raw payload. Detail page: https://www.isobus.net/isobus/pGNAndSPN/11561?type=PGN. Signal-level enrichment via PR welcome  see CONTRIBUTING.md.";
CM_ SG_ 2566611456 Vehicle_Fire_Suppression_System_ "Generic 8-byte raw payload. Detail page: https://www.isobus.net/isobus/pGNAndSPN/11569?type=PGN. Signal-level enrichment via PR welcome  see CONTRIBUTING.md.";
CM_ SG_ 2566611712 Vehicle_Fire_Suppression_System_ "Generic 8-byte raw payload. Detail page: https://www.isobus.net/isobus/pGNAndSPN/11582?type=PGN. Signal-level enrichment via PR welcome  see CONTRIBUTING.md.";
CM_ SG_ 2566611968 Vehicle_Fire_Suppression_System_ "Generic 8-byte raw payload. Detail page: https://www.isobus.net/isobus/pGNAndSPN/11595?type=PGN. Signal-level enrichment via PR welcome  see CONTRIBUTING.md.";
CM_ SG_ 2566612224 Vehicle_Fire_Suppression_System_ "Generic 8-byte raw payload. Detail page: https://www.isobus.net/isobus/pGNAndSPN/11608?type=PGN. Signal-level enrichment via PR welcome  see CONTRIBUTING.md.";
CM_ SG_ 2566612480 Vehicle_Fire_Suppression_System_ "Generic 8-byte raw payload. Detail page: https://www.isobus.net/isobus/pGNAndSPN/11621?type=PGN. Signal-level enrichment via PR welcome  see CONTRIBUTING.md.";
CM_ SG_ 2566612736 Motor_Generator_2_Inverter_Activ "Generic 8-byte raw payload. Detail page: https://www.isobus.net/isobus/pGNAndSPN/11640?type=PGN. Signal-level enrichment via PR welcome  see CONTRIBUTING.md.";
CM_ SG_ 2566612992 Motor_Generator_2_Inverter_Isola "Generic 8-byte raw payload. Detail page: https://www.isobus.net/isobus/pGNAndSPN/11647?type=PGN. Signal-level enrichment via PR welcome  see CONTRIBUTING.md.";
CM_ SG_ 2566613248 Motor_Generator_1_Inverter_Activ "Generic 8-byte raw payload. Detail page: https://www.isobus.net/isobus/pGNAndSPN/11666?type=PGN. Signal-level enrichment via PR welcome  see CONTRIBUTING.md.";
CM_ SG_ 2566613504 Motor_Generator_1_Inverter_Isola "Generic 8-byte raw payload. Detail page: https://www.isobus.net/isobus/pGNAndSPN/11673?type=PGN. Signal-level enrichment via PR welcome  see CONTRIBUTING.md.";
CM_ SG_ 2566613760 High_Voltage_Bus_Information_Raw "Generic 8-byte raw payload. Detail page: https://www.isobus.net/isobus/pGNAndSPN/11679?type=PGN. Signal-level enrichment via PR welcome  see CONTRIBUTING.md.";
CM_ SG_ 2566614016 Motor_Generator_2_Inverter_Refer "Generic 8-byte raw payload. Detail page: https://www.isobus.net/isobus/pGNAndSPN/11684?type=PGN. Signal-level enrichment via PR welcome  see CONTRIBUTING.md.";
CM_ SG_ 2566614272 Motor_Generator_2_Inverter_Statu "Generic 8-byte raw payload. Detail page: https://www.isobus.net/isobus/pGNAndSPN/11690?type=PGN. Signal-level enrichment via PR welcome  see CONTRIBUTING.md.";
CM_ SG_ 2566614528 Motor_Generator_2_Inverter_Refer "Generic 8-byte raw payload. Detail page: https://www.isobus.net/isobus/pGNAndSPN/11694?type=PGN. Signal-level enrichment via PR welcome  see CONTRIBUTING.md.";
CM_ SG_ 2566614784 Motor_Generator_2_Inverter_Tempe "Generic 8-byte raw payload. Detail page: https://www.isobus.net/isobus/pGNAndSPN/11699?type=PGN. Signal-level enrichment via PR welcome  see CONTRIBUTING.md.";
CM_ SG_ 2566615040 Motor_Generator_2_Inverter_Motor "Generic 8-byte raw payload. Detail page: https://www.isobus.net/isobus/pGNAndSPN/11703?type=PGN. Signal-level enrichment via PR welcome  see CONTRIBUTING.md.";
CM_ SG_ 2566615296 Motor_Generator_1_Inverter_Motor "Generic 8-byte raw payload. Detail page: https://www.isobus.net/isobus/pGNAndSPN/11707?type=PGN. Signal-level enrichment via PR welcome  see CONTRIBUTING.md.";
CM_ SG_ 2566615552 Motor_Generator_1_Inverter_Tempe "Generic 8-byte raw payload. Detail page: https://www.isobus.net/isobus/pGNAndSPN/11712?type=PGN. Signal-level enrichment via PR welcome  see CONTRIBUTING.md.";
CM_ SG_ 2566615808 Motor_Generator_1_Inverter_Refer "Generic 8-byte raw payload. Detail page: https://www.isobus.net/isobus/pGNAndSPN/11716?type=PGN. Signal-level enrichment via PR welcome  see CONTRIBUTING.md.";
CM_ SG_ 2566616064 Motor_Generator_1_Inverter_Statu "Generic 8-byte raw payload. Detail page: https://www.isobus.net/isobus/pGNAndSPN/11722?type=PGN. Signal-level enrichment via PR welcome  see CONTRIBUTING.md.";
CM_ SG_ 2566616320 Motor_Generator_1_Inverter_Refer "Generic 8-byte raw payload. Detail page: https://www.isobus.net/isobus/pGNAndSPN/11727?type=PGN. Signal-level enrichment via PR welcome  see CONTRIBUTING.md.";
CM_ SG_ 2566616576 Personnel_Detect_Status_RawPaylo "Generic 8-byte raw payload. Detail page: https://www.isobus.net/isobus/pGNAndSPN/11737?type=PGN. Signal-level enrichment via PR welcome  see CONTRIBUTING.md.";
CM_ SG_ 2566616832 Engine_Cylinder_Pressure_Gamma_1 "Generic 8-byte raw payload. Detail page: https://www.isobus.net/isobus/pGNAndSPN/11745?type=PGN. Signal-level enrichment via PR welcome  see CONTRIBUTING.md.";
CM_ SG_ 2566617088 Engine_Cylinder_Pressure_Gamma_2 "Generic 8-byte raw payload. Detail page: https://www.isobus.net/isobus/pGNAndSPN/11753?type=PGN. Signal-level enrichment via PR welcome  see CONTRIBUTING.md.";
CM_ SG_ 2566617344 Engine_Cylinder_Pressure_Gamma_3 "Generic 8-byte raw payload. Detail page: https://www.isobus.net/isobus/pGNAndSPN/11761?type=PGN. Signal-level enrichment via PR welcome  see CONTRIBUTING.md.";
CM_ SG_ 2566617600 Engine_Cylinder_Pressure_Gamma_4 "Generic 8-byte raw payload. Detail page: https://www.isobus.net/isobus/pGNAndSPN/11769?type=PGN. Signal-level enrichment via PR welcome  see CONTRIBUTING.md.";
CM_ SG_ 2566617856 Engine_Cylinder_Pressure_Gamma_5 "Generic 8-byte raw payload. Detail page: https://www.isobus.net/isobus/pGNAndSPN/11777?type=PGN. Signal-level enrichment via PR welcome  see CONTRIBUTING.md.";
CM_ SG_ 2566618112 Wake_Up_and_Sleep_RawPayload "Generic 8-byte raw payload. Detail page: https://www.isobus.net/isobus/pGNAndSPN/11779?type=PGN. Signal-level enrichment via PR welcome  see CONTRIBUTING.md.";
CM_ SG_ 2566618368 Electrified_Accessory_Generator_ "Generic 8-byte raw payload. Detail page: https://www.isobus.net/isobus/pGNAndSPN/11787?type=PGN. Signal-level enrichment via PR welcome  see CONTRIBUTING.md.";
CM_ SG_ 2566618624 Electrified_Accessory_Generator_ "Generic 8-byte raw payload. Detail page: https://www.isobus.net/isobus/pGNAndSPN/11795?type=PGN. Signal-level enrichment via PR welcome  see CONTRIBUTING.md.";
CM_ SG_ 2566618880 Well_Stimulation_Pump_System_Fil "Generic 8-byte raw payload. Detail page: https://www.isobus.net/isobus/pGNAndSPN/11798?type=PGN. Signal-level enrichment via PR welcome  see CONTRIBUTING.md.";
CM_ SG_ 2566619136 PTO_Governor_Configuration_RawPa "Generic 8-byte raw payload. Detail page: https://www.isobus.net/isobus/pGNAndSPN/11809?type=PGN. Signal-level enrichment via PR welcome  see CONTRIBUTING.md.";
CM_ SG_ 2566619392 On_Board_Programming_2_RawPayloa "Generic 8-byte raw payload. Detail page: https://www.isobus.net/isobus/pGNAndSPN/11812?type=PGN. Signal-level enrichment via PR welcome  see CONTRIBUTING.md.";
CM_ SG_ 2566619648 Primary_or_Rear_Hitch_Yaw_RawPay "Generic 8-byte raw payload. Detail page: https://www.isobus.net/isobus/pGNAndSPN/11817?type=PGN. Signal-level enrichment via PR welcome  see CONTRIBUTING.md.";
CM_ SG_ 2566619904 Secondary_or_Front_Hitch_Yaw_Raw "Generic 8-byte raw payload. Detail page: https://www.isobus.net/isobus/pGNAndSPN/11822?type=PGN. Signal-level enrichment via PR welcome  see CONTRIBUTING.md.";
CM_ SG_ 2566620160 Operator_Status_RawPayload "Generic 8-byte raw payload. Detail page: https://www.isobus.net/isobus/pGNAndSPN/11826?type=PGN. Signal-level enrichment via PR welcome  see CONTRIBUTING.md.";
CM_ SG_ 2566620416 Engine_Idle_Management_Informati "Generic 8-byte raw payload. Detail page: https://www.isobus.net/isobus/pGNAndSPN/11830?type=PGN. Signal-level enrichment via PR welcome  see CONTRIBUTING.md.";
CM_ SG_ 2566620672 Alcohol_Interlock_To_Vehicle_Raw "Generic 8-byte raw payload. Detail page: https://www.isobus.net/isobus/pGNAndSPN/11831?type=PGN. Signal-level enrichment via PR welcome  see CONTRIBUTING.md.";
CM_ SG_ 2566620928 Vehicle_To_Alcohol_Interlock_Raw "Generic 8-byte raw payload. Detail page: https://www.isobus.net/isobus/pGNAndSPN/11832?type=PGN. Signal-level enrichment via PR welcome  see CONTRIBUTING.md.";
CM_ SG_ 2566621184 Marine_Control_Information_3_Raw "Generic 8-byte raw payload. Detail page: https://www.isobus.net/isobus/pGNAndSPN/11845?type=PGN. Signal-level enrichment via PR welcome  see CONTRIBUTING.md.";
CM_ SG_ 2566621440 Engine_Fluid_Level_Pressure_13_R "Generic 8-byte raw payload. Detail page: https://www.isobus.net/isobus/pGNAndSPN/11852?type=PGN. Signal-level enrichment via PR welcome  see CONTRIBUTING.md.";
CM_ SG_ 2566621696 High_Voltage_Energy_Storage_Syst "Generic 8-byte raw payload. Detail page: https://www.isobus.net/isobus/pGNAndSPN/11857?type=PGN. Signal-level enrichment via PR welcome  see CONTRIBUTING.md.";
CM_ SG_ 2566621952 Economy_Mode_Inactive_Hours_RawP "Generic 8-byte raw payload. Detail page: https://www.isobus.net/isobus/pGNAndSPN/11859?type=PGN. Signal-level enrichment via PR welcome  see CONTRIBUTING.md.";
CM_ SG_ 2566622208 Economy_Mode_Estimated_Instantan "Generic 8-byte raw payload. Detail page: https://www.isobus.net/isobus/pGNAndSPN/11861?type=PGN. Signal-level enrichment via PR welcome  see CONTRIBUTING.md.";
CM_ SG_ 2566622464 Economy_Mode_Active_Hours_RawPay "Generic 8-byte raw payload. Detail page: https://www.isobus.net/isobus/pGNAndSPN/11863?type=PGN. Signal-level enrichment via PR welcome  see CONTRIBUTING.md.";
CM_ SG_ 2566622720 Economy_Mode_Fuel_Used_RawPayloa "Generic 8-byte raw payload. Detail page: https://www.isobus.net/isobus/pGNAndSPN/11865?type=PGN. Signal-level enrichment via PR welcome  see CONTRIBUTING.md.";
CM_ SG_ 2566622976 Economy_Mode_Estimated_Fuel_Savi "Generic 8-byte raw payload. Detail page: https://www.isobus.net/isobus/pGNAndSPN/11867?type=PGN. Signal-level enrichment via PR welcome  see CONTRIBUTING.md.";
CM_ SG_ 2566623232 DC_DC_Converter_4_Voltage_RawPay "Generic 8-byte raw payload. Detail page: https://www.isobus.net/isobus/pGNAndSPN/11869?type=PGN. Signal-level enrichment via PR welcome  see CONTRIBUTING.md.";
CM_ SG_ 2566623488 DC_DC_Converter_3_Voltage_RawPay "Generic 8-byte raw payload. Detail page: https://www.isobus.net/isobus/pGNAndSPN/11871?type=PGN. Signal-level enrichment via PR welcome  see CONTRIBUTING.md.";
CM_ SG_ 2566623744 DC_DC_Converter_2_Voltage_RawPay "Generic 8-byte raw payload. Detail page: https://www.isobus.net/isobus/pGNAndSPN/11873?type=PGN. Signal-level enrichment via PR welcome  see CONTRIBUTING.md.";
CM_ SG_ 2566624000 DC_DC_Converter_1_Voltage_RawPay "Generic 8-byte raw payload. Detail page: https://www.isobus.net/isobus/pGNAndSPN/11875?type=PGN. Signal-level enrichment via PR welcome  see CONTRIBUTING.md.";
CM_ SG_ 2566624256 Electronic_Engine_Controller_22_ "Generic 8-byte raw payload. Detail page: https://www.isobus.net/isobus/pGNAndSPN/11877?type=PGN. Signal-level enrichment via PR welcome  see CONTRIBUTING.md.";
CM_ SG_ 2566624512 Engine_Hours_2_RawPayload "Generic 8-byte raw payload. Detail page: https://www.isobus.net/isobus/pGNAndSPN/11878?type=PGN. Signal-level enrichment via PR welcome  see CONTRIBUTING.md.";
CM_ SG_ 2566624768 Engine_Information_3_RawPayload "Generic 8-byte raw payload. Detail page: https://www.isobus.net/isobus/pGNAndSPN/11881?type=PGN. Signal-level enrichment via PR welcome  see CONTRIBUTING.md.";
CM_ SG_ 2566625024 Vehicle_Electrical_Power_15_RawP "Generic 8-byte raw payload. Detail page: https://www.isobus.net/isobus/pGNAndSPN/11885?type=PGN. Signal-level enrichment via PR welcome  see CONTRIBUTING.md.";
CM_ SG_ 2566625280 Exhaust_Oxygen_2_RawPayload "Generic 8-byte raw payload. Detail page: https://www.isobus.net/isobus/pGNAndSPN/11886?type=PGN. Signal-level enrichment via PR welcome  see CONTRIBUTING.md.";
CM_ SG_ 2566625536 DC_AC_Accessory_Inverter_1_Tempe "Generic 8-byte raw payload. Detail page: https://www.isobus.net/isobus/pGNAndSPN/11891?type=PGN. Signal-level enrichment via PR welcome  see CONTRIBUTING.md.";
CM_ SG_ 2566625792 DC_AC_Accessory_Inverter_1_DC_Si "Generic 8-byte raw payload. Detail page: https://www.isobus.net/isobus/pGNAndSPN/11895?type=PGN. Signal-level enrichment via PR welcome  see CONTRIBUTING.md.";
CM_ SG_ 2566626048 DC_AC_Accessory_Inverter_1_AC_Si "Generic 8-byte raw payload. Detail page: https://www.isobus.net/isobus/pGNAndSPN/11898?type=PGN. Signal-level enrichment via PR welcome  see CONTRIBUTING.md.";
CM_ SG_ 2566626304 DC_AC_Accessory_Inverter_1_Confi "Generic 8-byte raw payload. Detail page: https://www.isobus.net/isobus/pGNAndSPN/11905?type=PGN. Signal-level enrichment via PR welcome  see CONTRIBUTING.md.";
CM_ SG_ 2566626560 DC_AC_Accessory_Inverter_1_Lifet "Generic 8-byte raw payload. Detail page: https://www.isobus.net/isobus/pGNAndSPN/11907?type=PGN. Signal-level enrichment via PR welcome  see CONTRIBUTING.md.";
CM_ SG_ 2566626816 DC_AC_Accessory_Inverter_2_Tempe "Generic 8-byte raw payload. Detail page: https://www.isobus.net/isobus/pGNAndSPN/11912?type=PGN. Signal-level enrichment via PR welcome  see CONTRIBUTING.md.";
CM_ SG_ 2566627072 DC_AC_Accessory_Inverter_2_DC_Si "Generic 8-byte raw payload. Detail page: https://www.isobus.net/isobus/pGNAndSPN/11916?type=PGN. Signal-level enrichment via PR welcome  see CONTRIBUTING.md.";
CM_ SG_ 2566627328 DC_AC_Accessory_Inverter_2_AC_Si "Generic 8-byte raw payload. Detail page: https://www.isobus.net/isobus/pGNAndSPN/11919?type=PGN. Signal-level enrichment via PR welcome  see CONTRIBUTING.md.";
CM_ SG_ 2566627584 DC_AC_Accessory_Inverter_2_Confi "Generic 8-byte raw payload. Detail page: https://www.isobus.net/isobus/pGNAndSPN/11926?type=PGN. Signal-level enrichment via PR welcome  see CONTRIBUTING.md.";
CM_ SG_ 2566627840 DC_AC_Accessory_Inverter_2_Lifet "Generic 8-byte raw payload. Detail page: https://www.isobus.net/isobus/pGNAndSPN/11928?type=PGN. Signal-level enrichment via PR welcome  see CONTRIBUTING.md.";
CM_ SG_ 2566628096 DC_AC_Accessory_Inverter_3_Tempe "Generic 8-byte raw payload. Detail page: https://www.isobus.net/isobus/pGNAndSPN/11933?type=PGN. Signal-level enrichment via PR welcome  see CONTRIBUTING.md.";
CM_ SG_ 2566628352 DC_AC_Accessory_Inverter_3_DC_Si "Generic 8-byte raw payload. Detail page: https://www.isobus.net/isobus/pGNAndSPN/11937?type=PGN. Signal-level enrichment via PR welcome  see CONTRIBUTING.md.";
CM_ SG_ 2566628608 DC_AC_Accessory_Inverter_3_AC_Si "Generic 8-byte raw payload. Detail page: https://www.isobus.net/isobus/pGNAndSPN/11940?type=PGN. Signal-level enrichment via PR welcome  see CONTRIBUTING.md.";
CM_ SG_ 2566628864 DC_AC_Accessory_Inverter_3_Confi "Generic 8-byte raw payload. Detail page: https://www.isobus.net/isobus/pGNAndSPN/11947?type=PGN. Signal-level enrichment via PR welcome  see CONTRIBUTING.md.";
CM_ SG_ 2566629120 DC_AC_Accessory_Inverter_3_Lifet "Generic 8-byte raw payload. Detail page: https://www.isobus.net/isobus/pGNAndSPN/11949?type=PGN. Signal-level enrichment via PR welcome  see CONTRIBUTING.md.";
CM_ SG_ 2566629376 DC_AC_Accessory_Inverter_4_Tempe "Generic 8-byte raw payload. Detail page: https://www.isobus.net/isobus/pGNAndSPN/11954?type=PGN. Signal-level enrichment via PR welcome  see CONTRIBUTING.md.";
CM_ SG_ 2566629632 DC_AC_Accessory_Inverter_4_DC_Si "Generic 8-byte raw payload. Detail page: https://www.isobus.net/isobus/pGNAndSPN/11958?type=PGN. Signal-level enrichment via PR welcome  see CONTRIBUTING.md.";
CM_ SG_ 2566629888 DC_AC_Accessory_Inverter_4_AC_Si "Generic 8-byte raw payload. Detail page: https://www.isobus.net/isobus/pGNAndSPN/11961?type=PGN. Signal-level enrichment via PR welcome  see CONTRIBUTING.md.";
CM_ SG_ 2566630144 DC_AC_Accessory_Inverter_4_Confi "Generic 8-byte raw payload. Detail page: https://www.isobus.net/isobus/pGNAndSPN/11968?type=PGN. Signal-level enrichment via PR welcome  see CONTRIBUTING.md.";
CM_ SG_ 2566630400 DC_AC_Accessory_Inverter_4_Lifet "Generic 8-byte raw payload. Detail page: https://www.isobus.net/isobus/pGNAndSPN/11970?type=PGN. Signal-level enrichment via PR welcome  see CONTRIBUTING.md.";
CM_ SG_ 2566630656 DC_AC_Accessory_Inverter_5_Tempe "Generic 8-byte raw payload. Detail page: https://www.isobus.net/isobus/pGNAndSPN/11975?type=PGN. Signal-level enrichment via PR welcome  see CONTRIBUTING.md.";
CM_ SG_ 2566630912 DC_AC_Accessory_Inverter_5_DC_Si "Generic 8-byte raw payload. Detail page: https://www.isobus.net/isobus/pGNAndSPN/11979?type=PGN. Signal-level enrichment via PR welcome  see CONTRIBUTING.md.";
CM_ SG_ 2566631168 DC_AC_Accessory_Inverter_5_AC_Si "Generic 8-byte raw payload. Detail page: https://www.isobus.net/isobus/pGNAndSPN/11982?type=PGN. Signal-level enrichment via PR welcome  see CONTRIBUTING.md.";
CM_ SG_ 2566631424 DC_AC_Accessory_Inverter_5_Confi "Generic 8-byte raw payload. Detail page: https://www.isobus.net/isobus/pGNAndSPN/11989?type=PGN. Signal-level enrichment via PR welcome  see CONTRIBUTING.md.";
CM_ SG_ 2566631680 DC_AC_Accessory_Inverter_5_Lifet "Generic 8-byte raw payload. Detail page: https://www.isobus.net/isobus/pGNAndSPN/11991?type=PGN. Signal-level enrichment via PR welcome  see CONTRIBUTING.md.";
CM_ SG_ 2566631936 Well_Stimulation_Pump_Sensor_Cal "Generic 8-byte raw payload. Detail page: https://www.isobus.net/isobus/pGNAndSPN/11995?type=PGN. Signal-level enrichment via PR welcome  see CONTRIBUTING.md.";
CM_ SG_ 2566632192 Well_Stimulation_Pump_Fluid_Volu "Generic 8-byte raw payload. Detail page: https://www.isobus.net/isobus/pGNAndSPN/11997?type=PGN. Signal-level enrichment via PR welcome  see CONTRIBUTING.md.";
CM_ SG_ 2566632448 Well_Stimulation_Pump_Serial_Num "Generic 8-byte raw payload. Detail page: https://www.isobus.net/isobus/pGNAndSPN/11999?type=PGN. Signal-level enrichment via PR welcome  see CONTRIBUTING.md.";
CM_ SG_ 2566632704 Well_Stimulation_Pump_Trip_Hours "Generic 8-byte raw payload. Detail page: https://www.isobus.net/isobus/pGNAndSPN/12001?type=PGN. Signal-level enrichment via PR welcome  see CONTRIBUTING.md.";
CM_ SG_ 2566632960 Aftertreatment_1_Outlet_Gas_4_Ra "Generic 8-byte raw payload. Detail page: https://www.isobus.net/isobus/pGNAndSPN/12003?type=PGN. Signal-level enrichment via PR welcome  see CONTRIBUTING.md.";
CM_ SG_ 2566633216 Aftertreatment_1_Intake_Gas_4_Ra "Generic 8-byte raw payload. Detail page: https://www.isobus.net/isobus/pGNAndSPN/12005?type=PGN. Signal-level enrichment via PR welcome  see CONTRIBUTING.md.";
CM_ SG_ 2566633472 DC_DC_Converter_4_Lifetime_Data_ "Generic 8-byte raw payload. Detail page: https://www.isobus.net/isobus/pGNAndSPN/12009?type=PGN. Signal-level enrichment via PR welcome  see CONTRIBUTING.md.";
CM_ SG_ 2566633728 DC_DC_Converter_4_Configuration_ "Generic 8-byte raw payload. Detail page: https://www.isobus.net/isobus/pGNAndSPN/12021?type=PGN. Signal-level enrichment via PR welcome  see CONTRIBUTING.md.";
CM_ SG_ 2566633984 DC_DC_Converter_4_SLI_Battery_Li "Generic 8-byte raw payload. Detail page: https://www.isobus.net/isobus/pGNAndSPN/12024?type=PGN. Signal-level enrichment via PR welcome  see CONTRIBUTING.md.";
CM_ SG_ 2566634240 DC_DC_Converter_4_Temperatures_R "Generic 8-byte raw payload. Detail page: https://www.isobus.net/isobus/pGNAndSPN/12029?type=PGN. Signal-level enrichment via PR welcome  see CONTRIBUTING.md.";
CM_ SG_ 2566634496 DC_DC_Converter_4_Low_Side_Limit "Generic 8-byte raw payload. Detail page: https://www.isobus.net/isobus/pGNAndSPN/12033?type=PGN. Signal-level enrichment via PR welcome  see CONTRIBUTING.md.";
CM_ SG_ 2566634752 DC_DC_Converter_4_High_Side_Limi "Generic 8-byte raw payload. Detail page: https://www.isobus.net/isobus/pGNAndSPN/12037?type=PGN. Signal-level enrichment via PR welcome  see CONTRIBUTING.md.";
CM_ SG_ 2566635008 DC_DC_Converter_3_Lifetime_Data_ "Generic 8-byte raw payload. Detail page: https://www.isobus.net/isobus/pGNAndSPN/12041?type=PGN. Signal-level enrichment via PR welcome  see CONTRIBUTING.md.";
CM_ SG_ 2566635264 DC_DC_Converter_3_Configuration_ "Generic 8-byte raw payload. Detail page: https://www.isobus.net/isobus/pGNAndSPN/12053?type=PGN. Signal-level enrichment via PR welcome  see CONTRIBUTING.md.";
CM_ SG_ 2566635520 DC_DC_Converter_3_SLI_Battery_Li "Generic 8-byte raw payload. Detail page: https://www.isobus.net/isobus/pGNAndSPN/12056?type=PGN. Signal-level enrichment via PR welcome  see CONTRIBUTING.md.";
CM_ SG_ 2566635776 DC_DC_Converter_3_Temperatures_R "Generic 8-byte raw payload. Detail page: https://www.isobus.net/isobus/pGNAndSPN/12061?type=PGN. Signal-level enrichment via PR welcome  see CONTRIBUTING.md.";
CM_ SG_ 2566636032 DC_DC_Converter_3_Low_Side_Limit "Generic 8-byte raw payload. Detail page: https://www.isobus.net/isobus/pGNAndSPN/12065?type=PGN. Signal-level enrichment via PR welcome  see CONTRIBUTING.md.";
CM_ SG_ 2566636288 DC_DC_Converter_3_High_Side_Limi "Generic 8-byte raw payload. Detail page: https://www.isobus.net/isobus/pGNAndSPN/12069?type=PGN. Signal-level enrichment via PR welcome  see CONTRIBUTING.md.";
CM_ SG_ 2566636544 DC_DC_Converter_2_Lifetime_Data_ "Generic 8-byte raw payload. Detail page: https://www.isobus.net/isobus/pGNAndSPN/12073?type=PGN. Signal-level enrichment via PR welcome  see CONTRIBUTING.md.";
CM_ SG_ 2566636800 DC_DC_Converter_2_Configuration_ "Generic 8-byte raw payload. Detail page: https://www.isobus.net/isobus/pGNAndSPN/12085?type=PGN. Signal-level enrichment via PR welcome  see CONTRIBUTING.md.";
CM_ SG_ 2566637056 DC_DC_Converter_2_SLI_Battery_Li "Generic 8-byte raw payload. Detail page: https://www.isobus.net/isobus/pGNAndSPN/12088?type=PGN. Signal-level enrichment via PR welcome  see CONTRIBUTING.md.";
CM_ SG_ 2566637312 DC_DC_Converter_2_Temperatures_R "Generic 8-byte raw payload. Detail page: https://www.isobus.net/isobus/pGNAndSPN/12093?type=PGN. Signal-level enrichment via PR welcome  see CONTRIBUTING.md.";
CM_ SG_ 2566637568 DC_DC_Converter_2_Low_Side_Limit "Generic 8-byte raw payload. Detail page: https://www.isobus.net/isobus/pGNAndSPN/12097?type=PGN. Signal-level enrichment via PR welcome  see CONTRIBUTING.md.";
CM_ SG_ 2566637824 DC_DC_Converter_2_High_Side_Limi "Generic 8-byte raw payload. Detail page: https://www.isobus.net/isobus/pGNAndSPN/12101?type=PGN. Signal-level enrichment via PR welcome  see CONTRIBUTING.md.";
CM_ SG_ 2566638080 CiA_602_2_AUTOSAR_CAN_NM_Obsolet "Generic 8-byte raw payload. Detail page: https://www.isobus.net/isobus/pGNAndSPN/12102?type=PGN. Signal-level enrichment via PR welcome  see CONTRIBUTING.md.";
CM_ SG_ 2566638336 Engine_Exhaust_Particulate_Contr "Generic 8-byte raw payload. Detail page: https://www.isobus.net/isobus/pGNAndSPN/12104?type=PGN. Signal-level enrichment via PR welcome  see CONTRIBUTING.md.";
CM_ SG_ 2566638592 Well_Stimulation_Pump_Hours_RawP "Generic 8-byte raw payload. Detail page: https://www.isobus.net/isobus/pGNAndSPN/12108?type=PGN. Signal-level enrichment via PR welcome  see CONTRIBUTING.md.";
CM_ SG_ 2566638848 Well_Stimulation_Pump_System_Con "Generic 8-byte raw payload. Detail page: https://www.isobus.net/isobus/pGNAndSPN/12119?type=PGN. Signal-level enrichment via PR welcome  see CONTRIBUTING.md.";
CM_ SG_ 2566639104 Configurable_Receive_SPNs_Status "Generic 8-byte raw payload. Detail page: https://www.isobus.net/isobus/pGNAndSPN/12126?type=PGN. Signal-level enrichment via PR welcome  see CONTRIBUTING.md.";
CM_ SG_ 2566639360 DC_DC_Converter_1_Lifetime_Data_ "Generic 8-byte raw payload. Detail page: https://www.isobus.net/isobus/pGNAndSPN/12130?type=PGN. Signal-level enrichment via PR welcome  see CONTRIBUTING.md.";
CM_ SG_ 2566639616 DC_DC_Converter_1_Configuration_ "Generic 8-byte raw payload. Detail page: https://www.isobus.net/isobus/pGNAndSPN/12142?type=PGN. Signal-level enrichment via PR welcome  see CONTRIBUTING.md.";
CM_ SG_ 2566639872 DC_DC_Converter_1_SLI_Battery_Li "Generic 8-byte raw payload. Detail page: https://www.isobus.net/isobus/pGNAndSPN/12145?type=PGN. Signal-level enrichment via PR welcome  see CONTRIBUTING.md.";
CM_ SG_ 2566640128 Pump_Oil_Message_RawPayload "Generic 8-byte raw payload. Detail page: https://www.isobus.net/isobus/pGNAndSPN/12149?type=PGN. Signal-level enrichment via PR welcome  see CONTRIBUTING.md.";
CM_ SG_ 2566640384 Well_Stimulation_Pump_System_Lif "Generic 8-byte raw payload. Detail page: https://www.isobus.net/isobus/pGNAndSPN/12153?type=PGN. Signal-level enrichment via PR welcome  see CONTRIBUTING.md.";
CM_ SG_ 2566640640 Well_Stimulation_Pump_System_Con "Generic 8-byte raw payload. Detail page: https://www.isobus.net/isobus/pGNAndSPN/12157?type=PGN. Signal-level enrichment via PR welcome  see CONTRIBUTING.md.";
CM_ SG_ 2566640896 Aftercooler_and_Oil_Cooler_Fluid "Generic 8-byte raw payload. Detail page: https://www.isobus.net/isobus/pGNAndSPN/12161?type=PGN. Signal-level enrichment via PR welcome  see CONTRIBUTING.md.";
CM_ SG_ 2566641152 Electronic_Engine_Controller_21_ "Generic 8-byte raw payload. Detail page: https://www.isobus.net/isobus/pGNAndSPN/12163?type=PGN. Signal-level enrichment via PR welcome  see CONTRIBUTING.md.";
CM_ SG_ 2566641408 Configurable_Transmit_PGNs_Statu "Generic 8-byte raw payload. Detail page: https://www.isobus.net/isobus/pGNAndSPN/12170?type=PGN. Signal-level enrichment via PR welcome  see CONTRIBUTING.md.";
CM_ SG_ 2566641664 DC_DC_Converter_1_Temperatures_R "Generic 8-byte raw payload. Detail page: https://www.isobus.net/isobus/pGNAndSPN/12175?type=PGN. Signal-level enrichment via PR welcome  see CONTRIBUTING.md.";
CM_ SG_ 2566641920 DC_DC_Converter_1_Low_Side_Limit "Generic 8-byte raw payload. Detail page: https://www.isobus.net/isobus/pGNAndSPN/12179?type=PGN. Signal-level enrichment via PR welcome  see CONTRIBUTING.md.";
CM_ SG_ 2566642176 DC_DC_Converter_1_High_Side_Limi "Generic 8-byte raw payload. Detail page: https://www.isobus.net/isobus/pGNAndSPN/12183?type=PGN. Signal-level enrichment via PR welcome  see CONTRIBUTING.md.";
CM_ SG_ 2566642688 Door_Control_4_RawPayload "Generic 8-byte raw payload. Detail page: https://www.isobus.net/isobus/pGNAndSPN/12216?type=PGN. Signal-level enrichment via PR welcome  see CONTRIBUTING.md.";
CM_ SG_ 2566642944 Door_Control_3_RawPayload "Generic 8-byte raw payload. Detail page: https://www.isobus.net/isobus/pGNAndSPN/12246?type=PGN. Signal-level enrichment via PR welcome  see CONTRIBUTING.md.";
CM_ SG_ 2566643200 Engine_Temperature_6_RawPayload "Generic 8-byte raw payload. Detail page: https://www.isobus.net/isobus/pGNAndSPN/12250?type=PGN. Signal-level enrichment via PR welcome  see CONTRIBUTING.md.";
CM_ SG_ 2566643456 Intake_Exhaust_Conditions_3_RawP "Generic 8-byte raw payload. Detail page: https://www.isobus.net/isobus/pGNAndSPN/12254?type=PGN. Signal-level enrichment via PR welcome  see CONTRIBUTING.md.";
CM_ SG_ 2566643712 Aftercooler_and_Oil_Cooler_Fluid "Generic 8-byte raw payload. Detail page: https://www.isobus.net/isobus/pGNAndSPN/12262?type=PGN. Signal-level enrichment via PR welcome  see CONTRIBUTING.md.";
CM_ SG_ 2566643968 Diode_Temperature_2_RawPayload "Generic 8-byte raw payload. Detail page: https://www.isobus.net/isobus/pGNAndSPN/12266?type=PGN. Signal-level enrichment via PR welcome  see CONTRIBUTING.md.";
CM_ SG_ 2566644224 Diode_Temperature_1_RawPayload "Generic 8-byte raw payload. Detail page: https://www.isobus.net/isobus/pGNAndSPN/12274?type=PGN. Signal-level enrichment via PR welcome  see CONTRIBUTING.md.";
CM_ SG_ 2566644480 Alternator_Temperature_2_RawPayl "Generic 8-byte raw payload. Detail page: https://www.isobus.net/isobus/pGNAndSPN/12282?type=PGN. Signal-level enrichment via PR welcome  see CONTRIBUTING.md.";
CM_ SG_ 2566644736 Fuel_Information_7_Gaseous_RawPa "Generic 8-byte raw payload. Detail page: https://www.isobus.net/isobus/pGNAndSPN/12294?type=PGN. Signal-level enrichment via PR welcome  see CONTRIBUTING.md.";
CM_ SG_ 2566644992 High_Voltage_Energy_Storage_Syst "Generic 8-byte raw payload. Detail page: https://www.isobus.net/isobus/pGNAndSPN/12303?type=PGN. Signal-level enrichment via PR welcome  see CONTRIBUTING.md.";
CM_ SG_ 2566645248 High_Voltage_Energy_Storage_Syst "Generic 8-byte raw payload. Detail page: https://www.isobus.net/isobus/pGNAndSPN/12325?type=PGN. Signal-level enrichment via PR welcome  see CONTRIBUTING.md.";
CM_ SG_ 2566645504 SCR_Operator_Inducement_Informat "Generic 8-byte raw payload. Detail page: https://www.isobus.net/isobus/pGNAndSPN/12327?type=PGN. Signal-level enrichment via PR welcome  see CONTRIBUTING.md.";
CM_ SG_ 2566645760 Aftertreatment_System_Informatio "Generic 8-byte raw payload. Detail page: https://www.isobus.net/isobus/pGNAndSPN/12331?type=PGN. Signal-level enrichment via PR welcome  see CONTRIBUTING.md.";
CM_ SG_ 2566646016 Ethernet_1_Connection_Informatio "Generic 8-byte raw payload. Detail page: https://www.isobus.net/isobus/pGNAndSPN/12332?type=PGN. Signal-level enrichment via PR welcome  see CONTRIBUTING.md.";
CM_ SG_ 2566646272 Ethernet_1_Connection_Informatio "Generic 8-byte raw payload. Detail page: https://www.isobus.net/isobus/pGNAndSPN/12352?type=PGN. Signal-level enrichment via PR welcome  see CONTRIBUTING.md.";
CM_ SG_ 2566646528 Oil_Debris_Monitor_Counts_Ferrou "Generic 8-byte raw payload. Detail page: https://www.isobus.net/isobus/pGNAndSPN/12355?type=PGN. Signal-level enrichment via PR welcome  see CONTRIBUTING.md.";
CM_ SG_ 2566646784 Oil_Debris_Monitor_Counts_Ferrou "Generic 8-byte raw payload. Detail page: https://www.isobus.net/isobus/pGNAndSPN/12358?type=PGN. Signal-level enrichment via PR welcome  see CONTRIBUTING.md.";
CM_ SG_ 2566647040 Oil_Debris_Monitor_Counts_Ferrou "Generic 8-byte raw payload. Detail page: https://www.isobus.net/isobus/pGNAndSPN/12361?type=PGN. Signal-level enrichment via PR welcome  see CONTRIBUTING.md.";
CM_ SG_ 2566647296 Oil_Debris_Monitor_Counts_Non_Fe "Generic 8-byte raw payload. Detail page: https://www.isobus.net/isobus/pGNAndSPN/12364?type=PGN. Signal-level enrichment via PR welcome  see CONTRIBUTING.md.";
CM_ SG_ 2566647552 Oil_Debris_Monitor_Counts_Non_Fe "Generic 8-byte raw payload. Detail page: https://www.isobus.net/isobus/pGNAndSPN/12367?type=PGN. Signal-level enrichment via PR welcome  see CONTRIBUTING.md.";
CM_ SG_ 2566647808 Oil_Debris_Monitor_Counts_Non_Fe "Generic 8-byte raw payload. Detail page: https://www.isobus.net/isobus/pGNAndSPN/12370?type=PGN. Signal-level enrichment via PR welcome  see CONTRIBUTING.md.";
CM_ SG_ 2566648064 Oil_Debris_Monitoring_System_Sta "Generic 8-byte raw payload. Detail page: https://www.isobus.net/isobus/pGNAndSPN/12376?type=PGN. Signal-level enrichment via PR welcome  see CONTRIBUTING.md.";
CM_ SG_ 2566648320 Engine_Fuel_Lube_Systems_3_RawPa "Generic 8-byte raw payload. Detail page: https://www.isobus.net/isobus/pGNAndSPN/12378?type=PGN. Signal-level enrichment via PR welcome  see CONTRIBUTING.md.";
CM_ SG_ 2566648576 Cruise_Control_Vehicle_Speed_5_R "Generic 8-byte raw payload. Detail page: https://www.isobus.net/isobus/pGNAndSPN/12379?type=PGN. Signal-level enrichment via PR welcome  see CONTRIBUTING.md.";
CM_ SG_ 2566648832 Aftertreatment_2_Diesel_Oxidatio "Generic 8-byte raw payload. Detail page: https://www.isobus.net/isobus/pGNAndSPN/12382?type=PGN. Signal-level enrichment via PR welcome  see CONTRIBUTING.md.";
CM_ SG_ 2566649088 Aftertreatment_1_Diesel_Oxidatio "Generic 8-byte raw payload. Detail page: https://www.isobus.net/isobus/pGNAndSPN/12385?type=PGN. Signal-level enrichment via PR welcome  see CONTRIBUTING.md.";
CM_ SG_ 2566649344 Vehicle_Position_2_RawPayload "Generic 8-byte raw payload. Detail page: https://www.isobus.net/isobus/pGNAndSPN/12390?type=PGN. Signal-level enrichment via PR welcome  see CONTRIBUTING.md.";
CM_ SG_ 2566649600 Electrified_Accessory_Propulsion "Generic 8-byte raw payload. Detail page: https://www.isobus.net/isobus/pGNAndSPN/12398?type=PGN. Signal-level enrichment via PR welcome  see CONTRIBUTING.md.";
CM_ SG_ 2566649856 Electrified_Accessory_Propulsion "Generic 8-byte raw payload. Detail page: https://www.isobus.net/isobus/pGNAndSPN/12406?type=PGN. Signal-level enrichment via PR welcome  see CONTRIBUTING.md.";
CM_ SG_ 2566650112 Electrified_Accessory_Propulsion "Generic 8-byte raw payload. Detail page: https://www.isobus.net/isobus/pGNAndSPN/12414?type=PGN. Signal-level enrichment via PR welcome  see CONTRIBUTING.md.";
CM_ SG_ 2566650368 Electrified_Accessory_Power_Elec "Generic 8-byte raw payload. Detail page: https://www.isobus.net/isobus/pGNAndSPN/12422?type=PGN. Signal-level enrichment via PR welcome  see CONTRIBUTING.md.";
CM_ SG_ 2566650624 Electrified_Accessory_Power_Elec "Generic 8-byte raw payload. Detail page: https://www.isobus.net/isobus/pGNAndSPN/12430?type=PGN. Signal-level enrichment via PR welcome  see CONTRIBUTING.md.";
CM_ SG_ 2566650880 Electrified_Accessory_Power_Elec "Generic 8-byte raw payload. Detail page: https://www.isobus.net/isobus/pGNAndSPN/12438?type=PGN. Signal-level enrichment via PR welcome  see CONTRIBUTING.md.";
CM_ SG_ 2566651136 Electrified_Accessory_Propulsion "Generic 8-byte raw payload. Detail page: https://www.isobus.net/isobus/pGNAndSPN/12446?type=PGN. Signal-level enrichment via PR welcome  see CONTRIBUTING.md.";
CM_ SG_ 2566651392 Electrified_Accessory_Propulsion "Generic 8-byte raw payload. Detail page: https://www.isobus.net/isobus/pGNAndSPN/12454?type=PGN. Signal-level enrichment via PR welcome  see CONTRIBUTING.md.";
CM_ SG_ 2566651648 Electrified_Accessory_Power_Elec "Generic 8-byte raw payload. Detail page: https://www.isobus.net/isobus/pGNAndSPN/12462?type=PGN. Signal-level enrichment via PR welcome  see CONTRIBUTING.md.";
CM_ SG_ 2566651904 Trailer_Wheel_Brake_Wear_Life_Re "Generic 8-byte raw payload. Detail page: https://www.isobus.net/isobus/pGNAndSPN/12478?type=PGN. Signal-level enrichment via PR welcome  see CONTRIBUTING.md.";
CM_ SG_ 2566652160 Electrified_Accessory_Motor_Stat "Generic 8-byte raw payload. Detail page: https://www.isobus.net/isobus/pGNAndSPN/12487?type=PGN. Signal-level enrichment via PR welcome  see CONTRIBUTING.md.";
CM_ SG_ 2566652416 SCR_System_Information_RawPayloa "Generic 8-byte raw payload. Detail page: https://www.isobus.net/isobus/pGNAndSPN/12492?type=PGN. Signal-level enrichment via PR welcome  see CONTRIBUTING.md.";
CM_ SG_ 2566652672 Vehicle_Electrical_Power_14_RawP "Generic 8-byte raw payload. Detail page: https://www.isobus.net/isobus/pGNAndSPN/12497?type=PGN. Signal-level enrichment via PR welcome  see CONTRIBUTING.md.";
CM_ SG_ 2566652928 Vehicle_Electrical_Power_13_RawP "Generic 8-byte raw payload. Detail page: https://www.isobus.net/isobus/pGNAndSPN/12500?type=PGN. Signal-level enrichment via PR welcome  see CONTRIBUTING.md.";
CM_ SG_ 2566653184 Vehicle_Electrical_Power_12_RawP "Generic 8-byte raw payload. Detail page: https://www.isobus.net/isobus/pGNAndSPN/12505?type=PGN. Signal-level enrichment via PR welcome  see CONTRIBUTING.md.";
CM_ SG_ 2566653440 Vehicle_Electrical_Power_11_RawP "Generic 8-byte raw payload. Detail page: https://www.isobus.net/isobus/pGNAndSPN/12508?type=PGN. Signal-level enrichment via PR welcome  see CONTRIBUTING.md.";
CM_ SG_ 2566653696 Vehicle_Electrical_Power_10_RawP "Generic 8-byte raw payload. Detail page: https://www.isobus.net/isobus/pGNAndSPN/12513?type=PGN. Signal-level enrichment via PR welcome  see CONTRIBUTING.md.";
CM_ SG_ 2566653952 Vehicle_Electrical_Power_9_RawPa "Generic 8-byte raw payload. Detail page: https://www.isobus.net/isobus/pGNAndSPN/12516?type=PGN. Signal-level enrichment via PR welcome  see CONTRIBUTING.md.";
CM_ SG_ 2566654208 Vehicle_Electrical_Power_8_RawPa "Generic 8-byte raw payload. Detail page: https://www.isobus.net/isobus/pGNAndSPN/12521?type=PGN. Signal-level enrichment via PR welcome  see CONTRIBUTING.md.";
CM_ SG_ 2566654464 Vehicle_Electrical_Power_7_RawPa "Generic 8-byte raw payload. Detail page: https://www.isobus.net/isobus/pGNAndSPN/12524?type=PGN. Signal-level enrichment via PR welcome  see CONTRIBUTING.md.";
CM_ SG_ 2566654720 Electronic_Engine_Controller_20_ "Generic 8-byte raw payload. Detail page: https://www.isobus.net/isobus/pGNAndSPN/12528?type=PGN. Signal-level enrichment via PR welcome  see CONTRIBUTING.md.";
CM_ SG_ 2566654976 Evaporative_Systems_RawPayload "Generic 8-byte raw payload. Detail page: https://www.isobus.net/isobus/pGNAndSPN/12531?type=PGN. Signal-level enrichment via PR welcome  see CONTRIBUTING.md.";
CM_ SG_ 2566655232 Fire_Pump_Statistics_1_RawPayloa "Generic 8-byte raw payload. Detail page: https://www.isobus.net/isobus/pGNAndSPN/12533?type=PGN. Signal-level enrichment via PR welcome  see CONTRIBUTING.md.";
CM_ SG_ 2566655488 Primary_or_Rear_Hitch_Roll_and_P "Generic 8-byte raw payload. Detail page: https://www.isobus.net/isobus/pGNAndSPN/12535?type=PGN. Signal-level enrichment via PR welcome  see CONTRIBUTING.md.";
CM_ SG_ 2566655744 Secondary_or_Front_Hitch_Roll_an "Generic 8-byte raw payload. Detail page: https://www.isobus.net/isobus/pGNAndSPN/12537?type=PGN. Signal-level enrichment via PR welcome  see CONTRIBUTING.md.";
CM_ SG_ 2566656000 Ambient_Conditions_3_RawPayload "Generic 8-byte raw payload. Detail page: https://www.isobus.net/isobus/pGNAndSPN/12540?type=PGN. Signal-level enrichment via PR welcome  see CONTRIBUTING.md.";
CM_ SG_ 2566656256 Total_Gaseous_Fuel_Information_R "Generic 8-byte raw payload. Detail page: https://www.isobus.net/isobus/pGNAndSPN/12542?type=PGN. Signal-level enrichment via PR welcome  see CONTRIBUTING.md.";
CM_ SG_ 2566656512 Cab_Door_Control_1_RawPayload "Generic 8-byte raw payload. Detail page: https://www.isobus.net/isobus/pGNAndSPN/12562?type=PGN. Signal-level enrichment via PR welcome  see CONTRIBUTING.md.";
CM_ SG_ 2566656768 Door_Latch_Status_RawPayload "Generic 8-byte raw payload. Detail page: https://www.isobus.net/isobus/pGNAndSPN/12566?type=PGN. Signal-level enrichment via PR welcome  see CONTRIBUTING.md.";
CM_ SG_ 2566657024 Vehicle_Electrical_Power_3_obsol "Generic 8-byte raw payload. Detail page: https://www.isobus.net/isobus/pGNAndSPN/12567?type=PGN. Signal-level enrichment via PR welcome  see CONTRIBUTING.md.";
CM_ SG_ 2566657280 Vehicle_Electrical_Power_6_RawPa "Generic 8-byte raw payload. Detail page: https://www.isobus.net/isobus/pGNAndSPN/12571?type=PGN. Signal-level enrichment via PR welcome  see CONTRIBUTING.md.";
CM_ SG_ 2566657536 Payload_Temperature_2_RawPayload "Generic 8-byte raw payload. Detail page: https://www.isobus.net/isobus/pGNAndSPN/12572?type=PGN. Signal-level enrichment via PR welcome  see CONTRIBUTING.md.";
CM_ SG_ 2566657792 Payload_Temperature_1_RawPayload "Generic 8-byte raw payload. Detail page: https://www.isobus.net/isobus/pGNAndSPN/12576?type=PGN. Signal-level enrichment via PR welcome  see CONTRIBUTING.md.";
CM_ SG_ 2566658048 Payload_System_Totals_2_RawPaylo "Generic 8-byte raw payload. Detail page: https://www.isobus.net/isobus/pGNAndSPN/12577?type=PGN. Signal-level enrichment via PR welcome  see CONTRIBUTING.md.";
CM_ SG_ 2566658304 Payload_System_Totals_1_RawPaylo "Generic 8-byte raw payload. Detail page: https://www.isobus.net/isobus/pGNAndSPN/12579?type=PGN. Signal-level enrichment via PR welcome  see CONTRIBUTING.md.";
CM_ SG_ 2566658560 HVESS_Thermal_Management_System_ "Generic 8-byte raw payload. Detail page: https://www.isobus.net/isobus/pGNAndSPN/12585?type=PGN. Signal-level enrichment via PR welcome  see CONTRIBUTING.md.";
CM_ SG_ 2566658816 HVESS_Thermal_Management_System_ "Generic 8-byte raw payload. Detail page: https://www.isobus.net/isobus/pGNAndSPN/12589?type=PGN. Signal-level enrichment via PR welcome  see CONTRIBUTING.md.";
CM_ SG_ 2566659072 Refrigeration_Compartment_Inform "Generic 8-byte raw payload. Detail page: https://www.isobus.net/isobus/pGNAndSPN/12593?type=PGN. Signal-level enrichment via PR welcome  see CONTRIBUTING.md.";
CM_ SG_ 2566659328 Refrigeration_Compartment_Inform "Generic 8-byte raw payload. Detail page: https://www.isobus.net/isobus/pGNAndSPN/12595?type=PGN. Signal-level enrichment via PR welcome  see CONTRIBUTING.md.";
CM_ SG_ 2566659584 Vehicle_Electrical_Power_16_RawP "Generic 8-byte raw payload. Detail page: https://www.isobus.net/isobus/pGNAndSPN/12599?type=PGN. Signal-level enrichment via PR welcome  see CONTRIBUTING.md.";
CM_ SG_ 2566659840 Vehicle_Electrical_Power_17_RawP "Generic 8-byte raw payload. Detail page: https://www.isobus.net/isobus/pGNAndSPN/12603?type=PGN. Signal-level enrichment via PR welcome  see CONTRIBUTING.md.";
CM_ SG_ 2566660096 High_Voltage_Energy_Storage_Syst "Generic 8-byte raw payload. Detail page: https://www.isobus.net/isobus/pGNAndSPN/12635?type=PGN. Signal-level enrichment via PR welcome  see CONTRIBUTING.md.";
CM_ SG_ 2566660352 High_Voltage_Energy_Storage_Syst "Generic 8-byte raw payload. Detail page: https://www.isobus.net/isobus/pGNAndSPN/12667?type=PGN. Signal-level enrichment via PR welcome  see CONTRIBUTING.md.";
CM_ SG_ 2566660608 Electronic_Engine_Controller_19_ "Generic 8-byte raw payload. Detail page: https://www.isobus.net/isobus/pGNAndSPN/12669?type=PGN. Signal-level enrichment via PR welcome  see CONTRIBUTING.md.";
CM_ SG_ 2566660864 Fuel_Consumption_Liquid_2_RawPay "Generic 8-byte raw payload. Detail page: https://www.isobus.net/isobus/pGNAndSPN/12670?type=PGN. Signal-level enrichment via PR welcome  see CONTRIBUTING.md.";
CM_ SG_ 2566661120 Aftertreatment_2_Diesel_Exhaust_ "Generic 8-byte raw payload. Detail page: https://www.isobus.net/isobus/pGNAndSPN/12673?type=PGN. Signal-level enrichment via PR welcome  see CONTRIBUTING.md.";
CM_ SG_ 2566661376 Aftertreatment_1_Diesel_Exhaust_ "Generic 8-byte raw payload. Detail page: https://www.isobus.net/isobus/pGNAndSPN/12676?type=PGN. Signal-level enrichment via PR welcome  see CONTRIBUTING.md.";
CM_ SG_ 2566661632 Aftertreatment_2_Diesel_Exhaust_ "Generic 8-byte raw payload. Detail page: https://www.isobus.net/isobus/pGNAndSPN/12678?type=PGN. Signal-level enrichment via PR welcome  see CONTRIBUTING.md.";
CM_ SG_ 2566661888 Aftertreatment_1_Diesel_Exhaust_ "Generic 8-byte raw payload. Detail page: https://www.isobus.net/isobus/pGNAndSPN/12680?type=PGN. Signal-level enrichment via PR welcome  see CONTRIBUTING.md.";
CM_ SG_ 2566662144 Cruise_Control_Vehicle_Speed_6_R "Generic 8-byte raw payload. Detail page: https://www.isobus.net/isobus/pGNAndSPN/12685?type=PGN. Signal-level enrichment via PR welcome  see CONTRIBUTING.md.";
CM_ SG_ 2566662400 Forward_Lane_Image_3_RawPayload "Generic 8-byte raw payload. Detail page: https://www.isobus.net/isobus/pGNAndSPN/12694?type=PGN. Signal-level enrichment via PR welcome  see CONTRIBUTING.md.";
CM_ SG_ 2566662656 Operator_Inducement_Information_ "Generic 8-byte raw payload. Detail page: https://www.isobus.net/isobus/pGNAndSPN/12699?type=PGN. Signal-level enrichment via PR welcome  see CONTRIBUTING.md.";
CM_ SG_ 2566662912 Cruise_Control_Vehicle_Speed_4_R "Generic 8-byte raw payload. Detail page: https://www.isobus.net/isobus/pGNAndSPN/12703?type=PGN. Signal-level enrichment via PR welcome  see CONTRIBUTING.md.";
CM_ SG_ 2566663168 Brake_Caliper_Lining_Clearance_R "Generic 8-byte raw payload. Detail page: https://www.isobus.net/isobus/pGNAndSPN/12723?type=PGN. Signal-level enrichment via PR welcome  see CONTRIBUTING.md.";
CM_ SG_ 2566663424 Alternate_Fuel_5_RawPayload "Generic 8-byte raw payload. Detail page: https://www.isobus.net/isobus/pGNAndSPN/12727?type=PGN. Signal-level enrichment via PR welcome  see CONTRIBUTING.md.";
CM_ SG_ 2566663680 Engine_Turbocharger_Control_3_Ra "Generic 8-byte raw payload. Detail page: https://www.isobus.net/isobus/pGNAndSPN/12734?type=PGN. Signal-level enrichment via PR welcome  see CONTRIBUTING.md.";
CM_ SG_ 2566663936 Fire_Suppression_Agent_Status_Ra "Generic 8-byte raw payload. Detail page: https://www.isobus.net/isobus/pGNAndSPN/12738?type=PGN. Signal-level enrichment via PR welcome  see CONTRIBUTING.md.";
CM_ SG_ 2566664192 SCR_Operator_Inducement_Informat "Generic 8-byte raw payload. Detail page: https://www.isobus.net/isobus/pGNAndSPN/12742?type=PGN. Signal-level enrichment via PR welcome  see CONTRIBUTING.md.";
CM_ SG_ 2566664448 Aftertreatment_System_Informatio "Generic 8-byte raw payload. Detail page: https://www.isobus.net/isobus/pGNAndSPN/12755?type=PGN. Signal-level enrichment via PR welcome  see CONTRIBUTING.md.";
CM_ SG_ 2566664704 Aftertreatment_1_Particulate_Sen "Generic 8-byte raw payload. Detail page: https://www.isobus.net/isobus/pGNAndSPN/12765?type=PGN. Signal-level enrichment via PR welcome  see CONTRIBUTING.md.";
CM_ SG_ 2566664960 Engine_Fuel_Injector_Metering_Ra "Generic 8-byte raw payload. Detail page: https://www.isobus.net/isobus/pGNAndSPN/12767?type=PGN. Signal-level enrichment via PR welcome  see CONTRIBUTING.md.";
CM_ SG_ 2566665216 Engine_Fuel_Injector_Metering_Ra "Generic 8-byte raw payload. Detail page: https://www.isobus.net/isobus/pGNAndSPN/12771?type=PGN. Signal-level enrichment via PR welcome  see CONTRIBUTING.md.";
CM_ SG_ 2566665472 Aftertreatment_2_Diesel_Exhaust_ "Generic 8-byte raw payload. Detail page: https://www.isobus.net/isobus/pGNAndSPN/12773?type=PGN. Signal-level enrichment via PR welcome  see CONTRIBUTING.md.";
CM_ SG_ 2566665728 Gaseous_Fuel_Supply_Valve_Inform "Generic 8-byte raw payload. Detail page: https://www.isobus.net/isobus/pGNAndSPN/12779?type=PGN. Signal-level enrichment via PR welcome  see CONTRIBUTING.md.";
CM_ SG_ 2566665984 Engine_Oil_Mist_Detection_Inform "Generic 8-byte raw payload. Detail page: https://www.isobus.net/isobus/pGNAndSPN/12781?type=PGN. Signal-level enrichment via PR welcome  see CONTRIBUTING.md.";
CM_ SG_ 2566666240 Engine_Oil_Mist_Detection_Inform "Generic 8-byte raw payload. Detail page: https://www.isobus.net/isobus/pGNAndSPN/12789?type=PGN. Signal-level enrichment via PR welcome  see CONTRIBUTING.md.";
CM_ SG_ 2566666496 Gaseous_Fuel_Supply_Pressure_2_R "Generic 8-byte raw payload. Detail page: https://www.isobus.net/isobus/pGNAndSPN/12791?type=PGN. Signal-level enrichment via PR welcome  see CONTRIBUTING.md.";
CM_ SG_ 2566666752 Gaseous_Fuel_Supply_Pressure_1_R "Generic 8-byte raw payload. Detail page: https://www.isobus.net/isobus/pGNAndSPN/12795?type=PGN. Signal-level enrichment via PR welcome  see CONTRIBUTING.md.";
CM_ SG_ 2566667008 Engine_End_Bearing_Temperature_3 "Generic 8-byte raw payload. Detail page: https://www.isobus.net/isobus/pGNAndSPN/12799?type=PGN. Signal-level enrichment via PR welcome  see CONTRIBUTING.md.";
CM_ SG_ 2566667264 Engine_End_Bearing_Temperature_2 "Generic 8-byte raw payload. Detail page: https://www.isobus.net/isobus/pGNAndSPN/12807?type=PGN. Signal-level enrichment via PR welcome  see CONTRIBUTING.md.";
CM_ SG_ 2566667520 Engine_End_Bearing_Temperature_1 "Generic 8-byte raw payload. Detail page: https://www.isobus.net/isobus/pGNAndSPN/12815?type=PGN. Signal-level enrichment via PR welcome  see CONTRIBUTING.md.";
CM_ SG_ 2566667776 Heat_Exchanger_Debris_Purge_Info "Generic 8-byte raw payload. Detail page: https://www.isobus.net/isobus/pGNAndSPN/12817?type=PGN. Signal-level enrichment via PR welcome  see CONTRIBUTING.md.";
CM_ SG_ 2566668032 Engine_Turbocharger_Control_2_Ra "Generic 8-byte raw payload. Detail page: https://www.isobus.net/isobus/pGNAndSPN/12819?type=PGN. Signal-level enrichment via PR welcome  see CONTRIBUTING.md.";
CM_ SG_ 2566668288 Engine_Hydraulic_Fuel_2_Pump_Sta "Generic 8-byte raw payload. Detail page: https://www.isobus.net/isobus/pGNAndSPN/12823?type=PGN. Signal-level enrichment via PR welcome  see CONTRIBUTING.md.";
CM_ SG_ 2566668544 Alternate_Fuel_4_RawPayload "Generic 8-byte raw payload. Detail page: https://www.isobus.net/isobus/pGNAndSPN/12828?type=PGN. Signal-level enrichment via PR welcome  see CONTRIBUTING.md.";
CM_ SG_ 2566668800 Tire_Condition_Message_2_RawPayl "Generic 8-byte raw payload. Detail page: https://www.isobus.net/isobus/pGNAndSPN/12831?type=PGN. Signal-level enrichment via PR welcome  see CONTRIBUTING.md.";
CM_ SG_ 2566669056 Tire_Configuration_Status_Inform "Generic 8-byte raw payload. Detail page: https://www.isobus.net/isobus/pGNAndSPN/12837?type=PGN. Signal-level enrichment via PR welcome  see CONTRIBUTING.md.";
CM_ SG_ 2566669312 High_Voltage_Energy_Storage_Syst "Generic 8-byte raw payload. Detail page: https://www.isobus.net/isobus/pGNAndSPN/12839?type=PGN. Signal-level enrichment via PR welcome  see CONTRIBUTING.md.";
CM_ SG_ 2566669568 Tire_Wireless_Signal_Strength_In "Generic 8-byte raw payload. Detail page: https://www.isobus.net/isobus/pGNAndSPN/12845?type=PGN. Signal-level enrichment via PR welcome  see CONTRIBUTING.md.";
CM_ SG_ 2566669824 Tire_Sensor_Identification_Statu "Generic 8-byte raw payload. Detail page: https://www.isobus.net/isobus/pGNAndSPN/12849?type=PGN. Signal-level enrichment via PR welcome  see CONTRIBUTING.md.";
CM_ SG_ 2566670080 Monitored_Tire_Information_RawPa "Generic 8-byte raw payload. Detail page: https://www.isobus.net/isobus/pGNAndSPN/12863?type=PGN. Signal-level enrichment via PR welcome  see CONTRIBUTING.md.";
CM_ SG_ 2566670336 Aftertreatment_2_Historical_Info "Generic 8-byte raw payload. Detail page: https://www.isobus.net/isobus/pGNAndSPN/12869?type=PGN. Signal-level enrichment via PR welcome  see CONTRIBUTING.md.";
CM_ SG_ 2566670592 Aftertreatment_1_Historical_Info "Generic 8-byte raw payload. Detail page: https://www.isobus.net/isobus/pGNAndSPN/12876?type=PGN. Signal-level enrichment via PR welcome  see CONTRIBUTING.md.";
CM_ SG_ 2566670848 SCR_System_Cleaning_RawPayload "Generic 8-byte raw payload. Detail page: https://www.isobus.net/isobus/pGNAndSPN/12897?type=PGN. Signal-level enrichment via PR welcome  see CONTRIBUTING.md.";
CM_ SG_ 2566671104 Electronic_Engine_Controller_17_ "Generic 8-byte raw payload. Detail page: https://www.isobus.net/isobus/pGNAndSPN/12901?type=PGN. Signal-level enrichment via PR welcome  see CONTRIBUTING.md.";
CM_ SG_ 2566671360 SCR_Operator_Inducement_Informat "Generic 8-byte raw payload. Detail page: https://www.isobus.net/isobus/pGNAndSPN/12905?type=PGN. Signal-level enrichment via PR welcome  see CONTRIBUTING.md.";
CM_ SG_ 2566671616 Aftertreatment_2_SCR_Dosing_Syst "Generic 8-byte raw payload. Detail page: https://www.isobus.net/isobus/pGNAndSPN/12910?type=PGN. Signal-level enrichment via PR welcome  see CONTRIBUTING.md.";
CM_ SG_ 2566671872 Aftertreatment_1_SCR_Dosing_Syst "Generic 8-byte raw payload. Detail page: https://www.isobus.net/isobus/pGNAndSPN/12915?type=PGN. Signal-level enrichment via PR welcome  see CONTRIBUTING.md.";
CM_ SG_ 2566672128 Payload_Weight_Sensor_Informatio "Generic 8-byte raw payload. Detail page: https://www.isobus.net/isobus/pGNAndSPN/12923?type=PGN. Signal-level enrichment via PR welcome  see CONTRIBUTING.md.";
CM_ SG_ 2566672384 Payload_System_Status_RawPayload "Generic 8-byte raw payload. Detail page: https://www.isobus.net/isobus/pGNAndSPN/12928?type=PGN. Signal-level enrichment via PR welcome  see CONTRIBUTING.md.";
CM_ SG_ 2566672640 Air_Suspension_Control_7_RawPayl "Generic 8-byte raw payload. Detail page: https://www.isobus.net/isobus/pGNAndSPN/12932?type=PGN. Signal-level enrichment via PR welcome  see CONTRIBUTING.md.";
CM_ SG_ 2566672896 Bin_Weight_and_Lift_Count_RawPay "Generic 8-byte raw payload. Detail page: https://www.isobus.net/isobus/pGNAndSPN/12936?type=PGN. Signal-level enrichment via PR welcome  see CONTRIBUTING.md.";
CM_ SG_ 2566673152 Engine_Gaseous_Leakage_Informati "Generic 8-byte raw payload. Detail page: https://www.isobus.net/isobus/pGNAndSPN/12942?type=PGN. Signal-level enrichment via PR welcome  see CONTRIBUTING.md.";
CM_ SG_ 2566673408 Driving_and_Rest_Times_Driver_2_ "Generic 8-byte raw payload. Detail page: https://www.isobus.net/isobus/pGNAndSPN/12943?type=PGN. Signal-level enrichment via PR welcome  see CONTRIBUTING.md.";
CM_ SG_ 2566673664 Driving_and_Rest_Times_Driver_1_ "Generic 8-byte raw payload. Detail page: https://www.isobus.net/isobus/pGNAndSPN/12944?type=PGN. Signal-level enrichment via PR welcome  see CONTRIBUTING.md.";
CM_ SG_ 2566673920 SCR_Operator_Inducement_Informat "Generic 8-byte raw payload. Detail page: https://www.isobus.net/isobus/pGNAndSPN/12946?type=PGN. Signal-level enrichment via PR welcome  see CONTRIBUTING.md.";
CM_ SG_ 2566674176 SCR_Operator_Inducement_Informat "Generic 8-byte raw payload. Detail page: https://www.isobus.net/isobus/pGNAndSPN/12948?type=PGN. Signal-level enrichment via PR welcome  see CONTRIBUTING.md.";
CM_ SG_ 2566674432 Turbocharger_Information_7_RawPa "Generic 8-byte raw payload. Detail page: https://www.isobus.net/isobus/pGNAndSPN/12953?type=PGN. Signal-level enrichment via PR welcome  see CONTRIBUTING.md.";
CM_ SG_ 2566674688 Engine_Load_Sharing_Information_ "Generic 8-byte raw payload. Detail page: https://www.isobus.net/isobus/pGNAndSPN/12956?type=PGN. Signal-level enrichment via PR welcome  see CONTRIBUTING.md.";
CM_ SG_ 2566674944 Synchronized_Service_Distance_In "Generic 8-byte raw payload. Detail page: https://www.isobus.net/isobus/pGNAndSPN/12958?type=PGN. Signal-level enrichment via PR welcome  see CONTRIBUTING.md.";
CM_ SG_ 2566675200 Synchronized_Service_Delay_Opera "Generic 8-byte raw payload. Detail page: https://www.isobus.net/isobus/pGNAndSPN/12960?type=PGN. Signal-level enrichment via PR welcome  see CONTRIBUTING.md.";
CM_ SG_ 2566675456 Synchronized_Service_Delay_Calen "Generic 8-byte raw payload. Detail page: https://www.isobus.net/isobus/pGNAndSPN/12962?type=PGN. Signal-level enrichment via PR welcome  see CONTRIBUTING.md.";
CM_ SG_ 2566675712 High_Voltage_Energy_Storage_Syst "Generic 8-byte raw payload. Detail page: https://www.isobus.net/isobus/pGNAndSPN/12973?type=PGN. Signal-level enrichment via PR welcome  see CONTRIBUTING.md.";
CM_ SG_ 2566675968 High_Voltage_Energy_Storage_Syst "Generic 8-byte raw payload. Detail page: https://www.isobus.net/isobus/pGNAndSPN/12979?type=PGN. Signal-level enrichment via PR welcome  see CONTRIBUTING.md.";
CM_ SG_ 2566676224 Encoder_Position_RawPayload "Generic 8-byte raw payload. Detail page: https://www.isobus.net/isobus/pGNAndSPN/12980?type=PGN. Signal-level enrichment via PR welcome  see CONTRIBUTING.md.";
CM_ SG_ 2566676480 Encoder_High_Resolution_Position "Generic 8-byte raw payload. Detail page: https://www.isobus.net/isobus/pGNAndSPN/12981?type=PGN. Signal-level enrichment via PR welcome  see CONTRIBUTING.md.";
CM_ SG_ 2566676736 Encoder_Speed_RawPayload "Generic 8-byte raw payload. Detail page: https://www.isobus.net/isobus/pGNAndSPN/12982?type=PGN. Signal-level enrichment via PR welcome  see CONTRIBUTING.md.";
CM_ SG_ 2566676992 Encoder_Acceleration_RawPayload "Generic 8-byte raw payload. Detail page: https://www.isobus.net/isobus/pGNAndSPN/12983?type=PGN. Signal-level enrichment via PR welcome  see CONTRIBUTING.md.";
CM_ SG_ 2566677248 Encoder_Position_with_Speed_and_ "Generic 8-byte raw payload. Detail page: https://www.isobus.net/isobus/pGNAndSPN/12984?type=PGN. Signal-level enrichment via PR welcome  see CONTRIBUTING.md.";
CM_ SG_ 2566677504 Inclinometer_Slope_Longitudinal_ "Generic 8-byte raw payload. Detail page: https://www.isobus.net/isobus/pGNAndSPN/12985?type=PGN. Signal-level enrichment via PR welcome  see CONTRIBUTING.md.";
CM_ SG_ 2566677760 Inclinometer_Slope_Longitudinal_ "Generic 8-byte raw payload. Detail page: https://www.isobus.net/isobus/pGNAndSPN/12986?type=PGN. Signal-level enrichment via PR welcome  see CONTRIBUTING.md.";
CM_ SG_ 2566678016 Inclinometer_Slope_Lateral_16_bi "Generic 8-byte raw payload. Detail page: https://www.isobus.net/isobus/pGNAndSPN/12987?type=PGN. Signal-level enrichment via PR welcome  see CONTRIBUTING.md.";
CM_ SG_ 2566678272 Inclinometer_Slope_Lateral_32_bi "Generic 8-byte raw payload. Detail page: https://www.isobus.net/isobus/pGNAndSPN/12988?type=PGN. Signal-level enrichment via PR welcome  see CONTRIBUTING.md.";
CM_ SG_ 2566678528 CANopen_Emergency_Message_RawPay "Generic 8-byte raw payload. Detail page: https://www.isobus.net/isobus/pGNAndSPN/12989?type=PGN. Signal-level enrichment via PR welcome  see CONTRIBUTING.md.";
CM_ SG_ 2566678784 EV_Operator_Indicators_1_RawPayl "Generic 8-byte raw payload. Detail page: https://www.isobus.net/isobus/pGNAndSPN/12990?type=PGN. Signal-level enrichment via PR welcome  see CONTRIBUTING.md.";
CM_ SG_ 2566679040 System_Identification_RawPayload "Generic 8-byte raw payload. Detail page: https://www.isobus.net/isobus/pGNAndSPN/12994?type=PGN. Signal-level enrichment via PR welcome  see CONTRIBUTING.md.";
CM_ SG_ 2566679296 Engine_Maximum_Net_Torque_Map_ob "Generic 8-byte raw payload. Detail page: https://www.isobus.net/isobus/pGNAndSPN/12995?type=PGN. Signal-level enrichment via PR welcome  see CONTRIBUTING.md.";
CM_ SG_ 2566679552 Alarm_RawPayload "Generic 8-byte raw payload. Detail page: https://www.isobus.net/isobus/pGNAndSPN/12996?type=PGN. Signal-level enrichment via PR welcome  see CONTRIBUTING.md.";
CM_ SG_ 2566679808 Acoustic_Warning_Request_RawPayl "Generic 8-byte raw payload. Detail page: https://www.isobus.net/isobus/pGNAndSPN/12997?type=PGN. Signal-level enrichment via PR welcome  see CONTRIBUTING.md.";
CM_ SG_ 2566680064 Acoustic_Warning_State_RawPayloa "Generic 8-byte raw payload. Detail page: https://www.isobus.net/isobus/pGNAndSPN/12998?type=PGN. Signal-level enrichment via PR welcome  see CONTRIBUTING.md.";
CM_ SG_ 2566680320 Vehicle_Load_RawPayload "Generic 8-byte raw payload. Detail page: https://www.isobus.net/isobus/pGNAndSPN/12999?type=PGN. Signal-level enrichment via PR welcome  see CONTRIBUTING.md.";
CM_ SG_ 2566680576 Body_Application_Unit_1_RawPaylo "Generic 8-byte raw payload. Detail page: https://www.isobus.net/isobus/pGNAndSPN/13000?type=PGN. Signal-level enrichment via PR welcome  see CONTRIBUTING.md.";
CM_ SG_ 2566680832 Body_Application_Unit_2_RawPaylo "Generic 8-byte raw payload. Detail page: https://www.isobus.net/isobus/pGNAndSPN/13001?type=PGN. Signal-level enrichment via PR welcome  see CONTRIBUTING.md.";
CM_ SG_ 2566681088 Body_Application_Unit_3_RawPaylo "Generic 8-byte raw payload. Detail page: https://www.isobus.net/isobus/pGNAndSPN/13002?type=PGN. Signal-level enrichment via PR welcome  see CONTRIBUTING.md.";
CM_ SG_ 2566681344 Body_Application_Unit_4_RawPaylo "Generic 8-byte raw payload. Detail page: https://www.isobus.net/isobus/pGNAndSPN/13003?type=PGN. Signal-level enrichment via PR welcome  see CONTRIBUTING.md.";
CM_ SG_ 2566681600 Body_Application_Unit_5_RawPaylo "Generic 8-byte raw payload. Detail page: https://www.isobus.net/isobus/pGNAndSPN/13004?type=PGN. Signal-level enrichment via PR welcome  see CONTRIBUTING.md.";
CM_ SG_ 2566681856 Body_Application_Unit_6_RawPaylo "Generic 8-byte raw payload. Detail page: https://www.isobus.net/isobus/pGNAndSPN/13005?type=PGN. Signal-level enrichment via PR welcome  see CONTRIBUTING.md.";
CM_ SG_ 2566682112 Body_Application_Unit_7_RawPaylo "Generic 8-byte raw payload. Detail page: https://www.isobus.net/isobus/pGNAndSPN/13006?type=PGN. Signal-level enrichment via PR welcome  see CONTRIBUTING.md.";
CM_ SG_ 2566682368 Body_Application_Unit_8_RawPaylo "Generic 8-byte raw payload. Detail page: https://www.isobus.net/isobus/pGNAndSPN/13007?type=PGN. Signal-level enrichment via PR welcome  see CONTRIBUTING.md.";
CM_ SG_ 2566682624 Electronic_Control_Unit_RawPaylo "Generic 8-byte raw payload. Detail page: https://www.isobus.net/isobus/pGNAndSPN/13008?type=PGN. Signal-level enrichment via PR welcome  see CONTRIBUTING.md.";
CM_ SG_ 2566682880 ECU_Power_Supply_RawPayload "Generic 8-byte raw payload. Detail page: https://www.isobus.net/isobus/pGNAndSPN/13009?type=PGN. Signal-level enrichment via PR welcome  see CONTRIBUTING.md.";
CM_ SG_ 2566683136 ECU_Temperature_RawPayload "Generic 8-byte raw payload. Detail page: https://www.isobus.net/isobus/pGNAndSPN/13010?type=PGN. Signal-level enrichment via PR welcome  see CONTRIBUTING.md.";
CM_ SG_ 2566683392 Error_RawPayload "Generic 8-byte raw payload. Detail page: https://www.isobus.net/isobus/pGNAndSPN/13011?type=PGN. Signal-level enrichment via PR welcome  see CONTRIBUTING.md.";
CM_ SG_ 2566683648 Heating_And_Refrigerating_Unit_1 "Generic 8-byte raw payload. Detail page: https://www.isobus.net/isobus/pGNAndSPN/13012?type=PGN. Signal-level enrichment via PR welcome  see CONTRIBUTING.md.";

BA_DEF_ BO_ "SystemMessageLongSymbol" STRING;
BA_DEF_ SG_ "SystemSignalLongSymbol" STRING;
BA_ "SystemMessageLongSymbol" BO_ 2566601472 "VDMA_FB3B_Motor_Generator_5_Inverter_Isola";
BA_ "SystemMessageLongSymbol" BO_ 2566601728 "VDMA_FB3C_Motor_Generator_5_Inverter_Activ";
BA_ "SystemMessageLongSymbol" BO_ 2566601984 "VDMA_FB3D_Motor_Generator_4_Inverter_Refer";
BA_ "SystemMessageLongSymbol" BO_ 2566602240 "VDMA_FB3E_Motor_Generator_4_Inverter_Statu";
BA_ "SystemMessageLongSymbol" BO_ 2566602496 "VDMA_FB3F_Motor_Generator_4_Inverter_Refer";
BA_ "SystemMessageLongSymbol" BO_ 2566602752 "VDMA_FB40_Motor_Generator_4_Inverter_Tempe";
BA_ "SystemMessageLongSymbol" BO_ 2566603008 "VDMA_FB41_Motor_Generator_4_Inverter_Motor";
BA_ "SystemMessageLongSymbol" BO_ 2566603264 "VDMA_FB42_Motor_Generator_4_Inverter_Isola";
BA_ "SystemMessageLongSymbol" BO_ 2566603520 "VDMA_FB43_Motor_Generator_4_Inverter_Activ";
BA_ "SystemMessageLongSymbol" BO_ 2566603776 "VDMA_FB44_Motor_Generator_3_Inverter_Refer";
BA_ "SystemMessageLongSymbol" BO_ 2566604032 "VDMA_FB45_Motor_Generator_3_Inverter_Statu";
BA_ "SystemMessageLongSymbol" BO_ 2566604288 "VDMA_FB46_Motor_Generator_3_Inverter_Refer";
BA_ "SystemMessageLongSymbol" BO_ 2566604544 "VDMA_FB47_Motor_Generator_3_Inverter_Tempe";
BA_ "SystemMessageLongSymbol" BO_ 2566604800 "VDMA_FB48_Motor_Generator_3_Inverter_Motor";
BA_ "SystemMessageLongSymbol" BO_ 2566605056 "VDMA_FB49_Motor_Generator_3_Inverter_Isola";
BA_ "SystemMessageLongSymbol" BO_ 2566605312 "VDMA_FB4A_Motor_Generator_3_Inverter_Activ";
BA_ "SystemMessageLongSymbol" BO_ 2566605568 "VDMA_FB4B_Automated_Driving_System_Status_";
BA_ "SystemMessageLongSymbol" BO_ 2566605824 "VDMA_FB4C_Cab_Climate_System_Information_2";
BA_ "SystemMessageLongSymbol" BO_ 2566606080 "VDMA_FB4D_Maintenance_Information_1";
BA_ "SystemMessageLongSymbol" BO_ 2566606336 "VDMA_FB4E_Hoist_Control_Information";
BA_ "SystemMessageLongSymbol" BO_ 2566606592 "VDMA_FB4F_High_Voltage_Energy_Storage_Pack";
BA_ "SystemMessageLongSymbol" BO_ 2566606848 "VDMA_FB50_High_Voltage_Energy_Storage_Pack";
BA_ "SystemMessageLongSymbol" BO_ 2566607104 "VDMA_FB51_High_Voltage_Energy_Storage_Pack";
BA_ "SystemMessageLongSymbol" BO_ 2566607360 "VDMA_FB52_High_Voltage_Energy_Storage_Pack";
BA_ "SystemMessageLongSymbol" BO_ 2566607616 "VDMA_FB53_High_Voltage_Energy_Storage_Pack";
BA_ "SystemMessageLongSymbol" BO_ 2566607872 "VDMA_FB54_High_Voltage_Energy_Storage_Pack";
BA_ "SystemMessageLongSymbol" BO_ 2566608128 "VDMA_FB55_High_Voltage_Energy_Storage_Pack";
BA_ "SystemMessageLongSymbol" BO_ 2566608384 "VDMA_FB56_High_Voltage_Energy_Storage_Pack";
BA_ "SystemMessageLongSymbol" BO_ 2566608640 "VDMA_FB57_High_Voltage_Energy_Storage_Pack";
BA_ "SystemMessageLongSymbol" BO_ 2566608896 "VDMA_FB58_High_Voltage_Energy_Storage_Pack";
BA_ "SystemMessageLongSymbol" BO_ 2566609152 "VDMA_FB59_High_Voltage_Energy_Storage_Pack";
BA_ "SystemMessageLongSymbol" BO_ 2566609408 "VDMA_FB5A_High_Voltage_Energy_Storage_Pack";
BA_ "SystemMessageLongSymbol" BO_ 2566609664 "VDMA_FB5B_Vehicle_Fire_Suppression_System_";
BA_ "SystemMessageLongSymbol" BO_ 2566609920 "VDMA_FB5C_Vehicle_Fire_Suppression_System_";
BA_ "SystemMessageLongSymbol" BO_ 2566610176 "VDMA_FB5D_Vehicle_Fire_Suppression_System_";
BA_ "SystemMessageLongSymbol" BO_ 2566610432 "VDMA_FB5E_Vehicle_Fire_Suppression_System_";
BA_ "SystemMessageLongSymbol" BO_ 2566610688 "VDMA_FB5F_Vehicle_Fire_Suppression_System_";
BA_ "SystemMessageLongSymbol" BO_ 2566610944 "VDMA_FB60_Vehicle_Fire_Suppression_System_";
BA_ "SystemMessageLongSymbol" BO_ 2566611200 "VDMA_FB61_Vehicle_Fire_Suppression_System_";
BA_ "SystemMessageLongSymbol" BO_ 2566611456 "VDMA_FB62_Vehicle_Fire_Suppression_System_";
BA_ "SystemMessageLongSymbol" BO_ 2566611712 "VDMA_FB63_Vehicle_Fire_Suppression_System_";
BA_ "SystemMessageLongSymbol" BO_ 2566611968 "VDMA_FB64_Vehicle_Fire_Suppression_System_";
BA_ "SystemMessageLongSymbol" BO_ 2566612224 "VDMA_FB65_Vehicle_Fire_Suppression_System_";
BA_ "SystemMessageLongSymbol" BO_ 2566612480 "VDMA_FB66_Vehicle_Fire_Suppression_System_";
BA_ "SystemMessageLongSymbol" BO_ 2566612736 "VDMA_FB67_Motor_Generator_2_Inverter_Activ";
BA_ "SystemMessageLongSymbol" BO_ 2566612992 "VDMA_FB68_Motor_Generator_2_Inverter_Isola";
BA_ "SystemMessageLongSymbol" BO_ 2566613248 "VDMA_FB69_Motor_Generator_1_Inverter_Activ";
BA_ "SystemMessageLongSymbol" BO_ 2566613504 "VDMA_FB6A_Motor_Generator_1_Inverter_Isola";
BA_ "SystemMessageLongSymbol" BO_ 2566613760 "VDMA_FB6B_High_Voltage_Bus_Information";
BA_ "SystemMessageLongSymbol" BO_ 2566614016 "VDMA_FB6C_Motor_Generator_2_Inverter_Refer";
BA_ "SystemMessageLongSymbol" BO_ 2566614272 "VDMA_FB6D_Motor_Generator_2_Inverter_Statu";
BA_ "SystemMessageLongSymbol" BO_ 2566614528 "VDMA_FB6E_Motor_Generator_2_Inverter_Refer";
BA_ "SystemMessageLongSymbol" BO_ 2566614784 "VDMA_FB6F_Motor_Generator_2_Inverter_Tempe";
BA_ "SystemMessageLongSymbol" BO_ 2566615040 "VDMA_FB70_Motor_Generator_2_Inverter_Motor";
BA_ "SystemMessageLongSymbol" BO_ 2566615296 "VDMA_FB71_Motor_Generator_1_Inverter_Motor";
BA_ "SystemMessageLongSymbol" BO_ 2566615552 "VDMA_FB72_Motor_Generator_1_Inverter_Tempe";
BA_ "SystemMessageLongSymbol" BO_ 2566615808 "VDMA_FB73_Motor_Generator_1_Inverter_Refer";
BA_ "SystemMessageLongSymbol" BO_ 2566616064 "VDMA_FB74_Motor_Generator_1_Inverter_Statu";
BA_ "SystemMessageLongSymbol" BO_ 2566616320 "VDMA_FB75_Motor_Generator_1_Inverter_Refer";
BA_ "SystemMessageLongSymbol" BO_ 2566616576 "VDMA_FB76_Personnel_Detect_Status";
BA_ "SystemMessageLongSymbol" BO_ 2566616832 "VDMA_FB77_Engine_Cylinder_Pressure_Gamma_1";
BA_ "SystemMessageLongSymbol" BO_ 2566617088 "VDMA_FB78_Engine_Cylinder_Pressure_Gamma_2";
BA_ "SystemMessageLongSymbol" BO_ 2566617344 "VDMA_FB79_Engine_Cylinder_Pressure_Gamma_3";
BA_ "SystemMessageLongSymbol" BO_ 2566617600 "VDMA_FB7A_Engine_Cylinder_Pressure_Gamma_4";
BA_ "SystemMessageLongSymbol" BO_ 2566617856 "VDMA_FB7B_Engine_Cylinder_Pressure_Gamma_5";
BA_ "SystemMessageLongSymbol" BO_ 2566618368 "VDMA_FB7D_Electrified_Accessory_Generator_";
BA_ "SystemMessageLongSymbol" BO_ 2566618624 "VDMA_FB7E_Electrified_Accessory_Generator_";
BA_ "SystemMessageLongSymbol" BO_ 2566618880 "VDMA_FB7F_Well_Stimulation_Pump_System_Fil";
BA_ "SystemMessageLongSymbol" BO_ 2566619136 "VDMA_FB80_PTO_Governor_Configuration";
BA_ "SystemMessageLongSymbol" BO_ 2566619648 "VDMA_FB82_Primary_or_Rear_Hitch_Yaw";
BA_ "SystemMessageLongSymbol" BO_ 2566619904 "VDMA_FB83_Secondary_or_Front_Hitch_Yaw";
BA_ "SystemMessageLongSymbol" BO_ 2566620416 "VDMA_FB85_Engine_Idle_Management_Informati";
BA_ "SystemMessageLongSymbol" BO_ 2566620672 "VDMA_FB86_Alcohol_Interlock_To_Vehicle";
BA_ "SystemMessageLongSymbol" BO_ 2566620928 "VDMA_FB87_Vehicle_To_Alcohol_Interlock";
BA_ "SystemMessageLongSymbol" BO_ 2566621184 "VDMA_FB88_Marine_Control_Information_3";
BA_ "SystemMessageLongSymbol" BO_ 2566621440 "VDMA_FB89_Engine_Fluid_Level_Pressure_13";
BA_ "SystemMessageLongSymbol" BO_ 2566621696 "VDMA_FB8A_High_Voltage_Energy_Storage_Syst";
BA_ "SystemMessageLongSymbol" BO_ 2566621952 "VDMA_FB8B_Economy_Mode_Inactive_Hours";
BA_ "SystemMessageLongSymbol" BO_ 2566622208 "VDMA_FB8C_Economy_Mode_Estimated_Instantan";
BA_ "SystemMessageLongSymbol" BO_ 2566622464 "VDMA_FB8D_Economy_Mode_Active_Hours";
BA_ "SystemMessageLongSymbol" BO_ 2566622976 "VDMA_FB8F_Economy_Mode_Estimated_Fuel_Savi";
BA_ "SystemMessageLongSymbol" BO_ 2566623232 "VDMA_FB90_DC_DC_Converter_4_Voltage";
BA_ "SystemMessageLongSymbol" BO_ 2566623488 "VDMA_FB91_DC_DC_Converter_3_Voltage";
BA_ "SystemMessageLongSymbol" BO_ 2566623744 "VDMA_FB92_DC_DC_Converter_2_Voltage";
BA_ "SystemMessageLongSymbol" BO_ 2566624000 "VDMA_FB93_DC_DC_Converter_1_Voltage";
BA_ "SystemMessageLongSymbol" BO_ 2566624256 "VDMA_FB94_Electronic_Engine_Controller_22";
BA_ "SystemMessageLongSymbol" BO_ 2566625024 "VDMA_FB97_Vehicle_Electrical_Power_15";
BA_ "SystemMessageLongSymbol" BO_ 2566625536 "VDMA_FB99_DC_AC_Accessory_Inverter_1_Tempe";
BA_ "SystemMessageLongSymbol" BO_ 2566625792 "VDMA_FB9A_DC_AC_Accessory_Inverter_1_DC_Si";
BA_ "SystemMessageLongSymbol" BO_ 2566626048 "VDMA_FB9B_DC_AC_Accessory_Inverter_1_AC_Si";
BA_ "SystemMessageLongSymbol" BO_ 2566626304 "VDMA_FB9C_DC_AC_Accessory_Inverter_1_Confi";
BA_ "SystemMessageLongSymbol" BO_ 2566626560 "VDMA_FB9D_DC_AC_Accessory_Inverter_1_Lifet";
BA_ "SystemMessageLongSymbol" BO_ 2566626816 "VDMA_FB9E_DC_AC_Accessory_Inverter_2_Tempe";
BA_ "SystemMessageLongSymbol" BO_ 2566627072 "VDMA_FB9F_DC_AC_Accessory_Inverter_2_DC_Si";
BA_ "SystemMessageLongSymbol" BO_ 2566627328 "VDMA_FBA0_DC_AC_Accessory_Inverter_2_AC_Si";
BA_ "SystemMessageLongSymbol" BO_ 2566627584 "VDMA_FBA1_DC_AC_Accessory_Inverter_2_Confi";
BA_ "SystemMessageLongSymbol" BO_ 2566627840 "VDMA_FBA2_DC_AC_Accessory_Inverter_2_Lifet";
BA_ "SystemMessageLongSymbol" BO_ 2566628096 "VDMA_FBA3_DC_AC_Accessory_Inverter_3_Tempe";
BA_ "SystemMessageLongSymbol" BO_ 2566628352 "VDMA_FBA4_DC_AC_Accessory_Inverter_3_DC_Si";
BA_ "SystemMessageLongSymbol" BO_ 2566628608 "VDMA_FBA5_DC_AC_Accessory_Inverter_3_AC_Si";
BA_ "SystemMessageLongSymbol" BO_ 2566628864 "VDMA_FBA6_DC_AC_Accessory_Inverter_3_Confi";
BA_ "SystemMessageLongSymbol" BO_ 2566629120 "VDMA_FBA7_DC_AC_Accessory_Inverter_3_Lifet";
BA_ "SystemMessageLongSymbol" BO_ 2566629376 "VDMA_FBA8_DC_AC_Accessory_Inverter_4_Tempe";
BA_ "SystemMessageLongSymbol" BO_ 2566629632 "VDMA_FBA9_DC_AC_Accessory_Inverter_4_DC_Si";
BA_ "SystemMessageLongSymbol" BO_ 2566629888 "VDMA_FBAA_DC_AC_Accessory_Inverter_4_AC_Si";
BA_ "SystemMessageLongSymbol" BO_ 2566630144 "VDMA_FBAB_DC_AC_Accessory_Inverter_4_Confi";
BA_ "SystemMessageLongSymbol" BO_ 2566630400 "VDMA_FBAC_DC_AC_Accessory_Inverter_4_Lifet";
BA_ "SystemMessageLongSymbol" BO_ 2566630656 "VDMA_FBAD_DC_AC_Accessory_Inverter_5_Tempe";
BA_ "SystemMessageLongSymbol" BO_ 2566630912 "VDMA_FBAE_DC_AC_Accessory_Inverter_5_DC_Si";
BA_ "SystemMessageLongSymbol" BO_ 2566631168 "VDMA_FBAF_DC_AC_Accessory_Inverter_5_AC_Si";
BA_ "SystemMessageLongSymbol" BO_ 2566631424 "VDMA_FBB0_DC_AC_Accessory_Inverter_5_Confi";
BA_ "SystemMessageLongSymbol" BO_ 2566631680 "VDMA_FBB1_DC_AC_Accessory_Inverter_5_Lifet";
BA_ "SystemMessageLongSymbol" BO_ 2566631936 "VDMA_FBB2_Well_Stimulation_Pump_Sensor_Cal";
BA_ "SystemMessageLongSymbol" BO_ 2566632192 "VDMA_FBB3_Well_Stimulation_Pump_Fluid_Volu";
BA_ "SystemMessageLongSymbol" BO_ 2566632448 "VDMA_FBB4_Well_Stimulation_Pump_Serial_Num";
BA_ "SystemMessageLongSymbol" BO_ 2566632704 "VDMA_FBB5_Well_Stimulation_Pump_Trip_Hours";
BA_ "SystemMessageLongSymbol" BO_ 2566632960 "VDMA_FBB6_Aftertreatment_1_Outlet_Gas_4";
BA_ "SystemMessageLongSymbol" BO_ 2566633216 "VDMA_FBB7_Aftertreatment_1_Intake_Gas_4";
BA_ "SystemMessageLongSymbol" BO_ 2566633472 "VDMA_FBB8_DC_DC_Converter_4_Lifetime_Data";
BA_ "SystemMessageLongSymbol" BO_ 2566633728 "VDMA_FBB9_DC_DC_Converter_4_Configuration_";
BA_ "SystemMessageLongSymbol" BO_ 2566633984 "VDMA_FBBA_DC_DC_Converter_4_SLI_Battery_Li";
BA_ "SystemMessageLongSymbol" BO_ 2566634240 "VDMA_FBBB_DC_DC_Converter_4_Temperatures";
BA_ "SystemMessageLongSymbol" BO_ 2566634496 "VDMA_FBBC_DC_DC_Converter_4_Low_Side_Limit";
BA_ "SystemMessageLongSymbol" BO_ 2566634752 "VDMA_FBBD_DC_DC_Converter_4_High_Side_Limi";
BA_ "SystemMessageLongSymbol" BO_ 2566635008 "VDMA_FBBE_DC_DC_Converter_3_Lifetime_Data";
BA_ "SystemMessageLongSymbol" BO_ 2566635264 "VDMA_FBBF_DC_DC_Converter_3_Configuration_";
BA_ "SystemMessageLongSymbol" BO_ 2566635520 "VDMA_FBC0_DC_DC_Converter_3_SLI_Battery_Li";
BA_ "SystemMessageLongSymbol" BO_ 2566635776 "VDMA_FBC1_DC_DC_Converter_3_Temperatures";
BA_ "SystemMessageLongSymbol" BO_ 2566636032 "VDMA_FBC2_DC_DC_Converter_3_Low_Side_Limit";
BA_ "SystemMessageLongSymbol" BO_ 2566636288 "VDMA_FBC3_DC_DC_Converter_3_High_Side_Limi";
BA_ "SystemMessageLongSymbol" BO_ 2566636544 "VDMA_FBC4_DC_DC_Converter_2_Lifetime_Data";
BA_ "SystemMessageLongSymbol" BO_ 2566636800 "VDMA_FBC5_DC_DC_Converter_2_Configuration_";
BA_ "SystemMessageLongSymbol" BO_ 2566637056 "VDMA_FBC6_DC_DC_Converter_2_SLI_Battery_Li";
BA_ "SystemMessageLongSymbol" BO_ 2566637312 "VDMA_FBC7_DC_DC_Converter_2_Temperatures";
BA_ "SystemMessageLongSymbol" BO_ 2566637568 "VDMA_FBC8_DC_DC_Converter_2_Low_Side_Limit";
BA_ "SystemMessageLongSymbol" BO_ 2566637824 "VDMA_FBC9_DC_DC_Converter_2_High_Side_Limi";
BA_ "SystemMessageLongSymbol" BO_ 2566638080 "VDMA_FBCA_CiA_602_2_AUTOSAR_CAN_NM_Obsolet";
BA_ "SystemMessageLongSymbol" BO_ 2566638336 "VDMA_FBCB_Engine_Exhaust_Particulate_Contr";
BA_ "SystemMessageLongSymbol" BO_ 2566638592 "VDMA_FBCC_Well_Stimulation_Pump_Hours";
BA_ "SystemMessageLongSymbol" BO_ 2566638848 "VDMA_FBCD_Well_Stimulation_Pump_System_Con";
BA_ "SystemMessageLongSymbol" BO_ 2566639104 "VDMA_FBCE_Configurable_Receive_SPNs_Status";
BA_ "SystemMessageLongSymbol" BO_ 2566639360 "VDMA_FBCF_DC_DC_Converter_1_Lifetime_Data";
BA_ "SystemMessageLongSymbol" BO_ 2566639616 "VDMA_FBD0_DC_DC_Converter_1_Configuration_";
BA_ "SystemMessageLongSymbol" BO_ 2566639872 "VDMA_FBD1_DC_DC_Converter_1_SLI_Battery_Li";
BA_ "SystemMessageLongSymbol" BO_ 2566640384 "VDMA_FBD3_Well_Stimulation_Pump_System_Lif";
BA_ "SystemMessageLongSymbol" BO_ 2566640640 "VDMA_FBD4_Well_Stimulation_Pump_System_Con";
BA_ "SystemMessageLongSymbol" BO_ 2566640896 "VDMA_FBD5_Aftercooler_and_Oil_Cooler_Fluid";
BA_ "SystemMessageLongSymbol" BO_ 2566641152 "VDMA_FBD6_Electronic_Engine_Controller_21";
BA_ "SystemMessageLongSymbol" BO_ 2566641408 "VDMA_FBD7_Configurable_Transmit_PGNs_Statu";
BA_ "SystemMessageLongSymbol" BO_ 2566641664 "VDMA_FBD8_DC_DC_Converter_1_Temperatures";
BA_ "SystemMessageLongSymbol" BO_ 2566641920 "VDMA_FBD9_DC_DC_Converter_1_Low_Side_Limit";
BA_ "SystemMessageLongSymbol" BO_ 2566642176 "VDMA_FBDA_DC_DC_Converter_1_High_Side_Limi";
BA_ "SystemMessageLongSymbol" BO_ 2566643456 "VDMA_FBDF_Intake_Exhaust_Conditions_3";
BA_ "SystemMessageLongSymbol" BO_ 2566643712 "VDMA_FBE0_Aftercooler_and_Oil_Cooler_Fluid";
BA_ "SystemMessageLongSymbol" BO_ 2566644480 "VDMA_FBE3_Alternator_Temperature_2";
BA_ "SystemMessageLongSymbol" BO_ 2566644736 "VDMA_FBE4_Fuel_Information_7_Gaseous";
BA_ "SystemMessageLongSymbol" BO_ 2566644992 "VDMA_FBE5_High_Voltage_Energy_Storage_Syst";
BA_ "SystemMessageLongSymbol" BO_ 2566645248 "VDMA_FBE6_High_Voltage_Energy_Storage_Syst";
BA_ "SystemMessageLongSymbol" BO_ 2566645504 "VDMA_FBE7_SCR_Operator_Inducement_Informat";
BA_ "SystemMessageLongSymbol" BO_ 2566645760 "VDMA_FBE8_Aftertreatment_System_Informatio";
BA_ "SystemMessageLongSymbol" BO_ 2566646016 "VDMA_FBE9_Ethernet_1_Connection_Informatio";
BA_ "SystemMessageLongSymbol" BO_ 2566646272 "VDMA_FBEA_Ethernet_1_Connection_Informatio";
BA_ "SystemMessageLongSymbol" BO_ 2566646528 "VDMA_FBEB_Oil_Debris_Monitor_Counts_Ferrou";
BA_ "SystemMessageLongSymbol" BO_ 2566646784 "VDMA_FBEC_Oil_Debris_Monitor_Counts_Ferrou";
BA_ "SystemMessageLongSymbol" BO_ 2566647040 "VDMA_FBED_Oil_Debris_Monitor_Counts_Ferrou";
BA_ "SystemMessageLongSymbol" BO_ 2566647296 "VDMA_FBEE_Oil_Debris_Monitor_Counts_Non_Fe";
BA_ "SystemMessageLongSymbol" BO_ 2566647552 "VDMA_FBEF_Oil_Debris_Monitor_Counts_Non_Fe";
BA_ "SystemMessageLongSymbol" BO_ 2566647808 "VDMA_FBF0_Oil_Debris_Monitor_Counts_Non_Fe";
BA_ "SystemMessageLongSymbol" BO_ 2566648064 "VDMA_FBF1_Oil_Debris_Monitoring_System_Sta";
BA_ "SystemMessageLongSymbol" BO_ 2566648320 "VDMA_FBF2_Engine_Fuel_Lube_Systems_3";
BA_ "SystemMessageLongSymbol" BO_ 2566648576 "VDMA_FBF3_Cruise_Control_Vehicle_Speed_5";
BA_ "SystemMessageLongSymbol" BO_ 2566648832 "VDMA_FBF4_Aftertreatment_2_Diesel_Oxidatio";
BA_ "SystemMessageLongSymbol" BO_ 2566649088 "VDMA_FBF5_Aftertreatment_1_Diesel_Oxidatio";
BA_ "SystemMessageLongSymbol" BO_ 2566649600 "VDMA_FBF7_Electrified_Accessory_Propulsion";
BA_ "SystemMessageLongSymbol" BO_ 2566649856 "VDMA_FBF8_Electrified_Accessory_Propulsion";
BA_ "SystemMessageLongSymbol" BO_ 2566650112 "VDMA_FBF9_Electrified_Accessory_Propulsion";
BA_ "SystemMessageLongSymbol" BO_ 2566650368 "VDMA_FBFA_Electrified_Accessory_Power_Elec";
BA_ "SystemMessageLongSymbol" BO_ 2566650624 "VDMA_FBFB_Electrified_Accessory_Power_Elec";
BA_ "SystemMessageLongSymbol" BO_ 2566650880 "VDMA_FBFC_Electrified_Accessory_Power_Elec";
BA_ "SystemMessageLongSymbol" BO_ 2566651136 "VDMA_FBFD_Electrified_Accessory_Propulsion";
BA_ "SystemMessageLongSymbol" BO_ 2566651392 "VDMA_FBFE_Electrified_Accessory_Propulsion";
BA_ "SystemMessageLongSymbol" BO_ 2566651648 "VDMA_FBFF_Electrified_Accessory_Power_Elec";
BA_ "SystemMessageLongSymbol" BO_ 2566651904 "VDMA_FC00_Trailer_Wheel_Brake_Wear_Life_Re";
BA_ "SystemMessageLongSymbol" BO_ 2566652160 "VDMA_FC01_Electrified_Accessory_Motor_Stat";
BA_ "SystemMessageLongSymbol" BO_ 2566652672 "VDMA_FC03_Vehicle_Electrical_Power_14";
BA_ "SystemMessageLongSymbol" BO_ 2566652928 "VDMA_FC04_Vehicle_Electrical_Power_13";
BA_ "SystemMessageLongSymbol" BO_ 2566653184 "VDMA_FC05_Vehicle_Electrical_Power_12";
BA_ "SystemMessageLongSymbol" BO_ 2566653440 "VDMA_FC06_Vehicle_Electrical_Power_11";
BA_ "SystemMessageLongSymbol" BO_ 2566653696 "VDMA_FC07_Vehicle_Electrical_Power_10";
BA_ "SystemMessageLongSymbol" BO_ 2566653952 "VDMA_FC08_Vehicle_Electrical_Power_9";
BA_ "SystemMessageLongSymbol" BO_ 2566654208 "VDMA_FC09_Vehicle_Electrical_Power_8";
BA_ "SystemMessageLongSymbol" BO_ 2566654464 "VDMA_FC0A_Vehicle_Electrical_Power_7";
BA_ "SystemMessageLongSymbol" BO_ 2566654720 "VDMA_FC0B_Electronic_Engine_Controller_20";
BA_ "SystemMessageLongSymbol" BO_ 2566655488 "VDMA_FC0E_Primary_or_Rear_Hitch_Roll_and_P";
BA_ "SystemMessageLongSymbol" BO_ 2566655744 "VDMA_FC0F_Secondary_or_Front_Hitch_Roll_an";
BA_ "SystemMessageLongSymbol" BO_ 2566656256 "VDMA_FC11_Total_Gaseous_Fuel_Information";
BA_ "SystemMessageLongSymbol" BO_ 2566657024 "VDMA_FC14_Vehicle_Electrical_Power_3_obsol";
BA_ "SystemMessageLongSymbol" BO_ 2566657280 "VDMA_FC15_Vehicle_Electrical_Power_6";
BA_ "SystemMessageLongSymbol" BO_ 2566658048 "VDMA_FC18_Payload_System_Totals_2";
BA_ "SystemMessageLongSymbol" BO_ 2566658304 "VDMA_FC19_Payload_System_Totals_1";
BA_ "SystemMessageLongSymbol" BO_ 2566658560 "VDMA_FC1A_HVESS_Thermal_Management_System_";
BA_ "SystemMessageLongSymbol" BO_ 2566658816 "VDMA_FC1B_HVESS_Thermal_Management_System_";
BA_ "SystemMessageLongSymbol" BO_ 2566659072 "VDMA_FC1C_Refrigeration_Compartment_Inform";
BA_ "SystemMessageLongSymbol" BO_ 2566659328 "VDMA_FC1D_Refrigeration_Compartment_Inform";
BA_ "SystemMessageLongSymbol" BO_ 2566659584 "VDMA_FC1E_Vehicle_Electrical_Power_16";
BA_ "SystemMessageLongSymbol" BO_ 2566659840 "VDMA_FC1F_Vehicle_Electrical_Power_17";
BA_ "SystemMessageLongSymbol" BO_ 2566660096 "VDMA_FC20_High_Voltage_Energy_Storage_Syst";
BA_ "SystemMessageLongSymbol" BO_ 2566660352 "VDMA_FC21_High_Voltage_Energy_Storage_Syst";
BA_ "SystemMessageLongSymbol" BO_ 2566660608 "VDMA_FC22_Electronic_Engine_Controller_19";
BA_ "SystemMessageLongSymbol" BO_ 2566660864 "VDMA_FC23_Fuel_Consumption_Liquid_2";
BA_ "SystemMessageLongSymbol" BO_ 2566661120 "VDMA_FC24_Aftertreatment_2_Diesel_Exhaust_";
BA_ "SystemMessageLongSymbol" BO_ 2566661376 "VDMA_FC25_Aftertreatment_1_Diesel_Exhaust_";
BA_ "SystemMessageLongSymbol" BO_ 2566661632 "VDMA_FC26_Aftertreatment_2_Diesel_Exhaust_";
BA_ "SystemMessageLongSymbol" BO_ 2566661888 "VDMA_FC27_Aftertreatment_1_Diesel_Exhaust_";
BA_ "SystemMessageLongSymbol" BO_ 2566662144 "VDMA_FC28_Cruise_Control_Vehicle_Speed_6";
BA_ "SystemMessageLongSymbol" BO_ 2566662656 "VDMA_FC2A_Operator_Inducement_Information_";
BA_ "SystemMessageLongSymbol" BO_ 2566662912 "VDMA_FC2B_Cruise_Control_Vehicle_Speed_4";
BA_ "SystemMessageLongSymbol" BO_ 2566663168 "VDMA_FC2C_Brake_Caliper_Lining_Clearance";
BA_ "SystemMessageLongSymbol" BO_ 2566663680 "VDMA_FC2E_Engine_Turbocharger_Control_3";
BA_ "SystemMessageLongSymbol" BO_ 2566663936 "VDMA_FC2F_Fire_Suppression_Agent_Status";
BA_ "SystemMessageLongSymbol" BO_ 2566664192 "VDMA_FC30_SCR_Operator_Inducement_Informat";
BA_ "SystemMessageLongSymbol" BO_ 2566664448 "VDMA_FC31_Aftertreatment_System_Informatio";
BA_ "SystemMessageLongSymbol" BO_ 2566664704 "VDMA_FC32_Aftertreatment_1_Particulate_Sen";
BA_ "SystemMessageLongSymbol" BO_ 2566664960 "VDMA_FC33_Engine_Fuel_Injector_Metering_Ra";
BA_ "SystemMessageLongSymbol" BO_ 2566665216 "VDMA_FC34_Engine_Fuel_Injector_Metering_Ra";
BA_ "SystemMessageLongSymbol" BO_ 2566665472 "VDMA_FC35_Aftertreatment_2_Diesel_Exhaust_";
BA_ "SystemMessageLongSymbol" BO_ 2566665728 "VDMA_FC36_Gaseous_Fuel_Supply_Valve_Inform";
BA_ "SystemMessageLongSymbol" BO_ 2566665984 "VDMA_FC37_Engine_Oil_Mist_Detection_Inform";
BA_ "SystemMessageLongSymbol" BO_ 2566666240 "VDMA_FC38_Engine_Oil_Mist_Detection_Inform";
BA_ "SystemMessageLongSymbol" BO_ 2566666496 "VDMA_FC39_Gaseous_Fuel_Supply_Pressure_2";
BA_ "SystemMessageLongSymbol" BO_ 2566666752 "VDMA_FC3A_Gaseous_Fuel_Supply_Pressure_1";
BA_ "SystemMessageLongSymbol" BO_ 2566667008 "VDMA_FC3B_Engine_End_Bearing_Temperature_3";
BA_ "SystemMessageLongSymbol" BO_ 2566667264 "VDMA_FC3C_Engine_End_Bearing_Temperature_2";
BA_ "SystemMessageLongSymbol" BO_ 2566667520 "VDMA_FC3D_Engine_End_Bearing_Temperature_1";
BA_ "SystemMessageLongSymbol" BO_ 2566667776 "VDMA_FC3E_Heat_Exchanger_Debris_Purge_Info";
BA_ "SystemMessageLongSymbol" BO_ 2566668032 "VDMA_FC3F_Engine_Turbocharger_Control_2";
BA_ "SystemMessageLongSymbol" BO_ 2566668288 "VDMA_FC40_Engine_Hydraulic_Fuel_2_Pump_Sta";
BA_ "SystemMessageLongSymbol" BO_ 2566668800 "VDMA_FC42_Tire_Condition_Message_2";
BA_ "SystemMessageLongSymbol" BO_ 2566669056 "VDMA_FC43_Tire_Configuration_Status_Inform";
BA_ "SystemMessageLongSymbol" BO_ 2566669312 "VDMA_FC44_High_Voltage_Energy_Storage_Syst";
BA_ "SystemMessageLongSymbol" BO_ 2566669568 "VDMA_FC45_Tire_Wireless_Signal_Strength_In";
BA_ "SystemMessageLongSymbol" BO_ 2566669824 "VDMA_FC46_Tire_Sensor_Identification_Statu";
BA_ "SystemMessageLongSymbol" BO_ 2566670080 "VDMA_FC47_Monitored_Tire_Information";
BA_ "SystemMessageLongSymbol" BO_ 2566670336 "VDMA_FC48_Aftertreatment_2_Historical_Info";
BA_ "SystemMessageLongSymbol" BO_ 2566670592 "VDMA_FC49_Aftertreatment_1_Historical_Info";
BA_ "SystemMessageLongSymbol" BO_ 2566671104 "VDMA_FC4B_Electronic_Engine_Controller_17";
BA_ "SystemMessageLongSymbol" BO_ 2566671360 "VDMA_FC4C_SCR_Operator_Inducement_Informat";
BA_ "SystemMessageLongSymbol" BO_ 2566671616 "VDMA_FC4D_Aftertreatment_2_SCR_Dosing_Syst";
BA_ "SystemMessageLongSymbol" BO_ 2566671872 "VDMA_FC4E_Aftertreatment_1_SCR_Dosing_Syst";
BA_ "SystemMessageLongSymbol" BO_ 2566672128 "VDMA_FC4F_Payload_Weight_Sensor_Informatio";
BA_ "SystemMessageLongSymbol" BO_ 2566672640 "VDMA_FC51_Air_Suspension_Control_7";
BA_ "SystemMessageLongSymbol" BO_ 2566672896 "VDMA_FC52_Bin_Weight_and_Lift_Count";
BA_ "SystemMessageLongSymbol" BO_ 2566673152 "VDMA_FC53_Engine_Gaseous_Leakage_Informati";
BA_ "SystemMessageLongSymbol" BO_ 2566673408 "VDMA_FC54_Driving_and_Rest_Times_Driver_2";
BA_ "SystemMessageLongSymbol" BO_ 2566673664 "VDMA_FC55_Driving_and_Rest_Times_Driver_1";
BA_ "SystemMessageLongSymbol" BO_ 2566673920 "VDMA_FC56_SCR_Operator_Inducement_Informat";
BA_ "SystemMessageLongSymbol" BO_ 2566674176 "VDMA_FC57_SCR_Operator_Inducement_Informat";
BA_ "SystemMessageLongSymbol" BO_ 2566674432 "VDMA_FC58_Turbocharger_Information_7";
BA_ "SystemMessageLongSymbol" BO_ 2566674688 "VDMA_FC59_Engine_Load_Sharing_Information";
BA_ "SystemMessageLongSymbol" BO_ 2566674944 "VDMA_FC5A_Synchronized_Service_Distance_In";
BA_ "SystemMessageLongSymbol" BO_ 2566675200 "VDMA_FC5B_Synchronized_Service_Delay_Opera";
BA_ "SystemMessageLongSymbol" BO_ 2566675456 "VDMA_FC5C_Synchronized_Service_Delay_Calen";
BA_ "SystemMessageLongSymbol" BO_ 2566675712 "VDMA_FC5D_High_Voltage_Energy_Storage_Syst";
BA_ "SystemMessageLongSymbol" BO_ 2566675968 "VDMA_FC5E_High_Voltage_Energy_Storage_Syst";
BA_ "SystemMessageLongSymbol" BO_ 2566676480 "VDMA_FC60_Encoder_High_Resolution_Position";
BA_ "SystemMessageLongSymbol" BO_ 2566677248 "VDMA_FC63_Encoder_Position_with_Speed_and_";
BA_ "SystemMessageLongSymbol" BO_ 2566677504 "VDMA_FC64_Inclinometer_Slope_Longitudinal_";
BA_ "SystemMessageLongSymbol" BO_ 2566677760 "VDMA_FC65_Inclinometer_Slope_Longitudinal_";
BA_ "SystemMessageLongSymbol" BO_ 2566678016 "VDMA_FC66_Inclinometer_Slope_Lateral_16_bi";
BA_ "SystemMessageLongSymbol" BO_ 2566678272 "VDMA_FC67_Inclinometer_Slope_Lateral_32_bi";
BA_ "SystemMessageLongSymbol" BO_ 2566678528 "VDMA_FC68_CANopen_Emergency_Message";
BA_ "SystemMessageLongSymbol" BO_ 2566678784 "VDMA_FC69_EV_Operator_Indicators_1";
BA_ "SystemMessageLongSymbol" BO_ 2566679296 "VDMA_FC6B_Engine_Maximum_Net_Torque_Map_ob";
BA_ "SystemMessageLongSymbol" BO_ 2566679808 "VDMA_FC6D_Acoustic_Warning_Request";
BA_ "SystemMessageLongSymbol" BO_ 2566680576 "VDMA_FC70_Body_Application_Unit_1";
BA_ "SystemMessageLongSymbol" BO_ 2566680832 "VDMA_FC71_Body_Application_Unit_2";
BA_ "SystemMessageLongSymbol" BO_ 2566681088 "VDMA_FC72_Body_Application_Unit_3";
BA_ "SystemMessageLongSymbol" BO_ 2566681344 "VDMA_FC73_Body_Application_Unit_4";
BA_ "SystemMessageLongSymbol" BO_ 2566681600 "VDMA_FC74_Body_Application_Unit_5";
BA_ "SystemMessageLongSymbol" BO_ 2566681856 "VDMA_FC75_Body_Application_Unit_6";
BA_ "SystemMessageLongSymbol" BO_ 2566682112 "VDMA_FC76_Body_Application_Unit_7";
BA_ "SystemMessageLongSymbol" BO_ 2566682368 "VDMA_FC77_Body_Application_Unit_8";
BA_ "SystemMessageLongSymbol" BO_ 2566682624 "VDMA_FC78_Electronic_Control_Unit";
BA_ "SystemMessageLongSymbol" BO_ 2566683648 "VDMA_FC7C_Heating_And_Refrigerating_Unit_1";
