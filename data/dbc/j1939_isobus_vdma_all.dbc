VERSION "created by canmatrix"

NS_ :

BS_:

BU_:

BA_DEF_ BO_ "SystemMessageLongSymbol" STRING;
BA_DEF_ SG_ "GenSigStartValue" FLOAT 0 100000000000;
BA_DEF_ SG_ "SystemSignalLongSymbol" STRING;

VERSION "created by canmatrix"

NS_ :

BS_:

BU_:

BA_DEF_ BO_ "SystemMessageLongSymbol" STRING;
BA_DEF_ SG_ "GenSigStartValue" FLOAT 0 100000000000;
BA_DEF_ SG_ "SystemSignalLongSymbol" STRING;

VERSION "created by canmatrix"

NS_ :

BS_:

BU_:

BO_ 2566516992 VDMA_F9F1_Engine_Cylinder_Averag: 8 Vector__XXX
 SG_ Engine_Cylinder_Average_Ignition : 0|64@1+ (1,0) [0|18446744073709551615] "" Vector__XXX

BO_ 2566517248 VDMA_F9F2_Engine_Cylinder_Averag: 8 Vector__XXX
 SG_ Engine_Cylinder_Average_Ignition : 0|64@1+ (1,0) [0|18446744073709551615] "" Vector__XXX

BO_ 2566517504 VDMA_F9F3_Engine_Indicated_Mean_: 8 Vector__XXX
 SG_ Engine_Indicated_Mean_Effective_ : 0|64@1+ (1,0) [0|18446744073709551615] "" Vector__XXX

BO_ 2566517760 VDMA_F9F4_Engine_Indicated_Mean_: 8 Vector__XXX
 SG_ Engine_Indicated_Mean_Effective_ : 0|64@1+ (1,0) [0|18446744073709551615] "" Vector__XXX

BO_ 2566518016 VDMA_F9F5_Engine_Indicated_Mean_: 8 Vector__XXX
 SG_ Engine_Indicated_Mean_Effective_ : 0|64@1+ (1,0) [0|18446744073709551615] "" Vector__XXX

BO_ 2566518272 VDMA_F9F6_Fuel_Cell_System_Coola: 8 Vector__XXX
 SG_ Fuel_Cell_System_Coolant_Fan_1_C : 0|64@1+ (1,0) [0|18446744073709551615] "" Vector__XXX

BO_ 2566518528 VDMA_F9F7_Fuel_Cell_System_Coola: 8 Vector__XXX
 SG_ Fuel_Cell_System_Coolant_Fan_1_S : 0|64@1+ (1,0) [0|18446744073709551615] "" Vector__XXX

BO_ 2566518784 VDMA_F9F8_Fuel_Cell_System_Coola: 8 Vector__XXX
 SG_ Fuel_Cell_System_Coolant_Fan_2_C : 0|64@1+ (1,0) [0|18446744073709551615] "" Vector__XXX

BO_ 2566519040 VDMA_F9F9_Fuel_Cell_System_Coola: 8 Vector__XXX
 SG_ Fuel_Cell_System_Coolant_Fan_2_S : 0|64@1+ (1,0) [0|18446744073709551615] "" Vector__XXX

BO_ 2566519296 VDMA_F9FA_Fuel_Cell_System_Coola: 8 Vector__XXX
 SG_ Fuel_Cell_System_Coolant_Fan_3_C : 0|64@1+ (1,0) [0|18446744073709551615] "" Vector__XXX

BO_ 2566519552 VDMA_F9FB_Fuel_Cell_System_Coola: 8 Vector__XXX
 SG_ Fuel_Cell_System_Coolant_Fan_3_S : 0|64@1+ (1,0) [0|18446744073709551615] "" Vector__XXX

BO_ 2566519808 VDMA_F9FC_Fuel_Cell_System_Coola: 8 Vector__XXX
 SG_ Fuel_Cell_System_Coolant_Fan_4_C : 0|64@1+ (1,0) [0|18446744073709551615] "" Vector__XXX

BO_ 2566520064 VDMA_F9FD_Fuel_Cell_System_Coola: 8 Vector__XXX
 SG_ Fuel_Cell_System_Coolant_Fan_4_S : 0|64@1+ (1,0) [0|18446744073709551615] "" Vector__XXX

BO_ 2566520320 VDMA_F9FE_APIs_Supported: 8 Vector__XXX
 SG_ APIs_Supported_RawPayload : 0|64@1+ (1,0) [0|18446744073709551615] "" Vector__XXX

BO_ 2566520576 VDMA_F9FF_Fuel_Cell_System_Confi: 8 Vector__XXX
 SG_ Fuel_Cell_System_Configuration_R : 0|64@1+ (1,0) [0|18446744073709551615] "" Vector__XXX

BO_ 2566520832 VDMA_FA00_Fuel_Cell_System_Coola: 8 Vector__XXX
 SG_ Fuel_Cell_System_Coolant_Informa : 0|64@1+ (1,0) [0|18446744073709551615] "" Vector__XXX

BO_ 2566521088 VDMA_FA01_Fuel_Cell_System_Coola: 8 Vector__XXX
 SG_ Fuel_Cell_System_Coolant_Informa : 0|64@1+ (1,0) [0|18446744073709551615] "" Vector__XXX

BO_ 2566522368 VDMA_FA06_Dash_Display_3: 8 Vector__XXX
 SG_ Dash_Display_3_RawPayload : 0|64@1+ (1,0) [0|18446744073709551615] "" Vector__XXX

BO_ 2566522624 VDMA_FA07_Vehicle_Speed_Profile: 8 Vector__XXX
 SG_ Vehicle_Speed_Profile_RawPayload : 0|64@1+ (1,0) [0|18446744073709551615] "" Vector__XXX

BO_ 2566522880 VDMA_FA08_Reference_Time: 8 Vector__XXX
 SG_ Reference_Time_RawPayload : 0|64@1+ (1,0) [0|18446744073709551615] "" Vector__XXX

BO_ 2566523136 VDMA_FA09_Software_History: 8 Vector__XXX
 SG_ Software_History_RawPayload : 0|64@1+ (1,0) [0|18446744073709551615] "" Vector__XXX

BO_ 2566523392 VDMA_FA0A_Motor_Generator_1_Ther: 8 Vector__XXX
 SG_ Motor_Generator_1_Thermal_Perfor : 0|64@1+ (1,0) [0|18446744073709551615] "" Vector__XXX

BO_ 2566523648 VDMA_FA0B_Motor_Generator_2_Ther: 8 Vector__XXX
 SG_ Motor_Generator_2_Thermal_Perfor : 0|64@1+ (1,0) [0|18446744073709551615] "" Vector__XXX

BO_ 2566523904 VDMA_FA0C_Motor_Generator_3_Ther: 8 Vector__XXX
 SG_ Motor_Generator_3_Thermal_Perfor : 0|64@1+ (1,0) [0|18446744073709551615] "" Vector__XXX

BO_ 2566524160 VDMA_FA0D_Motor_Generator_4_Ther: 8 Vector__XXX
 SG_ Motor_Generator_4_Thermal_Perfor : 0|64@1+ (1,0) [0|18446744073709551615] "" Vector__XXX

BO_ 2566524416 VDMA_FA0E_Motor_Generator_5_Ther: 8 Vector__XXX
 SG_ Motor_Generator_5_Thermal_Perfor : 0|64@1+ (1,0) [0|18446744073709551615] "" Vector__XXX

BO_ 2566524672 VDMA_FA0F_Motor_Generator_6_Ther: 8 Vector__XXX
 SG_ Motor_Generator_6_Thermal_Perfor : 0|64@1+ (1,0) [0|18446744073709551615] "" Vector__XXX

BO_ 2566524928 VDMA_FA10_On_Board_Programming_E: 8 Vector__XXX
 SG_ On_Board_Programming_Event_Time_ : 0|64@1+ (1,0) [0|18446744073709551615] "" Vector__XXX

BO_ 2566525184 VDMA_FA11_Aftertreatment_1_Light: 8 Vector__XXX
 SG_ Aftertreatment_1_Light_Off_SCR_S : 0|64@1+ (1,0) [0|18446744073709551615] "" Vector__XXX

BO_ 2566525440 VDMA_FA12_Motor_Generator_Locati: 8 Vector__XXX
 SG_ Motor_Generator_Location_Extende : 0|64@1+ (1,0) [0|18446744073709551615] "" Vector__XXX

BO_ 2566525696 VDMA_FA13_Cold_Start_Emissions_R: 8 Vector__XXX
 SG_ Cold_Start_Emissions_Reduction_S : 0|64@1+ (1,0) [0|18446744073709551615] "" Vector__XXX

BO_ 2566525952 VDMA_FA14_Cold_Start_Emissions_R: 8 Vector__XXX
 SG_ Cold_Start_Emissions_Reduction_S : 0|64@1+ (1,0) [0|18446744073709551615] "" Vector__XXX

BO_ 2566526208 VDMA_FA15_Genset_Supporting_Func: 8 Vector__XXX
 SG_ Genset_Supporting_Functions_RawP : 0|64@1+ (1,0) [0|18446744073709551615] "" Vector__XXX

BO_ 2566526464 VDMA_FA16_High_Voltage_Energy_St: 8 Vector__XXX
 SG_ High_Voltage_Energy_Storage_Syst : 0|64@1+ (1,0) [0|18446744073709551615] "" Vector__XXX

BO_ 2566526720 VDMA_FA17_High_Voltage_Energy_St: 8 Vector__XXX
 SG_ High_Voltage_Energy_Storage_Syst : 0|64@1+ (1,0) [0|18446744073709551615] "" Vector__XXX

BO_ 2566526976 VDMA_FA18_High_Voltage_Energy_St: 8 Vector__XXX
 SG_ High_Voltage_Energy_Storage_Syst : 0|64@1+ (1,0) [0|18446744073709551615] "" Vector__XXX

BO_ 2566527232 VDMA_FA19_High_Voltage_Energy_St: 8 Vector__XXX
 SG_ High_Voltage_Energy_Storage_Syst : 0|64@1+ (1,0) [0|18446744073709551615] "" Vector__XXX

BO_ 2566527488 VDMA_FA1A_Electronic_Engine_Cont: 8 Vector__XXX
 SG_ Electronic_Engine_Controller_23_ : 0|64@1+ (1,0) [0|18446744073709551615] "" Vector__XXX

BO_ 2566527744 VDMA_FA1B_Electronic_Engine_Cont: 8 Vector__XXX
 SG_ Electronic_Engine_Controller_24_ : 0|64@1+ (1,0) [0|18446744073709551615] "" Vector__XXX

BO_ 2566528000 VDMA_FA1C_Electronic_Engine_Cont: 8 Vector__XXX
 SG_ Electronic_Engine_Controller_25_ : 0|64@1+ (1,0) [0|18446744073709551615] "" Vector__XXX

BO_ 2566528256 VDMA_FA1D_High_Voltage_Bus_Conne: 8 Vector__XXX
 SG_ High_Voltage_Bus_Connection_Comm : 0|64@1+ (1,0) [0|18446744073709551615] "" Vector__XXX

BO_ 2566528512 VDMA_FA1E_High_Voltage_Bus_Conta: 8 Vector__XXX
 SG_ High_Voltage_Bus_Contactor_Statu : 0|64@1+ (1,0) [0|18446744073709551615] "" Vector__XXX

BO_ 2566528768 VDMA_FA1F_Aftertreatment_System_: 8 Vector__XXX
 SG_ Aftertreatment_System_Informatio : 0|64@1+ (1,0) [0|18446744073709551615] "" Vector__XXX

BO_ 2566529024 VDMA_FA20_EV_Multi_Connection_DC: 8 Vector__XXX
 SG_ EV_Multi_Connection_DC_Charging_ : 0|64@1+ (1,0) [0|18446744073709551615] "" Vector__XXX

BO_ 2566529280 VDMA_FA21_EV_Multi_Connection_Ch: 8 Vector__XXX
 SG_ EV_Multi_Connection_Charging_In_ : 0|64@1+ (1,0) [0|18446744073709551615] "" Vector__XXX

BO_ 2566529536 VDMA_FA22_Sensor_Supply_Voltage: 8 Vector__XXX
 SG_ Sensor_Supply_Voltage_RawPayload : 0|64@1+ (1,0) [0|18446744073709551615] "" Vector__XXX

BO_ 2566529792 VDMA_FA23_Motor_Generator_Locati: 8 Vector__XXX
 SG_ Motor_Generator_Location_obsolet : 0|64@1+ (1,0) [0|18446744073709551615] "" Vector__XXX

BO_ 2566530048 VDMA_FA24_High_Voltage_Energy_St: 8 Vector__XXX
 SG_ High_Voltage_Energy_Storage_Syst : 0|64@1+ (1,0) [0|18446744073709551615] "" Vector__XXX

BO_ 2566530304 VDMA_FA25_High_Voltage_Energy_St: 8 Vector__XXX
 SG_ High_Voltage_Energy_Storage_Syst : 0|64@1+ (1,0) [0|18446744073709551615] "" Vector__XXX

BO_ 2566530560 VDMA_FA26_High_Voltage_Energy_St: 8 Vector__XXX
 SG_ High_Voltage_Energy_Storage_Syst : 0|64@1+ (1,0) [0|18446744073709551615] "" Vector__XXX

BO_ 2566530816 VDMA_FA27_High_Voltage_Energy_St: 8 Vector__XXX
 SG_ High_Voltage_Energy_Storage_Pack : 0|64@1+ (1,0) [0|18446744073709551615] "" Vector__XXX

BO_ 2566531072 VDMA_FA28_High_Voltage_Energy_St: 8 Vector__XXX
 SG_ High_Voltage_Energy_Storage_Pack : 0|64@1+ (1,0) [0|18446744073709551615] "" Vector__XXX

BO_ 2566531328 VDMA_FA29_High_Voltage_Energy_St: 8 Vector__XXX
 SG_ High_Voltage_Energy_Storage_Pack : 0|64@1+ (1,0) [0|18446744073709551615] "" Vector__XXX

BO_ 2566531584 VDMA_FA2A_High_Voltage_Energy_St: 8 Vector__XXX
 SG_ High_Voltage_Energy_Storage_Pack : 0|64@1+ (1,0) [0|18446744073709551615] "" Vector__XXX

BO_ 2566531840 VDMA_FA2B_High_Voltage_Energy_St: 8 Vector__XXX
 SG_ High_Voltage_Energy_Storage_Pack : 0|64@1+ (1,0) [0|18446744073709551615] "" Vector__XXX

BO_ 2566532096 VDMA_FA2C_High_Voltage_Energy_St: 8 Vector__XXX
 SG_ High_Voltage_Energy_Storage_Pack : 0|64@1+ (1,0) [0|18446744073709551615] "" Vector__XXX

BO_ 2566532352 VDMA_FA2D_High_Voltage_Energy_St: 8 Vector__XXX
 SG_ High_Voltage_Energy_Storage_Pack : 0|64@1+ (1,0) [0|18446744073709551615] "" Vector__XXX

BO_ 2566532608 VDMA_FA2E_High_Voltage_Energy_St: 8 Vector__XXX
 SG_ High_Voltage_Energy_Storage_Pack : 0|64@1+ (1,0) [0|18446744073709551615] "" Vector__XXX

BO_ 2566532864 VDMA_FA2F_High_Voltage_Energy_St: 8 Vector__XXX
 SG_ High_Voltage_Energy_Storage_Pack : 0|64@1+ (1,0) [0|18446744073709551615] "" Vector__XXX

BO_ 2566533120 VDMA_FA30_High_Voltage_Energy_St: 8 Vector__XXX
 SG_ High_Voltage_Energy_Storage_Pack : 0|64@1+ (1,0) [0|18446744073709551615] "" Vector__XXX

BO_ 2566533376 VDMA_FA31_High_Voltage_Energy_St: 8 Vector__XXX
 SG_ High_Voltage_Energy_Storage_Pack : 0|64@1+ (1,0) [0|18446744073709551615] "" Vector__XXX

BO_ 2566533632 VDMA_FA32_High_Voltage_Energy_St: 8 Vector__XXX
 SG_ High_Voltage_Energy_Storage_Pack : 0|64@1+ (1,0) [0|18446744073709551615] "" Vector__XXX

BO_ 2566533888 VDMA_FA33_Multi_Color_Indicator_: 8 Vector__XXX
 SG_ Multi_Color_Indicator_Lamp_Comma : 0|64@1+ (1,0) [0|18446744073709551615] "" Vector__XXX

BO_ 2566534144 VDMA_FA34_Multi_Color_Indicator_: 8 Vector__XXX
 SG_ Multi_Color_Indicator_Lamp_Statu : 0|64@1+ (1,0) [0|18446744073709551615] "" Vector__XXX

BO_ 2566534400 VDMA_FA35_Refuse_Truck_Body_Info: 8 Vector__XXX
 SG_ Refuse_Truck_Body_Information_Ra : 0|64@1+ (1,0) [0|18446744073709551615] "" Vector__XXX

BO_ 2566534656 VDMA_FA36_Engine_Fluid_Level_Pre: 8 Vector__XXX
 SG_ Engine_Fluid_Level_Pressure_14_R : 0|64@1+ (1,0) [0|18446744073709551615] "" Vector__XXX

BO_ 2566534912 VDMA_FA37_Well_Stimulation_Trans: 8 Vector__XXX
 SG_ Well_Stimulation_Transmission_Co : 0|64@1+ (1,0) [0|18446744073709551615] "" Vector__XXX

BO_ 2566535168 VDMA_FA38_Well_Stimulation_Pump_: 8 Vector__XXX
 SG_ Well_Stimulation_Pump_Protection : 0|64@1+ (1,0) [0|18446744073709551615] "" Vector__XXX

BO_ 2566535424 VDMA_FA39_Well_Stimulation_Pump_: 8 Vector__XXX
 SG_ Well_Stimulation_Pump_Protection : 0|64@1+ (1,0) [0|18446744073709551615] "" Vector__XXX

BO_ 2566535680 VDMA_FA3A_Electric_PTO_Drive_Eng: 8 Vector__XXX
 SG_ Electric_PTO_Drive_Engagement_1_ : 0|64@1+ (1,0) [0|18446744073709551615] "" Vector__XXX

BO_ 2566535936 VDMA_FA3B_Electric_PTO_1_Informa: 8 Vector__XXX
 SG_ Electric_PTO_1_Information_RawPa : 0|64@1+ (1,0) [0|18446744073709551615] "" Vector__XXX

BO_ 2566536192 VDMA_FA3C_Engine_Exhaust_O2_Sens: 8 Vector__XXX
 SG_ Engine_Exhaust_O2_Sensor_Informa : 0|64@1+ (1,0) [0|18446744073709551615] "" Vector__XXX

BO_ 2566536448 VDMA_FA3D_Gaseous_Fuel_Supply_Pr: 8 Vector__XXX
 SG_ Gaseous_Fuel_Supply_Pressure_3_R : 0|64@1+ (1,0) [0|18446744073709551615] "" Vector__XXX

BO_ 2566536704 VDMA_FA3E_Traffic_Signage: 8 Vector__XXX
 SG_ Traffic_Signage_RawPayload : 0|64@1+ (1,0) [0|18446744073709551615] "" Vector__XXX

BO_ 2566536960 VDMA_FA3F_Engine_Configuration_4: 8 Vector__XXX
 SG_ Engine_Configuration_4_RawPayloa : 0|64@1+ (1,0) [0|18446744073709551615] "" Vector__XXX

BO_ 2566537216 VDMA_FA40_Electronic_Transmissio: 8 Vector__XXX
 SG_ Electronic_Transmission_Controll : 0|64@1+ (1,0) [0|18446744073709551615] "" Vector__XXX

BO_ 2566537472 VDMA_FA41_Automated_Driving_Syst: 8 Vector__XXX
 SG_ Automated_Driving_System_Network : 0|64@1+ (1,0) [0|18446744073709551615] "" Vector__XXX

BO_ 2566537728 VDMA_FA42_Automated_Driving_Syst: 8 Vector__XXX
 SG_ Automated_Driving_System_Network : 0|64@1+ (1,0) [0|18446744073709551615] "" Vector__XXX

BO_ 2566537984 VDMA_FA43_Hybrid_or_EV_System_In: 8 Vector__XXX
 SG_ Hybrid_or_EV_System_Inputs_2_Raw : 0|64@1+ (1,0) [0|18446744073709551615] "" Vector__XXX

BO_ 2566538240 VDMA_FA44_Engine_Speed_Load_Fact: 8 Vector__XXX
 SG_ Engine_Speed_Load_Factor_Informa : 0|64@1+ (1,0) [0|18446744073709551615] "" Vector__XXX

BO_ 2566538496 VDMA_FA45_Generator_Trip_Energy_: 8 Vector__XXX
 SG_ Generator_Trip_Energy_2_RawPaylo : 0|64@1+ (1,0) [0|18446744073709551615] "" Vector__XXX

BO_ 2566538752 VDMA_FA46_Security_System_Machin: 8 Vector__XXX
 SG_ Security_System_Machine_Operatio : 0|64@1+ (1,0) [0|18446744073709551615] "" Vector__XXX

BO_ 2566539008 VDMA_FA47_Engine_Fuel_Actuator_S: 8 Vector__XXX
 SG_ Engine_Fuel_Actuator_Service_Mod : 0|64@1+ (1,0) [0|18446744073709551615] "" Vector__XXX

BO_ 2566539264 VDMA_FA48_Steering_Wheel_Control: 8 Vector__XXX
 SG_ Steering_Wheel_Controls_RawPaylo : 0|64@1+ (1,0) [0|18446744073709551615] "" Vector__XXX

BO_ 2566539520 VDMA_FA49_Park_Assist: 8 Vector__XXX
 SG_ Park_Assist_RawPayload : 0|64@1+ (1,0) [0|18446744073709551615] "" Vector__XXX

BO_ 2566539776 VDMA_FA4A_Extended_DTC_informati: 8 Vector__XXX
 SG_ Extended_DTC_information_RawPayl : 0|64@1+ (1,0) [0|18446744073709551615] "" Vector__XXX

BO_ 2566540032 VDMA_FA4B_Aftertreatment_2_SCR_D: 8 Vector__XXX
 SG_ Aftertreatment_2_SCR_Dosing_Syst : 0|64@1+ (1,0) [0|18446744073709551615] "" Vector__XXX

BO_ 2566540288 VDMA_FA4C_Aftertreatment_1_SCR_D: 8 Vector__XXX
 SG_ Aftertreatment_1_SCR_Dosing_Syst : 0|64@1+ (1,0) [0|18446744073709551615] "" Vector__XXX

BO_ 2566540544 VDMA_FA4D_EV_Economy_Information: 8 Vector__XXX
 SG_ EV_Economy_Information_RawPayloa : 0|64@1+ (1,0) [0|18446744073709551615] "" Vector__XXX

BO_ 2566540800 VDMA_FA4E_Automated_Driving_Syst: 8 Vector__XXX
 SG_ Automated_Driving_System_Status_ : 0|64@1+ (1,0) [0|18446744073709551615] "" Vector__XXX

BO_ 2566541056 VDMA_FA4F_Automated_Driving_Syst: 8 Vector__XXX
 SG_ Automated_Driving_System_Control : 0|64@1+ (1,0) [0|18446744073709551615] "" Vector__XXX

BO_ 2566541312 VDMA_FA50_Aftercooler_Valve: 8 Vector__XXX
 SG_ Aftercooler_Valve_RawPayload : 0|64@1+ (1,0) [0|18446744073709551615] "" Vector__XXX

BO_ 2566541568 VDMA_FA51_Engine_Radiator_1: 8 Vector__XXX
 SG_ Engine_Radiator_1_RawPayload : 0|64@1+ (1,0) [0|18446744073709551615] "" Vector__XXX

BO_ 2566541824 VDMA_FA52_Engine_Radiator_2: 8 Vector__XXX
 SG_ Engine_Radiator_2_RawPayload : 0|64@1+ (1,0) [0|18446744073709551615] "" Vector__XXX

BO_ 2566542080 VDMA_FA53_Genset_Enclosure_Venti: 8 Vector__XXX
 SG_ Genset_Enclosure_Ventilation_Raw : 0|64@1+ (1,0) [0|18446744073709551615] "" Vector__XXX

BO_ 2566542336 VDMA_FA54_Heat_Exchanger_1: 8 Vector__XXX
 SG_ Heat_Exchanger_1_RawPayload : 0|64@1+ (1,0) [0|18446744073709551615] "" Vector__XXX

BO_ 2566542592 VDMA_FA55_Heat_Exchanger_2: 8 Vector__XXX
 SG_ Heat_Exchanger_2_RawPayload : 0|64@1+ (1,0) [0|18446744073709551615] "" Vector__XXX

BO_ 2566542848 VDMA_FA56_Heat_Exchanger_3: 8 Vector__XXX
 SG_ Heat_Exchanger_3_RawPayload : 0|64@1+ (1,0) [0|18446744073709551615] "" Vector__XXX

BO_ 2566543104 VDMA_FA57_Heat_Exchanger_4: 8 Vector__XXX
 SG_ Heat_Exchanger_4_RawPayload : 0|64@1+ (1,0) [0|18446744073709551615] "" Vector__XXX

BO_ 2566543360 VDMA_FA58_Engine_Exhaust_Gas_Hea: 8 Vector__XXX
 SG_ Engine_Exhaust_Gas_Heat_Exchange : 0|64@1+ (1,0) [0|18446744073709551615] "" Vector__XXX

BO_ 2566543616 VDMA_FA59_Genset_Enclosure_Venti: 8 Vector__XXX
 SG_ Genset_Enclosure_Ventilation_Lou : 0|64@1+ (1,0) [0|18446744073709551615] "" Vector__XXX

BO_ 2566543872 VDMA_FA5A_Genset_External_Coolan: 8 Vector__XXX
 SG_ Genset_External_Coolant_System_R : 0|64@1+ (1,0) [0|18446744073709551615] "" Vector__XXX

BO_ 2566544128 VDMA_FA5B_EV_DC_Status_1: 8 Vector__XXX
 SG_ EV_DC_Status_1_RawPayload : 0|64@1+ (1,0) [0|18446744073709551615] "" Vector__XXX

BO_ 2566544384 VDMA_FA5C_EVSE_DC_Charging_Limit: 8 Vector__XXX
 SG_ EVSE_DC_Charging_Limits_3_RawPay : 0|64@1+ (1,0) [0|18446744073709551615] "" Vector__XXX

BO_ 2566544640 VDMA_FA5D_EVSE_Power_Max_Schedul: 8 Vector__XXX
 SG_ EVSE_Power_Max_Schedule_RawPaylo : 0|64@1+ (1,0) [0|18446744073709551615] "" Vector__XXX

BO_ 2566544896 VDMA_FA5E_EV_Charge_Profile: 8 Vector__XXX
 SG_ EV_Charge_Profile_RawPayload : 0|64@1+ (1,0) [0|18446744073709551615] "" Vector__XXX

BO_ 2566545152 VDMA_FA5F_EV_DC_Charging_Limits_: 8 Vector__XXX
 SG_ EV_DC_Charging_Limits_2_RawPaylo : 0|64@1+ (1,0) [0|18446744073709551615] "" Vector__XXX

BO_ 2566545408 VDMA_FA60_EV_DC_Charging_In_Prog: 8 Vector__XXX
 SG_ EV_DC_Charging_In_Progress_RawPa : 0|64@1+ (1,0) [0|18446744073709551615] "" Vector__XXX

BO_ 2566545920 VDMA_FA62_Lighting_Data_2: 8 Vector__XXX
 SG_ Lighting_Data_2_RawPayload : 0|64@1+ (1,0) [0|18446744073709551615] "" Vector__XXX

BO_ 2566546176 VDMA_FA63_Lighting_Command_2: 8 Vector__XXX
 SG_ Lighting_Command_2_RawPayload : 0|64@1+ (1,0) [0|18446744073709551615] "" Vector__XXX

BO_ 2566546432 VDMA_FA64_Aftertreatment_System_: 8 Vector__XXX
 SG_ Aftertreatment_System_Informatio : 0|64@1+ (1,0) [0|18446744073709551615] "" Vector__XXX

BO_ 2566546688 VDMA_FA65_Aftertreatment_System_: 8 Vector__XXX
 SG_ Aftertreatment_System_Informatio : 0|64@1+ (1,0) [0|18446744073709551615] "" Vector__XXX

BO_ 2566546944 VDMA_FA66_Aftertreatment_System_: 8 Vector__XXX
 SG_ Aftertreatment_System_Informatio : 0|64@1+ (1,0) [0|18446744073709551615] "" Vector__XXX

BO_ 2566547200 VDMA_FA67_Fluid_Resistance_1: 8 Vector__XXX
 SG_ Fluid_Resistance_1_RawPayload : 0|64@1+ (1,0) [0|18446744073709551615] "" Vector__XXX

BO_ 2566547456 VDMA_FA68_Power_Converter_2_Isol: 8 Vector__XXX
 SG_ Power_Converter_2_Isolation_Inte : 0|64@1+ (1,0) [0|18446744073709551615] "" Vector__XXX

BO_ 2566547712 VDMA_FA69_Power_Converter_1_Isol: 8 Vector__XXX
 SG_ Power_Converter_1_Isolation_Inte : 0|64@1+ (1,0) [0|18446744073709551615] "" Vector__XXX

BO_ 2566547968 VDMA_FA6A_Power_Converter_2_Limi: 8 Vector__XXX
 SG_ Power_Converter_2_Limits_Request : 0|64@1+ (1,0) [0|18446744073709551615] "" Vector__XXX

BO_ 2566548224 VDMA_FA6B_Power_Converter_2_Limi: 8 Vector__XXX
 SG_ Power_Converter_2_Limits_Request : 0|64@1+ (1,0) [0|18446744073709551615] "" Vector__XXX

BO_ 2566548480 VDMA_FA6C_Power_Converter_2_Limi: 8 Vector__XXX
 SG_ Power_Converter_2_Limits_Request : 0|64@1+ (1,0) [0|18446744073709551615] "" Vector__XXX

BO_ 2566548736 VDMA_FA6D_Power_Converter_1_Limi: 8 Vector__XXX
 SG_ Power_Converter_1_Limits_Request : 0|64@1+ (1,0) [0|18446744073709551615] "" Vector__XXX

BO_ 2566548992 VDMA_FA6E_Power_Converter_1_Limi: 8 Vector__XXX
 SG_ Power_Converter_1_Limits_Request : 0|64@1+ (1,0) [0|18446744073709551615] "" Vector__XXX

BO_ 2566549248 VDMA_FA6F_Power_Converter_1_Limi: 8 Vector__XXX
 SG_ Power_Converter_1_Limits_Request : 0|64@1+ (1,0) [0|18446744073709551615] "" Vector__XXX

BO_ 2566549504 VDMA_FA70_Inverter_1_Lifetime_Da: 8 Vector__XXX
 SG_ Inverter_1_Lifetime_Data_RawPayl : 0|64@1+ (1,0) [0|18446744073709551615] "" Vector__XXX

BO_ 2566549760 VDMA_FA71_Inverter_2_Lifetime_Da: 8 Vector__XXX
 SG_ Inverter_2_Lifetime_Data_RawPayl : 0|64@1+ (1,0) [0|18446744073709551615] "" Vector__XXX

BO_ 2566550016 VDMA_FA72_Power_Converter_2_Acti: 8 Vector__XXX
 SG_ Power_Converter_2_Active_Power_L : 0|64@1+ (1,0) [0|18446744073709551615] "" Vector__XXX

BO_ 2566550272 VDMA_FA73_Power_Converter_1_Acti: 8 Vector__XXX
 SG_ Power_Converter_1_Active_Power_L : 0|64@1+ (1,0) [0|18446744073709551615] "" Vector__XXX

BO_ 2566550528 VDMA_FA74_Power_Converter_2_Refe: 8 Vector__XXX
 SG_ Power_Converter_2_Reference_1_Ra : 0|64@1+ (1,0) [0|18446744073709551615] "" Vector__XXX

BO_ 2566550784 VDMA_FA75_Power_Converter_2_Refe: 8 Vector__XXX
 SG_ Power_Converter_2_Reference_2_Ra : 0|64@1+ (1,0) [0|18446744073709551615] "" Vector__XXX

BO_ 2566551040 VDMA_FA76_Power_Converter_2_Temp: 8 Vector__XXX
 SG_ Power_Converter_2_Temperature_Ra : 0|64@1+ (1,0) [0|18446744073709551615] "" Vector__XXX

BO_ 2566551296 VDMA_FA77_Power_Converter_1_Temp: 8 Vector__XXX
 SG_ Power_Converter_1_Temperature_Ra : 0|64@1+ (1,0) [0|18446744073709551615] "" Vector__XXX

BO_ 2566551552 VDMA_FA78_Power_Converter_1_Refe: 8 Vector__XXX
 SG_ Power_Converter_1_Reference_2_Ra : 0|64@1+ (1,0) [0|18446744073709551615] "" Vector__XXX

BO_ 2566551808 VDMA_FA79_Power_Converter_1_Refe: 8 Vector__XXX
 SG_ Power_Converter_1_Reference_1_Ra : 0|64@1+ (1,0) [0|18446744073709551615] "" Vector__XXX

BO_ 2566552064 VDMA_FA7A_Power_Converter_1_Phas: 8 Vector__XXX
 SG_ Power_Converter_1_Phase_Current_ : 0|64@1+ (1,0) [0|18446744073709551615] "" Vector__XXX

BO_ 2566552320 VDMA_FA7B_Power_Converter_2_Phas: 8 Vector__XXX
 SG_ Power_Converter_2_Phase_Current_ : 0|64@1+ (1,0) [0|18446744073709551615] "" Vector__XXX

BO_ 2566552576 VDMA_FA7C_Power_Converter_1_Phas: 8 Vector__XXX
 SG_ Power_Converter_1_Phase_Voltage_ : 0|64@1+ (1,0) [0|18446744073709551615] "" Vector__XXX

BO_ 2566552832 VDMA_FA7D_Power_Converter_2_Phas: 8 Vector__XXX
 SG_ Power_Converter_2_Phase_Voltage_ : 0|64@1+ (1,0) [0|18446744073709551615] "" Vector__XXX

BO_ 2566553088 VDMA_FA7E_Power_Converter_Power_: 8 Vector__XXX
 SG_ Power_Converter_Power_Module_Swi : 0|64@1+ (1,0) [0|18446744073709551615] "" Vector__XXX

BO_ 2566553344 VDMA_FA7F_Power_Converter_1_Powe: 8 Vector__XXX
 SG_ Power_Converter_1_Power_Module_S : 0|64@1+ (1,0) [0|18446744073709551615] "" Vector__XXX

BO_ 2566553600 VDMA_FA80_Power_Converter_2_Powe: 8 Vector__XXX
 SG_ Power_Converter_2_Power_Module_S : 0|64@1+ (1,0) [0|18446744073709551615] "" Vector__XXX

BO_ 2566553856 VDMA_FA81_Power_Converter_Totals: 8 Vector__XXX
 SG_ Power_Converter_Totals_1_RawPayl : 0|64@1+ (1,0) [0|18446744073709551615] "" Vector__XXX

BO_ 2566554112 VDMA_FA82_Transformer_Temperatur: 8 Vector__XXX
 SG_ Transformer_Temperatures_RawPayl : 0|64@1+ (1,0) [0|18446744073709551615] "" Vector__XXX

BO_ 2566554368 VDMA_FA83_Electrified_Accessory_: 8 Vector__XXX
 SG_ Electrified_Accessory_Engine_Coo : 0|64@1+ (1,0) [0|18446744073709551615] "" Vector__XXX

BO_ 2566554624 VDMA_FA84_High_Voltage_Energy_St: 8 Vector__XXX
 SG_ High_Voltage_Energy_Storage_Pack : 0|64@1+ (1,0) [0|18446744073709551615] "" Vector__XXX

BO_ 2566554880 VDMA_FA85_High_Voltage_Energy_St: 8 Vector__XXX
 SG_ High_Voltage_Energy_Storage_Pack : 0|64@1+ (1,0) [0|18446744073709551615] "" Vector__XXX

BO_ 2566555136 VDMA_FA86_High_Voltage_Energy_St: 8 Vector__XXX
 SG_ High_Voltage_Energy_Storage_Pack : 0|64@1+ (1,0) [0|18446744073709551615] "" Vector__XXX

BO_ 2566555392 VDMA_FA87_High_Voltage_Energy_St: 8 Vector__XXX
 SG_ High_Voltage_Energy_Storage_Pack : 0|64@1+ (1,0) [0|18446744073709551615] "" Vector__XXX

BO_ 2566555648 VDMA_FA88_High_Voltage_Energy_St: 8 Vector__XXX
 SG_ High_Voltage_Energy_Storage_Pack : 0|64@1+ (1,0) [0|18446744073709551615] "" Vector__XXX

BO_ 2566555904 VDMA_FA89_High_Voltage_Energy_St: 8 Vector__XXX
 SG_ High_Voltage_Energy_Storage_Pack : 0|64@1+ (1,0) [0|18446744073709551615] "" Vector__XXX

BO_ 2566556160 VDMA_FA8A_High_Voltage_Energy_St: 8 Vector__XXX
 SG_ High_Voltage_Energy_Storage_Pack : 0|64@1+ (1,0) [0|18446744073709551615] "" Vector__XXX

BO_ 2566556416 VDMA_FA8B_High_Voltage_Energy_St: 8 Vector__XXX
 SG_ High_Voltage_Energy_Storage_Pack : 0|64@1+ (1,0) [0|18446744073709551615] "" Vector__XXX

BO_ 2566556672 VDMA_FA8C_High_Voltage_Energy_St: 8 Vector__XXX
 SG_ High_Voltage_Energy_Storage_Pack : 0|64@1+ (1,0) [0|18446744073709551615] "" Vector__XXX

BO_ 2566556928 VDMA_FA8D_High_Voltage_Energy_St: 8 Vector__XXX
 SG_ High_Voltage_Energy_Storage_Pack : 0|64@1+ (1,0) [0|18446744073709551615] "" Vector__XXX

BO_ 2566557184 VDMA_FA8E_High_Voltage_Energy_St: 8 Vector__XXX
 SG_ High_Voltage_Energy_Storage_Pack : 0|64@1+ (1,0) [0|18446744073709551615] "" Vector__XXX

BO_ 2566557440 VDMA_FA8F_High_Voltage_Energy_St: 8 Vector__XXX
 SG_ High_Voltage_Energy_Storage_Pack : 0|64@1+ (1,0) [0|18446744073709551615] "" Vector__XXX

BO_ 2566557696 VDMA_FA90_High_Voltage_Energy_St: 8 Vector__XXX
 SG_ High_Voltage_Energy_Storage_Pack : 0|64@1+ (1,0) [0|18446744073709551615] "" Vector__XXX

BO_ 2566557952 VDMA_FA91_High_Voltage_Energy_St: 8 Vector__XXX
 SG_ High_Voltage_Energy_Storage_Pack : 0|64@1+ (1,0) [0|18446744073709551615] "" Vector__XXX

BO_ 2566558208 VDMA_FA92_High_Voltage_Energy_St: 8 Vector__XXX
 SG_ High_Voltage_Energy_Storage_Pack : 0|64@1+ (1,0) [0|18446744073709551615] "" Vector__XXX

BO_ 2566558464 VDMA_FA93_High_Voltage_Energy_St: 8 Vector__XXX
 SG_ High_Voltage_Energy_Storage_Pack : 0|64@1+ (1,0) [0|18446744073709551615] "" Vector__XXX

BO_ 2566558720 VDMA_FA94_High_Voltage_Energy_St: 8 Vector__XXX
 SG_ High_Voltage_Energy_Storage_Pack : 0|64@1+ (1,0) [0|18446744073709551615] "" Vector__XXX

BO_ 2566558976 VDMA_FA95_High_Voltage_Energy_St: 8 Vector__XXX
 SG_ High_Voltage_Energy_Storage_Pack : 0|64@1+ (1,0) [0|18446744073709551615] "" Vector__XXX

BO_ 2566559232 VDMA_FA96_High_Voltage_Energy_St: 8 Vector__XXX
 SG_ High_Voltage_Energy_Storage_Pack : 0|64@1+ (1,0) [0|18446744073709551615] "" Vector__XXX

BO_ 2566559488 VDMA_FA97_High_Voltage_Energy_St: 8 Vector__XXX
 SG_ High_Voltage_Energy_Storage_Pack : 0|64@1+ (1,0) [0|18446744073709551615] "" Vector__XXX

BO_ 2566559744 VDMA_FA98_High_Voltage_Energy_St: 8 Vector__XXX
 SG_ High_Voltage_Energy_Storage_Pack : 0|64@1+ (1,0) [0|18446744073709551615] "" Vector__XXX

BO_ 2566560000 VDMA_FA99_High_Voltage_Energy_St: 8 Vector__XXX
 SG_ High_Voltage_Energy_Storage_Pack : 0|64@1+ (1,0) [0|18446744073709551615] "" Vector__XXX

BO_ 2566560256 VDMA_FA9A_High_Voltage_Energy_St: 8 Vector__XXX
 SG_ High_Voltage_Energy_Storage_Pack : 0|64@1+ (1,0) [0|18446744073709551615] "" Vector__XXX

BO_ 2566560512 VDMA_FA9B_High_Voltage_Energy_St: 8 Vector__XXX
 SG_ High_Voltage_Energy_Storage_Pack : 0|64@1+ (1,0) [0|18446744073709551615] "" Vector__XXX

BO_ 2566560768 VDMA_FA9C_High_Voltage_Energy_St: 8 Vector__XXX
 SG_ High_Voltage_Energy_Storage_Pack : 0|64@1+ (1,0) [0|18446744073709551615] "" Vector__XXX

BO_ 2566561024 VDMA_FA9D_High_Voltage_Energy_St: 8 Vector__XXX
 SG_ High_Voltage_Energy_Storage_Pack : 0|64@1+ (1,0) [0|18446744073709551615] "" Vector__XXX

BO_ 2566561280 VDMA_FA9E_High_Voltage_Energy_St: 8 Vector__XXX
 SG_ High_Voltage_Energy_Storage_Pack : 0|64@1+ (1,0) [0|18446744073709551615] "" Vector__XXX

BO_ 2566561536 VDMA_FA9F_High_Voltage_Energy_St: 8 Vector__XXX
 SG_ High_Voltage_Energy_Storage_Pack : 0|64@1+ (1,0) [0|18446744073709551615] "" Vector__XXX

BO_ 2566561792 VDMA_FAA0_High_Voltage_Energy_St: 8 Vector__XXX
 SG_ High_Voltage_Energy_Storage_Pack : 0|64@1+ (1,0) [0|18446744073709551615] "" Vector__XXX

BO_ 2566562048 VDMA_FAA1_High_Voltage_Energy_St: 8 Vector__XXX
 SG_ High_Voltage_Energy_Storage_Pack : 0|64@1+ (1,0) [0|18446744073709551615] "" Vector__XXX

BO_ 2566562304 VDMA_FAA2_High_Voltage_Energy_St: 8 Vector__XXX
 SG_ High_Voltage_Energy_Storage_Pack : 0|64@1+ (1,0) [0|18446744073709551615] "" Vector__XXX

BO_ 2566562560 VDMA_FAA3_High_Voltage_Energy_St: 8 Vector__XXX
 SG_ High_Voltage_Energy_Storage_Pack : 0|64@1+ (1,0) [0|18446744073709551615] "" Vector__XXX

BO_ 2566562816 VDMA_FAA4_Automated_Driving_Syst: 8 Vector__XXX
 SG_ Automated_Driving_System_Control : 0|64@1+ (1,0) [0|18446744073709551615] "" Vector__XXX

BO_ 2566563072 VDMA_FAA5_Dual_Fuel_Mode_3: 8 Vector__XXX
 SG_ Dual_Fuel_Mode_3_RawPayload : 0|64@1+ (1,0) [0|18446744073709551615] "" Vector__XXX

BO_ 2566563328 VDMA_FAA6_Dual_Fuel_Mode_2: 8 Vector__XXX
 SG_ Dual_Fuel_Mode_2_RawPayload : 0|64@1+ (1,0) [0|18446744073709551615] "" Vector__XXX

BO_ 2566563584 VDMA_FAA7_Dual_Fuel_Mode_1: 8 Vector__XXX
 SG_ Dual_Fuel_Mode_1_RawPayload : 0|64@1+ (1,0) [0|18446744073709551615] "" Vector__XXX

BO_ 2566563840 VDMA_FAA8_Transmission_1_History: 8 Vector__XXX
 SG_ Transmission_1_History_RawPayloa : 0|64@1+ (1,0) [0|18446744073709551615] "" Vector__XXX

BO_ 2566564096 VDMA_FAA9_Transmission_Shaft_Twi: 8 Vector__XXX
 SG_ Transmission_Shaft_Twist_Informa : 0|64@1+ (1,0) [0|18446744073709551615] "" Vector__XXX

BO_ 2566564352 VDMA_FAAA_Electronic_Auxiliary_T: 8 Vector__XXX
 SG_ Electronic_Auxiliary_Transmissio : 0|64@1+ (1,0) [0|18446744073709551615] "" Vector__XXX

BO_ 2566564608 VDMA_FAAB_High_Voltage_Energy_St: 8 Vector__XXX
 SG_ High_Voltage_Energy_Storage_Pack : 0|64@1+ (1,0) [0|18446744073709551615] "" Vector__XXX

BO_ 2566564864 VDMA_FAAC_High_Voltage_Energy_St: 8 Vector__XXX
 SG_ High_Voltage_Energy_Storage_Pack : 0|64@1+ (1,0) [0|18446744073709551615] "" Vector__XXX

BO_ 2566565120 VDMA_FAAD_High_Voltage_Energy_St: 8 Vector__XXX
 SG_ High_Voltage_Energy_Storage_Pack : 0|64@1+ (1,0) [0|18446744073709551615] "" Vector__XXX

BO_ 2566565376 VDMA_FAAE_High_Voltage_Energy_St: 8 Vector__XXX
 SG_ High_Voltage_Energy_Storage_Pack : 0|64@1+ (1,0) [0|18446744073709551615] "" Vector__XXX

BO_ 2566565632 VDMA_FAAF_High_Voltage_Energy_St: 8 Vector__XXX
 SG_ High_Voltage_Energy_Storage_Pack : 0|64@1+ (1,0) [0|18446744073709551615] "" Vector__XXX

BO_ 2566565888 VDMA_FAB0_High_Voltage_Energy_St: 8 Vector__XXX
 SG_ High_Voltage_Energy_Storage_Pack : 0|64@1+ (1,0) [0|18446744073709551615] "" Vector__XXX

BO_ 2566566144 VDMA_FAB1_High_Voltage_Energy_St: 8 Vector__XXX
 SG_ High_Voltage_Energy_Storage_Pack : 0|64@1+ (1,0) [0|18446744073709551615] "" Vector__XXX

BO_ 2566566400 VDMA_FAB2_High_Voltage_Energy_St: 8 Vector__XXX
 SG_ High_Voltage_Energy_Storage_Pack : 0|64@1+ (1,0) [0|18446744073709551615] "" Vector__XXX

BO_ 2566566656 VDMA_FAB3_AUTOSAR_Time_Synchroni: 8 Vector__XXX
 SG_ AUTOSAR_Time_Synchronization_Raw : 0|64@1+ (1,0) [0|18446744073709551615] "" Vector__XXX

BO_ 2566566912 VDMA_FAB4_EV_DC_Charging_Limits_: 8 Vector__XXX
 SG_ EV_DC_Charging_Limits_1_RawPaylo : 0|64@1+ (1,0) [0|18446744073709551615] "" Vector__XXX

BO_ 2566567168 VDMA_FAB5_EVSE_DC_Charging_Limit: 8 Vector__XXX
 SG_ EVSE_DC_Charging_Limits_1_RawPay : 0|64@1+ (1,0) [0|18446744073709551615] "" Vector__XXX

BO_ 2566567424 VDMA_FAB6_EVSE_DC_Charging_Limit: 8 Vector__XXX
 SG_ EVSE_DC_Charging_Limits_2_RawPay : 0|64@1+ (1,0) [0|18446744073709551615] "" Vector__XXX

BO_ 2566567680 VDMA_FAB7_EV_DC_Charging_Target: 8 Vector__XXX
 SG_ EV_DC_Charging_Target_RawPayload : 0|64@1+ (1,0) [0|18446744073709551615] "" Vector__XXX

BO_ 2566567936 VDMA_FAB8_EVSE_DC_Status_1: 8 Vector__XXX
 SG_ EVSE_DC_Status_1_RawPayload : 0|64@1+ (1,0) [0|18446744073709551615] "" Vector__XXX

BO_ 2566568192 VDMA_FAB9_EVSE_1_Contactor_Cmd_1: 8 Vector__XXX
 SG_ EVSE_1_Contactor_Cmd_1_RawPayloa : 0|64@1+ (1,0) [0|18446744073709551615] "" Vector__XXX

BO_ 2566568448 VDMA_FABA_EVSE_1_Contactor_Statu: 8 Vector__XXX
 SG_ EVSE_1_Contactor_Status_1_RawPay : 0|64@1+ (1,0) [0|18446744073709551615] "" Vector__XXX

BO_ 2566568704 VDMA_FABB_Direct_Lamp_Control_Co: 8 Vector__XXX
 SG_ Direct_Lamp_Control_Command_3_Ra : 0|64@1+ (1,0) [0|18446744073709551615] "" Vector__XXX

BO_ 2566568960 VDMA_FABC_Direct_Lamp_Control_Da: 8 Vector__XXX
 SG_ Direct_Lamp_Control_Data_3_RawPa : 0|64@1+ (1,0) [0|18446744073709551615] "" Vector__XXX

BO_ 2566569216 VDMA_FABD_Motor_Generator_1_Life: 8 Vector__XXX
 SG_ Motor_Generator_1_Lifetime_Data_ : 0|64@1+ (1,0) [0|18446744073709551615] "" Vector__XXX

BO_ 2566569472 VDMA_FABE_Motor_Generator_2_Life: 8 Vector__XXX
 SG_ Motor_Generator_2_Lifetime_Data_ : 0|64@1+ (1,0) [0|18446744073709551615] "" Vector__XXX

BO_ 2566569728 VDMA_FABF_Motor_Generator_3_Life: 8 Vector__XXX
 SG_ Motor_Generator_3_Lifetime_Data_ : 0|64@1+ (1,0) [0|18446744073709551615] "" Vector__XXX

BO_ 2566569984 VDMA_FAC0_Motor_Generator_4_Life: 8 Vector__XXX
 SG_ Motor_Generator_4_Lifetime_Data_ : 0|64@1+ (1,0) [0|18446744073709551615] "" Vector__XXX

BO_ 2566570240 VDMA_FAC1_Motor_Generator_5_Life: 8 Vector__XXX
 SG_ Motor_Generator_5_Lifetime_Data_ : 0|64@1+ (1,0) [0|18446744073709551615] "" Vector__XXX

BO_ 2566570496 VDMA_FAC2_Motor_Generator_6_Life: 8 Vector__XXX
 SG_ Motor_Generator_6_Lifetime_Data_ : 0|64@1+ (1,0) [0|18446744073709551615] "" Vector__XXX

BO_ 2566570752 VDMA_FAC3_Air_Supply_Pressure_3: 8 Vector__XXX
 SG_ Air_Supply_Pressure_3_RawPayload : 0|64@1+ (1,0) [0|18446744073709551615] "" Vector__XXX

BO_ 2566571008 VDMA_FAC4_EVSE_AC_Supply_Voltage: 8 Vector__XXX
 SG_ EVSE_AC_Supply_Voltage_RawPayloa : 0|64@1+ (1,0) [0|18446744073709551615] "" Vector__XXX

BO_ 2566571264 VDMA_FAC5_EVSE_AC_3_Phase_Load: 8 Vector__XXX
 SG_ EVSE_AC_3_Phase_Load_RawPayload : 0|64@1+ (1,0) [0|18446744073709551615] "" Vector__XXX

BO_ 2566571520 VDMA_FAC6_Electronic_Retarder_Co: 8 Vector__XXX
 SG_ Electronic_Retarder_Controller_3 : 0|64@1+ (1,0) [0|18446744073709551615] "" Vector__XXX

BO_ 2566572032 VDMA_FAC8_Electronic_Transmissio: 8 Vector__XXX
 SG_ Electronic_Transmission_Controll : 0|64@1+ (1,0) [0|18446744073709551615] "" Vector__XXX

BO_ 2566572800 VDMA_FACB_Collision_Avoidance_Sy: 8 Vector__XXX
 SG_ Collision_Avoidance_System_4_Raw : 0|64@1+ (1,0) [0|18446744073709551615] "" Vector__XXX

BO_ 2566573056 VDMA_FACC_Collision_Avoidance_Sy: 8 Vector__XXX
 SG_ Collision_Avoidance_System_3_Raw : 0|64@1+ (1,0) [0|18446744073709551615] "" Vector__XXX

BO_ 2566573312 VDMA_FACD_Aftertreatment_1_SCR_E: 8 Vector__XXX
 SG_ Aftertreatment_1_SCR_Exhaust_Gas : 0|64@1+ (1,0) [0|18446744073709551615] "" Vector__XXX

BO_ 2566573568 VDMA_FACE_PTO_Information_2: 8 Vector__XXX
 SG_ PTO_Information_2_RawPayload : 0|64@1+ (1,0) [0|18446744073709551615] "" Vector__XXX

BO_ 2566573824 VDMA_FACF_EVCC_Diagnostic_Data_1: 8 Vector__XXX
 SG_ EVCC_Diagnostic_Data_1_RawPayloa : 0|64@1+ (1,0) [0|18446744073709551615] "" Vector__XXX

BO_ 2566574080 VDMA_FAD0_Cab_Door_Control_2: 8 Vector__XXX
 SG_ Cab_Door_Control_2_RawPayload : 0|64@1+ (1,0) [0|18446744073709551615] "" Vector__XXX

BO_ 2566574336 VDMA_FAD1_Engine_Average_Informa: 8 Vector__XXX
 SG_ Engine_Average_Information_2_Raw : 0|64@1+ (1,0) [0|18446744073709551615] "" Vector__XXX

BO_ 2566574592 VDMA_FAD2_Turbocharger_Informati: 8 Vector__XXX
 SG_ Turbocharger_Information_9_RawPa : 0|64@1+ (1,0) [0|18446744073709551615] "" Vector__XXX

BO_ 2566574848 VDMA_FAD3_Automated_Driving_Syst: 8 Vector__XXX
 SG_ Automated_Driving_System_Control : 0|64@1+ (1,0) [0|18446744073709551615] "" Vector__XXX

BO_ 2566575104 VDMA_FAD4_EVSE_AC_Status_2: 8 Vector__XXX
 SG_ EVSE_AC_Status_2_RawPayload : 0|64@1+ (1,0) [0|18446744073709551615] "" Vector__XXX

BO_ 2566575360 VDMA_FAD5_EVSE_AC_Status_1: 8 Vector__XXX
 SG_ EVSE_AC_Status_1_RawPayload : 0|64@1+ (1,0) [0|18446744073709551615] "" Vector__XXX

BO_ 2566575616 VDMA_FAD6_EVSE_Status_1: 8 Vector__XXX
 SG_ EVSE_Status_1_RawPayload : 0|64@1+ (1,0) [0|18446744073709551615] "" Vector__XXX

BO_ 2566575872 VDMA_FAD7_Object_Detection_Messa: 8 Vector__XXX
 SG_ Object_Detection_Message_1_1_Raw : 0|64@1+ (1,0) [0|18446744073709551615] "" Vector__XXX

BO_ 2566576128 VDMA_FAD8_Object_Detection_Messa: 8 Vector__XXX
 SG_ Object_Detection_Message_2_1_Raw : 0|64@1+ (1,0) [0|18446744073709551615] "" Vector__XXX

BO_ 2566576384 VDMA_FAD9_Object_Detection_Messa: 8 Vector__XXX
 SG_ Object_Detection_Message_2_2_Raw : 0|64@1+ (1,0) [0|18446744073709551615] "" Vector__XXX

BO_ 2566576640 VDMA_FADA_Object_Detection_Messa: 8 Vector__XXX
 SG_ Object_Detection_Message_2_3_Raw : 0|64@1+ (1,0) [0|18446744073709551615] "" Vector__XXX

BO_ 2566576896 VDMA_FADB_Object_Detection_Messa: 8 Vector__XXX
 SG_ Object_Detection_Message_2_4_Raw : 0|64@1+ (1,0) [0|18446744073709551615] "" Vector__XXX

BO_ 2566577152 VDMA_FADC_Object_Detection_Messa: 8 Vector__XXX
 SG_ Object_Detection_Message_2_5_Raw : 0|64@1+ (1,0) [0|18446744073709551615] "" Vector__XXX

BO_ 2566577408 VDMA_FADD_Object_Detection_Messa: 8 Vector__XXX
 SG_ Object_Detection_Message_2_6_Raw : 0|64@1+ (1,0) [0|18446744073709551615] "" Vector__XXX

BO_ 2566577664 VDMA_FADE_Object_Detection_Messa: 8 Vector__XXX
 SG_ Object_Detection_Message_2_7_Raw : 0|64@1+ (1,0) [0|18446744073709551615] "" Vector__XXX

BO_ 2566577920 VDMA_FADF_Object_Detection_Messa: 8 Vector__XXX
 SG_ Object_Detection_Message_2_8_Raw : 0|64@1+ (1,0) [0|18446744073709551615] "" Vector__XXX

BO_ 2566578176 VDMA_FAE0_Object_Detection_Messa: 8 Vector__XXX
 SG_ Object_Detection_Message_2_9_Raw : 0|64@1+ (1,0) [0|18446744073709551615] "" Vector__XXX

BO_ 2566578432 VDMA_FAE1_Object_Detection_Messa: 8 Vector__XXX
 SG_ Object_Detection_Message_2_10_Ra : 0|64@1+ (1,0) [0|18446744073709551615] "" Vector__XXX

BO_ 2566578688 VDMA_FAE2_Object_Detection_Messa: 8 Vector__XXX
 SG_ Object_Detection_Message_2_11_Ra : 0|64@1+ (1,0) [0|18446744073709551615] "" Vector__XXX

BO_ 2566578944 VDMA_FAE3_Object_Detection_Messa: 8 Vector__XXX
 SG_ Object_Detection_Message_2_12_Ra : 0|64@1+ (1,0) [0|18446744073709551615] "" Vector__XXX

BO_ 2566579200 VDMA_FAE4_Object_Detection_Messa: 8 Vector__XXX
 SG_ Object_Detection_Message_2_13_Ra : 0|64@1+ (1,0) [0|18446744073709551615] "" Vector__XXX

BO_ 2566579456 VDMA_FAE5_Object_Detection_Messa: 8 Vector__XXX
 SG_ Object_Detection_Message_2_14_Ra : 0|64@1+ (1,0) [0|18446744073709551615] "" Vector__XXX

BO_ 2566579712 VDMA_FAE6_Object_Detection_Messa: 8 Vector__XXX
 SG_ Object_Detection_Message_2_15_Ra : 0|64@1+ (1,0) [0|18446744073709551615] "" Vector__XXX

BO_ 2566579968 VDMA_FAE7_Object_Detection_Messa: 8 Vector__XXX
 SG_ Object_Detection_Message_2_16_Ra : 0|64@1+ (1,0) [0|18446744073709551615] "" Vector__XXX

BO_ 2566580224 VDMA_FAE8_Object_Detection_Messa: 8 Vector__XXX
 SG_ Object_Detection_Message_2_17_Ra : 0|64@1+ (1,0) [0|18446744073709551615] "" Vector__XXX

BO_ 2566580480 VDMA_FAE9_Object_Detection_Messa: 8 Vector__XXX
 SG_ Object_Detection_Message_2_18_Ra : 0|64@1+ (1,0) [0|18446744073709551615] "" Vector__XXX

BO_ 2566580736 VDMA_FAEA_Object_Detection_Messa: 8 Vector__XXX
 SG_ Object_Detection_Message_2_19_Ra : 0|64@1+ (1,0) [0|18446744073709551615] "" Vector__XXX

BO_ 2566580992 VDMA_FAEB_Object_Detection_Messa: 8 Vector__XXX
 SG_ Object_Detection_Message_2_20_Ra : 0|64@1+ (1,0) [0|18446744073709551615] "" Vector__XXX

BO_ 2566581248 VDMA_FAEC_Object_Detection_Messa: 8 Vector__XXX
 SG_ Object_Detection_Message_2_21_Ra : 0|64@1+ (1,0) [0|18446744073709551615] "" Vector__XXX

BO_ 2566581504 VDMA_FAED_Temperature_Sensing_Mo: 8 Vector__XXX
 SG_ Temperature_Sensing_Module_1_Raw : 0|64@1+ (1,0) [0|18446744073709551615] "" Vector__XXX

BO_ 2566581760 VDMA_FAEE_Temperature_Sensing_Mo: 8 Vector__XXX
 SG_ Temperature_Sensing_Module_2_Raw : 0|64@1+ (1,0) [0|18446744073709551615] "" Vector__XXX

BO_ 2566582016 VDMA_FAEF_Aftertreatment_2_SCR_S: 8 Vector__XXX
 SG_ Aftertreatment_2_SCR_Service_Inf : 0|64@1+ (1,0) [0|18446744073709551615] "" Vector__XXX

BO_ 2566582272 VDMA_FAF0_Aftertreatment_1_SCR_S: 8 Vector__XXX
 SG_ Aftertreatment_1_SCR_Service_Inf : 0|64@1+ (1,0) [0|18446744073709551615] "" Vector__XXX

BO_ 2566582528 VDMA_FAF1_PSA_Times_Lifetime_Hou: 8 Vector__XXX
 SG_ PSA_Times_Lifetime_Hours_RawPayl : 0|64@1+ (1,0) [0|18446744073709551615] "" Vector__XXX

BO_ 2566582784 VDMA_FAF2_PSA_Times_Stored_100_H: 8 Vector__XXX
 SG_ PSA_Times_Stored_100_Hours_RawPa : 0|64@1+ (1,0) [0|18446744073709551615] "" Vector__XXX

BO_ 2566583040 VDMA_FAF3_PSA_Times_Active_100_H: 8 Vector__XXX
 SG_ PSA_Times_Active_100_Hours_RawPa : 0|64@1+ (1,0) [0|18446744073709551615] "" Vector__XXX

BO_ 2566583296 VDMA_FAF4_Hybrid_Charge_Depletin: 8 Vector__XXX
 SG_ Hybrid_Charge_Depleting_or_Incre : 0|64@1+ (1,0) [0|18446744073709551615] "" Vector__XXX

BO_ 2566583552 VDMA_FAF5_Hybrid_Charge_Depletin: 8 Vector__XXX
 SG_ Hybrid_Charge_Depleting_or_Incre : 0|64@1+ (1,0) [0|18446744073709551615] "" Vector__XXX

BO_ 2566583808 VDMA_FAF6_Hybrid_Charge_Depletin: 8 Vector__XXX
 SG_ Hybrid_Charge_Depleting_or_Incre : 0|64@1+ (1,0) [0|18446744073709551615] "" Vector__XXX

BO_ 2566584064 VDMA_FAF7_Aftertreatment_1_Histo: 8 Vector__XXX
 SG_ Aftertreatment_1_Historical_Info : 0|64@1+ (1,0) [0|18446744073709551615] "" Vector__XXX

BO_ 2566584320 VDMA_FAF8_Engine_Maximum_Net_Tor: 8 Vector__XXX
 SG_ Engine_Maximum_Net_Torque_Map_Ra : 0|64@1+ (1,0) [0|18446744073709551615] "" Vector__XXX

BO_ 2566584576 VDMA_FAF9_Aftertreatment_1_SCR_2: 8 Vector__XXX
 SG_ Aftertreatment_1_SCR_2_NOx_Mass_ : 0|64@1+ (1,0) [0|18446744073709551615] "" Vector__XXX

BO_ 2566584832 VDMA_FAFA_Aftertreatment_1_SCR_1: 8 Vector__XXX
 SG_ Aftertreatment_1_SCR_1_NOx_Mass_ : 0|64@1+ (1,0) [0|18446744073709551615] "" Vector__XXX

BO_ 2566585088 VDMA_FAFB_Evaporative_System_Pre: 8 Vector__XXX
 SG_ Evaporative_System_Pressure_and_ : 0|64@1+ (1,0) [0|18446744073709551615] "" Vector__XXX

BO_ 2566585344 VDMA_FAFC_GHG_Tracking_Lifetime_: 8 Vector__XXX
 SG_ GHG_Tracking_Lifetime_Array_Data : 0|64@1+ (1,0) [0|18446744073709551615] "" Vector__XXX

BO_ 2566585600 VDMA_FAFD_GHG_Tracking_Stored_10: 8 Vector__XXX
 SG_ GHG_Tracking_Stored_100_Hour_Arr : 0|64@1+ (1,0) [0|18446744073709551615] "" Vector__XXX

BO_ 2566585856 VDMA_FAFE_GHG_Tracking_Active_10: 8 Vector__XXX
 SG_ GHG_Tracking_Active_100_Hour_Arr : 0|64@1+ (1,0) [0|18446744073709551615] "" Vector__XXX

BO_ 2566586112 VDMA_FAFF_Green_House_Gas_Stored: 8 Vector__XXX
 SG_ Green_House_Gas_Stored_100_Hour_ : 0|64@1+ (1,0) [0|18446744073709551615] "" Vector__XXX

BO_ 2566586368 VDMA_FB00_Green_House_Gas_Active: 8 Vector__XXX
 SG_ Green_House_Gas_Active_100_Hour_ : 0|64@1+ (1,0) [0|18446744073709551615] "" Vector__XXX

BO_ 2566586624 VDMA_FB01_Green_House_Gas_Lifeti: 8 Vector__XXX
 SG_ Green_House_Gas_Lifetime_Active_ : 0|64@1+ (1,0) [0|18446744073709551615] "" Vector__XXX

BO_ 2566586880 VDMA_FB02_NOx_Tracking_Engine_Ac: 8 Vector__XXX
 SG_ NOx_Tracking_Engine_Activity_Lif : 0|64@1+ (1,0) [0|18446744073709551615] "" Vector__XXX

BO_ 2566587136 VDMA_FB03_NOx_Tracking_Engine_Ac: 8 Vector__XXX
 SG_ NOx_Tracking_Engine_Activity_Lif : 0|64@1+ (1,0) [0|18446744073709551615] "" Vector__XXX

BO_ 2566587392 VDMA_FB04_NOx_Tracking_Engine_Ac: 8 Vector__XXX
 SG_ NOx_Tracking_Engine_Activity_Lif : 0|64@1+ (1,0) [0|18446744073709551615] "" Vector__XXX

BO_ 2566587648 VDMA_FB05_NOx_Tracking_Engine_Ac: 8 Vector__XXX
 SG_ NOx_Tracking_Engine_Activity_Lif : 0|64@1+ (1,0) [0|18446744073709551615] "" Vector__XXX

BO_ 2566587904 VDMA_FB06_NOx_Tracking_Valid_NOx: 8 Vector__XXX
 SG_ NOx_Tracking_Valid_NOx_Lifetime_ : 0|64@1+ (1,0) [0|18446744073709551615] "" Vector__XXX

BO_ 2566588160 VDMA_FB07_NOx_Tracking_Valid_NOx: 8 Vector__XXX
 SG_ NOx_Tracking_Valid_NOx_Lifetime_ : 0|64@1+ (1,0) [0|18446744073709551615] "" Vector__XXX

BO_ 2566588416 VDMA_FB08_NOx_Tracking_Valid_NOx: 8 Vector__XXX
 SG_ NOx_Tracking_Valid_NOx_Lifetime_ : 0|64@1+ (1,0) [0|18446744073709551615] "" Vector__XXX

BO_ 2566588672 VDMA_FB09_NOx_Tracking_Valid_NOx: 8 Vector__XXX
 SG_ NOx_Tracking_Valid_NOx_Lifetime_ : 0|64@1+ (1,0) [0|18446744073709551615] "" Vector__XXX

BO_ 2566588928 VDMA_FB0A_NOx_Tracking_Valid_NOx: 8 Vector__XXX
 SG_ NOx_Tracking_Valid_NOx_Lifetime_ : 0|64@1+ (1,0) [0|18446744073709551615] "" Vector__XXX

BO_ 2566589184 VDMA_FB0B_NOx_Tracking_Valid_NOx: 8 Vector__XXX
 SG_ NOx_Tracking_Valid_NOx_Lifetime_ : 0|64@1+ (1,0) [0|18446744073709551615] "" Vector__XXX

BO_ 2566589440 VDMA_FB0C_NOx_Tracking_Stored_10: 8 Vector__XXX
 SG_ NOx_Tracking_Stored_100_Hour_Fue : 0|64@1+ (1,0) [0|18446744073709551615] "" Vector__XXX

BO_ 2566589696 VDMA_FB0D_NOx_Tracking_Stored_10: 8 Vector__XXX
 SG_ NOx_Tracking_Stored_100_Hour_Eng : 0|64@1+ (1,0) [0|18446744073709551615] "" Vector__XXX

BO_ 2566589952 VDMA_FB0E_NOx_Tracking_Stored_10: 8 Vector__XXX
 SG_ NOx_Tracking_Stored_100_Hour_Veh : 0|64@1+ (1,0) [0|18446744073709551615] "" Vector__XXX

BO_ 2566590208 VDMA_FB0F_NOx_Tracking_Stored_10: 8 Vector__XXX
 SG_ NOx_Tracking_Stored_100_Hour_Eng : 0|64@1+ (1,0) [0|18446744073709551615] "" Vector__XXX

BO_ 2566590464 VDMA_FB10_NOx_Tracking_Stored_10: 8 Vector__XXX
 SG_ NOx_Tracking_Stored_100_Hour_Eng : 0|64@1+ (1,0) [0|18446744073709551615] "" Vector__XXX

BO_ 2566590720 VDMA_FB11_NOx_Tracking_Stored_10: 8 Vector__XXX
 SG_ NOx_Tracking_Stored_100_Hour_Sys : 0|64@1+ (1,0) [0|18446744073709551615] "" Vector__XXX

BO_ 2566590976 VDMA_FB12_NOx_Tracking_Active_10: 8 Vector__XXX
 SG_ NOx_Tracking_Active_100_Hour_Fue : 0|64@1+ (1,0) [0|18446744073709551615] "" Vector__XXX

BO_ 2566591232 VDMA_FB13_NOx_Tracking_Active_10: 8 Vector__XXX
 SG_ NOx_Tracking_Active_100_Hour_Eng : 0|64@1+ (1,0) [0|18446744073709551615] "" Vector__XXX

BO_ 2566591488 VDMA_FB14_NOx_Tracking_Active_10: 8 Vector__XXX
 SG_ NOx_Tracking_Active_100_Hour_Veh : 0|64@1+ (1,0) [0|18446744073709551615] "" Vector__XXX

BO_ 2566591744 VDMA_FB15_NOx_Tracking_Active_10: 8 Vector__XXX
 SG_ NOx_Tracking_Active_100_Hour_Eng : 0|64@1+ (1,0) [0|18446744073709551615] "" Vector__XXX

BO_ 2566592000 VDMA_FB16_NOx_Tracking_Active_10: 8 Vector__XXX
 SG_ NOx_Tracking_Active_100_Hour_Eng : 0|64@1+ (1,0) [0|18446744073709551615] "" Vector__XXX

BO_ 2566592256 VDMA_FB17_NOx_Tracking_Active_10: 8 Vector__XXX
 SG_ NOx_Tracking_Active_100_Hour_Sys : 0|64@1+ (1,0) [0|18446744073709551615] "" Vector__XXX

BO_ 2566592512 VDMA_FB18_Motor_Generator_6_Inve: 8 Vector__XXX
 SG_ Motor_Generator_6_Inverter_Contr : 0|64@1+ (1,0) [0|18446744073709551615] "" Vector__XXX

BO_ 2566592768 VDMA_FB19_Motor_Generator_6_Inve: 8 Vector__XXX
 SG_ Motor_Generator_6_Inverter_Limit : 0|64@1+ (1,0) [0|18446744073709551615] "" Vector__XXX

BO_ 2566593024 VDMA_FB1A_Motor_Generator_6_Inve: 8 Vector__XXX
 SG_ Motor_Generator_6_Inverter_Limit : 0|64@1+ (1,0) [0|18446744073709551615] "" Vector__XXX

BO_ 2566593280 VDMA_FB1B_Motor_Generator_6_Inve: 8 Vector__XXX
 SG_ Motor_Generator_6_Inverter_Limit : 0|64@1+ (1,0) [0|18446744073709551615] "" Vector__XXX

BO_ 2566593536 VDMA_FB1C_Motor_Generator_6_Inve: 8 Vector__XXX
 SG_ Motor_Generator_6_Inverter_Isola : 0|64@1+ (1,0) [0|18446744073709551615] "" Vector__XXX

BO_ 2566593792 VDMA_FB1D_Motor_Generator_5_Inve: 8 Vector__XXX
 SG_ Motor_Generator_5_Inverter_Contr : 0|64@1+ (1,0) [0|18446744073709551615] "" Vector__XXX

BO_ 2566594048 VDMA_FB1E_Motor_Generator_5_Inve: 8 Vector__XXX
 SG_ Motor_Generator_5_Inverter_Limit : 0|64@1+ (1,0) [0|18446744073709551615] "" Vector__XXX

BO_ 2566594304 VDMA_FB1F_Motor_Generator_5_Inve: 8 Vector__XXX
 SG_ Motor_Generator_5_Inverter_Limit : 0|64@1+ (1,0) [0|18446744073709551615] "" Vector__XXX

BO_ 2566594560 VDMA_FB20_Motor_Generator_5_Inve: 8 Vector__XXX
 SG_ Motor_Generator_5_Inverter_Limit : 0|64@1+ (1,0) [0|18446744073709551615] "" Vector__XXX

BO_ 2566594816 VDMA_FB21_Motor_Generator_5_Inve: 8 Vector__XXX
 SG_ Motor_Generator_5_Inverter_Isola : 0|64@1+ (1,0) [0|18446744073709551615] "" Vector__XXX

BO_ 2566595072 VDMA_FB22_Motor_Generator_4_Inve: 8 Vector__XXX
 SG_ Motor_Generator_4_Inverter_Contr : 0|64@1+ (1,0) [0|18446744073709551615] "" Vector__XXX

BO_ 2566595328 VDMA_FB23_Motor_Generator_4_Inve: 8 Vector__XXX
 SG_ Motor_Generator_4_Inverter_Limit : 0|64@1+ (1,0) [0|18446744073709551615] "" Vector__XXX

BO_ 2566595584 VDMA_FB24_Motor_Generator_4_Inve: 8 Vector__XXX
 SG_ Motor_Generator_4_Inverter_Limit : 0|64@1+ (1,0) [0|18446744073709551615] "" Vector__XXX

BO_ 2566595840 VDMA_FB25_Motor_Generator_4_Inve: 8 Vector__XXX
 SG_ Motor_Generator_4_Inverter_Limit : 0|64@1+ (1,0) [0|18446744073709551615] "" Vector__XXX

BO_ 2566596096 VDMA_FB26_Motor_Generator_4_Inve: 8 Vector__XXX
 SG_ Motor_Generator_4_Inverter_Isola : 0|64@1+ (1,0) [0|18446744073709551615] "" Vector__XXX

BO_ 2566596352 VDMA_FB27_Motor_Generator_3_Inve: 8 Vector__XXX
 SG_ Motor_Generator_3_Inverter_Contr : 0|64@1+ (1,0) [0|18446744073709551615] "" Vector__XXX

BO_ 2566596608 VDMA_FB28_Motor_Generator_3_Inve: 8 Vector__XXX
 SG_ Motor_Generator_3_Inverter_Limit : 0|64@1+ (1,0) [0|18446744073709551615] "" Vector__XXX

BO_ 2566596864 VDMA_FB29_Motor_Generator_3_Inve: 8 Vector__XXX
 SG_ Motor_Generator_3_Inverter_Limit : 0|64@1+ (1,0) [0|18446744073709551615] "" Vector__XXX

BO_ 2566597120 VDMA_FB2A_Motor_Generator_3_Inve: 8 Vector__XXX
 SG_ Motor_Generator_3_Inverter_Limit : 0|64@1+ (1,0) [0|18446744073709551615] "" Vector__XXX

BO_ 2566597376 VDMA_FB2B_Motor_Generator_3_Inve: 8 Vector__XXX
 SG_ Motor_Generator_3_Inverter_Isola : 0|64@1+ (1,0) [0|18446744073709551615] "" Vector__XXX

BO_ 2566597632 VDMA_FB2C_Diagnostic_Readiness_4: 8 Vector__XXX
 SG_ Diagnostic_Readiness_4_RawPayloa : 0|64@1+ (1,0) [0|18446744073709551615] "" Vector__XXX

BO_ 2566597888 VDMA_FB2D_Turbocharger_Informati: 8 Vector__XXX
 SG_ Turbocharger_Information_8_RawPa : 0|64@1+ (1,0) [0|18446744073709551615] "" Vector__XXX

BO_ 2566598144 VDMA_FB2E_Winch_Information_2: 8 Vector__XXX
 SG_ Winch_Information_2_RawPayload : 0|64@1+ (1,0) [0|18446744073709551615] "" Vector__XXX

BO_ 2566598400 VDMA_FB2F_Motor_Generator_6_Inve: 8 Vector__XXX
 SG_ Motor_Generator_6_Inverter_Refer : 0|64@1+ (1,0) [0|18446744073709551615] "" Vector__XXX

BO_ 2566598656 VDMA_FB30_Motor_Generator_6_Inve: 8 Vector__XXX
 SG_ Motor_Generator_6_Inverter_Statu : 0|64@1+ (1,0) [0|18446744073709551615] "" Vector__XXX

BO_ 2566598912 VDMA_FB31_Motor_Generator_6_Inve: 8 Vector__XXX
 SG_ Motor_Generator_6_Inverter_Refer : 0|64@1+ (1,0) [0|18446744073709551615] "" Vector__XXX

BO_ 2566599168 VDMA_FB32_Motor_Generator_6_Inve: 8 Vector__XXX
 SG_ Motor_Generator_6_Inverter_Tempe : 0|64@1+ (1,0) [0|18446744073709551615] "" Vector__XXX

BO_ 2566599424 VDMA_FB33_Motor_Generator_6_Inve: 8 Vector__XXX
 SG_ Motor_Generator_6_Inverter_Motor : 0|64@1+ (1,0) [0|18446744073709551615] "" Vector__XXX

BO_ 2566599680 VDMA_FB34_Motor_Generator_6_Inve: 8 Vector__XXX
 SG_ Motor_Generator_6_Inverter_Isola : 0|64@1+ (1,0) [0|18446744073709551615] "" Vector__XXX

BO_ 2566599936 VDMA_FB35_Motor_Generator_6_Inve: 8 Vector__XXX
 SG_ Motor_Generator_6_Inverter_Activ : 0|64@1+ (1,0) [0|18446744073709551615] "" Vector__XXX

BO_ 2566600192 VDMA_FB36_Motor_Generator_5_Inve: 8 Vector__XXX
 SG_ Motor_Generator_5_Inverter_Refer : 0|64@1+ (1,0) [0|18446744073709551615] "" Vector__XXX

BO_ 2566600448 VDMA_FB37_Motor_Generator_5_Inve: 8 Vector__XXX
 SG_ Motor_Generator_5_Inverter_Statu : 0|64@1+ (1,0) [0|18446744073709551615] "" Vector__XXX

BO_ 2566600704 VDMA_FB38_Motor_Generator_5_Inve: 8 Vector__XXX
 SG_ Motor_Generator_5_Inverter_Refer : 0|64@1+ (1,0) [0|18446744073709551615] "" Vector__XXX

BO_ 2566600960 VDMA_FB39_Motor_Generator_5_Inve: 8 Vector__XXX
 SG_ Motor_Generator_5_Inverter_Tempe : 0|64@1+ (1,0) [0|18446744073709551615] "" Vector__XXX

BO_ 2566601216 VDMA_FB3A_Motor_Generator_5_Inve: 8 Vector__XXX
 SG_ Motor_Generator_5_Inverter_Motor : 0|64@1+ (1,0) [0|18446744073709551615] "" Vector__XXX

CM_ BO_ 2566516992  "Source: isobus.net VDMA Data Dictionary (https://www.isobus.net/isobus/pGNAndSPN/9125?type=PGN)";
CM_ BO_ 2566517248  "Source: isobus.net VDMA Data Dictionary (https://www.isobus.net/isobus/pGNAndSPN/9129?type=PGN)";
CM_ BO_ 2566517504  "Source: isobus.net VDMA Data Dictionary (https://www.isobus.net/isobus/pGNAndSPN/9137?type=PGN)";
CM_ BO_ 2566517760  "Source: isobus.net VDMA Data Dictionary (https://www.isobus.net/isobus/pGNAndSPN/9145?type=PGN)";
CM_ BO_ 2566518016  "Source: isobus.net VDMA Data Dictionary (https://www.isobus.net/isobus/pGNAndSPN/9153?type=PGN)";
CM_ BO_ 2566518272  "Source: isobus.net VDMA Data Dictionary (https://www.isobus.net/isobus/pGNAndSPN/9160?type=PGN)";
CM_ BO_ 2566518528  "Source: isobus.net VDMA Data Dictionary (https://www.isobus.net/isobus/pGNAndSPN/9168?type=PGN)";
CM_ BO_ 2566518784  "Source: isobus.net VDMA Data Dictionary (https://www.isobus.net/isobus/pGNAndSPN/9175?type=PGN)";
CM_ BO_ 2566519040  "Source: isobus.net VDMA Data Dictionary (https://www.isobus.net/isobus/pGNAndSPN/9183?type=PGN)";
CM_ BO_ 2566519296  "Source: isobus.net VDMA Data Dictionary (https://www.isobus.net/isobus/pGNAndSPN/9190?type=PGN)";
CM_ BO_ 2566519552  "Source: isobus.net VDMA Data Dictionary (https://www.isobus.net/isobus/pGNAndSPN/9198?type=PGN)";
CM_ BO_ 2566519808  "Source: isobus.net VDMA Data Dictionary (https://www.isobus.net/isobus/pGNAndSPN/9205?type=PGN)";
CM_ BO_ 2566520064  "Source: isobus.net VDMA Data Dictionary (https://www.isobus.net/isobus/pGNAndSPN/9213?type=PGN)";
CM_ BO_ 2566520320  "Source: isobus.net VDMA Data Dictionary (https://www.isobus.net/isobus/pGNAndSPN/9222?type=PGN)";
CM_ BO_ 2566520576  "Source: isobus.net VDMA Data Dictionary (https://www.isobus.net/isobus/pGNAndSPN/9227?type=PGN)";
CM_ BO_ 2566520832  "Source: isobus.net VDMA Data Dictionary (https://www.isobus.net/isobus/pGNAndSPN/9231?type=PGN)";
CM_ BO_ 2566521088  "Source: isobus.net VDMA Data Dictionary (https://www.isobus.net/isobus/pGNAndSPN/9236?type=PGN)";
CM_ BO_ 2566522368  "Source: isobus.net VDMA Data Dictionary (https://www.isobus.net/isobus/pGNAndSPN/9238?type=PGN)";
CM_ BO_ 2566522624  "Source: isobus.net VDMA Data Dictionary (https://www.isobus.net/isobus/pGNAndSPN/9241?type=PGN)";
CM_ BO_ 2566522880  "Source: isobus.net VDMA Data Dictionary (https://www.isobus.net/isobus/pGNAndSPN/9245?type=PGN)";
CM_ BO_ 2566523136  "Source: isobus.net VDMA Data Dictionary (https://www.isobus.net/isobus/pGNAndSPN/9246?type=PGN)";
CM_ BO_ 2566523392  "Source: isobus.net VDMA Data Dictionary (https://www.isobus.net/isobus/pGNAndSPN/9248?type=PGN)";
CM_ BO_ 2566523648  "Source: isobus.net VDMA Data Dictionary (https://www.isobus.net/isobus/pGNAndSPN/9250?type=PGN)";
CM_ BO_ 2566523904  "Source: isobus.net VDMA Data Dictionary (https://www.isobus.net/isobus/pGNAndSPN/9252?type=PGN)";
CM_ BO_ 2566524160  "Source: isobus.net VDMA Data Dictionary (https://www.isobus.net/isobus/pGNAndSPN/9254?type=PGN)";
CM_ BO_ 2566524416  "Source: isobus.net VDMA Data Dictionary (https://www.isobus.net/isobus/pGNAndSPN/9256?type=PGN)";
CM_ BO_ 2566524672  "Source: isobus.net VDMA Data Dictionary (https://www.isobus.net/isobus/pGNAndSPN/9258?type=PGN)";
CM_ BO_ 2566524928  "Source: isobus.net VDMA Data Dictionary (https://www.isobus.net/isobus/pGNAndSPN/9266?type=PGN)";
CM_ BO_ 2566525184  "Source: isobus.net VDMA Data Dictionary (https://www.isobus.net/isobus/pGNAndSPN/9268?type=PGN)";
CM_ BO_ 2566525440  "Source: isobus.net VDMA Data Dictionary (https://www.isobus.net/isobus/pGNAndSPN/9276?type=PGN)";
CM_ BO_ 2566525696  "Source: isobus.net VDMA Data Dictionary (https://www.isobus.net/isobus/pGNAndSPN/9286?type=PGN)";
CM_ BO_ 2566525952  "Source: isobus.net VDMA Data Dictionary (https://www.isobus.net/isobus/pGNAndSPN/9296?type=PGN)";
CM_ BO_ 2566526208  "Source: isobus.net VDMA Data Dictionary (https://www.isobus.net/isobus/pGNAndSPN/9300?type=PGN)";
CM_ BO_ 2566526464  "Source: isobus.net VDMA Data Dictionary (https://www.isobus.net/isobus/pGNAndSPN/9304?type=PGN)";
CM_ BO_ 2566526720  "Source: isobus.net VDMA Data Dictionary (https://www.isobus.net/isobus/pGNAndSPN/9308?type=PGN)";
CM_ BO_ 2566526976  "Source: isobus.net VDMA Data Dictionary (https://www.isobus.net/isobus/pGNAndSPN/9312?type=PGN)";
CM_ BO_ 2566527232  "Source: isobus.net VDMA Data Dictionary (https://www.isobus.net/isobus/pGNAndSPN/9316?type=PGN)";
CM_ BO_ 2566527488  "Source: isobus.net VDMA Data Dictionary (https://www.isobus.net/isobus/pGNAndSPN/9318?type=PGN)";
CM_ BO_ 2566527744  "Source: isobus.net VDMA Data Dictionary (https://www.isobus.net/isobus/pGNAndSPN/9324?type=PGN)";
CM_ BO_ 2566528000  "Source: isobus.net VDMA Data Dictionary (https://www.isobus.net/isobus/pGNAndSPN/9330?type=PGN)";
CM_ BO_ 2566528256  "Source: isobus.net VDMA Data Dictionary (https://www.isobus.net/isobus/pGNAndSPN/9357?type=PGN)";
CM_ BO_ 2566528512  "Source: isobus.net VDMA Data Dictionary (https://www.isobus.net/isobus/pGNAndSPN/9384?type=PGN)";
CM_ BO_ 2566528768  "Source: isobus.net VDMA Data Dictionary (https://www.isobus.net/isobus/pGNAndSPN/9385?type=PGN)";
CM_ BO_ 2566529024  "Source: isobus.net VDMA Data Dictionary (https://www.isobus.net/isobus/pGNAndSPN/9390?type=PGN)";
CM_ BO_ 2566529280  "Source: isobus.net VDMA Data Dictionary (https://www.isobus.net/isobus/pGNAndSPN/9396?type=PGN)";
CM_ BO_ 2566529536  "Source: isobus.net VDMA Data Dictionary (https://www.isobus.net/isobus/pGNAndSPN/9403?type=PGN)";
CM_ BO_ 2566529792  "Source: isobus.net VDMA Data Dictionary (https://www.isobus.net/isobus/pGNAndSPN/9410?type=PGN)";
CM_ BO_ 2566530048  "Source: isobus.net VDMA Data Dictionary (https://www.isobus.net/isobus/pGNAndSPN/9417?type=PGN)";
CM_ BO_ 2566530304  "Source: isobus.net VDMA Data Dictionary (https://www.isobus.net/isobus/pGNAndSPN/9421?type=PGN)";
CM_ BO_ 2566530560  "Source: isobus.net VDMA Data Dictionary (https://www.isobus.net/isobus/pGNAndSPN/9425?type=PGN)";
CM_ BO_ 2566530816  "Source: isobus.net VDMA Data Dictionary (https://www.isobus.net/isobus/pGNAndSPN/9441?type=PGN)";
CM_ BO_ 2566531072  "Source: isobus.net VDMA Data Dictionary (https://www.isobus.net/isobus/pGNAndSPN/9457?type=PGN)";
CM_ BO_ 2566531328  "Source: isobus.net VDMA Data Dictionary (https://www.isobus.net/isobus/pGNAndSPN/9473?type=PGN)";
CM_ BO_ 2566531584  "Source: isobus.net VDMA Data Dictionary (https://www.isobus.net/isobus/pGNAndSPN/9489?type=PGN)";
CM_ BO_ 2566531840  "Source: isobus.net VDMA Data Dictionary (https://www.isobus.net/isobus/pGNAndSPN/9505?type=PGN)";
CM_ BO_ 2566532096  "Source: isobus.net VDMA Data Dictionary (https://www.isobus.net/isobus/pGNAndSPN/9521?type=PGN)";
CM_ BO_ 2566532352  "Source: isobus.net VDMA Data Dictionary (https://www.isobus.net/isobus/pGNAndSPN/9537?type=PGN)";
CM_ BO_ 2566532608  "Source: isobus.net VDMA Data Dictionary (https://www.isobus.net/isobus/pGNAndSPN/9553?type=PGN)";
CM_ BO_ 2566532864  "Source: isobus.net VDMA Data Dictionary (https://www.isobus.net/isobus/pGNAndSPN/9569?type=PGN)";
CM_ BO_ 2566533120  "Source: isobus.net VDMA Data Dictionary (https://www.isobus.net/isobus/pGNAndSPN/9585?type=PGN)";
CM_ BO_ 2566533376  "Source: isobus.net VDMA Data Dictionary (https://www.isobus.net/isobus/pGNAndSPN/9601?type=PGN)";
CM_ BO_ 2566533632  "Source: isobus.net VDMA Data Dictionary (https://www.isobus.net/isobus/pGNAndSPN/9617?type=PGN)";
CM_ BO_ 2566533888  "Source: isobus.net VDMA Data Dictionary (https://www.isobus.net/isobus/pGNAndSPN/9631?type=PGN)";
CM_ BO_ 2566534144  "Source: isobus.net VDMA Data Dictionary (https://www.isobus.net/isobus/pGNAndSPN/9647?type=PGN)";
CM_ BO_ 2566534400  "Source: isobus.net VDMA Data Dictionary (https://www.isobus.net/isobus/pGNAndSPN/9652?type=PGN)";
CM_ BO_ 2566534656  "Source: isobus.net VDMA Data Dictionary (https://www.isobus.net/isobus/pGNAndSPN/9656?type=PGN)";
CM_ BO_ 2566534912  "Source: isobus.net VDMA Data Dictionary (https://www.isobus.net/isobus/pGNAndSPN/9663?type=PGN)";
CM_ BO_ 2566535168  "Source: isobus.net VDMA Data Dictionary (https://www.isobus.net/isobus/pGNAndSPN/9671?type=PGN)";
CM_ BO_ 2566535424  "Source: isobus.net VDMA Data Dictionary (https://www.isobus.net/isobus/pGNAndSPN/9678?type=PGN)";
CM_ BO_ 2566535680  "Source: isobus.net VDMA Data Dictionary (https://www.isobus.net/isobus/pGNAndSPN/9686?type=PGN)";
CM_ BO_ 2566535936  "Source: isobus.net VDMA Data Dictionary (https://www.isobus.net/isobus/pGNAndSPN/9689?type=PGN)";
CM_ BO_ 2566536192  "Source: isobus.net VDMA Data Dictionary (https://www.isobus.net/isobus/pGNAndSPN/9693?type=PGN)";
CM_ BO_ 2566536448  "Source: isobus.net VDMA Data Dictionary (https://www.isobus.net/isobus/pGNAndSPN/9698?type=PGN)";
CM_ BO_ 2566536704  "Source: isobus.net VDMA Data Dictionary (https://www.isobus.net/isobus/pGNAndSPN/9699?type=PGN)";
CM_ BO_ 2566536960  "Source: isobus.net VDMA Data Dictionary (https://www.isobus.net/isobus/pGNAndSPN/9701?type=PGN)";
CM_ BO_ 2566537216  "Source: isobus.net VDMA Data Dictionary (https://www.isobus.net/isobus/pGNAndSPN/9706?type=PGN)";
CM_ BO_ 2566537472  "Source: isobus.net VDMA Data Dictionary (https://www.isobus.net/isobus/pGNAndSPN/9714?type=PGN)";
CM_ BO_ 2566537728  "Source: isobus.net VDMA Data Dictionary (https://www.isobus.net/isobus/pGNAndSPN/9722?type=PGN)";
CM_ BO_ 2566537984  "Source: isobus.net VDMA Data Dictionary (https://www.isobus.net/isobus/pGNAndSPN/9723?type=PGN)";
CM_ BO_ 2566538240  "Source: isobus.net VDMA Data Dictionary (https://www.isobus.net/isobus/pGNAndSPN/9725?type=PGN)";
CM_ BO_ 2566538496  "Source: isobus.net VDMA Data Dictionary (https://www.isobus.net/isobus/pGNAndSPN/9726?type=PGN)";
CM_ BO_ 2566538752  "Source: isobus.net VDMA Data Dictionary (https://www.isobus.net/isobus/pGNAndSPN/9731?type=PGN)";
CM_ BO_ 2566539008  "Source: isobus.net VDMA Data Dictionary (https://www.isobus.net/isobus/pGNAndSPN/9733?type=PGN)";
CM_ BO_ 2566539264  "Source: isobus.net VDMA Data Dictionary (https://www.isobus.net/isobus/pGNAndSPN/9740?type=PGN)";
CM_ BO_ 2566539520  "Source: isobus.net VDMA Data Dictionary (https://www.isobus.net/isobus/pGNAndSPN/9742?type=PGN)";
CM_ BO_ 2566539776  "Source: isobus.net VDMA Data Dictionary (https://www.isobus.net/isobus/pGNAndSPN/9743?type=PGN)";
CM_ BO_ 2566540032  "Source: isobus.net VDMA Data Dictionary (https://www.isobus.net/isobus/pGNAndSPN/9745?type=PGN)";
CM_ BO_ 2566540288  "Source: isobus.net VDMA Data Dictionary (https://www.isobus.net/isobus/pGNAndSPN/9747?type=PGN)";
CM_ BO_ 2566540544  "Source: isobus.net VDMA Data Dictionary (https://www.isobus.net/isobus/pGNAndSPN/9749?type=PGN)";
CM_ BO_ 2566540800  "Source: isobus.net VDMA Data Dictionary (https://www.isobus.net/isobus/pGNAndSPN/9761?type=PGN)";
CM_ BO_ 2566541056  "Source: isobus.net VDMA Data Dictionary (https://www.isobus.net/isobus/pGNAndSPN/9765?type=PGN)";
CM_ BO_ 2566541312  "Source: isobus.net VDMA Data Dictionary (https://www.isobus.net/isobus/pGNAndSPN/9770?type=PGN)";
CM_ BO_ 2566541568  "Source: isobus.net VDMA Data Dictionary (https://www.isobus.net/isobus/pGNAndSPN/9781?type=PGN)";
CM_ BO_ 2566541824  "Source: isobus.net VDMA Data Dictionary (https://www.isobus.net/isobus/pGNAndSPN/9791?type=PGN)";
CM_ BO_ 2566542080  "Source: isobus.net VDMA Data Dictionary (https://www.isobus.net/isobus/pGNAndSPN/9795?type=PGN)";
CM_ BO_ 2566542336  "Source: isobus.net VDMA Data Dictionary (https://www.isobus.net/isobus/pGNAndSPN/9799?type=PGN)";
CM_ BO_ 2566542592  "Source: isobus.net VDMA Data Dictionary (https://www.isobus.net/isobus/pGNAndSPN/9803?type=PGN)";
CM_ BO_ 2566542848  "Source: isobus.net VDMA Data Dictionary (https://www.isobus.net/isobus/pGNAndSPN/9807?type=PGN)";
CM_ BO_ 2566543104  "Source: isobus.net VDMA Data Dictionary (https://www.isobus.net/isobus/pGNAndSPN/9811?type=PGN)";
CM_ BO_ 2566543360  "Source: isobus.net VDMA Data Dictionary (https://www.isobus.net/isobus/pGNAndSPN/9814?type=PGN)";
CM_ BO_ 2566543616  "Source: isobus.net VDMA Data Dictionary (https://www.isobus.net/isobus/pGNAndSPN/9820?type=PGN)";
CM_ BO_ 2566543872  "Source: isobus.net VDMA Data Dictionary (https://www.isobus.net/isobus/pGNAndSPN/9826?type=PGN)";
CM_ BO_ 2566544128  "Source: isobus.net VDMA Data Dictionary (https://www.isobus.net/isobus/pGNAndSPN/9829?type=PGN)";
CM_ BO_ 2566544384  "Source: isobus.net VDMA Data Dictionary (https://www.isobus.net/isobus/pGNAndSPN/9830?type=PGN)";
CM_ BO_ 2566544640  "Source: isobus.net VDMA Data Dictionary (https://www.isobus.net/isobus/pGNAndSPN/9837?type=PGN)";
CM_ BO_ 2566544896  "Source: isobus.net VDMA Data Dictionary (https://www.isobus.net/isobus/pGNAndSPN/9840?type=PGN)";
CM_ BO_ 2566545152  "Source: isobus.net VDMA Data Dictionary (https://www.isobus.net/isobus/pGNAndSPN/9844?type=PGN)";
CM_ BO_ 2566545408  "Source: isobus.net VDMA Data Dictionary (https://www.isobus.net/isobus/pGNAndSPN/9849?type=PGN)";
CM_ BO_ 2566545920  "Source: isobus.net VDMA Data Dictionary (https://www.isobus.net/isobus/pGNAndSPN/9850?type=PGN)";
CM_ BO_ 2566546176  "Source: isobus.net VDMA Data Dictionary (https://www.isobus.net/isobus/pGNAndSPN/9852?type=PGN)";
CM_ BO_ 2566546432  "Source: isobus.net VDMA Data Dictionary (https://www.isobus.net/isobus/pGNAndSPN/9854?type=PGN)";
CM_ BO_ 2566546688  "Source: isobus.net VDMA Data Dictionary (https://www.isobus.net/isobus/pGNAndSPN/9856?type=PGN)";
CM_ BO_ 2566546944  "Source: isobus.net VDMA Data Dictionary (https://www.isobus.net/isobus/pGNAndSPN/9858?type=PGN)";
CM_ BO_ 2566547200  "Source: isobus.net VDMA Data Dictionary (https://www.isobus.net/isobus/pGNAndSPN/9860?type=PGN)";
CM_ BO_ 2566547456  "Source: isobus.net VDMA Data Dictionary (https://www.isobus.net/isobus/pGNAndSPN/9864?type=PGN)";
CM_ BO_ 2566547712  "Source: isobus.net VDMA Data Dictionary (https://www.isobus.net/isobus/pGNAndSPN/9868?type=PGN)";
CM_ BO_ 2566547968  "Source: isobus.net VDMA Data Dictionary (https://www.isobus.net/isobus/pGNAndSPN/9874?type=PGN)";
CM_ BO_ 2566548224  "Source: isobus.net VDMA Data Dictionary (https://www.isobus.net/isobus/pGNAndSPN/9880?type=PGN)";
CM_ BO_ 2566548480  "Source: isobus.net VDMA Data Dictionary (https://www.isobus.net/isobus/pGNAndSPN/9886?type=PGN)";
CM_ BO_ 2566548736  "Source: isobus.net VDMA Data Dictionary (https://www.isobus.net/isobus/pGNAndSPN/9892?type=PGN)";
CM_ BO_ 2566548992  "Source: isobus.net VDMA Data Dictionary (https://www.isobus.net/isobus/pGNAndSPN/9898?type=PGN)";
CM_ BO_ 2566549248  "Source: isobus.net VDMA Data Dictionary (https://www.isobus.net/isobus/pGNAndSPN/9904?type=PGN)";
CM_ BO_ 2566549504  "Source: isobus.net VDMA Data Dictionary (https://www.isobus.net/isobus/pGNAndSPN/9908?type=PGN)";
CM_ BO_ 2566549760  "Source: isobus.net VDMA Data Dictionary (https://www.isobus.net/isobus/pGNAndSPN/9912?type=PGN)";
CM_ BO_ 2566550016  "Source: isobus.net VDMA Data Dictionary (https://www.isobus.net/isobus/pGNAndSPN/9930?type=PGN)";
CM_ BO_ 2566550272  "Source: isobus.net VDMA Data Dictionary (https://www.isobus.net/isobus/pGNAndSPN/9948?type=PGN)";
CM_ BO_ 2566550528  "Source: isobus.net VDMA Data Dictionary (https://www.isobus.net/isobus/pGNAndSPN/9953?type=PGN)";
CM_ BO_ 2566550784  "Source: isobus.net VDMA Data Dictionary (https://www.isobus.net/isobus/pGNAndSPN/9957?type=PGN)";
CM_ BO_ 2566551040  "Source: isobus.net VDMA Data Dictionary (https://www.isobus.net/isobus/pGNAndSPN/9961?type=PGN)";
CM_ BO_ 2566551296  "Source: isobus.net VDMA Data Dictionary (https://www.isobus.net/isobus/pGNAndSPN/9965?type=PGN)";
CM_ BO_ 2566551552  "Source: isobus.net VDMA Data Dictionary (https://www.isobus.net/isobus/pGNAndSPN/9969?type=PGN)";
CM_ BO_ 2566551808  "Source: isobus.net VDMA Data Dictionary (https://www.isobus.net/isobus/pGNAndSPN/9974?type=PGN)";
CM_ BO_ 2566552064  "Source: isobus.net VDMA Data Dictionary (https://www.isobus.net/isobus/pGNAndSPN/9977?type=PGN)";
CM_ BO_ 2566552320  "Source: isobus.net VDMA Data Dictionary (https://www.isobus.net/isobus/pGNAndSPN/9980?type=PGN)";
CM_ BO_ 2566552576  "Source: isobus.net VDMA Data Dictionary (https://www.isobus.net/isobus/pGNAndSPN/9983?type=PGN)";
CM_ BO_ 2566552832  "Source: isobus.net VDMA Data Dictionary (https://www.isobus.net/isobus/pGNAndSPN/9986?type=PGN)";
CM_ BO_ 2566553088  "Source: isobus.net VDMA Data Dictionary (https://www.isobus.net/isobus/pGNAndSPN/9992?type=PGN)";
CM_ BO_ 2566553344  "Source: isobus.net VDMA Data Dictionary (https://www.isobus.net/isobus/pGNAndSPN/9995?type=PGN)";
CM_ BO_ 2566553600  "Source: isobus.net VDMA Data Dictionary (https://www.isobus.net/isobus/pGNAndSPN/9998?type=PGN)";
CM_ BO_ 2566553856  "Source: isobus.net VDMA Data Dictionary (https://www.isobus.net/isobus/pGNAndSPN/10002?type=PGN)";
CM_ BO_ 2566554112  "Source: isobus.net VDMA Data Dictionary (https://www.isobus.net/isobus/pGNAndSPN/10008?type=PGN)";
CM_ BO_ 2566554368  "Source: isobus.net VDMA Data Dictionary (https://www.isobus.net/isobus/pGNAndSPN/10016?type=PGN)";
CM_ BO_ 2566554624  "Source: isobus.net VDMA Data Dictionary (https://www.isobus.net/isobus/pGNAndSPN/10022?type=PGN)";
CM_ BO_ 2566554880  "Source: isobus.net VDMA Data Dictionary (https://www.isobus.net/isobus/pGNAndSPN/10032?type=PGN)";
CM_ BO_ 2566555136  "Source: isobus.net VDMA Data Dictionary (https://www.isobus.net/isobus/pGNAndSPN/10038?type=PGN)";
CM_ BO_ 2566555392  "Source: isobus.net VDMA Data Dictionary (https://www.isobus.net/isobus/pGNAndSPN/10048?type=PGN)";
CM_ BO_ 2566555648  "Source: isobus.net VDMA Data Dictionary (https://www.isobus.net/isobus/pGNAndSPN/10054?type=PGN)";
CM_ BO_ 2566555904  "Source: isobus.net VDMA Data Dictionary (https://www.isobus.net/isobus/pGNAndSPN/10064?type=PGN)";
CM_ BO_ 2566556160  "Source: isobus.net VDMA Data Dictionary (https://www.isobus.net/isobus/pGNAndSPN/10070?type=PGN)";
CM_ BO_ 2566556416  "Source: isobus.net VDMA Data Dictionary (https://www.isobus.net/isobus/pGNAndSPN/10080?type=PGN)";
CM_ BO_ 2566556672  "Source: isobus.net VDMA Data Dictionary (https://www.isobus.net/isobus/pGNAndSPN/10086?type=PGN)";
CM_ BO_ 2566556928  "Source: isobus.net VDMA Data Dictionary (https://www.isobus.net/isobus/pGNAndSPN/10096?type=PGN)";
CM_ BO_ 2566557184  "Source: isobus.net VDMA Data Dictionary (https://www.isobus.net/isobus/pGNAndSPN/10102?type=PGN)";
CM_ BO_ 2566557440  "Source: isobus.net VDMA Data Dictionary (https://www.isobus.net/isobus/pGNAndSPN/10112?type=PGN)";
CM_ BO_ 2566557696  "Source: isobus.net VDMA Data Dictionary (https://www.isobus.net/isobus/pGNAndSPN/10118?type=PGN)";
CM_ BO_ 2566557952  "Source: isobus.net VDMA Data Dictionary (https://www.isobus.net/isobus/pGNAndSPN/10128?type=PGN)";
CM_ BO_ 2566558208  "Source: isobus.net VDMA Data Dictionary (https://www.isobus.net/isobus/pGNAndSPN/10134?type=PGN)";
CM_ BO_ 2566558464  "Source: isobus.net VDMA Data Dictionary (https://www.isobus.net/isobus/pGNAndSPN/10144?type=PGN)";
CM_ BO_ 2566558720  "Source: isobus.net VDMA Data Dictionary (https://www.isobus.net/isobus/pGNAndSPN/10150?type=PGN)";
CM_ BO_ 2566558976  "Source: isobus.net VDMA Data Dictionary (https://www.isobus.net/isobus/pGNAndSPN/10160?type=PGN)";
CM_ BO_ 2566559232  "Source: isobus.net VDMA Data Dictionary (https://www.isobus.net/isobus/pGNAndSPN/10166?type=PGN)";
CM_ BO_ 2566559488  "Source: isobus.net VDMA Data Dictionary (https://www.isobus.net/isobus/pGNAndSPN/10176?type=PGN)";
CM_ BO_ 2566559744  "Source: isobus.net VDMA Data Dictionary (https://www.isobus.net/isobus/pGNAndSPN/10182?type=PGN)";
CM_ BO_ 2566560000  "Source: isobus.net VDMA Data Dictionary (https://www.isobus.net/isobus/pGNAndSPN/10192?type=PGN)";
CM_ BO_ 2566560256  "Source: isobus.net VDMA Data Dictionary (https://www.isobus.net/isobus/pGNAndSPN/10198?type=PGN)";
CM_ BO_ 2566560512  "Source: isobus.net VDMA Data Dictionary (https://www.isobus.net/isobus/pGNAndSPN/10208?type=PGN)";
CM_ BO_ 2566560768  "Source: isobus.net VDMA Data Dictionary (https://www.isobus.net/isobus/pGNAndSPN/10214?type=PGN)";
CM_ BO_ 2566561024  "Source: isobus.net VDMA Data Dictionary (https://www.isobus.net/isobus/pGNAndSPN/10224?type=PGN)";
CM_ BO_ 2566561280  "Source: isobus.net VDMA Data Dictionary (https://www.isobus.net/isobus/pGNAndSPN/10230?type=PGN)";
CM_ BO_ 2566561536  "Source: isobus.net VDMA Data Dictionary (https://www.isobus.net/isobus/pGNAndSPN/10240?type=PGN)";
CM_ BO_ 2566561792  "Source: isobus.net VDMA Data Dictionary (https://www.isobus.net/isobus/pGNAndSPN/10246?type=PGN)";
CM_ BO_ 2566562048  "Source: isobus.net VDMA Data Dictionary (https://www.isobus.net/isobus/pGNAndSPN/10256?type=PGN)";
CM_ BO_ 2566562304  "Source: isobus.net VDMA Data Dictionary (https://www.isobus.net/isobus/pGNAndSPN/10262?type=PGN)";
CM_ BO_ 2566562560  "Source: isobus.net VDMA Data Dictionary (https://www.isobus.net/isobus/pGNAndSPN/10272?type=PGN)";
CM_ BO_ 2566562816  "Source: isobus.net VDMA Data Dictionary (https://www.isobus.net/isobus/pGNAndSPN/10277?type=PGN)";
CM_ BO_ 2566563072  "Source: isobus.net VDMA Data Dictionary (https://www.isobus.net/isobus/pGNAndSPN/10280?type=PGN)";
CM_ BO_ 2566563328  "Source: isobus.net VDMA Data Dictionary (https://www.isobus.net/isobus/pGNAndSPN/10282?type=PGN)";
CM_ BO_ 2566563584  "Source: isobus.net VDMA Data Dictionary (https://www.isobus.net/isobus/pGNAndSPN/10287?type=PGN)";
CM_ BO_ 2566563840  "Source: isobus.net VDMA Data Dictionary (https://www.isobus.net/isobus/pGNAndSPN/10290?type=PGN)";
CM_ BO_ 2566564096  "Source: isobus.net VDMA Data Dictionary (https://www.isobus.net/isobus/pGNAndSPN/10293?type=PGN)";
CM_ BO_ 2566564352  "Source: isobus.net VDMA Data Dictionary (https://www.isobus.net/isobus/pGNAndSPN/10295?type=PGN)";
CM_ BO_ 2566564608  "Source: isobus.net VDMA Data Dictionary (https://www.isobus.net/isobus/pGNAndSPN/10305?type=PGN)";
CM_ BO_ 2566564864  "Source: isobus.net VDMA Data Dictionary (https://www.isobus.net/isobus/pGNAndSPN/10311?type=PGN)";
CM_ BO_ 2566565120  "Source: isobus.net VDMA Data Dictionary (https://www.isobus.net/isobus/pGNAndSPN/10321?type=PGN)";
CM_ BO_ 2566565376  "Source: isobus.net VDMA Data Dictionary (https://www.isobus.net/isobus/pGNAndSPN/10327?type=PGN)";
CM_ BO_ 2566565632  "Source: isobus.net VDMA Data Dictionary (https://www.isobus.net/isobus/pGNAndSPN/10337?type=PGN)";
CM_ BO_ 2566565888  "Source: isobus.net VDMA Data Dictionary (https://www.isobus.net/isobus/pGNAndSPN/10343?type=PGN)";
CM_ BO_ 2566566144  "Source: isobus.net VDMA Data Dictionary (https://www.isobus.net/isobus/pGNAndSPN/10353?type=PGN)";
CM_ BO_ 2566566400  "Source: isobus.net VDMA Data Dictionary (https://www.isobus.net/isobus/pGNAndSPN/10359?type=PGN)";
CM_ BO_ 2566566656  "Source: isobus.net VDMA Data Dictionary (https://www.isobus.net/isobus/pGNAndSPN/10360?type=PGN)";
CM_ BO_ 2566566912  "Source: isobus.net VDMA Data Dictionary (https://www.isobus.net/isobus/pGNAndSPN/10364?type=PGN)";
CM_ BO_ 2566567168  "Source: isobus.net VDMA Data Dictionary (https://www.isobus.net/isobus/pGNAndSPN/10368?type=PGN)";
CM_ BO_ 2566567424  "Source: isobus.net VDMA Data Dictionary (https://www.isobus.net/isobus/pGNAndSPN/10372?type=PGN)";
CM_ BO_ 2566567680  "Source: isobus.net VDMA Data Dictionary (https://www.isobus.net/isobus/pGNAndSPN/10376?type=PGN)";
CM_ BO_ 2566567936  "Source: isobus.net VDMA Data Dictionary (https://www.isobus.net/isobus/pGNAndSPN/10386?type=PGN)";
CM_ BO_ 2566568192  "Source: isobus.net VDMA Data Dictionary (https://www.isobus.net/isobus/pGNAndSPN/10387?type=PGN)";
CM_ BO_ 2566568448  "Source: isobus.net VDMA Data Dictionary (https://www.isobus.net/isobus/pGNAndSPN/10390?type=PGN)";
CM_ BO_ 2566568704  "Source: isobus.net VDMA Data Dictionary (https://www.isobus.net/isobus/pGNAndSPN/10392?type=PGN)";
CM_ BO_ 2566568960  "Source: isobus.net VDMA Data Dictionary (https://www.isobus.net/isobus/pGNAndSPN/10394?type=PGN)";
CM_ BO_ 2566569216  "Source: isobus.net VDMA Data Dictionary (https://www.isobus.net/isobus/pGNAndSPN/10398?type=PGN)";
CM_ BO_ 2566569472  "Source: isobus.net VDMA Data Dictionary (https://www.isobus.net/isobus/pGNAndSPN/10402?type=PGN)";
CM_ BO_ 2566569728  "Source: isobus.net VDMA Data Dictionary (https://www.isobus.net/isobus/pGNAndSPN/10406?type=PGN)";
CM_ BO_ 2566569984  "Source: isobus.net VDMA Data Dictionary (https://www.isobus.net/isobus/pGNAndSPN/10410?type=PGN)";
CM_ BO_ 2566570240  "Source: isobus.net VDMA Data Dictionary (https://www.isobus.net/isobus/pGNAndSPN/10414?type=PGN)";
CM_ BO_ 2566570496  "Source: isobus.net VDMA Data Dictionary (https://www.isobus.net/isobus/pGNAndSPN/10418?type=PGN)";
CM_ BO_ 2566570752  "Source: isobus.net VDMA Data Dictionary (https://www.isobus.net/isobus/pGNAndSPN/10420?type=PGN)";
CM_ BO_ 2566571008  "Source: isobus.net VDMA Data Dictionary (https://www.isobus.net/isobus/pGNAndSPN/10423?type=PGN)";
CM_ BO_ 2566571264  "Source: isobus.net VDMA Data Dictionary (https://www.isobus.net/isobus/pGNAndSPN/10427?type=PGN)";
CM_ BO_ 2566571520  "Source: isobus.net VDMA Data Dictionary (https://www.isobus.net/isobus/pGNAndSPN/10429?type=PGN)";
CM_ BO_ 2566572032  "Source: isobus.net VDMA Data Dictionary (https://www.isobus.net/isobus/pGNAndSPN/10434?type=PGN)";
CM_ BO_ 2566572800  "Source: isobus.net VDMA Data Dictionary (https://www.isobus.net/isobus/pGNAndSPN/10435?type=PGN)";
CM_ BO_ 2566573056  "Source: isobus.net VDMA Data Dictionary (https://www.isobus.net/isobus/pGNAndSPN/10436?type=PGN)";
CM_ BO_ 2566573312  "Source: isobus.net VDMA Data Dictionary (https://www.isobus.net/isobus/pGNAndSPN/10438?type=PGN)";
CM_ BO_ 2566573568  "Source: isobus.net VDMA Data Dictionary (https://www.isobus.net/isobus/pGNAndSPN/10440?type=PGN)";
CM_ BO_ 2566573824  "Source: isobus.net VDMA Data Dictionary (https://www.isobus.net/isobus/pGNAndSPN/10449?type=PGN)";
CM_ BO_ 2566574080  "Source: isobus.net VDMA Data Dictionary (https://www.isobus.net/isobus/pGNAndSPN/10452?type=PGN)";
CM_ BO_ 2566574336  "Source: isobus.net VDMA Data Dictionary (https://www.isobus.net/isobus/pGNAndSPN/10455?type=PGN)";
CM_ BO_ 2566574592  "Source: isobus.net VDMA Data Dictionary (https://www.isobus.net/isobus/pGNAndSPN/10459?type=PGN)";
CM_ BO_ 2566574848  "Source: isobus.net VDMA Data Dictionary (https://www.isobus.net/isobus/pGNAndSPN/10464?type=PGN)";
CM_ BO_ 2566575104  "Source: isobus.net VDMA Data Dictionary (https://www.isobus.net/isobus/pGNAndSPN/10466?type=PGN)";
CM_ BO_ 2566575360  "Source: isobus.net VDMA Data Dictionary (https://www.isobus.net/isobus/pGNAndSPN/10470?type=PGN)";
CM_ BO_ 2566575616  "Source: isobus.net VDMA Data Dictionary (https://www.isobus.net/isobus/pGNAndSPN/10478?type=PGN)";
CM_ BO_ 2566575872  "Source: isobus.net VDMA Data Dictionary (https://www.isobus.net/isobus/pGNAndSPN/10479?type=PGN)";
CM_ BO_ 2566576128  "Source: isobus.net VDMA Data Dictionary (https://www.isobus.net/isobus/pGNAndSPN/10480?type=PGN)";
CM_ BO_ 2566576384  "Source: isobus.net VDMA Data Dictionary (https://www.isobus.net/isobus/pGNAndSPN/10481?type=PGN)";
CM_ BO_ 2566576640  "Source: isobus.net VDMA Data Dictionary (https://www.isobus.net/isobus/pGNAndSPN/10482?type=PGN)";
CM_ BO_ 2566576896  "Source: isobus.net VDMA Data Dictionary (https://www.isobus.net/isobus/pGNAndSPN/10483?type=PGN)";
CM_ BO_ 2566577152  "Source: isobus.net VDMA Data Dictionary (https://www.isobus.net/isobus/pGNAndSPN/10484?type=PGN)";
CM_ BO_ 2566577408  "Source: isobus.net VDMA Data Dictionary (https://www.isobus.net/isobus/pGNAndSPN/10485?type=PGN)";
CM_ BO_ 2566577664  "Source: isobus.net VDMA Data Dictionary (https://www.isobus.net/isobus/pGNAndSPN/10486?type=PGN)";
CM_ BO_ 2566577920  "Source: isobus.net VDMA Data Dictionary (https://www.isobus.net/isobus/pGNAndSPN/10487?type=PGN)";
CM_ BO_ 2566578176  "Source: isobus.net VDMA Data Dictionary (https://www.isobus.net/isobus/pGNAndSPN/10488?type=PGN)";
CM_ BO_ 2566578432  "Source: isobus.net VDMA Data Dictionary (https://www.isobus.net/isobus/pGNAndSPN/10489?type=PGN)";
CM_ BO_ 2566578688  "Source: isobus.net VDMA Data Dictionary (https://www.isobus.net/isobus/pGNAndSPN/10490?type=PGN)";
CM_ BO_ 2566578944  "Source: isobus.net VDMA Data Dictionary (https://www.isobus.net/isobus/pGNAndSPN/10491?type=PGN)";
CM_ BO_ 2566579200  "Source: isobus.net VDMA Data Dictionary (https://www.isobus.net/isobus/pGNAndSPN/10492?type=PGN)";
CM_ BO_ 2566579456  "Source: isobus.net VDMA Data Dictionary (https://www.isobus.net/isobus/pGNAndSPN/10493?type=PGN)";
CM_ BO_ 2566579712  "Source: isobus.net VDMA Data Dictionary (https://www.isobus.net/isobus/pGNAndSPN/10494?type=PGN)";
CM_ BO_ 2566579968  "Source: isobus.net VDMA Data Dictionary (https://www.isobus.net/isobus/pGNAndSPN/10495?type=PGN)";
CM_ BO_ 2566580224  "Source: isobus.net VDMA Data Dictionary (https://www.isobus.net/isobus/pGNAndSPN/10496?type=PGN)";
CM_ BO_ 2566580480  "Source: isobus.net VDMA Data Dictionary (https://www.isobus.net/isobus/pGNAndSPN/10497?type=PGN)";
CM_ BO_ 2566580736  "Source: isobus.net VDMA Data Dictionary (https://www.isobus.net/isobus/pGNAndSPN/10498?type=PGN)";
CM_ BO_ 2566580992  "Source: isobus.net VDMA Data Dictionary (https://www.isobus.net/isobus/pGNAndSPN/10499?type=PGN)";
CM_ BO_ 2566581248  "Source: isobus.net VDMA Data Dictionary (https://www.isobus.net/isobus/pGNAndSPN/10500?type=PGN)";
CM_ BO_ 2566581504  "Source: isobus.net VDMA Data Dictionary (https://www.isobus.net/isobus/pGNAndSPN/10508?type=PGN)";
CM_ BO_ 2566581760  "Source: isobus.net VDMA Data Dictionary (https://www.isobus.net/isobus/pGNAndSPN/10516?type=PGN)";
CM_ BO_ 2566582016  "Source: isobus.net VDMA Data Dictionary (https://www.isobus.net/isobus/pGNAndSPN/10517?type=PGN)";
CM_ BO_ 2566582272  "Source: isobus.net VDMA Data Dictionary (https://www.isobus.net/isobus/pGNAndSPN/10519?type=PGN)";
CM_ BO_ 2566582528  "Source: isobus.net VDMA Data Dictionary (https://www.isobus.net/isobus/pGNAndSPN/10522?type=PGN)";
CM_ BO_ 2566582784  "Source: isobus.net VDMA Data Dictionary (https://www.isobus.net/isobus/pGNAndSPN/10525?type=PGN)";
CM_ BO_ 2566583040  "Source: isobus.net VDMA Data Dictionary (https://www.isobus.net/isobus/pGNAndSPN/10528?type=PGN)";
CM_ BO_ 2566583296  "Source: isobus.net VDMA Data Dictionary (https://www.isobus.net/isobus/pGNAndSPN/10536?type=PGN)";
CM_ BO_ 2566583552  "Source: isobus.net VDMA Data Dictionary (https://www.isobus.net/isobus/pGNAndSPN/10544?type=PGN)";
CM_ BO_ 2566583808  "Source: isobus.net VDMA Data Dictionary (https://www.isobus.net/isobus/pGNAndSPN/10552?type=PGN)";
CM_ BO_ 2566584064  "Source: isobus.net VDMA Data Dictionary (https://www.isobus.net/isobus/pGNAndSPN/10560?type=PGN)";
CM_ BO_ 2566584320  "Source: isobus.net VDMA Data Dictionary (https://www.isobus.net/isobus/pGNAndSPN/10568?type=PGN)";
CM_ BO_ 2566584576  "Source: isobus.net VDMA Data Dictionary (https://www.isobus.net/isobus/pGNAndSPN/10572?type=PGN)";
CM_ BO_ 2566584832  "Source: isobus.net VDMA Data Dictionary (https://www.isobus.net/isobus/pGNAndSPN/10576?type=PGN)";
CM_ BO_ 2566585088  "Source: isobus.net VDMA Data Dictionary (https://www.isobus.net/isobus/pGNAndSPN/10580?type=PGN)";
CM_ BO_ 2566585344  "Source: isobus.net VDMA Data Dictionary (https://www.isobus.net/isobus/pGNAndSPN/10593?type=PGN)";
CM_ BO_ 2566585600  "Source: isobus.net VDMA Data Dictionary (https://www.isobus.net/isobus/pGNAndSPN/10606?type=PGN)";
CM_ BO_ 2566585856  "Source: isobus.net VDMA Data Dictionary (https://www.isobus.net/isobus/pGNAndSPN/10619?type=PGN)";
CM_ BO_ 2566586112  "Source: isobus.net VDMA Data Dictionary (https://www.isobus.net/isobus/pGNAndSPN/10622?type=PGN)";
CM_ BO_ 2566586368  "Source: isobus.net VDMA Data Dictionary (https://www.isobus.net/isobus/pGNAndSPN/10625?type=PGN)";
CM_ BO_ 2566586624  "Source: isobus.net VDMA Data Dictionary (https://www.isobus.net/isobus/pGNAndSPN/10628?type=PGN)";
CM_ BO_ 2566586880  "Source: isobus.net VDMA Data Dictionary (https://www.isobus.net/isobus/pGNAndSPN/10645?type=PGN)";
CM_ BO_ 2566587136  "Source: isobus.net VDMA Data Dictionary (https://www.isobus.net/isobus/pGNAndSPN/10662?type=PGN)";
CM_ BO_ 2566587392  "Source: isobus.net VDMA Data Dictionary (https://www.isobus.net/isobus/pGNAndSPN/10679?type=PGN)";
CM_ BO_ 2566587648  "Source: isobus.net VDMA Data Dictionary (https://www.isobus.net/isobus/pGNAndSPN/10696?type=PGN)";
CM_ BO_ 2566587904  "Source: isobus.net VDMA Data Dictionary (https://www.isobus.net/isobus/pGNAndSPN/10713?type=PGN)";
CM_ BO_ 2566588160  "Source: isobus.net VDMA Data Dictionary (https://www.isobus.net/isobus/pGNAndSPN/10730?type=PGN)";
CM_ BO_ 2566588416  "Source: isobus.net VDMA Data Dictionary (https://www.isobus.net/isobus/pGNAndSPN/10747?type=PGN)";
CM_ BO_ 2566588672  "Source: isobus.net VDMA Data Dictionary (https://www.isobus.net/isobus/pGNAndSPN/10764?type=PGN)";
CM_ BO_ 2566588928  "Source: isobus.net VDMA Data Dictionary (https://www.isobus.net/isobus/pGNAndSPN/10781?type=PGN)";
CM_ BO_ 2566589184  "Source: isobus.net VDMA Data Dictionary (https://www.isobus.net/isobus/pGNAndSPN/10798?type=PGN)";
CM_ BO_ 2566589440  "Source: isobus.net VDMA Data Dictionary (https://www.isobus.net/isobus/pGNAndSPN/10815?type=PGN)";
CM_ BO_ 2566589696  "Source: isobus.net VDMA Data Dictionary (https://www.isobus.net/isobus/pGNAndSPN/10832?type=PGN)";
CM_ BO_ 2566589952  "Source: isobus.net VDMA Data Dictionary (https://www.isobus.net/isobus/pGNAndSPN/10849?type=PGN)";
CM_ BO_ 2566590208  "Source: isobus.net VDMA Data Dictionary (https://www.isobus.net/isobus/pGNAndSPN/10866?type=PGN)";
CM_ BO_ 2566590464  "Source: isobus.net VDMA Data Dictionary (https://www.isobus.net/isobus/pGNAndSPN/10883?type=PGN)";
CM_ BO_ 2566590720  "Source: isobus.net VDMA Data Dictionary (https://www.isobus.net/isobus/pGNAndSPN/10900?type=PGN)";
CM_ BO_ 2566590976  "Source: isobus.net VDMA Data Dictionary (https://www.isobus.net/isobus/pGNAndSPN/10917?type=PGN)";
CM_ BO_ 2566591232  "Source: isobus.net VDMA Data Dictionary (https://www.isobus.net/isobus/pGNAndSPN/10934?type=PGN)";
CM_ BO_ 2566591488  "Source: isobus.net VDMA Data Dictionary (https://www.isobus.net/isobus/pGNAndSPN/10951?type=PGN)";
CM_ BO_ 2566591744  "Source: isobus.net VDMA Data Dictionary (https://www.isobus.net/isobus/pGNAndSPN/10968?type=PGN)";
CM_ BO_ 2566592000  "Source: isobus.net VDMA Data Dictionary (https://www.isobus.net/isobus/pGNAndSPN/10985?type=PGN)";
CM_ BO_ 2566592256  "Source: isobus.net VDMA Data Dictionary (https://www.isobus.net/isobus/pGNAndSPN/11002?type=PGN)";
CM_ BO_ 2566592512  "Source: isobus.net VDMA Data Dictionary (https://www.isobus.net/isobus/pGNAndSPN/11009?type=PGN)";
CM_ BO_ 2566592768  "Source: isobus.net VDMA Data Dictionary (https://www.isobus.net/isobus/pGNAndSPN/11015?type=PGN)";
CM_ BO_ 2566593024  "Source: isobus.net VDMA Data Dictionary (https://www.isobus.net/isobus/pGNAndSPN/11021?type=PGN)";
CM_ BO_ 2566593280  "Source: isobus.net VDMA Data Dictionary (https://www.isobus.net/isobus/pGNAndSPN/11027?type=PGN)";
CM_ BO_ 2566593536  "Source: isobus.net VDMA Data Dictionary (https://www.isobus.net/isobus/pGNAndSPN/11031?type=PGN)";
CM_ BO_ 2566593792  "Source: isobus.net VDMA Data Dictionary (https://www.isobus.net/isobus/pGNAndSPN/11038?type=PGN)";
CM_ BO_ 2566594048  "Source: isobus.net VDMA Data Dictionary (https://www.isobus.net/isobus/pGNAndSPN/11044?type=PGN)";
CM_ BO_ 2566594304  "Source: isobus.net VDMA Data Dictionary (https://www.isobus.net/isobus/pGNAndSPN/11050?type=PGN)";
CM_ BO_ 2566594560  "Source: isobus.net VDMA Data Dictionary (https://www.isobus.net/isobus/pGNAndSPN/11056?type=PGN)";
CM_ BO_ 2566594816  "Source: isobus.net VDMA Data Dictionary (https://www.isobus.net/isobus/pGNAndSPN/11060?type=PGN)";
CM_ BO_ 2566595072  "Source: isobus.net VDMA Data Dictionary (https://www.isobus.net/isobus/pGNAndSPN/11067?type=PGN)";
CM_ BO_ 2566595328  "Source: isobus.net VDMA Data Dictionary (https://www.isobus.net/isobus/pGNAndSPN/11073?type=PGN)";
CM_ BO_ 2566595584  "Source: isobus.net VDMA Data Dictionary (https://www.isobus.net/isobus/pGNAndSPN/11079?type=PGN)";
CM_ BO_ 2566595840  "Source: isobus.net VDMA Data Dictionary (https://www.isobus.net/isobus/pGNAndSPN/11085?type=PGN)";
CM_ BO_ 2566596096  "Source: isobus.net VDMA Data Dictionary (https://www.isobus.net/isobus/pGNAndSPN/11089?type=PGN)";
CM_ BO_ 2566596352  "Source: isobus.net VDMA Data Dictionary (https://www.isobus.net/isobus/pGNAndSPN/11096?type=PGN)";
CM_ BO_ 2566596608  "Source: isobus.net VDMA Data Dictionary (https://www.isobus.net/isobus/pGNAndSPN/11102?type=PGN)";
CM_ BO_ 2566596864  "Source: isobus.net VDMA Data Dictionary (https://www.isobus.net/isobus/pGNAndSPN/11108?type=PGN)";
CM_ BO_ 2566597120  "Source: isobus.net VDMA Data Dictionary (https://www.isobus.net/isobus/pGNAndSPN/11114?type=PGN)";
CM_ BO_ 2566597376  "Source: isobus.net VDMA Data Dictionary (https://www.isobus.net/isobus/pGNAndSPN/11118?type=PGN)";
CM_ BO_ 2566597632  "Source: isobus.net VDMA Data Dictionary (https://www.isobus.net/isobus/pGNAndSPN/11119?type=PGN)";
CM_ BO_ 2566597888  "Source: isobus.net VDMA Data Dictionary (https://www.isobus.net/isobus/pGNAndSPN/11123?type=PGN)";
CM_ BO_ 2566598144  "Source: isobus.net VDMA Data Dictionary (https://www.isobus.net/isobus/pGNAndSPN/11124?type=PGN)";
CM_ BO_ 2566598400  "Source: isobus.net VDMA Data Dictionary (https://www.isobus.net/isobus/pGNAndSPN/11129?type=PGN)";
CM_ BO_ 2566598656  "Source: isobus.net VDMA Data Dictionary (https://www.isobus.net/isobus/pGNAndSPN/11135?type=PGN)";
CM_ BO_ 2566598912  "Source: isobus.net VDMA Data Dictionary (https://www.isobus.net/isobus/pGNAndSPN/11139?type=PGN)";
CM_ BO_ 2566599168  "Source: isobus.net VDMA Data Dictionary (https://www.isobus.net/isobus/pGNAndSPN/11144?type=PGN)";
CM_ BO_ 2566599424  "Source: isobus.net VDMA Data Dictionary (https://www.isobus.net/isobus/pGNAndSPN/11148?type=PGN)";
CM_ BO_ 2566599680  "Source: isobus.net VDMA Data Dictionary (https://www.isobus.net/isobus/pGNAndSPN/11155?type=PGN)";
CM_ BO_ 2566599936  "Source: isobus.net VDMA Data Dictionary (https://www.isobus.net/isobus/pGNAndSPN/11174?type=PGN)";
CM_ BO_ 2566600192  "Source: isobus.net VDMA Data Dictionary (https://www.isobus.net/isobus/pGNAndSPN/11179?type=PGN)";
CM_ BO_ 2566600448  "Source: isobus.net VDMA Data Dictionary (https://www.isobus.net/isobus/pGNAndSPN/11185?type=PGN)";
CM_ BO_ 2566600704  "Source: isobus.net VDMA Data Dictionary (https://www.isobus.net/isobus/pGNAndSPN/11189?type=PGN)";
CM_ BO_ 2566600960  "Source: isobus.net VDMA Data Dictionary (https://www.isobus.net/isobus/pGNAndSPN/11194?type=PGN)";
CM_ BO_ 2566601216  "Source: isobus.net VDMA Data Dictionary (https://www.isobus.net/isobus/pGNAndSPN/11198?type=PGN)";
CM_ SG_ 2566516992 Engine_Cylinder_Average_Ignition "Generic 8-byte raw payload. Detail page: https://www.isobus.net/isobus/pGNAndSPN/9125?type=PGN. Signal-level enrichment via PR welcome  see CONTRIBUTING.md.";
CM_ SG_ 2566517248 Engine_Cylinder_Average_Ignition "Generic 8-byte raw payload. Detail page: https://www.isobus.net/isobus/pGNAndSPN/9129?type=PGN. Signal-level enrichment via PR welcome  see CONTRIBUTING.md.";
CM_ SG_ 2566517504 Engine_Indicated_Mean_Effective_ "Generic 8-byte raw payload. Detail page: https://www.isobus.net/isobus/pGNAndSPN/9137?type=PGN. Signal-level enrichment via PR welcome  see CONTRIBUTING.md.";
CM_ SG_ 2566517760 Engine_Indicated_Mean_Effective_ "Generic 8-byte raw payload. Detail page: https://www.isobus.net/isobus/pGNAndSPN/9145?type=PGN. Signal-level enrichment via PR welcome  see CONTRIBUTING.md.";
CM_ SG_ 2566518016 Engine_Indicated_Mean_Effective_ "Generic 8-byte raw payload. Detail page: https://www.isobus.net/isobus/pGNAndSPN/9153?type=PGN. Signal-level enrichment via PR welcome  see CONTRIBUTING.md.";
CM_ SG_ 2566518272 Fuel_Cell_System_Coolant_Fan_1_C "Generic 8-byte raw payload. Detail page: https://www.isobus.net/isobus/pGNAndSPN/9160?type=PGN. Signal-level enrichment via PR welcome  see CONTRIBUTING.md.";
CM_ SG_ 2566518528 Fuel_Cell_System_Coolant_Fan_1_S "Generic 8-byte raw payload. Detail page: https://www.isobus.net/isobus/pGNAndSPN/9168?type=PGN. Signal-level enrichment via PR welcome  see CONTRIBUTING.md.";
CM_ SG_ 2566518784 Fuel_Cell_System_Coolant_Fan_2_C "Generic 8-byte raw payload. Detail page: https://www.isobus.net/isobus/pGNAndSPN/9175?type=PGN. Signal-level enrichment via PR welcome  see CONTRIBUTING.md.";
CM_ SG_ 2566519040 Fuel_Cell_System_Coolant_Fan_2_S "Generic 8-byte raw payload. Detail page: https://www.isobus.net/isobus/pGNAndSPN/9183?type=PGN. Signal-level enrichment via PR welcome  see CONTRIBUTING.md.";
CM_ SG_ 2566519296 Fuel_Cell_System_Coolant_Fan_3_C "Generic 8-byte raw payload. Detail page: https://www.isobus.net/isobus/pGNAndSPN/9190?type=PGN. Signal-level enrichment via PR welcome  see CONTRIBUTING.md.";
CM_ SG_ 2566519552 Fuel_Cell_System_Coolant_Fan_3_S "Generic 8-byte raw payload. Detail page: https://www.isobus.net/isobus/pGNAndSPN/9198?type=PGN. Signal-level enrichment via PR welcome  see CONTRIBUTING.md.";
CM_ SG_ 2566519808 Fuel_Cell_System_Coolant_Fan_4_C "Generic 8-byte raw payload. Detail page: https://www.isobus.net/isobus/pGNAndSPN/9205?type=PGN. Signal-level enrichment via PR welcome  see CONTRIBUTING.md.";
CM_ SG_ 2566520064 Fuel_Cell_System_Coolant_Fan_4_S "Generic 8-byte raw payload. Detail page: https://www.isobus.net/isobus/pGNAndSPN/9213?type=PGN. Signal-level enrichment via PR welcome  see CONTRIBUTING.md.";
CM_ SG_ 2566520320 APIs_Supported_RawPayload "Generic 8-byte raw payload. Detail page: https://www.isobus.net/isobus/pGNAndSPN/9222?type=PGN. Signal-level enrichment via PR welcome  see CONTRIBUTING.md.";
CM_ SG_ 2566520576 Fuel_Cell_System_Configuration_R "Generic 8-byte raw payload. Detail page: https://www.isobus.net/isobus/pGNAndSPN/9227?type=PGN. Signal-level enrichment via PR welcome  see CONTRIBUTING.md.";
CM_ SG_ 2566520832 Fuel_Cell_System_Coolant_Informa "Generic 8-byte raw payload. Detail page: https://www.isobus.net/isobus/pGNAndSPN/9231?type=PGN. Signal-level enrichment via PR welcome  see CONTRIBUTING.md.";
CM_ SG_ 2566521088 Fuel_Cell_System_Coolant_Informa "Generic 8-byte raw payload. Detail page: https://www.isobus.net/isobus/pGNAndSPN/9236?type=PGN. Signal-level enrichment via PR welcome  see CONTRIBUTING.md.";
CM_ SG_ 2566522368 Dash_Display_3_RawPayload "Generic 8-byte raw payload. Detail page: https://www.isobus.net/isobus/pGNAndSPN/9238?type=PGN. Signal-level enrichment via PR welcome  see CONTRIBUTING.md.";
CM_ SG_ 2566522624 Vehicle_Speed_Profile_RawPayload "Generic 8-byte raw payload. Detail page: https://www.isobus.net/isobus/pGNAndSPN/9241?type=PGN. Signal-level enrichment via PR welcome  see CONTRIBUTING.md.";
CM_ SG_ 2566522880 Reference_Time_RawPayload "Generic 8-byte raw payload. Detail page: https://www.isobus.net/isobus/pGNAndSPN/9245?type=PGN. Signal-level enrichment via PR welcome  see CONTRIBUTING.md.";
CM_ SG_ 2566523136 Software_History_RawPayload "Generic 8-byte raw payload. Detail page: https://www.isobus.net/isobus/pGNAndSPN/9246?type=PGN. Signal-level enrichment via PR welcome  see CONTRIBUTING.md.";
CM_ SG_ 2566523392 Motor_Generator_1_Thermal_Perfor "Generic 8-byte raw payload. Detail page: https://www.isobus.net/isobus/pGNAndSPN/9248?type=PGN. Signal-level enrichment via PR welcome  see CONTRIBUTING.md.";
CM_ SG_ 2566523648 Motor_Generator_2_Thermal_Perfor "Generic 8-byte raw payload. Detail page: https://www.isobus.net/isobus/pGNAndSPN/9250?type=PGN. Signal-level enrichment via PR welcome  see CONTRIBUTING.md.";
CM_ SG_ 2566523904 Motor_Generator_3_Thermal_Perfor "Generic 8-byte raw payload. Detail page: https://www.isobus.net/isobus/pGNAndSPN/9252?type=PGN. Signal-level enrichment via PR welcome  see CONTRIBUTING.md.";
CM_ SG_ 2566524160 Motor_Generator_4_Thermal_Perfor "Generic 8-byte raw payload. Detail page: https://www.isobus.net/isobus/pGNAndSPN/9254?type=PGN. Signal-level enrichment via PR welcome  see CONTRIBUTING.md.";
CM_ SG_ 2566524416 Motor_Generator_5_Thermal_Perfor "Generic 8-byte raw payload. Detail page: https://www.isobus.net/isobus/pGNAndSPN/9256?type=PGN. Signal-level enrichment via PR welcome  see CONTRIBUTING.md.";
CM_ SG_ 2566524672 Motor_Generator_6_Thermal_Perfor "Generic 8-byte raw payload. Detail page: https://www.isobus.net/isobus/pGNAndSPN/9258?type=PGN. Signal-level enrichment via PR welcome  see CONTRIBUTING.md.";
CM_ SG_ 2566524928 On_Board_Programming_Event_Time_ "Generic 8-byte raw payload. Detail page: https://www.isobus.net/isobus/pGNAndSPN/9266?type=PGN. Signal-level enrichment via PR welcome  see CONTRIBUTING.md.";
CM_ SG_ 2566525184 Aftertreatment_1_Light_Off_SCR_S "Generic 8-byte raw payload. Detail page: https://www.isobus.net/isobus/pGNAndSPN/9268?type=PGN. Signal-level enrichment via PR welcome  see CONTRIBUTING.md.";
CM_ SG_ 2566525440 Motor_Generator_Location_Extende "Generic 8-byte raw payload. Detail page: https://www.isobus.net/isobus/pGNAndSPN/9276?type=PGN. Signal-level enrichment via PR welcome  see CONTRIBUTING.md.";
CM_ SG_ 2566525696 Cold_Start_Emissions_Reduction_S "Generic 8-byte raw payload. Detail page: https://www.isobus.net/isobus/pGNAndSPN/9286?type=PGN. Signal-level enrichment via PR welcome  see CONTRIBUTING.md.";
CM_ SG_ 2566525952 Cold_Start_Emissions_Reduction_S "Generic 8-byte raw payload. Detail page: https://www.isobus.net/isobus/pGNAndSPN/9296?type=PGN. Signal-level enrichment via PR welcome  see CONTRIBUTING.md.";
CM_ SG_ 2566526208 Genset_Supporting_Functions_RawP "Generic 8-byte raw payload. Detail page: https://www.isobus.net/isobus/pGNAndSPN/9300?type=PGN. Signal-level enrichment via PR welcome  see CONTRIBUTING.md.";
CM_ SG_ 2566526464 High_Voltage_Energy_Storage_Syst "Generic 8-byte raw payload. Detail page: https://www.isobus.net/isobus/pGNAndSPN/9304?type=PGN. Signal-level enrichment via PR welcome  see CONTRIBUTING.md.";
CM_ SG_ 2566526720 High_Voltage_Energy_Storage_Syst "Generic 8-byte raw payload. Detail page: https://www.isobus.net/isobus/pGNAndSPN/9308?type=PGN. Signal-level enrichment via PR welcome  see CONTRIBUTING.md.";
CM_ SG_ 2566526976 High_Voltage_Energy_Storage_Syst "Generic 8-byte raw payload. Detail page: https://www.isobus.net/isobus/pGNAndSPN/9312?type=PGN. Signal-level enrichment via PR welcome  see CONTRIBUTING.md.";
CM_ SG_ 2566527232 High_Voltage_Energy_Storage_Syst "Generic 8-byte raw payload. Detail page: https://www.isobus.net/isobus/pGNAndSPN/9316?type=PGN. Signal-level enrichment via PR welcome  see CONTRIBUTING.md.";
CM_ SG_ 2566527488 Electronic_Engine_Controller_23_ "Generic 8-byte raw payload. Detail page: https://www.isobus.net/isobus/pGNAndSPN/9318?type=PGN. Signal-level enrichment via PR welcome  see CONTRIBUTING.md.";
CM_ SG_ 2566527744 Electronic_Engine_Controller_24_ "Generic 8-byte raw payload. Detail page: https://www.isobus.net/isobus/pGNAndSPN/9324?type=PGN. Signal-level enrichment via PR welcome  see CONTRIBUTING.md.";
CM_ SG_ 2566528000 Electronic_Engine_Controller_25_ "Generic 8-byte raw payload. Detail page: https://www.isobus.net/isobus/pGNAndSPN/9330?type=PGN. Signal-level enrichment via PR welcome  see CONTRIBUTING.md.";
CM_ SG_ 2566528256 High_Voltage_Bus_Connection_Comm "Generic 8-byte raw payload. Detail page: https://www.isobus.net/isobus/pGNAndSPN/9357?type=PGN. Signal-level enrichment via PR welcome  see CONTRIBUTING.md.";
CM_ SG_ 2566528512 High_Voltage_Bus_Contactor_Statu "Generic 8-byte raw payload. Detail page: https://www.isobus.net/isobus/pGNAndSPN/9384?type=PGN. Signal-level enrichment via PR welcome  see CONTRIBUTING.md.";
CM_ SG_ 2566528768 Aftertreatment_System_Informatio "Generic 8-byte raw payload. Detail page: https://www.isobus.net/isobus/pGNAndSPN/9385?type=PGN. Signal-level enrichment via PR welcome  see CONTRIBUTING.md.";
CM_ SG_ 2566529024 EV_Multi_Connection_DC_Charging_ "Generic 8-byte raw payload. Detail page: https://www.isobus.net/isobus/pGNAndSPN/9390?type=PGN. Signal-level enrichment via PR welcome  see CONTRIBUTING.md.";
CM_ SG_ 2566529280 EV_Multi_Connection_Charging_In_ "Generic 8-byte raw payload. Detail page: https://www.isobus.net/isobus/pGNAndSPN/9396?type=PGN. Signal-level enrichment via PR welcome  see CONTRIBUTING.md.";
CM_ SG_ 2566529536 Sensor_Supply_Voltage_RawPayload "Generic 8-byte raw payload. Detail page: https://www.isobus.net/isobus/pGNAndSPN/9403?type=PGN. Signal-level enrichment via PR welcome  see CONTRIBUTING.md.";
CM_ SG_ 2566529792 Motor_Generator_Location_obsolet "Generic 8-byte raw payload. Detail page: https://www.isobus.net/isobus/pGNAndSPN/9410?type=PGN. Signal-level enrichment via PR welcome  see CONTRIBUTING.md.";
CM_ SG_ 2566530048 High_Voltage_Energy_Storage_Syst "Generic 8-byte raw payload. Detail page: https://www.isobus.net/isobus/pGNAndSPN/9417?type=PGN. Signal-level enrichment via PR welcome  see CONTRIBUTING.md.";
CM_ SG_ 2566530304 High_Voltage_Energy_Storage_Syst "Generic 8-byte raw payload. Detail page: https://www.isobus.net/isobus/pGNAndSPN/9421?type=PGN. Signal-level enrichment via PR welcome  see CONTRIBUTING.md.";
CM_ SG_ 2566530560 High_Voltage_Energy_Storage_Syst "Generic 8-byte raw payload. Detail page: https://www.isobus.net/isobus/pGNAndSPN/9425?type=PGN. Signal-level enrichment via PR welcome  see CONTRIBUTING.md.";
CM_ SG_ 2566530816 High_Voltage_Energy_Storage_Pack "Generic 8-byte raw payload. Detail page: https://www.isobus.net/isobus/pGNAndSPN/9441?type=PGN. Signal-level enrichment via PR welcome  see CONTRIBUTING.md.";
CM_ SG_ 2566531072 High_Voltage_Energy_Storage_Pack "Generic 8-byte raw payload. Detail page: https://www.isobus.net/isobus/pGNAndSPN/9457?type=PGN. Signal-level enrichment via PR welcome  see CONTRIBUTING.md.";
CM_ SG_ 2566531328 High_Voltage_Energy_Storage_Pack "Generic 8-byte raw payload. Detail page: https://www.isobus.net/isobus/pGNAndSPN/9473?type=PGN. Signal-level enrichment via PR welcome  see CONTRIBUTING.md.";
CM_ SG_ 2566531584 High_Voltage_Energy_Storage_Pack "Generic 8-byte raw payload. Detail page: https://www.isobus.net/isobus/pGNAndSPN/9489?type=PGN. Signal-level enrichment via PR welcome  see CONTRIBUTING.md.";
CM_ SG_ 2566531840 High_Voltage_Energy_Storage_Pack "Generic 8-byte raw payload. Detail page: https://www.isobus.net/isobus/pGNAndSPN/9505?type=PGN. Signal-level enrichment via PR welcome  see CONTRIBUTING.md.";
CM_ SG_ 2566532096 High_Voltage_Energy_Storage_Pack "Generic 8-byte raw payload. Detail page: https://www.isobus.net/isobus/pGNAndSPN/9521?type=PGN. Signal-level enrichment via PR welcome  see CONTRIBUTING.md.";
CM_ SG_ 2566532352 High_Voltage_Energy_Storage_Pack "Generic 8-byte raw payload. Detail page: https://www.isobus.net/isobus/pGNAndSPN/9537?type=PGN. Signal-level enrichment via PR welcome  see CONTRIBUTING.md.";
CM_ SG_ 2566532608 High_Voltage_Energy_Storage_Pack "Generic 8-byte raw payload. Detail page: https://www.isobus.net/isobus/pGNAndSPN/9553?type=PGN. Signal-level enrichment via PR welcome  see CONTRIBUTING.md.";
CM_ SG_ 2566532864 High_Voltage_Energy_Storage_Pack "Generic 8-byte raw payload. Detail page: https://www.isobus.net/isobus/pGNAndSPN/9569?type=PGN. Signal-level enrichment via PR welcome  see CONTRIBUTING.md.";
CM_ SG_ 2566533120 High_Voltage_Energy_Storage_Pack "Generic 8-byte raw payload. Detail page: https://www.isobus.net/isobus/pGNAndSPN/9585?type=PGN. Signal-level enrichment via PR welcome  see CONTRIBUTING.md.";
CM_ SG_ 2566533376 High_Voltage_Energy_Storage_Pack "Generic 8-byte raw payload. Detail page: https://www.isobus.net/isobus/pGNAndSPN/9601?type=PGN. Signal-level enrichment via PR welcome  see CONTRIBUTING.md.";
CM_ SG_ 2566533632 High_Voltage_Energy_Storage_Pack "Generic 8-byte raw payload. Detail page: https://www.isobus.net/isobus/pGNAndSPN/9617?type=PGN. Signal-level enrichment via PR welcome  see CONTRIBUTING.md.";
CM_ SG_ 2566533888 Multi_Color_Indicator_Lamp_Comma "Generic 8-byte raw payload. Detail page: https://www.isobus.net/isobus/pGNAndSPN/9631?type=PGN. Signal-level enrichment via PR welcome  see CONTRIBUTING.md.";
CM_ SG_ 2566534144 Multi_Color_Indicator_Lamp_Statu "Generic 8-byte raw payload. Detail page: https://www.isobus.net/isobus/pGNAndSPN/9647?type=PGN. Signal-level enrichment via PR welcome  see CONTRIBUTING.md.";
CM_ SG_ 2566534400 Refuse_Truck_Body_Information_Ra "Generic 8-byte raw payload. Detail page: https://www.isobus.net/isobus/pGNAndSPN/9652?type=PGN. Signal-level enrichment via PR welcome  see CONTRIBUTING.md.";
CM_ SG_ 2566534656 Engine_Fluid_Level_Pressure_14_R "Generic 8-byte raw payload. Detail page: https://www.isobus.net/isobus/pGNAndSPN/9656?type=PGN. Signal-level enrichment via PR welcome  see CONTRIBUTING.md.";
CM_ SG_ 2566534912 Well_Stimulation_Transmission_Co "Generic 8-byte raw payload. Detail page: https://www.isobus.net/isobus/pGNAndSPN/9663?type=PGN. Signal-level enrichment via PR welcome  see CONTRIBUTING.md.";
CM_ SG_ 2566535168 Well_Stimulation_Pump_Protection "Generic 8-byte raw payload. Detail page: https://www.isobus.net/isobus/pGNAndSPN/9671?type=PGN. Signal-level enrichment via PR welcome  see CONTRIBUTING.md.";
CM_ SG_ 2566535424 Well_Stimulation_Pump_Protection "Generic 8-byte raw payload. Detail page: https://www.isobus.net/isobus/pGNAndSPN/9678?type=PGN. Signal-level enrichment via PR welcome  see CONTRIBUTING.md.";
CM_ SG_ 2566535680 Electric_PTO_Drive_Engagement_1_ "Generic 8-byte raw payload. Detail page: https://www.isobus.net/isobus/pGNAndSPN/9686?type=PGN. Signal-level enrichment via PR welcome  see CONTRIBUTING.md.";
CM_ SG_ 2566535936 Electric_PTO_1_Information_RawPa "Generic 8-byte raw payload. Detail page: https://www.isobus.net/isobus/pGNAndSPN/9689?type=PGN. Signal-level enrichment via PR welcome  see CONTRIBUTING.md.";
CM_ SG_ 2566536192 Engine_Exhaust_O2_Sensor_Informa "Generic 8-byte raw payload. Detail page: https://www.isobus.net/isobus/pGNAndSPN/9693?type=PGN. Signal-level enrichment via PR welcome  see CONTRIBUTING.md.";
CM_ SG_ 2566536448 Gaseous_Fuel_Supply_Pressure_3_R "Generic 8-byte raw payload. Detail page: https://www.isobus.net/isobus/pGNAndSPN/9698?type=PGN. Signal-level enrichment via PR welcome  see CONTRIBUTING.md.";
CM_ SG_ 2566536704 Traffic_Signage_RawPayload "Generic 8-byte raw payload. Detail page: https://www.isobus.net/isobus/pGNAndSPN/9699?type=PGN. Signal-level enrichment via PR welcome  see CONTRIBUTING.md.";
CM_ SG_ 2566536960 Engine_Configuration_4_RawPayloa "Generic 8-byte raw payload. Detail page: https://www.isobus.net/isobus/pGNAndSPN/9701?type=PGN. Signal-level enrichment via PR welcome  see CONTRIBUTING.md.";
CM_ SG_ 2566537216 Electronic_Transmission_Controll "Generic 8-byte raw payload. Detail page: https://www.isobus.net/isobus/pGNAndSPN/9706?type=PGN. Signal-level enrichment via PR welcome  see CONTRIBUTING.md.";
CM_ SG_ 2566537472 Automated_Driving_System_Network "Generic 8-byte raw payload. Detail page: https://www.isobus.net/isobus/pGNAndSPN/9714?type=PGN. Signal-level enrichment via PR welcome  see CONTRIBUTING.md.";
CM_ SG_ 2566537728 Automated_Driving_System_Network "Generic 8-byte raw payload. Detail page: https://www.isobus.net/isobus/pGNAndSPN/9722?type=PGN. Signal-level enrichment via PR welcome  see CONTRIBUTING.md.";
CM_ SG_ 2566537984 Hybrid_or_EV_System_Inputs_2_Raw "Generic 8-byte raw payload. Detail page: https://www.isobus.net/isobus/pGNAndSPN/9723?type=PGN. Signal-level enrichment via PR welcome  see CONTRIBUTING.md.";
CM_ SG_ 2566538240 Engine_Speed_Load_Factor_Informa "Generic 8-byte raw payload. Detail page: https://www.isobus.net/isobus/pGNAndSPN/9725?type=PGN. Signal-level enrichment via PR welcome  see CONTRIBUTING.md.";
CM_ SG_ 2566538496 Generator_Trip_Energy_2_RawPaylo "Generic 8-byte raw payload. Detail page: https://www.isobus.net/isobus/pGNAndSPN/9726?type=PGN. Signal-level enrichment via PR welcome  see CONTRIBUTING.md.";
CM_ SG_ 2566538752 Security_System_Machine_Operatio "Generic 8-byte raw payload. Detail page: https://www.isobus.net/isobus/pGNAndSPN/9731?type=PGN. Signal-level enrichment via PR welcome  see CONTRIBUTING.md.";
CM_ SG_ 2566539008 Engine_Fuel_Actuator_Service_Mod "Generic 8-byte raw payload. Detail page: https://www.isobus.net/isobus/pGNAndSPN/9733?type=PGN. Signal-level enrichment via PR welcome  see CONTRIBUTING.md.";
CM_ SG_ 2566539264 Steering_Wheel_Controls_RawPaylo "Generic 8-byte raw payload. Detail page: https://www.isobus.net/isobus/pGNAndSPN/9740?type=PGN. Signal-level enrichment via PR welcome  see CONTRIBUTING.md.";
CM_ SG_ 2566539520 Park_Assist_RawPayload "Generic 8-byte raw payload. Detail page: https://www.isobus.net/isobus/pGNAndSPN/9742?type=PGN. Signal-level enrichment via PR welcome  see CONTRIBUTING.md.";
CM_ SG_ 2566539776 Extended_DTC_information_RawPayl "Generic 8-byte raw payload. Detail page: https://www.isobus.net/isobus/pGNAndSPN/9743?type=PGN. Signal-level enrichment via PR welcome  see CONTRIBUTING.md.";
CM_ SG_ 2566540032 Aftertreatment_2_SCR_Dosing_Syst "Generic 8-byte raw payload. Detail page: https://www.isobus.net/isobus/pGNAndSPN/9745?type=PGN. Signal-level enrichment via PR welcome  see CONTRIBUTING.md.";
CM_ SG_ 2566540288 Aftertreatment_1_SCR_Dosing_Syst "Generic 8-byte raw payload. Detail page: https://www.isobus.net/isobus/pGNAndSPN/9747?type=PGN. Signal-level enrichment via PR welcome  see CONTRIBUTING.md.";
CM_ SG_ 2566540544 EV_Economy_Information_RawPayloa "Generic 8-byte raw payload. Detail page: https://www.isobus.net/isobus/pGNAndSPN/9749?type=PGN. Signal-level enrichment via PR welcome  see CONTRIBUTING.md.";
CM_ SG_ 2566540800 Automated_Driving_System_Status_ "Generic 8-byte raw payload. Detail page: https://www.isobus.net/isobus/pGNAndSPN/9761?type=PGN. Signal-level enrichment via PR welcome  see CONTRIBUTING.md.";
CM_ SG_ 2566541056 Automated_Driving_System_Control "Generic 8-byte raw payload. Detail page: https://www.isobus.net/isobus/pGNAndSPN/9765?type=PGN. Signal-level enrichment via PR welcome  see CONTRIBUTING.md.";
CM_ SG_ 2566541312 Aftercooler_Valve_RawPayload "Generic 8-byte raw payload. Detail page: https://www.isobus.net/isobus/pGNAndSPN/9770?type=PGN. Signal-level enrichment via PR welcome  see CONTRIBUTING.md.";
CM_ SG_ 2566541568 Engine_Radiator_1_RawPayload "Generic 8-byte raw payload. Detail page: https://www.isobus.net/isobus/pGNAndSPN/9781?type=PGN. Signal-level enrichment via PR welcome  see CONTRIBUTING.md.";
CM_ SG_ 2566541824 Engine_Radiator_2_RawPayload "Generic 8-byte raw payload. Detail page: https://www.isobus.net/isobus/pGNAndSPN/9791?type=PGN. Signal-level enrichment via PR welcome  see CONTRIBUTING.md.";
CM_ SG_ 2566542080 Genset_Enclosure_Ventilation_Raw "Generic 8-byte raw payload. Detail page: https://www.isobus.net/isobus/pGNAndSPN/9795?type=PGN. Signal-level enrichment via PR welcome  see CONTRIBUTING.md.";
CM_ SG_ 2566542336 Heat_Exchanger_1_RawPayload "Generic 8-byte raw payload. Detail page: https://www.isobus.net/isobus/pGNAndSPN/9799?type=PGN. Signal-level enrichment via PR welcome  see CONTRIBUTING.md.";
CM_ SG_ 2566542592 Heat_Exchanger_2_RawPayload "Generic 8-byte raw payload. Detail page: https://www.isobus.net/isobus/pGNAndSPN/9803?type=PGN. Signal-level enrichment via PR welcome  see CONTRIBUTING.md.";
CM_ SG_ 2566542848 Heat_Exchanger_3_RawPayload "Generic 8-byte raw payload. Detail page: https://www.isobus.net/isobus/pGNAndSPN/9807?type=PGN. Signal-level enrichment via PR welcome  see CONTRIBUTING.md.";
CM_ SG_ 2566543104 Heat_Exchanger_4_RawPayload "Generic 8-byte raw payload. Detail page: https://www.isobus.net/isobus/pGNAndSPN/9811?type=PGN. Signal-level enrichment via PR welcome  see CONTRIBUTING.md.";
CM_ SG_ 2566543360 Engine_Exhaust_Gas_Heat_Exchange "Generic 8-byte raw payload. Detail page: https://www.isobus.net/isobus/pGNAndSPN/9814?type=PGN. Signal-level enrichment via PR welcome  see CONTRIBUTING.md.";
CM_ SG_ 2566543616 Genset_Enclosure_Ventilation_Lou "Generic 8-byte raw payload. Detail page: https://www.isobus.net/isobus/pGNAndSPN/9820?type=PGN. Signal-level enrichment via PR welcome  see CONTRIBUTING.md.";
CM_ SG_ 2566543872 Genset_External_Coolant_System_R "Generic 8-byte raw payload. Detail page: https://www.isobus.net/isobus/pGNAndSPN/9826?type=PGN. Signal-level enrichment via PR welcome  see CONTRIBUTING.md.";
CM_ SG_ 2566544128 EV_DC_Status_1_RawPayload "Generic 8-byte raw payload. Detail page: https://www.isobus.net/isobus/pGNAndSPN/9829?type=PGN. Signal-level enrichment via PR welcome  see CONTRIBUTING.md.";
CM_ SG_ 2566544384 EVSE_DC_Charging_Limits_3_RawPay "Generic 8-byte raw payload. Detail page: https://www.isobus.net/isobus/pGNAndSPN/9830?type=PGN. Signal-level enrichment via PR welcome  see CONTRIBUTING.md.";
CM_ SG_ 2566544640 EVSE_Power_Max_Schedule_RawPaylo "Generic 8-byte raw payload. Detail page: https://www.isobus.net/isobus/pGNAndSPN/9837?type=PGN. Signal-level enrichment via PR welcome  see CONTRIBUTING.md.";
CM_ SG_ 2566544896 EV_Charge_Profile_RawPayload "Generic 8-byte raw payload. Detail page: https://www.isobus.net/isobus/pGNAndSPN/9840?type=PGN. Signal-level enrichment via PR welcome  see CONTRIBUTING.md.";
CM_ SG_ 2566545152 EV_DC_Charging_Limits_2_RawPaylo "Generic 8-byte raw payload. Detail page: https://www.isobus.net/isobus/pGNAndSPN/9844?type=PGN. Signal-level enrichment via PR welcome  see CONTRIBUTING.md.";
CM_ SG_ 2566545408 EV_DC_Charging_In_Progress_RawPa "Generic 8-byte raw payload. Detail page: https://www.isobus.net/isobus/pGNAndSPN/9849?type=PGN. Signal-level enrichment via PR welcome  see CONTRIBUTING.md.";
CM_ SG_ 2566545920 Lighting_Data_2_RawPayload "Generic 8-byte raw payload. Detail page: https://www.isobus.net/isobus/pGNAndSPN/9850?type=PGN. Signal-level enrichment via PR welcome  see CONTRIBUTING.md.";
CM_ SG_ 2566546176 Lighting_Command_2_RawPayload "Generic 8-byte raw payload. Detail page: https://www.isobus.net/isobus/pGNAndSPN/9852?type=PGN. Signal-level enrichment via PR welcome  see CONTRIBUTING.md.";
CM_ SG_ 2566546432 Aftertreatment_System_Informatio "Generic 8-byte raw payload. Detail page: https://www.isobus.net/isobus/pGNAndSPN/9854?type=PGN. Signal-level enrichment via PR welcome  see CONTRIBUTING.md.";
CM_ SG_ 2566546688 Aftertreatment_System_Informatio "Generic 8-byte raw payload. Detail page: https://www.isobus.net/isobus/pGNAndSPN/9856?type=PGN. Signal-level enrichment via PR welcome  see CONTRIBUTING.md.";
CM_ SG_ 2566546944 Aftertreatment_System_Informatio "Generic 8-byte raw payload. Detail page: https://www.isobus.net/isobus/pGNAndSPN/9858?type=PGN. Signal-level enrichment via PR welcome  see CONTRIBUTING.md.";
CM_ SG_ 2566547200 Fluid_Resistance_1_RawPayload "Generic 8-byte raw payload. Detail page: https://www.isobus.net/isobus/pGNAndSPN/9860?type=PGN. Signal-level enrichment via PR welcome  see CONTRIBUTING.md.";
CM_ SG_ 2566547456 Power_Converter_2_Isolation_Inte "Generic 8-byte raw payload. Detail page: https://www.isobus.net/isobus/pGNAndSPN/9864?type=PGN. Signal-level enrichment via PR welcome  see CONTRIBUTING.md.";
CM_ SG_ 2566547712 Power_Converter_1_Isolation_Inte "Generic 8-byte raw payload. Detail page: https://www.isobus.net/isobus/pGNAndSPN/9868?type=PGN. Signal-level enrichment via PR welcome  see CONTRIBUTING.md.";
CM_ SG_ 2566547968 Power_Converter_2_Limits_Request "Generic 8-byte raw payload. Detail page: https://www.isobus.net/isobus/pGNAndSPN/9874?type=PGN. Signal-level enrichment via PR welcome  see CONTRIBUTING.md.";
CM_ SG_ 2566548224 Power_Converter_2_Limits_Request "Generic 8-byte raw payload. Detail page: https://www.isobus.net/isobus/pGNAndSPN/9880?type=PGN. Signal-level enrichment via PR welcome  see CONTRIBUTING.md.";
CM_ SG_ 2566548480 Power_Converter_2_Limits_Request "Generic 8-byte raw payload. Detail page: https://www.isobus.net/isobus/pGNAndSPN/9886?type=PGN. Signal-level enrichment via PR welcome  see CONTRIBUTING.md.";
CM_ SG_ 2566548736 Power_Converter_1_Limits_Request "Generic 8-byte raw payload. Detail page: https://www.isobus.net/isobus/pGNAndSPN/9892?type=PGN. Signal-level enrichment via PR welcome  see CONTRIBUTING.md.";
CM_ SG_ 2566548992 Power_Converter_1_Limits_Request "Generic 8-byte raw payload. Detail page: https://www.isobus.net/isobus/pGNAndSPN/9898?type=PGN. Signal-level enrichment via PR welcome  see CONTRIBUTING.md.";
CM_ SG_ 2566549248 Power_Converter_1_Limits_Request "Generic 8-byte raw payload. Detail page: https://www.isobus.net/isobus/pGNAndSPN/9904?type=PGN. Signal-level enrichment via PR welcome  see CONTRIBUTING.md.";
CM_ SG_ 2566549504 Inverter_1_Lifetime_Data_RawPayl "Generic 8-byte raw payload. Detail page: https://www.isobus.net/isobus/pGNAndSPN/9908?type=PGN. Signal-level enrichment via PR welcome  see CONTRIBUTING.md.";
CM_ SG_ 2566549760 Inverter_2_Lifetime_Data_RawPayl "Generic 8-byte raw payload. Detail page: https://www.isobus.net/isobus/pGNAndSPN/9912?type=PGN. Signal-level enrichment via PR welcome  see CONTRIBUTING.md.";
CM_ SG_ 2566550016 Power_Converter_2_Active_Power_L "Generic 8-byte raw payload. Detail page: https://www.isobus.net/isobus/pGNAndSPN/9930?type=PGN. Signal-level enrichment via PR welcome  see CONTRIBUTING.md.";
CM_ SG_ 2566550272 Power_Converter_1_Active_Power_L "Generic 8-byte raw payload. Detail page: https://www.isobus.net/isobus/pGNAndSPN/9948?type=PGN. Signal-level enrichment via PR welcome  see CONTRIBUTING.md.";
CM_ SG_ 2566550528 Power_Converter_2_Reference_1_Ra "Generic 8-byte raw payload. Detail page: https://www.isobus.net/isobus/pGNAndSPN/9953?type=PGN. Signal-level enrichment via PR welcome  see CONTRIBUTING.md.";
CM_ SG_ 2566550784 Power_Converter_2_Reference_2_Ra "Generic 8-byte raw payload. Detail page: https://www.isobus.net/isobus/pGNAndSPN/9957?type=PGN. Signal-level enrichment via PR welcome  see CONTRIBUTING.md.";
CM_ SG_ 2566551040 Power_Converter_2_Temperature_Ra "Generic 8-byte raw payload. Detail page: https://www.isobus.net/isobus/pGNAndSPN/9961?type=PGN. Signal-level enrichment via PR welcome  see CONTRIBUTING.md.";
CM_ SG_ 2566551296 Power_Converter_1_Temperature_Ra "Generic 8-byte raw payload. Detail page: https://www.isobus.net/isobus/pGNAndSPN/9965?type=PGN. Signal-level enrichment via PR welcome  see CONTRIBUTING.md.";
CM_ SG_ 2566551552 Power_Converter_1_Reference_2_Ra "Generic 8-byte raw payload. Detail page: https://www.isobus.net/isobus/pGNAndSPN/9969?type=PGN. Signal-level enrichment via PR welcome  see CONTRIBUTING.md.";
CM_ SG_ 2566551808 Power_Converter_1_Reference_1_Ra "Generic 8-byte raw payload. Detail page: https://www.isobus.net/isobus/pGNAndSPN/9974?type=PGN. Signal-level enrichment via PR welcome  see CONTRIBUTING.md.";
CM_ SG_ 2566552064 Power_Converter_1_Phase_Current_ "Generic 8-byte raw payload. Detail page: https://www.isobus.net/isobus/pGNAndSPN/9977?type=PGN. Signal-level enrichment via PR welcome  see CONTRIBUTING.md.";
CM_ SG_ 2566552320 Power_Converter_2_Phase_Current_ "Generic 8-byte raw payload. Detail page: https://www.isobus.net/isobus/pGNAndSPN/9980?type=PGN. Signal-level enrichment via PR welcome  see CONTRIBUTING.md.";
CM_ SG_ 2566552576 Power_Converter_1_Phase_Voltage_ "Generic 8-byte raw payload. Detail page: https://www.isobus.net/isobus/pGNAndSPN/9983?type=PGN. Signal-level enrichment via PR welcome  see CONTRIBUTING.md.";
CM_ SG_ 2566552832 Power_Converter_2_Phase_Voltage_ "Generic 8-byte raw payload. Detail page: https://www.isobus.net/isobus/pGNAndSPN/9986?type=PGN. Signal-level enrichment via PR welcome  see CONTRIBUTING.md.";
CM_ SG_ 2566553088 Power_Converter_Power_Module_Swi "Generic 8-byte raw payload. Detail page: https://www.isobus.net/isobus/pGNAndSPN/9992?type=PGN. Signal-level enrichment via PR welcome  see CONTRIBUTING.md.";
CM_ SG_ 2566553344 Power_Converter_1_Power_Module_S "Generic 8-byte raw payload. Detail page: https://www.isobus.net/isobus/pGNAndSPN/9995?type=PGN. Signal-level enrichment via PR welcome  see CONTRIBUTING.md.";
CM_ SG_ 2566553600 Power_Converter_2_Power_Module_S "Generic 8-byte raw payload. Detail page: https://www.isobus.net/isobus/pGNAndSPN/9998?type=PGN. Signal-level enrichment via PR welcome  see CONTRIBUTING.md.";
CM_ SG_ 2566553856 Power_Converter_Totals_1_RawPayl "Generic 8-byte raw payload. Detail page: https://www.isobus.net/isobus/pGNAndSPN/10002?type=PGN. Signal-level enrichment via PR welcome  see CONTRIBUTING.md.";
CM_ SG_ 2566554112 Transformer_Temperatures_RawPayl "Generic 8-byte raw payload. Detail page: https://www.isobus.net/isobus/pGNAndSPN/10008?type=PGN. Signal-level enrichment via PR welcome  see CONTRIBUTING.md.";
CM_ SG_ 2566554368 Electrified_Accessory_Engine_Coo "Generic 8-byte raw payload. Detail page: https://www.isobus.net/isobus/pGNAndSPN/10016?type=PGN. Signal-level enrichment via PR welcome  see CONTRIBUTING.md.";
CM_ SG_ 2566554624 High_Voltage_Energy_Storage_Pack "Generic 8-byte raw payload. Detail page: https://www.isobus.net/isobus/pGNAndSPN/10022?type=PGN. Signal-level enrichment via PR welcome  see CONTRIBUTING.md.";
CM_ SG_ 2566554880 High_Voltage_Energy_Storage_Pack "Generic 8-byte raw payload. Detail page: https://www.isobus.net/isobus/pGNAndSPN/10032?type=PGN. Signal-level enrichment via PR welcome  see CONTRIBUTING.md.";
CM_ SG_ 2566555136 High_Voltage_Energy_Storage_Pack "Generic 8-byte raw payload. Detail page: https://www.isobus.net/isobus/pGNAndSPN/10038?type=PGN. Signal-level enrichment via PR welcome  see CONTRIBUTING.md.";
CM_ SG_ 2566555392 High_Voltage_Energy_Storage_Pack "Generic 8-byte raw payload. Detail page: https://www.isobus.net/isobus/pGNAndSPN/10048?type=PGN. Signal-level enrichment via PR welcome  see CONTRIBUTING.md.";
CM_ SG_ 2566555648 High_Voltage_Energy_Storage_Pack "Generic 8-byte raw payload. Detail page: https://www.isobus.net/isobus/pGNAndSPN/10054?type=PGN. Signal-level enrichment via PR welcome  see CONTRIBUTING.md.";
CM_ SG_ 2566555904 High_Voltage_Energy_Storage_Pack "Generic 8-byte raw payload. Detail page: https://www.isobus.net/isobus/pGNAndSPN/10064?type=PGN. Signal-level enrichment via PR welcome  see CONTRIBUTING.md.";
CM_ SG_ 2566556160 High_Voltage_Energy_Storage_Pack "Generic 8-byte raw payload. Detail page: https://www.isobus.net/isobus/pGNAndSPN/10070?type=PGN. Signal-level enrichment via PR welcome  see CONTRIBUTING.md.";
CM_ SG_ 2566556416 High_Voltage_Energy_Storage_Pack "Generic 8-byte raw payload. Detail page: https://www.isobus.net/isobus/pGNAndSPN/10080?type=PGN. Signal-level enrichment via PR welcome  see CONTRIBUTING.md.";
CM_ SG_ 2566556672 High_Voltage_Energy_Storage_Pack "Generic 8-byte raw payload. Detail page: https://www.isobus.net/isobus/pGNAndSPN/10086?type=PGN. Signal-level enrichment via PR welcome  see CONTRIBUTING.md.";
CM_ SG_ 2566556928 High_Voltage_Energy_Storage_Pack "Generic 8-byte raw payload. Detail page: https://www.isobus.net/isobus/pGNAndSPN/10096?type=PGN. Signal-level enrichment via PR welcome  see CONTRIBUTING.md.";
CM_ SG_ 2566557184 High_Voltage_Energy_Storage_Pack "Generic 8-byte raw payload. Detail page: https://www.isobus.net/isobus/pGNAndSPN/10102?type=PGN. Signal-level enrichment via PR welcome  see CONTRIBUTING.md.";
CM_ SG_ 2566557440 High_Voltage_Energy_Storage_Pack "Generic 8-byte raw payload. Detail page: https://www.isobus.net/isobus/pGNAndSPN/10112?type=PGN. Signal-level enrichment via PR welcome  see CONTRIBUTING.md.";
CM_ SG_ 2566557696 High_Voltage_Energy_Storage_Pack "Generic 8-byte raw payload. Detail page: https://www.isobus.net/isobus/pGNAndSPN/10118?type=PGN. Signal-level enrichment via PR welcome  see CONTRIBUTING.md.";
CM_ SG_ 2566557952 High_Voltage_Energy_Storage_Pack "Generic 8-byte raw payload. Detail page: https://www.isobus.net/isobus/pGNAndSPN/10128?type=PGN. Signal-level enrichment via PR welcome  see CONTRIBUTING.md.";
CM_ SG_ 2566558208 High_Voltage_Energy_Storage_Pack "Generic 8-byte raw payload. Detail page: https://www.isobus.net/isobus/pGNAndSPN/10134?type=PGN. Signal-level enrichment via PR welcome  see CONTRIBUTING.md.";
CM_ SG_ 2566558464 High_Voltage_Energy_Storage_Pack "Generic 8-byte raw payload. Detail page: https://www.isobus.net/isobus/pGNAndSPN/10144?type=PGN. Signal-level enrichment via PR welcome  see CONTRIBUTING.md.";
CM_ SG_ 2566558720 High_Voltage_Energy_Storage_Pack "Generic 8-byte raw payload. Detail page: https://www.isobus.net/isobus/pGNAndSPN/10150?type=PGN. Signal-level enrichment via PR welcome  see CONTRIBUTING.md.";
CM_ SG_ 2566558976 High_Voltage_Energy_Storage_Pack "Generic 8-byte raw payload. Detail page: https://www.isobus.net/isobus/pGNAndSPN/10160?type=PGN. Signal-level enrichment via PR welcome  see CONTRIBUTING.md.";
CM_ SG_ 2566559232 High_Voltage_Energy_Storage_Pack "Generic 8-byte raw payload. Detail page: https://www.isobus.net/isobus/pGNAndSPN/10166?type=PGN. Signal-level enrichment via PR welcome  see CONTRIBUTING.md.";
CM_ SG_ 2566559488 High_Voltage_Energy_Storage_Pack "Generic 8-byte raw payload. Detail page: https://www.isobus.net/isobus/pGNAndSPN/10176?type=PGN. Signal-level enrichment via PR welcome  see CONTRIBUTING.md.";
CM_ SG_ 2566559744 High_Voltage_Energy_Storage_Pack "Generic 8-byte raw payload. Detail page: https://www.isobus.net/isobus/pGNAndSPN/10182?type=PGN. Signal-level enrichment via PR welcome  see CONTRIBUTING.md.";
CM_ SG_ 2566560000 High_Voltage_Energy_Storage_Pack "Generic 8-byte raw payload. Detail page: https://www.isobus.net/isobus/pGNAndSPN/10192?type=PGN. Signal-level enrichment via PR welcome  see CONTRIBUTING.md.";
CM_ SG_ 2566560256 High_Voltage_Energy_Storage_Pack "Generic 8-byte raw payload. Detail page: https://www.isobus.net/isobus/pGNAndSPN/10198?type=PGN. Signal-level enrichment via PR welcome  see CONTRIBUTING.md.";
CM_ SG_ 2566560512 High_Voltage_Energy_Storage_Pack "Generic 8-byte raw payload. Detail page: https://www.isobus.net/isobus/pGNAndSPN/10208?type=PGN. Signal-level enrichment via PR welcome  see CONTRIBUTING.md.";
CM_ SG_ 2566560768 High_Voltage_Energy_Storage_Pack "Generic 8-byte raw payload. Detail page: https://www.isobus.net/isobus/pGNAndSPN/10214?type=PGN. Signal-level enrichment via PR welcome  see CONTRIBUTING.md.";
CM_ SG_ 2566561024 High_Voltage_Energy_Storage_Pack "Generic 8-byte raw payload. Detail page: https://www.isobus.net/isobus/pGNAndSPN/10224?type=PGN. Signal-level enrichment via PR welcome  see CONTRIBUTING.md.";
CM_ SG_ 2566561280 High_Voltage_Energy_Storage_Pack "Generic 8-byte raw payload. Detail page: https://www.isobus.net/isobus/pGNAndSPN/10230?type=PGN. Signal-level enrichment via PR welcome  see CONTRIBUTING.md.";
CM_ SG_ 2566561536 High_Voltage_Energy_Storage_Pack "Generic 8-byte raw payload. Detail page: https://www.isobus.net/isobus/pGNAndSPN/10240?type=PGN. Signal-level enrichment via PR welcome  see CONTRIBUTING.md.";
CM_ SG_ 2566561792 High_Voltage_Energy_Storage_Pack "Generic 8-byte raw payload. Detail page: https://www.isobus.net/isobus/pGNAndSPN/10246?type=PGN. Signal-level enrichment via PR welcome  see CONTRIBUTING.md.";
CM_ SG_ 2566562048 High_Voltage_Energy_Storage_Pack "Generic 8-byte raw payload. Detail page: https://www.isobus.net/isobus/pGNAndSPN/10256?type=PGN. Signal-level enrichment via PR welcome  see CONTRIBUTING.md.";
CM_ SG_ 2566562304 High_Voltage_Energy_Storage_Pack "Generic 8-byte raw payload. Detail page: https://www.isobus.net/isobus/pGNAndSPN/10262?type=PGN. Signal-level enrichment via PR welcome  see CONTRIBUTING.md.";
CM_ SG_ 2566562560 High_Voltage_Energy_Storage_Pack "Generic 8-byte raw payload. Detail page: https://www.isobus.net/isobus/pGNAndSPN/10272?type=PGN. Signal-level enrichment via PR welcome  see CONTRIBUTING.md.";
CM_ SG_ 2566562816 Automated_Driving_System_Control "Generic 8-byte raw payload. Detail page: https://www.isobus.net/isobus/pGNAndSPN/10277?type=PGN. Signal-level enrichment via PR welcome  see CONTRIBUTING.md.";
CM_ SG_ 2566563072 Dual_Fuel_Mode_3_RawPayload "Generic 8-byte raw payload. Detail page: https://www.isobus.net/isobus/pGNAndSPN/10280?type=PGN. Signal-level enrichment via PR welcome  see CONTRIBUTING.md.";
CM_ SG_ 2566563328 Dual_Fuel_Mode_2_RawPayload "Generic 8-byte raw payload. Detail page: https://www.isobus.net/isobus/pGNAndSPN/10282?type=PGN. Signal-level enrichment via PR welcome  see CONTRIBUTING.md.";
CM_ SG_ 2566563584 Dual_Fuel_Mode_1_RawPayload "Generic 8-byte raw payload. Detail page: https://www.isobus.net/isobus/pGNAndSPN/10287?type=PGN. Signal-level enrichment via PR welcome  see CONTRIBUTING.md.";
CM_ SG_ 2566563840 Transmission_1_History_RawPayloa "Generic 8-byte raw payload. Detail page: https://www.isobus.net/isobus/pGNAndSPN/10290?type=PGN. Signal-level enrichment via PR welcome  see CONTRIBUTING.md.";
CM_ SG_ 2566564096 Transmission_Shaft_Twist_Informa "Generic 8-byte raw payload. Detail page: https://www.isobus.net/isobus/pGNAndSPN/10293?type=PGN. Signal-level enrichment via PR welcome  see CONTRIBUTING.md.";
CM_ SG_ 2566564352 Electronic_Auxiliary_Transmissio "Generic 8-byte raw payload. Detail page: https://www.isobus.net/isobus/pGNAndSPN/10295?type=PGN. Signal-level enrichment via PR welcome  see CONTRIBUTING.md.";
CM_ SG_ 2566564608 High_Voltage_Energy_Storage_Pack "Generic 8-byte raw payload. Detail page: https://www.isobus.net/isobus/pGNAndSPN/10305?type=PGN. Signal-level enrichment via PR welcome  see CONTRIBUTING.md.";
CM_ SG_ 2566564864 High_Voltage_Energy_Storage_Pack "Generic 8-byte raw payload. Detail page: https://www.isobus.net/isobus/pGNAndSPN/10311?type=PGN. Signal-level enrichment via PR welcome  see CONTRIBUTING.md.";
CM_ SG_ 2566565120 High_Voltage_Energy_Storage_Pack "Generic 8-byte raw payload. Detail page: https://www.isobus.net/isobus/pGNAndSPN/10321?type=PGN. Signal-level enrichment via PR welcome  see CONTRIBUTING.md.";
CM_ SG_ 2566565376 High_Voltage_Energy_Storage_Pack "Generic 8-byte raw payload. Detail page: https://www.isobus.net/isobus/pGNAndSPN/10327?type=PGN. Signal-level enrichment via PR welcome  see CONTRIBUTING.md.";
CM_ SG_ 2566565632 High_Voltage_Energy_Storage_Pack "Generic 8-byte raw payload. Detail page: https://www.isobus.net/isobus/pGNAndSPN/10337?type=PGN. Signal-level enrichment via PR welcome  see CONTRIBUTING.md.";
CM_ SG_ 2566565888 High_Voltage_Energy_Storage_Pack "Generic 8-byte raw payload. Detail page: https://www.isobus.net/isobus/pGNAndSPN/10343?type=PGN. Signal-level enrichment via PR welcome  see CONTRIBUTING.md.";
CM_ SG_ 2566566144 High_Voltage_Energy_Storage_Pack "Generic 8-byte raw payload. Detail page: https://www.isobus.net/isobus/pGNAndSPN/10353?type=PGN. Signal-level enrichment via PR welcome  see CONTRIBUTING.md.";
CM_ SG_ 2566566400 High_Voltage_Energy_Storage_Pack "Generic 8-byte raw payload. Detail page: https://www.isobus.net/isobus/pGNAndSPN/10359?type=PGN. Signal-level enrichment via PR welcome  see CONTRIBUTING.md.";
CM_ SG_ 2566566656 AUTOSAR_Time_Synchronization_Raw "Generic 8-byte raw payload. Detail page: https://www.isobus.net/isobus/pGNAndSPN/10360?type=PGN. Signal-level enrichment via PR welcome  see CONTRIBUTING.md.";
CM_ SG_ 2566566912 EV_DC_Charging_Limits_1_RawPaylo "Generic 8-byte raw payload. Detail page: https://www.isobus.net/isobus/pGNAndSPN/10364?type=PGN. Signal-level enrichment via PR welcome  see CONTRIBUTING.md.";
CM_ SG_ 2566567168 EVSE_DC_Charging_Limits_1_RawPay "Generic 8-byte raw payload. Detail page: https://www.isobus.net/isobus/pGNAndSPN/10368?type=PGN. Signal-level enrichment via PR welcome  see CONTRIBUTING.md.";
CM_ SG_ 2566567424 EVSE_DC_Charging_Limits_2_RawPay "Generic 8-byte raw payload. Detail page: https://www.isobus.net/isobus/pGNAndSPN/10372?type=PGN. Signal-level enrichment via PR welcome  see CONTRIBUTING.md.";
CM_ SG_ 2566567680 EV_DC_Charging_Target_RawPayload "Generic 8-byte raw payload. Detail page: https://www.isobus.net/isobus/pGNAndSPN/10376?type=PGN. Signal-level enrichment via PR welcome  see CONTRIBUTING.md.";
CM_ SG_ 2566567936 EVSE_DC_Status_1_RawPayload "Generic 8-byte raw payload. Detail page: https://www.isobus.net/isobus/pGNAndSPN/10386?type=PGN. Signal-level enrichment via PR welcome  see CONTRIBUTING.md.";
CM_ SG_ 2566568192 EVSE_1_Contactor_Cmd_1_RawPayloa "Generic 8-byte raw payload. Detail page: https://www.isobus.net/isobus/pGNAndSPN/10387?type=PGN. Signal-level enrichment via PR welcome  see CONTRIBUTING.md.";
CM_ SG_ 2566568448 EVSE_1_Contactor_Status_1_RawPay "Generic 8-byte raw payload. Detail page: https://www.isobus.net/isobus/pGNAndSPN/10390?type=PGN. Signal-level enrichment via PR welcome  see CONTRIBUTING.md.";
CM_ SG_ 2566568704 Direct_Lamp_Control_Command_3_Ra "Generic 8-byte raw payload. Detail page: https://www.isobus.net/isobus/pGNAndSPN/10392?type=PGN. Signal-level enrichment via PR welcome  see CONTRIBUTING.md.";
CM_ SG_ 2566568960 Direct_Lamp_Control_Data_3_RawPa "Generic 8-byte raw payload. Detail page: https://www.isobus.net/isobus/pGNAndSPN/10394?type=PGN. Signal-level enrichment via PR welcome  see CONTRIBUTING.md.";
CM_ SG_ 2566569216 Motor_Generator_1_Lifetime_Data_ "Generic 8-byte raw payload. Detail page: https://www.isobus.net/isobus/pGNAndSPN/10398?type=PGN. Signal-level enrichment via PR welcome  see CONTRIBUTING.md.";
CM_ SG_ 2566569472 Motor_Generator_2_Lifetime_Data_ "Generic 8-byte raw payload. Detail page: https://www.isobus.net/isobus/pGNAndSPN/10402?type=PGN. Signal-level enrichment via PR welcome  see CONTRIBUTING.md.";
CM_ SG_ 2566569728 Motor_Generator_3_Lifetime_Data_ "Generic 8-byte raw payload. Detail page: https://www.isobus.net/isobus/pGNAndSPN/10406?type=PGN. Signal-level enrichment via PR welcome  see CONTRIBUTING.md.";
CM_ SG_ 2566569984 Motor_Generator_4_Lifetime_Data_ "Generic 8-byte raw payload. Detail page: https://www.isobus.net/isobus/pGNAndSPN/10410?type=PGN. Signal-level enrichment via PR welcome  see CONTRIBUTING.md.";
CM_ SG_ 2566570240 Motor_Generator_5_Lifetime_Data_ "Generic 8-byte raw payload. Detail page: https://www.isobus.net/isobus/pGNAndSPN/10414?type=PGN. Signal-level enrichment via PR welcome  see CONTRIBUTING.md.";
CM_ SG_ 2566570496 Motor_Generator_6_Lifetime_Data_ "Generic 8-byte raw payload. Detail page: https://www.isobus.net/isobus/pGNAndSPN/10418?type=PGN. Signal-level enrichment via PR welcome  see CONTRIBUTING.md.";
CM_ SG_ 2566570752 Air_Supply_Pressure_3_RawPayload "Generic 8-byte raw payload. Detail page: https://www.isobus.net/isobus/pGNAndSPN/10420?type=PGN. Signal-level enrichment via PR welcome  see CONTRIBUTING.md.";
CM_ SG_ 2566571008 EVSE_AC_Supply_Voltage_RawPayloa "Generic 8-byte raw payload. Detail page: https://www.isobus.net/isobus/pGNAndSPN/10423?type=PGN. Signal-level enrichment via PR welcome  see CONTRIBUTING.md.";
CM_ SG_ 2566571264 EVSE_AC_3_Phase_Load_RawPayload "Generic 8-byte raw payload. Detail page: https://www.isobus.net/isobus/pGNAndSPN/10427?type=PGN. Signal-level enrichment via PR welcome  see CONTRIBUTING.md.";
CM_ SG_ 2566571520 Electronic_Retarder_Controller_3 "Generic 8-byte raw payload. Detail page: https://www.isobus.net/isobus/pGNAndSPN/10429?type=PGN. Signal-level enrichment via PR welcome  see CONTRIBUTING.md.";
CM_ SG_ 2566572032 Electronic_Transmission_Controll "Generic 8-byte raw payload. Detail page: https://www.isobus.net/isobus/pGNAndSPN/10434?type=PGN. Signal-level enrichment via PR welcome  see CONTRIBUTING.md.";
CM_ SG_ 2566572800 Collision_Avoidance_System_4_Raw "Generic 8-byte raw payload. Detail page: https://www.isobus.net/isobus/pGNAndSPN/10435?type=PGN. Signal-level enrichment via PR welcome  see CONTRIBUTING.md.";
CM_ SG_ 2566573056 Collision_Avoidance_System_3_Raw "Generic 8-byte raw payload. Detail page: https://www.isobus.net/isobus/pGNAndSPN/10436?type=PGN. Signal-level enrichment via PR welcome  see CONTRIBUTING.md.";
CM_ SG_ 2566573312 Aftertreatment_1_SCR_Exhaust_Gas "Generic 8-byte raw payload. Detail page: https://www.isobus.net/isobus/pGNAndSPN/10438?type=PGN. Signal-level enrichment via PR welcome  see CONTRIBUTING.md.";
CM_ SG_ 2566573568 PTO_Information_2_RawPayload "Generic 8-byte raw payload. Detail page: https://www.isobus.net/isobus/pGNAndSPN/10440?type=PGN. Signal-level enrichment via PR welcome  see CONTRIBUTING.md.";
CM_ SG_ 2566573824 EVCC_Diagnostic_Data_1_RawPayloa "Generic 8-byte raw payload. Detail page: https://www.isobus.net/isobus/pGNAndSPN/10449?type=PGN. Signal-level enrichment via PR welcome  see CONTRIBUTING.md.";
CM_ SG_ 2566574080 Cab_Door_Control_2_RawPayload "Generic 8-byte raw payload. Detail page: https://www.isobus.net/isobus/pGNAndSPN/10452?type=PGN. Signal-level enrichment via PR welcome  see CONTRIBUTING.md.";
CM_ SG_ 2566574336 Engine_Average_Information_2_Raw "Generic 8-byte raw payload. Detail page: https://www.isobus.net/isobus/pGNAndSPN/10455?type=PGN. Signal-level enrichment via PR welcome  see CONTRIBUTING.md.";
CM_ SG_ 2566574592 Turbocharger_Information_9_RawPa "Generic 8-byte raw payload. Detail page: https://www.isobus.net/isobus/pGNAndSPN/10459?type=PGN. Signal-level enrichment via PR welcome  see CONTRIBUTING.md.";
CM_ SG_ 2566574848 Automated_Driving_System_Control "Generic 8-byte raw payload. Detail page: https://www.isobus.net/isobus/pGNAndSPN/10464?type=PGN. Signal-level enrichment via PR welcome  see CONTRIBUTING.md.";
CM_ SG_ 2566575104 EVSE_AC_Status_2_RawPayload "Generic 8-byte raw payload. Detail page: https://www.isobus.net/isobus/pGNAndSPN/10466?type=PGN. Signal-level enrichment via PR welcome  see CONTRIBUTING.md.";
CM_ SG_ 2566575360 EVSE_AC_Status_1_RawPayload "Generic 8-byte raw payload. Detail page: https://www.isobus.net/isobus/pGNAndSPN/10470?type=PGN. Signal-level enrichment via PR welcome  see CONTRIBUTING.md.";
CM_ SG_ 2566575616 EVSE_Status_1_RawPayload "Generic 8-byte raw payload. Detail page: https://www.isobus.net/isobus/pGNAndSPN/10478?type=PGN. Signal-level enrichment via PR welcome  see CONTRIBUTING.md.";
CM_ SG_ 2566575872 Object_Detection_Message_1_1_Raw "Generic 8-byte raw payload. Detail page: https://www.isobus.net/isobus/pGNAndSPN/10479?type=PGN. Signal-level enrichment via PR welcome  see CONTRIBUTING.md.";
CM_ SG_ 2566576128 Object_Detection_Message_2_1_Raw "Generic 8-byte raw payload. Detail page: https://www.isobus.net/isobus/pGNAndSPN/10480?type=PGN. Signal-level enrichment via PR welcome  see CONTRIBUTING.md.";
CM_ SG_ 2566576384 Object_Detection_Message_2_2_Raw "Generic 8-byte raw payload. Detail page: https://www.isobus.net/isobus/pGNAndSPN/10481?type=PGN. Signal-level enrichment via PR welcome  see CONTRIBUTING.md.";
CM_ SG_ 2566576640 Object_Detection_Message_2_3_Raw "Generic 8-byte raw payload. Detail page: https://www.isobus.net/isobus/pGNAndSPN/10482?type=PGN. Signal-level enrichment via PR welcome  see CONTRIBUTING.md.";
CM_ SG_ 2566576896 Object_Detection_Message_2_4_Raw "Generic 8-byte raw payload. Detail page: https://www.isobus.net/isobus/pGNAndSPN/10483?type=PGN. Signal-level enrichment via PR welcome  see CONTRIBUTING.md.";
CM_ SG_ 2566577152 Object_Detection_Message_2_5_Raw "Generic 8-byte raw payload. Detail page: https://www.isobus.net/isobus/pGNAndSPN/10484?type=PGN. Signal-level enrichment via PR welcome  see CONTRIBUTING.md.";
CM_ SG_ 2566577408 Object_Detection_Message_2_6_Raw "Generic 8-byte raw payload. Detail page: https://www.isobus.net/isobus/pGNAndSPN/10485?type=PGN. Signal-level enrichment via PR welcome  see CONTRIBUTING.md.";
CM_ SG_ 2566577664 Object_Detection_Message_2_7_Raw "Generic 8-byte raw payload. Detail page: https://www.isobus.net/isobus/pGNAndSPN/10486?type=PGN. Signal-level enrichment via PR welcome  see CONTRIBUTING.md.";
CM_ SG_ 2566577920 Object_Detection_Message_2_8_Raw "Generic 8-byte raw payload. Detail page: https://www.isobus.net/isobus/pGNAndSPN/10487?type=PGN. Signal-level enrichment via PR welcome  see CONTRIBUTING.md.";
CM_ SG_ 2566578176 Object_Detection_Message_2_9_Raw "Generic 8-byte raw payload. Detail page: https://www.isobus.net/isobus/pGNAndSPN/10488?type=PGN. Signal-level enrichment via PR welcome  see CONTRIBUTING.md.";
CM_ SG_ 2566578432 Object_Detection_Message_2_10_Ra "Generic 8-byte raw payload. Detail page: https://www.isobus.net/isobus/pGNAndSPN/10489?type=PGN. Signal-level enrichment via PR welcome  see CONTRIBUTING.md.";
CM_ SG_ 2566578688 Object_Detection_Message_2_11_Ra "Generic 8-byte raw payload. Detail page: https://www.isobus.net/isobus/pGNAndSPN/10490?type=PGN. Signal-level enrichment via PR welcome  see CONTRIBUTING.md.";
CM_ SG_ 2566578944 Object_Detection_Message_2_12_Ra "Generic 8-byte raw payload. Detail page: https://www.isobus.net/isobus/pGNAndSPN/10491?type=PGN. Signal-level enrichment via PR welcome  see CONTRIBUTING.md.";
CM_ SG_ 2566579200 Object_Detection_Message_2_13_Ra "Generic 8-byte raw payload. Detail page: https://www.isobus.net/isobus/pGNAndSPN/10492?type=PGN. Signal-level enrichment via PR welcome  see CONTRIBUTING.md.";
CM_ SG_ 2566579456 Object_Detection_Message_2_14_Ra "Generic 8-byte raw payload. Detail page: https://www.isobus.net/isobus/pGNAndSPN/10493?type=PGN. Signal-level enrichment via PR welcome  see CONTRIBUTING.md.";
CM_ SG_ 2566579712 Object_Detection_Message_2_15_Ra "Generic 8-byte raw payload. Detail page: https://www.isobus.net/isobus/pGNAndSPN/10494?type=PGN. Signal-level enrichment via PR welcome  see CONTRIBUTING.md.";
CM_ SG_ 2566579968 Object_Detection_Message_2_16_Ra "Generic 8-byte raw payload. Detail page: https://www.isobus.net/isobus/pGNAndSPN/10495?type=PGN. Signal-level enrichment via PR welcome  see CONTRIBUTING.md.";
CM_ SG_ 2566580224 Object_Detection_Message_2_17_Ra "Generic 8-byte raw payload. Detail page: https://www.isobus.net/isobus/pGNAndSPN/10496?type=PGN. Signal-level enrichment via PR welcome  see CONTRIBUTING.md.";
CM_ SG_ 2566580480 Object_Detection_Message_2_18_Ra "Generic 8-byte raw payload. Detail page: https://www.isobus.net/isobus/pGNAndSPN/10497?type=PGN. Signal-level enrichment via PR welcome  see CONTRIBUTING.md.";
CM_ SG_ 2566580736 Object_Detection_Message_2_19_Ra "Generic 8-byte raw payload. Detail page: https://www.isobus.net/isobus/pGNAndSPN/10498?type=PGN. Signal-level enrichment via PR welcome  see CONTRIBUTING.md.";
CM_ SG_ 2566580992 Object_Detection_Message_2_20_Ra "Generic 8-byte raw payload. Detail page: https://www.isobus.net/isobus/pGNAndSPN/10499?type=PGN. Signal-level enrichment via PR welcome  see CONTRIBUTING.md.";
CM_ SG_ 2566581248 Object_Detection_Message_2_21_Ra "Generic 8-byte raw payload. Detail page: https://www.isobus.net/isobus/pGNAndSPN/10500?type=PGN. Signal-level enrichment via PR welcome  see CONTRIBUTING.md.";
CM_ SG_ 2566581504 Temperature_Sensing_Module_1_Raw "Generic 8-byte raw payload. Detail page: https://www.isobus.net/isobus/pGNAndSPN/10508?type=PGN. Signal-level enrichment via PR welcome  see CONTRIBUTING.md.";
CM_ SG_ 2566581760 Temperature_Sensing_Module_2_Raw "Generic 8-byte raw payload. Detail page: https://www.isobus.net/isobus/pGNAndSPN/10516?type=PGN. Signal-level enrichment via PR welcome  see CONTRIBUTING.md.";
CM_ SG_ 2566582016 Aftertreatment_2_SCR_Service_Inf "Generic 8-byte raw payload. Detail page: https://www.isobus.net/isobus/pGNAndSPN/10517?type=PGN. Signal-level enrichment via PR welcome  see CONTRIBUTING.md.";
CM_ SG_ 2566582272 Aftertreatment_1_SCR_Service_Inf "Generic 8-byte raw payload. Detail page: https://www.isobus.net/isobus/pGNAndSPN/10519?type=PGN. Signal-level enrichment via PR welcome  see CONTRIBUTING.md.";
CM_ SG_ 2566582528 PSA_Times_Lifetime_Hours_RawPayl "Generic 8-byte raw payload. Detail page: https://www.isobus.net/isobus/pGNAndSPN/10522?type=PGN. Signal-level enrichment via PR welcome  see CONTRIBUTING.md.";
CM_ SG_ 2566582784 PSA_Times_Stored_100_Hours_RawPa "Generic 8-byte raw payload. Detail page: https://www.isobus.net/isobus/pGNAndSPN/10525?type=PGN. Signal-level enrichment via PR welcome  see CONTRIBUTING.md.";
CM_ SG_ 2566583040 PSA_Times_Active_100_Hours_RawPa "Generic 8-byte raw payload. Detail page: https://www.isobus.net/isobus/pGNAndSPN/10528?type=PGN. Signal-level enrichment via PR welcome  see CONTRIBUTING.md.";
CM_ SG_ 2566583296 Hybrid_Charge_Depleting_or_Incre "Generic 8-byte raw payload. Detail page: https://www.isobus.net/isobus/pGNAndSPN/10536?type=PGN. Signal-level enrichment via PR welcome  see CONTRIBUTING.md.";
CM_ SG_ 2566583552 Hybrid_Charge_Depleting_or_Incre "Generic 8-byte raw payload. Detail page: https://www.isobus.net/isobus/pGNAndSPN/10544?type=PGN. Signal-level enrichment via PR welcome  see CONTRIBUTING.md.";
CM_ SG_ 2566583808 Hybrid_Charge_Depleting_or_Incre "Generic 8-byte raw payload. Detail page: https://www.isobus.net/isobus/pGNAndSPN/10552?type=PGN. Signal-level enrichment via PR welcome  see CONTRIBUTING.md.";
CM_ SG_ 2566584064 Aftertreatment_1_Historical_Info "Generic 8-byte raw payload. Detail page: https://www.isobus.net/isobus/pGNAndSPN/10560?type=PGN. Signal-level enrichment via PR welcome  see CONTRIBUTING.md.";
CM_ SG_ 2566584320 Engine_Maximum_Net_Torque_Map_Ra "Generic 8-byte raw payload. Detail page: https://www.isobus.net/isobus/pGNAndSPN/10568?type=PGN. Signal-level enrichment via PR welcome  see CONTRIBUTING.md.";
CM_ SG_ 2566584576 Aftertreatment_1_SCR_2_NOx_Mass_ "Generic 8-byte raw payload. Detail page: https://www.isobus.net/isobus/pGNAndSPN/10572?type=PGN. Signal-level enrichment via PR welcome  see CONTRIBUTING.md.";
CM_ SG_ 2566584832 Aftertreatment_1_SCR_1_NOx_Mass_ "Generic 8-byte raw payload. Detail page: https://www.isobus.net/isobus/pGNAndSPN/10576?type=PGN. Signal-level enrichment via PR welcome  see CONTRIBUTING.md.";
CM_ SG_ 2566585088 Evaporative_System_Pressure_and_ "Generic 8-byte raw payload. Detail page: https://www.isobus.net/isobus/pGNAndSPN/10580?type=PGN. Signal-level enrichment via PR welcome  see CONTRIBUTING.md.";
CM_ SG_ 2566585344 GHG_Tracking_Lifetime_Array_Data "Generic 8-byte raw payload. Detail page: https://www.isobus.net/isobus/pGNAndSPN/10593?type=PGN. Signal-level enrichment via PR welcome  see CONTRIBUTING.md.";
CM_ SG_ 2566585600 GHG_Tracking_Stored_100_Hour_Arr "Generic 8-byte raw payload. Detail page: https://www.isobus.net/isobus/pGNAndSPN/10606?type=PGN. Signal-level enrichment via PR welcome  see CONTRIBUTING.md.";
CM_ SG_ 2566585856 GHG_Tracking_Active_100_Hour_Arr "Generic 8-byte raw payload. Detail page: https://www.isobus.net/isobus/pGNAndSPN/10619?type=PGN. Signal-level enrichment via PR welcome  see CONTRIBUTING.md.";
CM_ SG_ 2566586112 Green_House_Gas_Stored_100_Hour_ "Generic 8-byte raw payload. Detail page: https://www.isobus.net/isobus/pGNAndSPN/10622?type=PGN. Signal-level enrichment via PR welcome  see CONTRIBUTING.md.";
CM_ SG_ 2566586368 Green_House_Gas_Active_100_Hour_ "Generic 8-byte raw payload. Detail page: https://www.isobus.net/isobus/pGNAndSPN/10625?type=PGN. Signal-level enrichment via PR welcome  see CONTRIBUTING.md.";
CM_ SG_ 2566586624 Green_House_Gas_Lifetime_Active_ "Generic 8-byte raw payload. Detail page: https://www.isobus.net/isobus/pGNAndSPN/10628?type=PGN. Signal-level enrichment via PR welcome  see CONTRIBUTING.md.";
CM_ SG_ 2566586880 NOx_Tracking_Engine_Activity_Lif "Generic 8-byte raw payload. Detail page: https://www.isobus.net/isobus/pGNAndSPN/10645?type=PGN. Signal-level enrichment via PR welcome  see CONTRIBUTING.md.";
CM_ SG_ 2566587136 NOx_Tracking_Engine_Activity_Lif "Generic 8-byte raw payload. Detail page: https://www.isobus.net/isobus/pGNAndSPN/10662?type=PGN. Signal-level enrichment via PR welcome  see CONTRIBUTING.md.";
CM_ SG_ 2566587392 NOx_Tracking_Engine_Activity_Lif "Generic 8-byte raw payload. Detail page: https://www.isobus.net/isobus/pGNAndSPN/10679?type=PGN. Signal-level enrichment via PR welcome  see CONTRIBUTING.md.";
CM_ SG_ 2566587648 NOx_Tracking_Engine_Activity_Lif "Generic 8-byte raw payload. Detail page: https://www.isobus.net/isobus/pGNAndSPN/10696?type=PGN. Signal-level enrichment via PR welcome  see CONTRIBUTING.md.";
CM_ SG_ 2566587904 NOx_Tracking_Valid_NOx_Lifetime_ "Generic 8-byte raw payload. Detail page: https://www.isobus.net/isobus/pGNAndSPN/10713?type=PGN. Signal-level enrichment via PR welcome  see CONTRIBUTING.md.";
CM_ SG_ 2566588160 NOx_Tracking_Valid_NOx_Lifetime_ "Generic 8-byte raw payload. Detail page: https://www.isobus.net/isobus/pGNAndSPN/10730?type=PGN. Signal-level enrichment via PR welcome  see CONTRIBUTING.md.";
CM_ SG_ 2566588416 NOx_Tracking_Valid_NOx_Lifetime_ "Generic 8-byte raw payload. Detail page: https://www.isobus.net/isobus/pGNAndSPN/10747?type=PGN. Signal-level enrichment via PR welcome  see CONTRIBUTING.md.";
CM_ SG_ 2566588672 NOx_Tracking_Valid_NOx_Lifetime_ "Generic 8-byte raw payload. Detail page: https://www.isobus.net/isobus/pGNAndSPN/10764?type=PGN. Signal-level enrichment via PR welcome  see CONTRIBUTING.md.";
CM_ SG_ 2566588928 NOx_Tracking_Valid_NOx_Lifetime_ "Generic 8-byte raw payload. Detail page: https://www.isobus.net/isobus/pGNAndSPN/10781?type=PGN. Signal-level enrichment via PR welcome  see CONTRIBUTING.md.";
CM_ SG_ 2566589184 NOx_Tracking_Valid_NOx_Lifetime_ "Generic 8-byte raw payload. Detail page: https://www.isobus.net/isobus/pGNAndSPN/10798?type=PGN. Signal-level enrichment via PR welcome  see CONTRIBUTING.md.";
CM_ SG_ 2566589440 NOx_Tracking_Stored_100_Hour_Fue "Generic 8-byte raw payload. Detail page: https://www.isobus.net/isobus/pGNAndSPN/10815?type=PGN. Signal-level enrichment via PR welcome  see CONTRIBUTING.md.";
CM_ SG_ 2566589696 NOx_Tracking_Stored_100_Hour_Eng "Generic 8-byte raw payload. Detail page: https://www.isobus.net/isobus/pGNAndSPN/10832?type=PGN. Signal-level enrichment via PR welcome  see CONTRIBUTING.md.";
CM_ SG_ 2566589952 NOx_Tracking_Stored_100_Hour_Veh "Generic 8-byte raw payload. Detail page: https://www.isobus.net/isobus/pGNAndSPN/10849?type=PGN. Signal-level enrichment via PR welcome  see CONTRIBUTING.md.";
CM_ SG_ 2566590208 NOx_Tracking_Stored_100_Hour_Eng "Generic 8-byte raw payload. Detail page: https://www.isobus.net/isobus/pGNAndSPN/10866?type=PGN. Signal-level enrichment via PR welcome  see CONTRIBUTING.md.";
CM_ SG_ 2566590464 NOx_Tracking_Stored_100_Hour_Eng "Generic 8-byte raw payload. Detail page: https://www.isobus.net/isobus/pGNAndSPN/10883?type=PGN. Signal-level enrichment via PR welcome  see CONTRIBUTING.md.";
CM_ SG_ 2566590720 NOx_Tracking_Stored_100_Hour_Sys "Generic 8-byte raw payload. Detail page: https://www.isobus.net/isobus/pGNAndSPN/10900?type=PGN. Signal-level enrichment via PR welcome  see CONTRIBUTING.md.";
CM_ SG_ 2566590976 NOx_Tracking_Active_100_Hour_Fue "Generic 8-byte raw payload. Detail page: https://www.isobus.net/isobus/pGNAndSPN/10917?type=PGN. Signal-level enrichment via PR welcome  see CONTRIBUTING.md.";
CM_ SG_ 2566591232 NOx_Tracking_Active_100_Hour_Eng "Generic 8-byte raw payload. Detail page: https://www.isobus.net/isobus/pGNAndSPN/10934?type=PGN. Signal-level enrichment via PR welcome  see CONTRIBUTING.md.";
CM_ SG_ 2566591488 NOx_Tracking_Active_100_Hour_Veh "Generic 8-byte raw payload. Detail page: https://www.isobus.net/isobus/pGNAndSPN/10951?type=PGN. Signal-level enrichment via PR welcome  see CONTRIBUTING.md.";
CM_ SG_ 2566591744 NOx_Tracking_Active_100_Hour_Eng "Generic 8-byte raw payload. Detail page: https://www.isobus.net/isobus/pGNAndSPN/10968?type=PGN. Signal-level enrichment via PR welcome  see CONTRIBUTING.md.";
CM_ SG_ 2566592000 NOx_Tracking_Active_100_Hour_Eng "Generic 8-byte raw payload. Detail page: https://www.isobus.net/isobus/pGNAndSPN/10985?type=PGN. Signal-level enrichment via PR welcome  see CONTRIBUTING.md.";
CM_ SG_ 2566592256 NOx_Tracking_Active_100_Hour_Sys "Generic 8-byte raw payload. Detail page: https://www.isobus.net/isobus/pGNAndSPN/11002?type=PGN. Signal-level enrichment via PR welcome  see CONTRIBUTING.md.";
CM_ SG_ 2566592512 Motor_Generator_6_Inverter_Contr "Generic 8-byte raw payload. Detail page: https://www.isobus.net/isobus/pGNAndSPN/11009?type=PGN. Signal-level enrichment via PR welcome  see CONTRIBUTING.md.";
CM_ SG_ 2566592768 Motor_Generator_6_Inverter_Limit "Generic 8-byte raw payload. Detail page: https://www.isobus.net/isobus/pGNAndSPN/11015?type=PGN. Signal-level enrichment via PR welcome  see CONTRIBUTING.md.";
CM_ SG_ 2566593024 Motor_Generator_6_Inverter_Limit "Generic 8-byte raw payload. Detail page: https://www.isobus.net/isobus/pGNAndSPN/11021?type=PGN. Signal-level enrichment via PR welcome  see CONTRIBUTING.md.";
CM_ SG_ 2566593280 Motor_Generator_6_Inverter_Limit "Generic 8-byte raw payload. Detail page: https://www.isobus.net/isobus/pGNAndSPN/11027?type=PGN. Signal-level enrichment via PR welcome  see CONTRIBUTING.md.";
CM_ SG_ 2566593536 Motor_Generator_6_Inverter_Isola "Generic 8-byte raw payload. Detail page: https://www.isobus.net/isobus/pGNAndSPN/11031?type=PGN. Signal-level enrichment via PR welcome  see CONTRIBUTING.md.";
CM_ SG_ 2566593792 Motor_Generator_5_Inverter_Contr "Generic 8-byte raw payload. Detail page: https://www.isobus.net/isobus/pGNAndSPN/11038?type=PGN. Signal-level enrichment via PR welcome  see CONTRIBUTING.md.";
CM_ SG_ 2566594048 Motor_Generator_5_Inverter_Limit "Generic 8-byte raw payload. Detail page: https://www.isobus.net/isobus/pGNAndSPN/11044?type=PGN. Signal-level enrichment via PR welcome  see CONTRIBUTING.md.";
CM_ SG_ 2566594304 Motor_Generator_5_Inverter_Limit "Generic 8-byte raw payload. Detail page: https://www.isobus.net/isobus/pGNAndSPN/11050?type=PGN. Signal-level enrichment via PR welcome  see CONTRIBUTING.md.";
CM_ SG_ 2566594560 Motor_Generator_5_Inverter_Limit "Generic 8-byte raw payload. Detail page: https://www.isobus.net/isobus/pGNAndSPN/11056?type=PGN. Signal-level enrichment via PR welcome  see CONTRIBUTING.md.";
CM_ SG_ 2566594816 Motor_Generator_5_Inverter_Isola "Generic 8-byte raw payload. Detail page: https://www.isobus.net/isobus/pGNAndSPN/11060?type=PGN. Signal-level enrichment via PR welcome  see CONTRIBUTING.md.";
CM_ SG_ 2566595072 Motor_Generator_4_Inverter_Contr "Generic 8-byte raw payload. Detail page: https://www.isobus.net/isobus/pGNAndSPN/11067?type=PGN. Signal-level enrichment via PR welcome  see CONTRIBUTING.md.";
CM_ SG_ 2566595328 Motor_Generator_4_Inverter_Limit "Generic 8-byte raw payload. Detail page: https://www.isobus.net/isobus/pGNAndSPN/11073?type=PGN. Signal-level enrichment via PR welcome  see CONTRIBUTING.md.";
CM_ SG_ 2566595584 Motor_Generator_4_Inverter_Limit "Generic 8-byte raw payload. Detail page: https://www.isobus.net/isobus/pGNAndSPN/11079?type=PGN. Signal-level enrichment via PR welcome  see CONTRIBUTING.md.";
CM_ SG_ 2566595840 Motor_Generator_4_Inverter_Limit "Generic 8-byte raw payload. Detail page: https://www.isobus.net/isobus/pGNAndSPN/11085?type=PGN. Signal-level enrichment via PR welcome  see CONTRIBUTING.md.";
CM_ SG_ 2566596096 Motor_Generator_4_Inverter_Isola "Generic 8-byte raw payload. Detail page: https://www.isobus.net/isobus/pGNAndSPN/11089?type=PGN. Signal-level enrichment via PR welcome  see CONTRIBUTING.md.";
CM_ SG_ 2566596352 Motor_Generator_3_Inverter_Contr "Generic 8-byte raw payload. Detail page: https://www.isobus.net/isobus/pGNAndSPN/11096?type=PGN. Signal-level enrichment via PR welcome  see CONTRIBUTING.md.";
CM_ SG_ 2566596608 Motor_Generator_3_Inverter_Limit "Generic 8-byte raw payload. Detail page: https://www.isobus.net/isobus/pGNAndSPN/11102?type=PGN. Signal-level enrichment via PR welcome  see CONTRIBUTING.md.";
CM_ SG_ 2566596864 Motor_Generator_3_Inverter_Limit "Generic 8-byte raw payload. Detail page: https://www.isobus.net/isobus/pGNAndSPN/11108?type=PGN. Signal-level enrichment via PR welcome  see CONTRIBUTING.md.";
CM_ SG_ 2566597120 Motor_Generator_3_Inverter_Limit "Generic 8-byte raw payload. Detail page: https://www.isobus.net/isobus/pGNAndSPN/11114?type=PGN. Signal-level enrichment via PR welcome  see CONTRIBUTING.md.";
CM_ SG_ 2566597376 Motor_Generator_3_Inverter_Isola "Generic 8-byte raw payload. Detail page: https://www.isobus.net/isobus/pGNAndSPN/11118?type=PGN. Signal-level enrichment via PR welcome  see CONTRIBUTING.md.";
CM_ SG_ 2566597632 Diagnostic_Readiness_4_RawPayloa "Generic 8-byte raw payload. Detail page: https://www.isobus.net/isobus/pGNAndSPN/11119?type=PGN. Signal-level enrichment via PR welcome  see CONTRIBUTING.md.";
CM_ SG_ 2566597888 Turbocharger_Information_8_RawPa "Generic 8-byte raw payload. Detail page: https://www.isobus.net/isobus/pGNAndSPN/11123?type=PGN. Signal-level enrichment via PR welcome  see CONTRIBUTING.md.";
CM_ SG_ 2566598144 Winch_Information_2_RawPayload "Generic 8-byte raw payload. Detail page: https://www.isobus.net/isobus/pGNAndSPN/11124?type=PGN. Signal-level enrichment via PR welcome  see CONTRIBUTING.md.";
CM_ SG_ 2566598400 Motor_Generator_6_Inverter_Refer "Generic 8-byte raw payload. Detail page: https://www.isobus.net/isobus/pGNAndSPN/11129?type=PGN. Signal-level enrichment via PR welcome  see CONTRIBUTING.md.";
CM_ SG_ 2566598656 Motor_Generator_6_Inverter_Statu "Generic 8-byte raw payload. Detail page: https://www.isobus.net/isobus/pGNAndSPN/11135?type=PGN. Signal-level enrichment via PR welcome  see CONTRIBUTING.md.";
CM_ SG_ 2566598912 Motor_Generator_6_Inverter_Refer "Generic 8-byte raw payload. Detail page: https://www.isobus.net/isobus/pGNAndSPN/11139?type=PGN. Signal-level enrichment via PR welcome  see CONTRIBUTING.md.";
CM_ SG_ 2566599168 Motor_Generator_6_Inverter_Tempe "Generic 8-byte raw payload. Detail page: https://www.isobus.net/isobus/pGNAndSPN/11144?type=PGN. Signal-level enrichment via PR welcome  see CONTRIBUTING.md.";
CM_ SG_ 2566599424 Motor_Generator_6_Inverter_Motor "Generic 8-byte raw payload. Detail page: https://www.isobus.net/isobus/pGNAndSPN/11148?type=PGN. Signal-level enrichment via PR welcome  see CONTRIBUTING.md.";
CM_ SG_ 2566599680 Motor_Generator_6_Inverter_Isola "Generic 8-byte raw payload. Detail page: https://www.isobus.net/isobus/pGNAndSPN/11155?type=PGN. Signal-level enrichment via PR welcome  see CONTRIBUTING.md.";
CM_ SG_ 2566599936 Motor_Generator_6_Inverter_Activ "Generic 8-byte raw payload. Detail page: https://www.isobus.net/isobus/pGNAndSPN/11174?type=PGN. Signal-level enrichment via PR welcome  see CONTRIBUTING.md.";
CM_ SG_ 2566600192 Motor_Generator_5_Inverter_Refer "Generic 8-byte raw payload. Detail page: https://www.isobus.net/isobus/pGNAndSPN/11179?type=PGN. Signal-level enrichment via PR welcome  see CONTRIBUTING.md.";
CM_ SG_ 2566600448 Motor_Generator_5_Inverter_Statu "Generic 8-byte raw payload. Detail page: https://www.isobus.net/isobus/pGNAndSPN/11185?type=PGN. Signal-level enrichment via PR welcome  see CONTRIBUTING.md.";
CM_ SG_ 2566600704 Motor_Generator_5_Inverter_Refer "Generic 8-byte raw payload. Detail page: https://www.isobus.net/isobus/pGNAndSPN/11189?type=PGN. Signal-level enrichment via PR welcome  see CONTRIBUTING.md.";
CM_ SG_ 2566600960 Motor_Generator_5_Inverter_Tempe "Generic 8-byte raw payload. Detail page: https://www.isobus.net/isobus/pGNAndSPN/11194?type=PGN. Signal-level enrichment via PR welcome  see CONTRIBUTING.md.";
CM_ SG_ 2566601216 Motor_Generator_5_Inverter_Motor "Generic 8-byte raw payload. Detail page: https://www.isobus.net/isobus/pGNAndSPN/11198?type=PGN. Signal-level enrichment via PR welcome  see CONTRIBUTING.md.";

BA_DEF_ BO_ "SystemMessageLongSymbol" STRING;
BA_DEF_ SG_ "SystemSignalLongSymbol" STRING;
BA_ "SystemMessageLongSymbol" BO_ 2566516992 "VDMA_F9F1_Engine_Cylinder_Average_Ignition";
BA_ "SystemMessageLongSymbol" BO_ 2566517248 "VDMA_F9F2_Engine_Cylinder_Average_Ignition";
BA_ "SystemMessageLongSymbol" BO_ 2566517504 "VDMA_F9F3_Engine_Indicated_Mean_Effective_";
BA_ "SystemMessageLongSymbol" BO_ 2566517760 "VDMA_F9F4_Engine_Indicated_Mean_Effective_";
BA_ "SystemMessageLongSymbol" BO_ 2566518016 "VDMA_F9F5_Engine_Indicated_Mean_Effective_";
BA_ "SystemMessageLongSymbol" BO_ 2566518272 "VDMA_F9F6_Fuel_Cell_System_Coolant_Fan_1_C";
BA_ "SystemMessageLongSymbol" BO_ 2566518528 "VDMA_F9F7_Fuel_Cell_System_Coolant_Fan_1_S";
BA_ "SystemMessageLongSymbol" BO_ 2566518784 "VDMA_F9F8_Fuel_Cell_System_Coolant_Fan_2_C";
BA_ "SystemMessageLongSymbol" BO_ 2566519040 "VDMA_F9F9_Fuel_Cell_System_Coolant_Fan_2_S";
BA_ "SystemMessageLongSymbol" BO_ 2566519296 "VDMA_F9FA_Fuel_Cell_System_Coolant_Fan_3_C";
BA_ "SystemMessageLongSymbol" BO_ 2566519552 "VDMA_F9FB_Fuel_Cell_System_Coolant_Fan_3_S";
BA_ "SystemMessageLongSymbol" BO_ 2566519808 "VDMA_F9FC_Fuel_Cell_System_Coolant_Fan_4_C";
BA_ "SystemMessageLongSymbol" BO_ 2566520064 "VDMA_F9FD_Fuel_Cell_System_Coolant_Fan_4_S";
BA_ "SystemMessageLongSymbol" BO_ 2566520576 "VDMA_F9FF_Fuel_Cell_System_Configuration";
BA_ "SystemMessageLongSymbol" BO_ 2566520832 "VDMA_FA00_Fuel_Cell_System_Coolant_Informa";
BA_ "SystemMessageLongSymbol" BO_ 2566521088 "VDMA_FA01_Fuel_Cell_System_Coolant_Informa";
BA_ "SystemMessageLongSymbol" BO_ 2566523392 "VDMA_FA0A_Motor_Generator_1_Thermal_Perfor";
BA_ "SystemMessageLongSymbol" BO_ 2566523648 "VDMA_FA0B_Motor_Generator_2_Thermal_Perfor";
BA_ "SystemMessageLongSymbol" BO_ 2566523904 "VDMA_FA0C_Motor_Generator_3_Thermal_Perfor";
BA_ "SystemMessageLongSymbol" BO_ 2566524160 "VDMA_FA0D_Motor_Generator_4_Thermal_Perfor";
BA_ "SystemMessageLongSymbol" BO_ 2566524416 "VDMA_FA0E_Motor_Generator_5_Thermal_Perfor";
BA_ "SystemMessageLongSymbol" BO_ 2566524672 "VDMA_FA0F_Motor_Generator_6_Thermal_Perfor";
BA_ "SystemMessageLongSymbol" BO_ 2566524928 "VDMA_FA10_On_Board_Programming_Event_Time_";
BA_ "SystemMessageLongSymbol" BO_ 2566525184 "VDMA_FA11_Aftertreatment_1_Light_Off_SCR_S";
BA_ "SystemMessageLongSymbol" BO_ 2566525440 "VDMA_FA12_Motor_Generator_Location_Extende";
BA_ "SystemMessageLongSymbol" BO_ 2566525696 "VDMA_FA13_Cold_Start_Emissions_Reduction_S";
BA_ "SystemMessageLongSymbol" BO_ 2566525952 "VDMA_FA14_Cold_Start_Emissions_Reduction_S";
BA_ "SystemMessageLongSymbol" BO_ 2566526208 "VDMA_FA15_Genset_Supporting_Functions";
BA_ "SystemMessageLongSymbol" BO_ 2566526464 "VDMA_FA16_High_Voltage_Energy_Storage_Syst";
BA_ "SystemMessageLongSymbol" BO_ 2566526720 "VDMA_FA17_High_Voltage_Energy_Storage_Syst";
BA_ "SystemMessageLongSymbol" BO_ 2566526976 "VDMA_FA18_High_Voltage_Energy_Storage_Syst";
BA_ "SystemMessageLongSymbol" BO_ 2566527232 "VDMA_FA19_High_Voltage_Energy_Storage_Syst";
BA_ "SystemMessageLongSymbol" BO_ 2566527488 "VDMA_FA1A_Electronic_Engine_Controller_23";
BA_ "SystemMessageLongSymbol" BO_ 2566527744 "VDMA_FA1B_Electronic_Engine_Controller_24";
BA_ "SystemMessageLongSymbol" BO_ 2566528000 "VDMA_FA1C_Electronic_Engine_Controller_25";
BA_ "SystemMessageLongSymbol" BO_ 2566528256 "VDMA_FA1D_High_Voltage_Bus_Connection_Comm";
BA_ "SystemMessageLongSymbol" BO_ 2566528512 "VDMA_FA1E_High_Voltage_Bus_Contactor_Statu";
BA_ "SystemMessageLongSymbol" BO_ 2566528768 "VDMA_FA1F_Aftertreatment_System_Informatio";
BA_ "SystemMessageLongSymbol" BO_ 2566529024 "VDMA_FA20_EV_Multi_Connection_DC_Charging_";
BA_ "SystemMessageLongSymbol" BO_ 2566529280 "VDMA_FA21_EV_Multi_Connection_Charging_In_";
BA_ "SystemMessageLongSymbol" BO_ 2566529792 "VDMA_FA23_Motor_Generator_Location_obsolet";
BA_ "SystemMessageLongSymbol" BO_ 2566530048 "VDMA_FA24_High_Voltage_Energy_Storage_Syst";
BA_ "SystemMessageLongSymbol" BO_ 2566530304 "VDMA_FA25_High_Voltage_Energy_Storage_Syst";
BA_ "SystemMessageLongSymbol" BO_ 2566530560 "VDMA_FA26_High_Voltage_Energy_Storage_Syst";
BA_ "SystemMessageLongSymbol" BO_ 2566530816 "VDMA_FA27_High_Voltage_Energy_Storage_Pack";
BA_ "SystemMessageLongSymbol" BO_ 2566531072 "VDMA_FA28_High_Voltage_Energy_Storage_Pack";
BA_ "SystemMessageLongSymbol" BO_ 2566531328 "VDMA_FA29_High_Voltage_Energy_Storage_Pack";
BA_ "SystemMessageLongSymbol" BO_ 2566531584 "VDMA_FA2A_High_Voltage_Energy_Storage_Pack";
BA_ "SystemMessageLongSymbol" BO_ 2566531840 "VDMA_FA2B_High_Voltage_Energy_Storage_Pack";
BA_ "SystemMessageLongSymbol" BO_ 2566532096 "VDMA_FA2C_High_Voltage_Energy_Storage_Pack";
BA_ "SystemMessageLongSymbol" BO_ 2566532352 "VDMA_FA2D_High_Voltage_Energy_Storage_Pack";
BA_ "SystemMessageLongSymbol" BO_ 2566532608 "VDMA_FA2E_High_Voltage_Energy_Storage_Pack";
BA_ "SystemMessageLongSymbol" BO_ 2566532864 "VDMA_FA2F_High_Voltage_Energy_Storage_Pack";
BA_ "SystemMessageLongSymbol" BO_ 2566533120 "VDMA_FA30_High_Voltage_Energy_Storage_Pack";
BA_ "SystemMessageLongSymbol" BO_ 2566533376 "VDMA_FA31_High_Voltage_Energy_Storage_Pack";
BA_ "SystemMessageLongSymbol" BO_ 2566533632 "VDMA_FA32_High_Voltage_Energy_Storage_Pack";
BA_ "SystemMessageLongSymbol" BO_ 2566533888 "VDMA_FA33_Multi_Color_Indicator_Lamp_Comma";
BA_ "SystemMessageLongSymbol" BO_ 2566534144 "VDMA_FA34_Multi_Color_Indicator_Lamp_Statu";
BA_ "SystemMessageLongSymbol" BO_ 2566534400 "VDMA_FA35_Refuse_Truck_Body_Information";
BA_ "SystemMessageLongSymbol" BO_ 2566534656 "VDMA_FA36_Engine_Fluid_Level_Pressure_14";
BA_ "SystemMessageLongSymbol" BO_ 2566534912 "VDMA_FA37_Well_Stimulation_Transmission_Co";
BA_ "SystemMessageLongSymbol" BO_ 2566535168 "VDMA_FA38_Well_Stimulation_Pump_Protection";
BA_ "SystemMessageLongSymbol" BO_ 2566535424 "VDMA_FA39_Well_Stimulation_Pump_Protection";
BA_ "SystemMessageLongSymbol" BO_ 2566535680 "VDMA_FA3A_Electric_PTO_Drive_Engagement_1";
BA_ "SystemMessageLongSymbol" BO_ 2566535936 "VDMA_FA3B_Electric_PTO_1_Information";
BA_ "SystemMessageLongSymbol" BO_ 2566536192 "VDMA_FA3C_Engine_Exhaust_O2_Sensor_Informa";
BA_ "SystemMessageLongSymbol" BO_ 2566536448 "VDMA_FA3D_Gaseous_Fuel_Supply_Pressure_3";
BA_ "SystemMessageLongSymbol" BO_ 2566537216 "VDMA_FA40_Electronic_Transmission_Controll";
BA_ "SystemMessageLongSymbol" BO_ 2566537472 "VDMA_FA41_Automated_Driving_System_Network";
BA_ "SystemMessageLongSymbol" BO_ 2566537728 "VDMA_FA42_Automated_Driving_System_Network";
BA_ "SystemMessageLongSymbol" BO_ 2566537984 "VDMA_FA43_Hybrid_or_EV_System_Inputs_2";
BA_ "SystemMessageLongSymbol" BO_ 2566538240 "VDMA_FA44_Engine_Speed_Load_Factor_Informa";
BA_ "SystemMessageLongSymbol" BO_ 2566538496 "VDMA_FA45_Generator_Trip_Energy_2";
BA_ "SystemMessageLongSymbol" BO_ 2566538752 "VDMA_FA46_Security_System_Machine_Operatio";
BA_ "SystemMessageLongSymbol" BO_ 2566539008 "VDMA_FA47_Engine_Fuel_Actuator_Service_Mod";
BA_ "SystemMessageLongSymbol" BO_ 2566539264 "VDMA_FA48_Steering_Wheel_Controls";
BA_ "SystemMessageLongSymbol" BO_ 2566539776 "VDMA_FA4A_Extended_DTC_information";
BA_ "SystemMessageLongSymbol" BO_ 2566540032 "VDMA_FA4B_Aftertreatment_2_SCR_Dosing_Syst";
BA_ "SystemMessageLongSymbol" BO_ 2566540288 "VDMA_FA4C_Aftertreatment_1_SCR_Dosing_Syst";
BA_ "SystemMessageLongSymbol" BO_ 2566540800 "VDMA_FA4E_Automated_Driving_System_Status_";
BA_ "SystemMessageLongSymbol" BO_ 2566541056 "VDMA_FA4F_Automated_Driving_System_Control";
BA_ "SystemMessageLongSymbol" BO_ 2566542080 "VDMA_FA53_Genset_Enclosure_Ventilation";
BA_ "SystemMessageLongSymbol" BO_ 2566543360 "VDMA_FA58_Engine_Exhaust_Gas_Heat_Exchange";
BA_ "SystemMessageLongSymbol" BO_ 2566543616 "VDMA_FA59_Genset_Enclosure_Ventilation_Lou";
BA_ "SystemMessageLongSymbol" BO_ 2566543872 "VDMA_FA5A_Genset_External_Coolant_System";
BA_ "SystemMessageLongSymbol" BO_ 2566544384 "VDMA_FA5C_EVSE_DC_Charging_Limits_3";
BA_ "SystemMessageLongSymbol" BO_ 2566544640 "VDMA_FA5D_EVSE_Power_Max_Schedule";
BA_ "SystemMessageLongSymbol" BO_ 2566545152 "VDMA_FA5F_EV_DC_Charging_Limits_2";
BA_ "SystemMessageLongSymbol" BO_ 2566545408 "VDMA_FA60_EV_DC_Charging_In_Progress";
BA_ "SystemMessageLongSymbol" BO_ 2566546432 "VDMA_FA64_Aftertreatment_System_Informatio";
BA_ "SystemMessageLongSymbol" BO_ 2566546688 "VDMA_FA65_Aftertreatment_System_Informatio";
BA_ "SystemMessageLongSymbol" BO_ 2566546944 "VDMA_FA66_Aftertreatment_System_Informatio";
BA_ "SystemMessageLongSymbol" BO_ 2566547456 "VDMA_FA68_Power_Converter_2_Isolation_Inte";
BA_ "SystemMessageLongSymbol" BO_ 2566547712 "VDMA_FA69_Power_Converter_1_Isolation_Inte";
BA_ "SystemMessageLongSymbol" BO_ 2566547968 "VDMA_FA6A_Power_Converter_2_Limits_Request";
BA_ "SystemMessageLongSymbol" BO_ 2566548224 "VDMA_FA6B_Power_Converter_2_Limits_Request";
BA_ "SystemMessageLongSymbol" BO_ 2566548480 "VDMA_FA6C_Power_Converter_2_Limits_Request";
BA_ "SystemMessageLongSymbol" BO_ 2566548736 "VDMA_FA6D_Power_Converter_1_Limits_Request";
BA_ "SystemMessageLongSymbol" BO_ 2566548992 "VDMA_FA6E_Power_Converter_1_Limits_Request";
BA_ "SystemMessageLongSymbol" BO_ 2566549248 "VDMA_FA6F_Power_Converter_1_Limits_Request";
BA_ "SystemMessageLongSymbol" BO_ 2566549504 "VDMA_FA70_Inverter_1_Lifetime_Data";
BA_ "SystemMessageLongSymbol" BO_ 2566549760 "VDMA_FA71_Inverter_2_Lifetime_Data";
BA_ "SystemMessageLongSymbol" BO_ 2566550016 "VDMA_FA72_Power_Converter_2_Active_Power_L";
BA_ "SystemMessageLongSymbol" BO_ 2566550272 "VDMA_FA73_Power_Converter_1_Active_Power_L";
BA_ "SystemMessageLongSymbol" BO_ 2566550528 "VDMA_FA74_Power_Converter_2_Reference_1";
BA_ "SystemMessageLongSymbol" BO_ 2566550784 "VDMA_FA75_Power_Converter_2_Reference_2";
BA_ "SystemMessageLongSymbol" BO_ 2566551040 "VDMA_FA76_Power_Converter_2_Temperature";
BA_ "SystemMessageLongSymbol" BO_ 2566551296 "VDMA_FA77_Power_Converter_1_Temperature";
BA_ "SystemMessageLongSymbol" BO_ 2566551552 "VDMA_FA78_Power_Converter_1_Reference_2";
BA_ "SystemMessageLongSymbol" BO_ 2566551808 "VDMA_FA79_Power_Converter_1_Reference_1";
BA_ "SystemMessageLongSymbol" BO_ 2566552064 "VDMA_FA7A_Power_Converter_1_Phase_Current";
BA_ "SystemMessageLongSymbol" BO_ 2566552320 "VDMA_FA7B_Power_Converter_2_Phase_Current";
BA_ "SystemMessageLongSymbol" BO_ 2566552576 "VDMA_FA7C_Power_Converter_1_Phase_Voltage";
BA_ "SystemMessageLongSymbol" BO_ 2566552832 "VDMA_FA7D_Power_Converter_2_Phase_Voltage";
BA_ "SystemMessageLongSymbol" BO_ 2566553088 "VDMA_FA7E_Power_Converter_Power_Module_Swi";
BA_ "SystemMessageLongSymbol" BO_ 2566553344 "VDMA_FA7F_Power_Converter_1_Power_Module_S";
BA_ "SystemMessageLongSymbol" BO_ 2566553600 "VDMA_FA80_Power_Converter_2_Power_Module_S";
BA_ "SystemMessageLongSymbol" BO_ 2566553856 "VDMA_FA81_Power_Converter_Totals_1";
BA_ "SystemMessageLongSymbol" BO_ 2566554112 "VDMA_FA82_Transformer_Temperatures";
BA_ "SystemMessageLongSymbol" BO_ 2566554368 "VDMA_FA83_Electrified_Accessory_Engine_Coo";
BA_ "SystemMessageLongSymbol" BO_ 2566554624 "VDMA_FA84_High_Voltage_Energy_Storage_Pack";
BA_ "SystemMessageLongSymbol" BO_ 2566554880 "VDMA_FA85_High_Voltage_Energy_Storage_Pack";
BA_ "SystemMessageLongSymbol" BO_ 2566555136 "VDMA_FA86_High_Voltage_Energy_Storage_Pack";
BA_ "SystemMessageLongSymbol" BO_ 2566555392 "VDMA_FA87_High_Voltage_Energy_Storage_Pack";
BA_ "SystemMessageLongSymbol" BO_ 2566555648 "VDMA_FA88_High_Voltage_Energy_Storage_Pack";
BA_ "SystemMessageLongSymbol" BO_ 2566555904 "VDMA_FA89_High_Voltage_Energy_Storage_Pack";
BA_ "SystemMessageLongSymbol" BO_ 2566556160 "VDMA_FA8A_High_Voltage_Energy_Storage_Pack";
BA_ "SystemMessageLongSymbol" BO_ 2566556416 "VDMA_FA8B_High_Voltage_Energy_Storage_Pack";
BA_ "SystemMessageLongSymbol" BO_ 2566556672 "VDMA_FA8C_High_Voltage_Energy_Storage_Pack";
BA_ "SystemMessageLongSymbol" BO_ 2566556928 "VDMA_FA8D_High_Voltage_Energy_Storage_Pack";
BA_ "SystemMessageLongSymbol" BO_ 2566557184 "VDMA_FA8E_High_Voltage_Energy_Storage_Pack";
BA_ "SystemMessageLongSymbol" BO_ 2566557440 "VDMA_FA8F_High_Voltage_Energy_Storage_Pack";
BA_ "SystemMessageLongSymbol" BO_ 2566557696 "VDMA_FA90_High_Voltage_Energy_Storage_Pack";
BA_ "SystemMessageLongSymbol" BO_ 2566557952 "VDMA_FA91_High_Voltage_Energy_Storage_Pack";
BA_ "SystemMessageLongSymbol" BO_ 2566558208 "VDMA_FA92_High_Voltage_Energy_Storage_Pack";
BA_ "SystemMessageLongSymbol" BO_ 2566558464 "VDMA_FA93_High_Voltage_Energy_Storage_Pack";
BA_ "SystemMessageLongSymbol" BO_ 2566558720 "VDMA_FA94_High_Voltage_Energy_Storage_Pack";
BA_ "SystemMessageLongSymbol" BO_ 2566558976 "VDMA_FA95_High_Voltage_Energy_Storage_Pack";
BA_ "SystemMessageLongSymbol" BO_ 2566559232 "VDMA_FA96_High_Voltage_Energy_Storage_Pack";
BA_ "SystemMessageLongSymbol" BO_ 2566559488 "VDMA_FA97_High_Voltage_Energy_Storage_Pack";
BA_ "SystemMessageLongSymbol" BO_ 2566559744 "VDMA_FA98_High_Voltage_Energy_Storage_Pack";
BA_ "SystemMessageLongSymbol" BO_ 2566560000 "VDMA_FA99_High_Voltage_Energy_Storage_Pack";
BA_ "SystemMessageLongSymbol" BO_ 2566560256 "VDMA_FA9A_High_Voltage_Energy_Storage_Pack";
BA_ "SystemMessageLongSymbol" BO_ 2566560512 "VDMA_FA9B_High_Voltage_Energy_Storage_Pack";
BA_ "SystemMessageLongSymbol" BO_ 2566560768 "VDMA_FA9C_High_Voltage_Energy_Storage_Pack";
BA_ "SystemMessageLongSymbol" BO_ 2566561024 "VDMA_FA9D_High_Voltage_Energy_Storage_Pack";
BA_ "SystemMessageLongSymbol" BO_ 2566561280 "VDMA_FA9E_High_Voltage_Energy_Storage_Pack";
BA_ "SystemMessageLongSymbol" BO_ 2566561536 "VDMA_FA9F_High_Voltage_Energy_Storage_Pack";
BA_ "SystemMessageLongSymbol" BO_ 2566561792 "VDMA_FAA0_High_Voltage_Energy_Storage_Pack";
BA_ "SystemMessageLongSymbol" BO_ 2566562048 "VDMA_FAA1_High_Voltage_Energy_Storage_Pack";
BA_ "SystemMessageLongSymbol" BO_ 2566562304 "VDMA_FAA2_High_Voltage_Energy_Storage_Pack";
BA_ "SystemMessageLongSymbol" BO_ 2566562560 "VDMA_FAA3_High_Voltage_Energy_Storage_Pack";
BA_ "SystemMessageLongSymbol" BO_ 2566562816 "VDMA_FAA4_Automated_Driving_System_Control";
BA_ "SystemMessageLongSymbol" BO_ 2566564096 "VDMA_FAA9_Transmission_Shaft_Twist_Informa";
BA_ "SystemMessageLongSymbol" BO_ 2566564352 "VDMA_FAAA_Electronic_Auxiliary_Transmissio";
BA_ "SystemMessageLongSymbol" BO_ 2566564608 "VDMA_FAAB_High_Voltage_Energy_Storage_Pack";
BA_ "SystemMessageLongSymbol" BO_ 2566564864 "VDMA_FAAC_High_Voltage_Energy_Storage_Pack";
BA_ "SystemMessageLongSymbol" BO_ 2566565120 "VDMA_FAAD_High_Voltage_Energy_Storage_Pack";
BA_ "SystemMessageLongSymbol" BO_ 2566565376 "VDMA_FAAE_High_Voltage_Energy_Storage_Pack";
BA_ "SystemMessageLongSymbol" BO_ 2566565632 "VDMA_FAAF_High_Voltage_Energy_Storage_Pack";
BA_ "SystemMessageLongSymbol" BO_ 2566565888 "VDMA_FAB0_High_Voltage_Energy_Storage_Pack";
BA_ "SystemMessageLongSymbol" BO_ 2566566144 "VDMA_FAB1_High_Voltage_Energy_Storage_Pack";
BA_ "SystemMessageLongSymbol" BO_ 2566566400 "VDMA_FAB2_High_Voltage_Energy_Storage_Pack";
BA_ "SystemMessageLongSymbol" BO_ 2566566656 "VDMA_FAB3_AUTOSAR_Time_Synchronization";
BA_ "SystemMessageLongSymbol" BO_ 2566566912 "VDMA_FAB4_EV_DC_Charging_Limits_1";
BA_ "SystemMessageLongSymbol" BO_ 2566567168 "VDMA_FAB5_EVSE_DC_Charging_Limits_1";
BA_ "SystemMessageLongSymbol" BO_ 2566567424 "VDMA_FAB6_EVSE_DC_Charging_Limits_2";
BA_ "SystemMessageLongSymbol" BO_ 2566568448 "VDMA_FABA_EVSE_1_Contactor_Status_1";
BA_ "SystemMessageLongSymbol" BO_ 2566568704 "VDMA_FABB_Direct_Lamp_Control_Command_3";
BA_ "SystemMessageLongSymbol" BO_ 2566568960 "VDMA_FABC_Direct_Lamp_Control_Data_3";
BA_ "SystemMessageLongSymbol" BO_ 2566569216 "VDMA_FABD_Motor_Generator_1_Lifetime_Data";
BA_ "SystemMessageLongSymbol" BO_ 2566569472 "VDMA_FABE_Motor_Generator_2_Lifetime_Data";
BA_ "SystemMessageLongSymbol" BO_ 2566569728 "VDMA_FABF_Motor_Generator_3_Lifetime_Data";
BA_ "SystemMessageLongSymbol" BO_ 2566569984 "VDMA_FAC0_Motor_Generator_4_Lifetime_Data";
BA_ "SystemMessageLongSymbol" BO_ 2566570240 "VDMA_FAC1_Motor_Generator_5_Lifetime_Data";
BA_ "SystemMessageLongSymbol" BO_ 2566570496 "VDMA_FAC2_Motor_Generator_6_Lifetime_Data";
BA_ "SystemMessageLongSymbol" BO_ 2566571520 "VDMA_FAC6_Electronic_Retarder_Controller_3";
BA_ "SystemMessageLongSymbol" BO_ 2566572032 "VDMA_FAC8_Electronic_Transmission_Controll";
BA_ "SystemMessageLongSymbol" BO_ 2566572800 "VDMA_FACB_Collision_Avoidance_System_4";
BA_ "SystemMessageLongSymbol" BO_ 2566573056 "VDMA_FACC_Collision_Avoidance_System_3";
BA_ "SystemMessageLongSymbol" BO_ 2566573312 "VDMA_FACD_Aftertreatment_1_SCR_Exhaust_Gas";
BA_ "SystemMessageLongSymbol" BO_ 2566574336 "VDMA_FAD1_Engine_Average_Information_2";
BA_ "SystemMessageLongSymbol" BO_ 2566574592 "VDMA_FAD2_Turbocharger_Information_9";
BA_ "SystemMessageLongSymbol" BO_ 2566574848 "VDMA_FAD3_Automated_Driving_System_Control";
BA_ "SystemMessageLongSymbol" BO_ 2566575872 "VDMA_FAD7_Object_Detection_Message_1_1";
BA_ "SystemMessageLongSymbol" BO_ 2566576128 "VDMA_FAD8_Object_Detection_Message_2_1";
BA_ "SystemMessageLongSymbol" BO_ 2566576384 "VDMA_FAD9_Object_Detection_Message_2_2";
BA_ "SystemMessageLongSymbol" BO_ 2566576640 "VDMA_FADA_Object_Detection_Message_2_3";
BA_ "SystemMessageLongSymbol" BO_ 2566576896 "VDMA_FADB_Object_Detection_Message_2_4";
BA_ "SystemMessageLongSymbol" BO_ 2566577152 "VDMA_FADC_Object_Detection_Message_2_5";
BA_ "SystemMessageLongSymbol" BO_ 2566577408 "VDMA_FADD_Object_Detection_Message_2_6";
BA_ "SystemMessageLongSymbol" BO_ 2566577664 "VDMA_FADE_Object_Detection_Message_2_7";
BA_ "SystemMessageLongSymbol" BO_ 2566577920 "VDMA_FADF_Object_Detection_Message_2_8";
BA_ "SystemMessageLongSymbol" BO_ 2566578176 "VDMA_FAE0_Object_Detection_Message_2_9";
BA_ "SystemMessageLongSymbol" BO_ 2566578432 "VDMA_FAE1_Object_Detection_Message_2_10";
BA_ "SystemMessageLongSymbol" BO_ 2566578688 "VDMA_FAE2_Object_Detection_Message_2_11";
BA_ "SystemMessageLongSymbol" BO_ 2566578944 "VDMA_FAE3_Object_Detection_Message_2_12";
BA_ "SystemMessageLongSymbol" BO_ 2566579200 "VDMA_FAE4_Object_Detection_Message_2_13";
BA_ "SystemMessageLongSymbol" BO_ 2566579456 "VDMA_FAE5_Object_Detection_Message_2_14";
BA_ "SystemMessageLongSymbol" BO_ 2566579712 "VDMA_FAE6_Object_Detection_Message_2_15";
BA_ "SystemMessageLongSymbol" BO_ 2566579968 "VDMA_FAE7_Object_Detection_Message_2_16";
BA_ "SystemMessageLongSymbol" BO_ 2566580224 "VDMA_FAE8_Object_Detection_Message_2_17";
BA_ "SystemMessageLongSymbol" BO_ 2566580480 "VDMA_FAE9_Object_Detection_Message_2_18";
BA_ "SystemMessageLongSymbol" BO_ 2566580736 "VDMA_FAEA_Object_Detection_Message_2_19";
BA_ "SystemMessageLongSymbol" BO_ 2566580992 "VDMA_FAEB_Object_Detection_Message_2_20";
BA_ "SystemMessageLongSymbol" BO_ 2566581248 "VDMA_FAEC_Object_Detection_Message_2_21";
BA_ "SystemMessageLongSymbol" BO_ 2566581504 "VDMA_FAED_Temperature_Sensing_Module_1";
BA_ "SystemMessageLongSymbol" BO_ 2566581760 "VDMA_FAEE_Temperature_Sensing_Module_2";
BA_ "SystemMessageLongSymbol" BO_ 2566582016 "VDMA_FAEF_Aftertreatment_2_SCR_Service_Inf";
BA_ "SystemMessageLongSymbol" BO_ 2566582272 "VDMA_FAF0_Aftertreatment_1_SCR_Service_Inf";
BA_ "SystemMessageLongSymbol" BO_ 2566582528 "VDMA_FAF1_PSA_Times_Lifetime_Hours";
BA_ "SystemMessageLongSymbol" BO_ 2566582784 "VDMA_FAF2_PSA_Times_Stored_100_Hours";
BA_ "SystemMessageLongSymbol" BO_ 2566583040 "VDMA_FAF3_PSA_Times_Active_100_Hours";
BA_ "SystemMessageLongSymbol" BO_ 2566583296 "VDMA_FAF4_Hybrid_Charge_Depleting_or_Incre";
BA_ "SystemMessageLongSymbol" BO_ 2566583552 "VDMA_FAF5_Hybrid_Charge_Depleting_or_Incre";
BA_ "SystemMessageLongSymbol" BO_ 2566583808 "VDMA_FAF6_Hybrid_Charge_Depleting_or_Incre";
BA_ "SystemMessageLongSymbol" BO_ 2566584064 "VDMA_FAF7_Aftertreatment_1_Historical_Info";
BA_ "SystemMessageLongSymbol" BO_ 2566584320 "VDMA_FAF8_Engine_Maximum_Net_Torque_Map";
BA_ "SystemMessageLongSymbol" BO_ 2566584576 "VDMA_FAF9_Aftertreatment_1_SCR_2_NOx_Mass_";
BA_ "SystemMessageLongSymbol" BO_ 2566584832 "VDMA_FAFA_Aftertreatment_1_SCR_1_NOx_Mass_";
BA_ "SystemMessageLongSymbol" BO_ 2566585088 "VDMA_FAFB_Evaporative_System_Pressure_and_";
BA_ "SystemMessageLongSymbol" BO_ 2566585344 "VDMA_FAFC_GHG_Tracking_Lifetime_Array_Data";
BA_ "SystemMessageLongSymbol" BO_ 2566585600 "VDMA_FAFD_GHG_Tracking_Stored_100_Hour_Arr";
BA_ "SystemMessageLongSymbol" BO_ 2566585856 "VDMA_FAFE_GHG_Tracking_Active_100_Hour_Arr";
BA_ "SystemMessageLongSymbol" BO_ 2566586112 "VDMA_FAFF_Green_House_Gas_Stored_100_Hour_";
BA_ "SystemMessageLongSymbol" BO_ 2566586368 "VDMA_FB00_Green_House_Gas_Active_100_Hour_";
BA_ "SystemMessageLongSymbol" BO_ 2566586624 "VDMA_FB01_Green_House_Gas_Lifetime_Active_";
BA_ "SystemMessageLongSymbol" BO_ 2566586880 "VDMA_FB02_NOx_Tracking_Engine_Activity_Lif";
BA_ "SystemMessageLongSymbol" BO_ 2566587136 "VDMA_FB03_NOx_Tracking_Engine_Activity_Lif";
BA_ "SystemMessageLongSymbol" BO_ 2566587392 "VDMA_FB04_NOx_Tracking_Engine_Activity_Lif";
BA_ "SystemMessageLongSymbol" BO_ 2566587648 "VDMA_FB05_NOx_Tracking_Engine_Activity_Lif";
BA_ "SystemMessageLongSymbol" BO_ 2566587904 "VDMA_FB06_NOx_Tracking_Valid_NOx_Lifetime_";
BA_ "SystemMessageLongSymbol" BO_ 2566588160 "VDMA_FB07_NOx_Tracking_Valid_NOx_Lifetime_";
BA_ "SystemMessageLongSymbol" BO_ 2566588416 "VDMA_FB08_NOx_Tracking_Valid_NOx_Lifetime_";
BA_ "SystemMessageLongSymbol" BO_ 2566588672 "VDMA_FB09_NOx_Tracking_Valid_NOx_Lifetime_";
BA_ "SystemMessageLongSymbol" BO_ 2566588928 "VDMA_FB0A_NOx_Tracking_Valid_NOx_Lifetime_";
BA_ "SystemMessageLongSymbol" BO_ 2566589184 "VDMA_FB0B_NOx_Tracking_Valid_NOx_Lifetime_";
BA_ "SystemMessageLongSymbol" BO_ 2566589440 "VDMA_FB0C_NOx_Tracking_Stored_100_Hour_Fue";
BA_ "SystemMessageLongSymbol" BO_ 2566589696 "VDMA_FB0D_NOx_Tracking_Stored_100_Hour_Eng";
BA_ "SystemMessageLongSymbol" BO_ 2566589952 "VDMA_FB0E_NOx_Tracking_Stored_100_Hour_Veh";
BA_ "SystemMessageLongSymbol" BO_ 2566590208 "VDMA_FB0F_NOx_Tracking_Stored_100_Hour_Eng";
BA_ "SystemMessageLongSymbol" BO_ 2566590464 "VDMA_FB10_NOx_Tracking_Stored_100_Hour_Eng";
BA_ "SystemMessageLongSymbol" BO_ 2566590720 "VDMA_FB11_NOx_Tracking_Stored_100_Hour_Sys";
BA_ "SystemMessageLongSymbol" BO_ 2566590976 "VDMA_FB12_NOx_Tracking_Active_100_Hour_Fue";
BA_ "SystemMessageLongSymbol" BO_ 2566591232 "VDMA_FB13_NOx_Tracking_Active_100_Hour_Eng";
BA_ "SystemMessageLongSymbol" BO_ 2566591488 "VDMA_FB14_NOx_Tracking_Active_100_Hour_Veh";
BA_ "SystemMessageLongSymbol" BO_ 2566591744 "VDMA_FB15_NOx_Tracking_Active_100_Hour_Eng";
BA_ "SystemMessageLongSymbol" BO_ 2566592000 "VDMA_FB16_NOx_Tracking_Active_100_Hour_Eng";
BA_ "SystemMessageLongSymbol" BO_ 2566592256 "VDMA_FB17_NOx_Tracking_Active_100_Hour_Sys";
BA_ "SystemMessageLongSymbol" BO_ 2566592512 "VDMA_FB18_Motor_Generator_6_Inverter_Contr";
BA_ "SystemMessageLongSymbol" BO_ 2566592768 "VDMA_FB19_Motor_Generator_6_Inverter_Limit";
BA_ "SystemMessageLongSymbol" BO_ 2566593024 "VDMA_FB1A_Motor_Generator_6_Inverter_Limit";
BA_ "SystemMessageLongSymbol" BO_ 2566593280 "VDMA_FB1B_Motor_Generator_6_Inverter_Limit";
BA_ "SystemMessageLongSymbol" BO_ 2566593536 "VDMA_FB1C_Motor_Generator_6_Inverter_Isola";
BA_ "SystemMessageLongSymbol" BO_ 2566593792 "VDMA_FB1D_Motor_Generator_5_Inverter_Contr";
BA_ "SystemMessageLongSymbol" BO_ 2566594048 "VDMA_FB1E_Motor_Generator_5_Inverter_Limit";
BA_ "SystemMessageLongSymbol" BO_ 2566594304 "VDMA_FB1F_Motor_Generator_5_Inverter_Limit";
BA_ "SystemMessageLongSymbol" BO_ 2566594560 "VDMA_FB20_Motor_Generator_5_Inverter_Limit";
BA_ "SystemMessageLongSymbol" BO_ 2566594816 "VDMA_FB21_Motor_Generator_5_Inverter_Isola";
BA_ "SystemMessageLongSymbol" BO_ 2566595072 "VDMA_FB22_Motor_Generator_4_Inverter_Contr";
BA_ "SystemMessageLongSymbol" BO_ 2566595328 "VDMA_FB23_Motor_Generator_4_Inverter_Limit";
BA_ "SystemMessageLongSymbol" BO_ 2566595584 "VDMA_FB24_Motor_Generator_4_Inverter_Limit";
BA_ "SystemMessageLongSymbol" BO_ 2566595840 "VDMA_FB25_Motor_Generator_4_Inverter_Limit";
BA_ "SystemMessageLongSymbol" BO_ 2566596096 "VDMA_FB26_Motor_Generator_4_Inverter_Isola";
BA_ "SystemMessageLongSymbol" BO_ 2566596352 "VDMA_FB27_Motor_Generator_3_Inverter_Contr";
BA_ "SystemMessageLongSymbol" BO_ 2566596608 "VDMA_FB28_Motor_Generator_3_Inverter_Limit";
BA_ "SystemMessageLongSymbol" BO_ 2566596864 "VDMA_FB29_Motor_Generator_3_Inverter_Limit";
BA_ "SystemMessageLongSymbol" BO_ 2566597120 "VDMA_FB2A_Motor_Generator_3_Inverter_Limit";
BA_ "SystemMessageLongSymbol" BO_ 2566597376 "VDMA_FB2B_Motor_Generator_3_Inverter_Isola";
BA_ "SystemMessageLongSymbol" BO_ 2566597888 "VDMA_FB2D_Turbocharger_Information_8";
BA_ "SystemMessageLongSymbol" BO_ 2566598400 "VDMA_FB2F_Motor_Generator_6_Inverter_Refer";
BA_ "SystemMessageLongSymbol" BO_ 2566598656 "VDMA_FB30_Motor_Generator_6_Inverter_Statu";
BA_ "SystemMessageLongSymbol" BO_ 2566598912 "VDMA_FB31_Motor_Generator_6_Inverter_Refer";
BA_ "SystemMessageLongSymbol" BO_ 2566599168 "VDMA_FB32_Motor_Generator_6_Inverter_Tempe";
BA_ "SystemMessageLongSymbol" BO_ 2566599424 "VDMA_FB33_Motor_Generator_6_Inverter_Motor";
BA_ "SystemMessageLongSymbol" BO_ 2566599680 "VDMA_FB34_Motor_Generator_6_Inverter_Isola";
BA_ "SystemMessageLongSymbol" BO_ 2566599936 "VDMA_FB35_Motor_Generator_6_Inverter_Activ";
BA_ "SystemMessageLongSymbol" BO_ 2566600192 "VDMA_FB36_Motor_Generator_5_Inverter_Refer";
BA_ "SystemMessageLongSymbol" BO_ 2566600448 "VDMA_FB37_Motor_Generator_5_Inverter_Statu";
BA_ "SystemMessageLongSymbol" BO_ 2566600704 "VDMA_FB38_Motor_Generator_5_Inverter_Refer";
BA_ "SystemMessageLongSymbol" BO_ 2566600960 "VDMA_FB39_Motor_Generator_5_Inverter_Tempe";
BA_ "SystemMessageLongSymbol" BO_ 2566601216 "VDMA_FB3A_Motor_Generator_5_Inverter_Motor";
