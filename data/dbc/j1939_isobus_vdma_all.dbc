VERSION "created by canmatrix"

NS_ :

BS_:

BU_:

BA_DEF_ BO_ "SystemMessageLongSymbol" STRING;
BA_DEF_ SG_ "GenSigStartValue" FLOAT 0 100000000000;
BA_DEF_ SG_ "SystemSignalLongSymbol" STRING;

VERSION "created by canmatrix"

NS_ :

BS_:

BU_:

BA_DEF_ BO_ "SystemMessageLongSymbol" STRING;
BA_DEF_ SG_ "GenSigStartValue" FLOAT 0 100000000000;
BA_DEF_ SG_ "SystemSignalLongSymbol" STRING;

VERSION "created by canmatrix"

NS_ :

BS_:

BU_:

BO_ 2566769664 VDMA_FDCC_Operators_External_Lig: 8 Vector__XXX
 SG_ Operators_External_Light_Control : 0|64@1+ (1,0) [0|18446744073709551615] "" Vector__XXX

BO_ 2566769920 VDMA_FDCD_Operator_Wiper_and_Was: 8 Vector__XXX
 SG_ Operator_Wiper_and_Washer_Contro : 0|64@1+ (1,0) [0|18446744073709551615] "" Vector__XXX

BO_ 2566770176 VDMA_FDCE_Working_Set_Member_Mes: 8 Vector__XXX
 SG_ Working_Set_Member_Message_Obsol : 0|64@1+ (1,0) [0|18446744073709551615] "" Vector__XXX

BO_ 2566770432 VDMA_FDCF_Working_Set_Master_Mes: 8 Vector__XXX
 SG_ Working_Set_Master_Message_Obsol : 0|64@1+ (1,0) [0|18446744073709551615] "" Vector__XXX

BO_ 2566770688 VDMA_FDD0_Intake_Exhaust_Conditi: 8 Vector__XXX
 SG_ Intake_Exhaust_Conditions_2_RawP : 0|64@1+ (1,0) [0|18446744073709551615] "" Vector__XXX

BO_ 2566770944 VDMA_FDD1_FMS_standard_Interface: 8 Vector__XXX
 SG_ FMS_standard_Interface_Identity_ : 0|64@1+ (1,0) [0|18446744073709551615] "" Vector__XXX

BO_ 2566771200 VDMA_FDD2_ECU_Performance: 8 Vector__XXX
 SG_ ECU_Performance_RawPayload : 0|64@1+ (1,0) [0|18446744073709551615] "" Vector__XXX

BO_ 2566771456 VDMA_FDD3_Turbocharger_Informati: 8 Vector__XXX
 SG_ Turbocharger_Information_6_RawPa : 0|64@1+ (1,0) [0|18446744073709551615] "" Vector__XXX

BO_ 2566771712 VDMA_FDD4_Cab_Message_3: 8 Vector__XXX
 SG_ Cab_Message_3_RawPayload : 0|64@1+ (1,0) [0|18446744073709551615] "" Vector__XXX

BO_ 2566771968 VDMA_FDD5_Electronic_Engine_Cont: 8 Vector__XXX
 SG_ Electronic_Engine_Controller_5_R : 0|64@1+ (1,0) [0|18446744073709551615] "" Vector__XXX

BO_ 2566772224 VDMA_FDD6_Basic_Joystick_Message: 8 Vector__XXX
 SG_ Basic_Joystick_Message_1_RawPayl : 0|64@1+ (1,0) [0|18446744073709551615] "" Vector__XXX

BO_ 2566772480 VDMA_FDD7_Extended_Joystick_Mess: 8 Vector__XXX
 SG_ Extended_Joystick_Message_1_RawP : 0|64@1+ (1,0) [0|18446744073709551615] "" Vector__XXX

BO_ 2566772736 VDMA_FDD8_Basic_Joystick_Message: 8 Vector__XXX
 SG_ Basic_Joystick_Message_2_RawPayl : 0|64@1+ (1,0) [0|18446744073709551615] "" Vector__XXX

BO_ 2566772992 VDMA_FDD9_Extended_Joystick_Mess: 8 Vector__XXX
 SG_ Extended_Joystick_Message_2_RawP : 0|64@1+ (1,0) [0|18446744073709551615] "" Vector__XXX

BO_ 2566773248 VDMA_FDDA_Basic_Joystick_Message: 8 Vector__XXX
 SG_ Basic_Joystick_Message_3_RawPayl : 0|64@1+ (1,0) [0|18446744073709551615] "" Vector__XXX

BO_ 2566773504 VDMA_FDDB_Extended_Joystick_Mess: 8 Vector__XXX
 SG_ Extended_Joystick_Message_3_RawP : 0|64@1+ (1,0) [0|18446744073709551615] "" Vector__XXX

BO_ 2566773760 VDMA_FDDC_Marine_Control_Informa: 8 Vector__XXX
 SG_ Marine_Control_Information_RawPa : 0|64@1+ (1,0) [0|18446744073709551615] "" Vector__XXX

BO_ 2566774016 VDMA_FDDD_Military_Application_M: 8 Vector__XXX
 SG_ Military_Application_Message_1_1 : 0|64@1+ (1,0) [0|18446744073709551615] "" Vector__XXX

BO_ 2566774272 VDMA_FDDE_Military_Application_M: 8 Vector__XXX
 SG_ Military_Application_Message_2_1 : 0|64@1+ (1,0) [0|18446744073709551615] "" Vector__XXX

BO_ 2566774528 VDMA_FDDF_Front_Wheel_Drive_Stat: 8 Vector__XXX
 SG_ Front_Wheel_Drive_Status_RawPayl : 0|64@1+ (1,0) [0|18446744073709551615] "" Vector__XXX

BO_ 2566774784 VDMA_FDE0_Ambient_Conditions_2: 8 Vector__XXX
 SG_ Ambient_Conditions_2_RawPayload : 0|64@1+ (1,0) [0|18446744073709551615] "" Vector__XXX

BO_ 2566775040 VDMA_FDE1_Cab_Climate_System_Inf: 8 Vector__XXX
 SG_ Cab_Climate_System_Information_1 : 0|64@1+ (1,0) [0|18446744073709551615] "" Vector__XXX

BO_ 2566775296 VDMA_FDE2_Supply_Pressure_Demand: 8 Vector__XXX
 SG_ Supply_Pressure_Demand_RawPayloa : 0|64@1+ (1,0) [0|18446744073709551615] "" Vector__XXX

BO_ 2566775552 VDMA_FDE3_Equipment_Operation_an: 8 Vector__XXX
 SG_ Equipment_Operation_and_Control_ : 0|64@1+ (1,0) [0|18446744073709551615] "" Vector__XXX

BO_ 2566775808 VDMA_FDE4_Equipment_Performance_: 8 Vector__XXX
 SG_ Equipment_Performance_Data_RawPa : 0|64@1+ (1,0) [0|18446744073709551615] "" Vector__XXX

BO_ 2566776064 VDMA_FDE5_Maximum_Vehicle_Speed_: 8 Vector__XXX
 SG_ Maximum_Vehicle_Speed_Limit_Stat : 0|64@1+ (1,0) [0|18446744073709551615] "" Vector__XXX

BO_ 2566776320 VDMA_FDE6_Hydraulic_Braking_Syst: 8 Vector__XXX
 SG_ Hydraulic_Braking_System_RawPayl : 0|64@1+ (1,0) [0|18446744073709551615] "" Vector__XXX

BO_ 2566776576 VDMA_FDE7_Bus_1_Utility_Sync_Che: 8 Vector__XXX
 SG_ Bus_1_Utility_Sync_Check_Status_ : 0|64@1+ (1,0) [0|18446744073709551615] "" Vector__XXX

BO_ 2566776832 VDMA_FDE8_Bus_1_Generator_Sync_C: 8 Vector__XXX
 SG_ Bus_1_Generator_Sync_Check_Statu : 0|64@1+ (1,0) [0|18446744073709551615] "" Vector__XXX

BO_ 2566777088 VDMA_FDE9_Bus_1_Phase_C_Basic_AC: 8 Vector__XXX
 SG_ Bus_1_Phase_C_Basic_AC_Quantitie : 0|64@1+ (1,0) [0|18446744073709551615] "" Vector__XXX

BO_ 2566777344 VDMA_FDEA_Bus_1_Phase_B_Basic_AC: 8 Vector__XXX
 SG_ Bus_1_Phase_B_Basic_AC_Quantitie : 0|64@1+ (1,0) [0|18446744073709551615] "" Vector__XXX

BO_ 2566777600 VDMA_FDEB_Bus_1_Phase_A_Basic_AC: 8 Vector__XXX
 SG_ Bus_1_Phase_A_Basic_AC_Quantitie : 0|64@1+ (1,0) [0|18446744073709551615] "" Vector__XXX

BO_ 2566777856 VDMA_FDEC_Bus_1_Average_Basic_AC: 8 Vector__XXX
 SG_ Bus_1_Average_Basic_AC_Quantitie : 0|64@1+ (1,0) [0|18446744073709551615] "" Vector__XXX

BO_ 2566778112 VDMA_FDED_Utility_Total_AC_Energ: 8 Vector__XXX
 SG_ Utility_Total_AC_Energy_RawPaylo : 0|64@1+ (1,0) [0|18446744073709551615] "" Vector__XXX

BO_ 2566778368 VDMA_FDEE_Utility_Phase_C_AC_Rea: 8 Vector__XXX
 SG_ Utility_Phase_C_AC_Reactive_Powe : 0|64@1+ (1,0) [0|18446744073709551615] "" Vector__XXX

BO_ 2566778624 VDMA_FDEF_Utility_Phase_C_AC_Pow: 8 Vector__XXX
 SG_ Utility_Phase_C_AC_Power_RawPayl : 0|64@1+ (1,0) [0|18446744073709551615] "" Vector__XXX

BO_ 2566778880 VDMA_FDF0_Utility_Phase_C_AC_Bas: 8 Vector__XXX
 SG_ Utility_Phase_C_AC_Basic_Quantit : 0|64@1+ (1,0) [0|18446744073709551615] "" Vector__XXX

BO_ 2566779136 VDMA_FDF1_Utility_Phase_B_AC_Rea: 8 Vector__XXX
 SG_ Utility_Phase_B_AC_Reactive_Powe : 0|64@1+ (1,0) [0|18446744073709551615] "" Vector__XXX

BO_ 2566779392 VDMA_FDF2_Utility_Phase_B_AC_Pow: 8 Vector__XXX
 SG_ Utility_Phase_B_AC_Power_RawPayl : 0|64@1+ (1,0) [0|18446744073709551615] "" Vector__XXX

BO_ 2566779648 VDMA_FDF3_Utility_Phase_B_AC_Bas: 8 Vector__XXX
 SG_ Utility_Phase_B_AC_Basic_Quantit : 0|64@1+ (1,0) [0|18446744073709551615] "" Vector__XXX

BO_ 2566779904 VDMA_FDF4_Utility_Phase_A_AC_Rea: 8 Vector__XXX
 SG_ Utility_Phase_A_AC_Reactive_Powe : 0|64@1+ (1,0) [0|18446744073709551615] "" Vector__XXX

BO_ 2566780160 VDMA_FDF5_Utility_Phase_A_AC_Pow: 8 Vector__XXX
 SG_ Utility_Phase_A_AC_Power_RawPayl : 0|64@1+ (1,0) [0|18446744073709551615] "" Vector__XXX

BO_ 2566780416 VDMA_FDF6_Utility_Phase_A_Basic_: 8 Vector__XXX
 SG_ Utility_Phase_A_Basic_AC_Quantit : 0|64@1+ (1,0) [0|18446744073709551615] "" Vector__XXX

BO_ 2566780672 VDMA_FDF7_Utility_Total_AC_React: 8 Vector__XXX
 SG_ Utility_Total_AC_Reactive_Power_ : 0|64@1+ (1,0) [0|18446744073709551615] "" Vector__XXX

BO_ 2566780928 VDMA_FDF8_Utility_Total_AC_Power: 8 Vector__XXX
 SG_ Utility_Total_AC_Power_RawPayloa : 0|64@1+ (1,0) [0|18446744073709551615] "" Vector__XXX

BO_ 2566781184 VDMA_FDF9_Utility_Average_Basic_: 8 Vector__XXX
 SG_ Utility_Average_Basic_AC_Quantit : 0|64@1+ (1,0) [0|18446744073709551615] "" Vector__XXX

BO_ 2566781440 VDMA_FDFA_Generator_Total_AC_Ene: 8 Vector__XXX
 SG_ Generator_Total_AC_Energy_RawPay : 0|64@1+ (1,0) [0|18446744073709551615] "" Vector__XXX

BO_ 2566781696 VDMA_FDFB_Generator_Phase_C_AC_R: 8 Vector__XXX
 SG_ Generator_Phase_C_AC_Reactive_Po : 0|64@1+ (1,0) [0|18446744073709551615] "" Vector__XXX

BO_ 2566781952 VDMA_FDFC_Generator_Phase_C_AC_P: 8 Vector__XXX
 SG_ Generator_Phase_C_AC_Power_RawPa : 0|64@1+ (1,0) [0|18446744073709551615] "" Vector__XXX

BO_ 2566782208 VDMA_FDFD_Generator_Phase_C_Basi: 8 Vector__XXX
 SG_ Generator_Phase_C_Basic_AC_Quant : 0|64@1+ (1,0) [0|18446744073709551615] "" Vector__XXX

BO_ 2566782464 VDMA_FDFE_Generator_Phase_B_AC_R: 8 Vector__XXX
 SG_ Generator_Phase_B_AC_Reactive_Po : 0|64@1+ (1,0) [0|18446744073709551615] "" Vector__XXX

BO_ 2566782720 VDMA_FDFF_Generator_Phase_B_AC_P: 8 Vector__XXX
 SG_ Generator_Phase_B_AC_Power_RawPa : 0|64@1+ (1,0) [0|18446744073709551615] "" Vector__XXX

BO_ 2566782976 VDMA_FE00_Generator_Phase_B_Basi: 8 Vector__XXX
 SG_ Generator_Phase_B_Basic_AC_Quant : 0|64@1+ (1,0) [0|18446744073709551615] "" Vector__XXX

BO_ 2566783232 VDMA_FE01_Generator_Phase_A_AC_R: 8 Vector__XXX
 SG_ Generator_Phase_A_AC_Reactive_Po : 0|64@1+ (1,0) [0|18446744073709551615] "" Vector__XXX

BO_ 2566783488 VDMA_FE02_Generator_Phase_A_AC_P: 8 Vector__XXX
 SG_ Generator_Phase_A_AC_Power_RawPa : 0|64@1+ (1,0) [0|18446744073709551615] "" Vector__XXX

BO_ 2566783744 VDMA_FE03_Generator_Phase_A_Basi: 8 Vector__XXX
 SG_ Generator_Phase_A_Basic_AC_Quant : 0|64@1+ (1,0) [0|18446744073709551615] "" Vector__XXX

BO_ 2566784000 VDMA_FE04_Generator_Total_AC_Rea: 8 Vector__XXX
 SG_ Generator_Total_AC_Reactive_Powe : 0|64@1+ (1,0) [0|18446744073709551615] "" Vector__XXX

BO_ 2566784256 VDMA_FE05_Generator_Total_AC_Pow: 8 Vector__XXX
 SG_ Generator_Total_AC_Power_RawPayl : 0|64@1+ (1,0) [0|18446744073709551615] "" Vector__XXX

BO_ 2566784512 VDMA_FE06_Generator_Average_Basi: 8 Vector__XXX
 SG_ Generator_Average_Basic_AC_Quant : 0|64@1+ (1,0) [0|18446744073709551615] "" Vector__XXX

BO_ 2566784768 VDMA_FE07_Exhaust_Temperature: 8 Vector__XXX
 SG_ Exhaust_Temperature_RawPayload : 0|64@1+ (1,0) [0|18446744073709551615] "" Vector__XXX

BO_ 2566785024 VDMA_FE08_Required_Tractor_Facil: 8 Vector__XXX
 SG_ Required_Tractor_Facilities_mess : 0|64@1+ (1,0) [0|18446744073709551615] "" Vector__XXX

BO_ 2566785280 VDMA_FE09_Tractor_Facilities_res: 8 Vector__XXX
 SG_ Tractor_Facilities_response_mess : 0|64@1+ (1,0) [0|18446744073709551615] "" Vector__XXX

BO_ 2566785536 VDMA_FE0A_Tractor_control_comman: 8 Vector__XXX
 SG_ Tractor_control_command_tractor_ : 0|64@1+ (1,0) [0|18446744073709551615] "" Vector__XXX

BO_ 2566785792 VDMA_FE0B_Tractor_control_mode_c: 8 Vector__XXX
 SG_ Tractor_control_mode_command_Raw : 0|64@1+ (1,0) [0|18446744073709551615] "" Vector__XXX

BO_ 2566786048 VDMA_FE0C_Working_Set_Member: 8 Vector__XXX
 SG_ Working_Set_Member_RawPayload : 0|64@1+ (1,0) [0|18446744073709551615] "" Vector__XXX

BO_ 2566786560 VDMA_FE0E_Response_for_Repetitio: 8 Vector__XXX
 SG_ Response_for_Repetition_Rate_Raw : 0|64@1+ (1,0) [0|18446744073709551615] "" Vector__XXX

BO_ 2566787072 VDMA_FE10_Auxiliary_valve_0_esti: 8 Vector__XXX
 SG_ Auxiliary_valve_0_estimated_flow : 0|64@1+ (1,0) [0|18446744073709551615] "" Vector__XXX

BO_ 2566787328 VDMA_FE11_Auxiliary_valve_1_esti: 8 Vector__XXX
 SG_ Auxiliary_valve_1_estimated_flow : 0|64@1+ (1,0) [0|18446744073709551615] "" Vector__XXX

BO_ 2566787584 VDMA_FE12_Auxiliary_valve_2_esti: 8 Vector__XXX
 SG_ Auxiliary_valve_2_estimated_flow : 0|64@1+ (1,0) [0|18446744073709551615] "" Vector__XXX

BO_ 2566787840 VDMA_FE13_Auxiliary_valve_3_esti: 8 Vector__XXX
 SG_ Auxiliary_valve_3_estimated_flow : 0|64@1+ (1,0) [0|18446744073709551615] "" Vector__XXX

BO_ 2566788096 VDMA_FE14_Auxiliary_valve_4_esti: 8 Vector__XXX
 SG_ Auxiliary_valve_4_estimated_flow : 0|64@1+ (1,0) [0|18446744073709551615] "" Vector__XXX

BO_ 2566788352 VDMA_FE15_Auxiliary_valve_5_esti: 8 Vector__XXX
 SG_ Auxiliary_valve_5_estimated_flow : 0|64@1+ (1,0) [0|18446744073709551615] "" Vector__XXX

BO_ 2566788608 VDMA_FE16_Auxiliary_valve_6_esti: 8 Vector__XXX
 SG_ Auxiliary_valve_6_estimated_flow : 0|64@1+ (1,0) [0|18446744073709551615] "" Vector__XXX

BO_ 2566788864 VDMA_FE17_Auxiliary_valve_7_esti: 8 Vector__XXX
 SG_ Auxiliary_valve_7_estimated_flow : 0|64@1+ (1,0) [0|18446744073709551615] "" Vector__XXX

BO_ 2566789120 VDMA_FE18_Auxiliary_valve_8_esti: 8 Vector__XXX
 SG_ Auxiliary_valve_8_estimated_flow : 0|64@1+ (1,0) [0|18446744073709551615] "" Vector__XXX

BO_ 2566789376 VDMA_FE19_Auxiliary_valve_9_esti: 8 Vector__XXX
 SG_ Auxiliary_valve_9_estimated_flow : 0|64@1+ (1,0) [0|18446744073709551615] "" Vector__XXX

BO_ 2566789632 VDMA_FE1A_Auxiliary_valve_10_est: 8 Vector__XXX
 SG_ Auxiliary_valve_10_estimated_flo : 0|64@1+ (1,0) [0|18446744073709551615] "" Vector__XXX

BO_ 2566789888 VDMA_FE1B_Auxiliary_valve_11_est: 8 Vector__XXX
 SG_ Auxiliary_valve_11_estimated_flo : 0|64@1+ (1,0) [0|18446744073709551615] "" Vector__XXX

BO_ 2566790144 VDMA_FE1C_Auxiliary_valve_12_est: 8 Vector__XXX
 SG_ Auxiliary_valve_12_estimated_flo : 0|64@1+ (1,0) [0|18446744073709551615] "" Vector__XXX

BO_ 2566790400 VDMA_FE1D_Auxiliary_valve_13_est: 8 Vector__XXX
 SG_ Auxiliary_valve_13_estimated_flo : 0|64@1+ (1,0) [0|18446744073709551615] "" Vector__XXX

BO_ 2566790656 VDMA_FE1E_Auxiliary_valve_14_est: 8 Vector__XXX
 SG_ Auxiliary_valve_14_estimated_flo : 0|64@1+ (1,0) [0|18446744073709551615] "" Vector__XXX

BO_ 2566790912 VDMA_FE1F_Auxiliary_valve_15_est: 8 Vector__XXX
 SG_ Auxiliary_valve_15_estimated_flo : 0|64@1+ (1,0) [0|18446744073709551615] "" Vector__XXX

BO_ 2566791168 VDMA_FE20_Auxiliary_valve_0_meas: 8 Vector__XXX
 SG_ Auxiliary_valve_0_measured_flow_ : 0|64@1+ (1,0) [0|18446744073709551615] "" Vector__XXX

BO_ 2566791424 VDMA_FE21_Auxiliary_valve_1_meas: 8 Vector__XXX
 SG_ Auxiliary_valve_1_measured_flow_ : 0|64@1+ (1,0) [0|18446744073709551615] "" Vector__XXX

BO_ 2566791680 VDMA_FE22_Auxiliary_valve_2_meas: 8 Vector__XXX
 SG_ Auxiliary_valve_2_measured_flow_ : 0|64@1+ (1,0) [0|18446744073709551615] "" Vector__XXX

BO_ 2566791936 VDMA_FE23_Auxiliary_valve_3_meas: 8 Vector__XXX
 SG_ Auxiliary_valve_3_measured_flow_ : 0|64@1+ (1,0) [0|18446744073709551615] "" Vector__XXX

BO_ 2566792192 VDMA_FE24_Auxiliary_valve_4_meas: 8 Vector__XXX
 SG_ Auxiliary_valve_4_measured_flow_ : 0|64@1+ (1,0) [0|18446744073709551615] "" Vector__XXX

BO_ 2566792448 VDMA_FE25_Auxiliary_valve_5_meas: 8 Vector__XXX
 SG_ Auxiliary_valve_5_measured_flow_ : 0|64@1+ (1,0) [0|18446744073709551615] "" Vector__XXX

BO_ 2566792704 VDMA_FE26_Auxiliary_valve_6_meas: 8 Vector__XXX
 SG_ Auxiliary_valve_6_measured_flow_ : 0|64@1+ (1,0) [0|18446744073709551615] "" Vector__XXX

BO_ 2566792960 VDMA_FE27_Auxiliary_valve_7_meas: 8 Vector__XXX
 SG_ Auxiliary_valve_7_measured_flow_ : 0|64@1+ (1,0) [0|18446744073709551615] "" Vector__XXX

BO_ 2566793216 VDMA_FE28_Auxiliary_valve_8_meas: 8 Vector__XXX
 SG_ Auxiliary_valve_8_measured_flow_ : 0|64@1+ (1,0) [0|18446744073709551615] "" Vector__XXX

BO_ 2566793472 VDMA_FE29_Auxiliary_valve_9_meas: 8 Vector__XXX
 SG_ Auxiliary_valve_9_measured_flow_ : 0|64@1+ (1,0) [0|18446744073709551615] "" Vector__XXX

BO_ 2566793728 VDMA_FE2A_Auxiliary_valve_10_mea: 8 Vector__XXX
 SG_ Auxiliary_valve_10_measured_flow : 0|64@1+ (1,0) [0|18446744073709551615] "" Vector__XXX

BO_ 2566793984 VDMA_FE2B_Auxiliary_valve_11_mea: 8 Vector__XXX
 SG_ Auxiliary_valve_11_measured_flow : 0|64@1+ (1,0) [0|18446744073709551615] "" Vector__XXX

BO_ 2566794240 VDMA_FE2C_Auxiliary_valve_12_mea: 8 Vector__XXX
 SG_ Auxiliary_valve_12_measured_flow : 0|64@1+ (1,0) [0|18446744073709551615] "" Vector__XXX

BO_ 2566794496 VDMA_FE2D_Auxiliary_valve_13_mea: 8 Vector__XXX
 SG_ Auxiliary_valve_13_measured_flow : 0|64@1+ (1,0) [0|18446744073709551615] "" Vector__XXX

BO_ 2566794752 VDMA_FE2E_Auxiliary_valve_14_mea: 8 Vector__XXX
 SG_ Auxiliary_valve_14_measured_flow : 0|64@1+ (1,0) [0|18446744073709551615] "" Vector__XXX

BO_ 2566795008 VDMA_FE2F_Auxiliary_valve_15_mea: 8 Vector__XXX
 SG_ Auxiliary_valve_15_measured_flow : 0|64@1+ (1,0) [0|18446744073709551615] "" Vector__XXX

BO_ 2566795264 VDMA_FE30_Auxiliary_valve_0_comm: 8 Vector__XXX
 SG_ Auxiliary_valve_0_command_RawPay : 0|64@1+ (1,0) [0|18446744073709551615] "" Vector__XXX

BO_ 2566795520 VDMA_FE31_Auxiliary_valve_1_comm: 8 Vector__XXX
 SG_ Auxiliary_valve_1_command_RawPay : 0|64@1+ (1,0) [0|18446744073709551615] "" Vector__XXX

BO_ 2566795776 VDMA_FE32_Auxiliary_valve_2_comm: 8 Vector__XXX
 SG_ Auxiliary_valve_2_command_RawPay : 0|64@1+ (1,0) [0|18446744073709551615] "" Vector__XXX

BO_ 2566796032 VDMA_FE33_Auxiliary_valve_3_comm: 8 Vector__XXX
 SG_ Auxiliary_valve_3_command_RawPay : 0|64@1+ (1,0) [0|18446744073709551615] "" Vector__XXX

BO_ 2566796288 VDMA_FE34_Auxiliary_valve_4_comm: 8 Vector__XXX
 SG_ Auxiliary_valve_4_command_RawPay : 0|64@1+ (1,0) [0|18446744073709551615] "" Vector__XXX

BO_ 2566796544 VDMA_FE35_Auxiliary_valve_5_comm: 8 Vector__XXX
 SG_ Auxiliary_valve_5_command_RawPay : 0|64@1+ (1,0) [0|18446744073709551615] "" Vector__XXX

BO_ 2566796800 VDMA_FE36_Auxiliary_valve_6_comm: 8 Vector__XXX
 SG_ Auxiliary_valve_6_command_RawPay : 0|64@1+ (1,0) [0|18446744073709551615] "" Vector__XXX

BO_ 2566797056 VDMA_FE37_Auxiliary_valve_7_comm: 8 Vector__XXX
 SG_ Auxiliary_valve_7_command_RawPay : 0|64@1+ (1,0) [0|18446744073709551615] "" Vector__XXX

BO_ 2566797312 VDMA_FE38_Auxiliary_valve_8_comm: 8 Vector__XXX
 SG_ Auxiliary_valve_8_command_RawPay : 0|64@1+ (1,0) [0|18446744073709551615] "" Vector__XXX

BO_ 2566797568 VDMA_FE39_Auxiliary_valve_9_comm: 8 Vector__XXX
 SG_ Auxiliary_valve_9_command_RawPay : 0|64@1+ (1,0) [0|18446744073709551615] "" Vector__XXX

BO_ 2566797824 VDMA_FE3A_Auxiliary_valve_10_com: 8 Vector__XXX
 SG_ Auxiliary_valve_10_command_RawPa : 0|64@1+ (1,0) [0|18446744073709551615] "" Vector__XXX

BO_ 2566798080 VDMA_FE3B_Auxiliary_valve_11_com: 8 Vector__XXX
 SG_ Auxiliary_valve_11_command_RawPa : 0|64@1+ (1,0) [0|18446744073709551615] "" Vector__XXX

BO_ 2566798336 VDMA_FE3C_Auxiliary_valve_12_com: 8 Vector__XXX
 SG_ Auxiliary_valve_12_command_RawPa : 0|64@1+ (1,0) [0|18446744073709551615] "" Vector__XXX

BO_ 2566798592 VDMA_FE3D_Auxiliary_valve_13_com: 8 Vector__XXX
 SG_ Auxiliary_valve_13_command_RawPa : 0|64@1+ (1,0) [0|18446744073709551615] "" Vector__XXX

BO_ 2566798848 VDMA_FE3E_Auxiliary_valve_14_com: 8 Vector__XXX
 SG_ Auxiliary_valve_14_command_RawPa : 0|64@1+ (1,0) [0|18446744073709551615] "" Vector__XXX

BO_ 2566799104 VDMA_FE3F_Auxiliary_valve_15_com: 8 Vector__XXX
 SG_ Auxiliary_valve_15_command_RawPa : 0|64@1+ (1,0) [0|18446744073709551615] "" Vector__XXX

BO_ 2566799360 VDMA_FE40_Lighting_Data: 8 Vector__XXX
 SG_ Lighting_Data_RawPayload : 0|64@1+ (1,0) [0|18446744073709551615] "" Vector__XXX

BO_ 2566799616 VDMA_FE41_Lighting_command: 8 Vector__XXX
 SG_ Lighting_command_RawPayload : 0|64@1+ (1,0) [0|18446744073709551615] "" Vector__XXX

BO_ 2566799872 VDMA_FE42_Hitch_and_PTO_commands: 8 Vector__XXX
 SG_ Hitch_and_PTO_commands_RawPayloa : 0|64@1+ (1,0) [0|18446744073709551615] "" Vector__XXX

BO_ 2566800128 VDMA_FE43_Primary_or_Rear_Power_: 8 Vector__XXX
 SG_ Primary_or_Rear_Power_Take_off_O : 0|64@1+ (1,0) [0|18446744073709551615] "" Vector__XXX

BO_ 2566800384 VDMA_FE44_Secondary_or_Front_Pow: 8 Vector__XXX
 SG_ Secondary_or_Front_Power_Take_of : 0|64@1+ (1,0) [0|18446744073709551615] "" Vector__XXX

BO_ 2566800640 VDMA_FE45_Primary_or_Rear_Hitch_: 8 Vector__XXX
 SG_ Primary_or_Rear_Hitch_Status_Raw : 0|64@1+ (1,0) [0|18446744073709551615] "" Vector__XXX

BO_ 2566800896 VDMA_FE46_Secondary_or_Front_Hit: 8 Vector__XXX
 SG_ Secondary_or_Front_Hitch_Status_ : 0|64@1+ (1,0) [0|18446744073709551615] "" Vector__XXX

BO_ 2566801920 VDMA_FE4A_Electronic_Transmissio: 8 Vector__XXX
 SG_ Electronic_Transmission_Controll : 0|64@1+ (1,0) [0|18446744073709551615] "" Vector__XXX

BO_ 2566802176 VDMA_FE4B_Transmission_Configura: 8 Vector__XXX
 SG_ Transmission_Configuration_2_Raw : 0|64@1+ (1,0) [0|18446744073709551615] "" Vector__XXX

BO_ 2566802432 VDMA_FE4C_Military_Lighting_Comm: 8 Vector__XXX
 SG_ Military_Lighting_Command_RawPay : 0|64@1+ (1,0) [0|18446744073709551615] "" Vector__XXX

BO_ 2566802688 VDMA_FE4D_Total_Averaged_Informa: 8 Vector__XXX
 SG_ Total_Averaged_Information_RawPa : 0|64@1+ (1,0) [0|18446744073709551615] "" Vector__XXX

BO_ 2566802944 VDMA_FE4E_Door_Control_1: 8 Vector__XXX
 SG_ Door_Control_1_RawPayload : 0|64@1+ (1,0) [0|18446744073709551615] "" Vector__XXX

BO_ 2566803200 VDMA_FE4F_Vehicle_Dynamic_Stabil: 8 Vector__XXX
 SG_ Vehicle_Dynamic_Stability_Contro : 0|64@1+ (1,0) [0|18446744073709551615] "" Vector__XXX

BO_ 2566803456 VDMA_FE50_Battery_Temperature: 8 Vector__XXX
 SG_ Battery_Temperature_RawPayload : 0|64@1+ (1,0) [0|18446744073709551615] "" Vector__XXX

BO_ 2566803712 VDMA_FE51_Adaptive_Cruise_Contro: 8 Vector__XXX
 SG_ Adaptive_Cruise_Control_Operator : 0|64@1+ (1,0) [0|18446744073709551615] "" Vector__XXX

BO_ 2566803968 VDMA_FE52_Vehicle_Electrical_Pow: 8 Vector__XXX
 SG_ Vehicle_Electrical_Power_3_RawPa : 0|64@1+ (1,0) [0|18446744073709551615] "" Vector__XXX

BO_ 2566804224 VDMA_FE53_Retarder_Continuous_To: 8 Vector__XXX
 SG_ Retarder_Continuous_Torque_Speed : 0|64@1+ (1,0) [0|18446744073709551615] "" Vector__XXX

BO_ 2566804480 VDMA_FE54_Engine_Continuous_Torq: 8 Vector__XXX
 SG_ Engine_Continuous_Torque_Speed_L : 0|64@1+ (1,0) [0|18446744073709551615] "" Vector__XXX

BO_ 2566804736 VDMA_FE55_Gaseous_Fuel_Propertie: 8 Vector__XXX
 SG_ Gaseous_Fuel_Properties_RawPaylo : 0|64@1+ (1,0) [0|18446744073709551615] "" Vector__XXX

BO_ 2566804992 VDMA_FE56_Aftertreatment_1_Diese: 8 Vector__XXX
 SG_ Aftertreatment_1_Diesel_Exhaust_ : 0|64@1+ (1,0) [0|18446744073709551615] "" Vector__XXX

BO_ 2566805248 VDMA_FE57_Air_Suspension_Control: 8 Vector__XXX
 SG_ Air_Suspension_Control_5_RawPayl : 0|64@1+ (1,0) [0|18446744073709551615] "" Vector__XXX

BO_ 2566805504 VDMA_FE58_Air_Suspension_Control: 8 Vector__XXX
 SG_ Air_Suspension_Control_4_RawPayl : 0|64@1+ (1,0) [0|18446744073709551615] "" Vector__XXX

BO_ 2566805760 VDMA_FE59_Air_Suspension_Control: 8 Vector__XXX
 SG_ Air_Suspension_Control_3_RawPayl : 0|64@1+ (1,0) [0|18446744073709551615] "" Vector__XXX

BO_ 2566806016 VDMA_FE5A_Air_Suspension_Control: 8 Vector__XXX
 SG_ Air_Suspension_Control_1_RawPayl : 0|64@1+ (1,0) [0|18446744073709551615] "" Vector__XXX

BO_ 2566806272 VDMA_FE5B_Forward_Lane_Image_2: 8 Vector__XXX
 SG_ Forward_Lane_Image_2_RawPayload : 0|64@1+ (1,0) [0|18446744073709551615] "" Vector__XXX

BO_ 2566806528 VDMA_FE5C_Running_Gear_Equipment: 8 Vector__XXX
 SG_ Running_Gear_Equipment_2_2_RawPa : 0|64@1+ (1,0) [0|18446744073709551615] "" Vector__XXX

BO_ 2566806784 VDMA_FE5D_General_Purpose_Messag: 8 Vector__XXX
 SG_ General_Purpose_Message_1_2_RawP : 0|64@1+ (1,0) [0|18446744073709551615] "" Vector__XXX

BO_ 2566807040 VDMA_FE5E_Running_Gear_Equipment: 8 Vector__XXX
 SG_ Running_Gear_Equipment_2_3_RawPa : 0|64@1+ (1,0) [0|18446744073709551615] "" Vector__XXX

BO_ 2566807296 VDMA_FE5F_General_Purpose_Messag: 8 Vector__XXX
 SG_ General_Purpose_Message_1_3_RawP : 0|64@1+ (1,0) [0|18446744073709551615] "" Vector__XXX

BO_ 2566807552 VDMA_FE60_General_Purpose_Messag: 8 Vector__XXX
 SG_ General_Purpose_Message_2_3_RawP : 0|64@1+ (1,0) [0|18446744073709551615] "" Vector__XXX

BO_ 2566807808 VDMA_FE61_General_Purpose_Messag: 8 Vector__XXX
 SG_ General_Purpose_Message_1_4_RawP : 0|64@1+ (1,0) [0|18446744073709551615] "" Vector__XXX

BO_ 2566808064 VDMA_FE62_General_Purpose_Messag: 8 Vector__XXX
 SG_ General_Purpose_Message_2_4_RawP : 0|64@1+ (1,0) [0|18446744073709551615] "" Vector__XXX

BO_ 2566808320 VDMA_FE63_General_Purpose_Messag: 8 Vector__XXX
 SG_ General_Purpose_Message_1_5_RawP : 0|64@1+ (1,0) [0|18446744073709551615] "" Vector__XXX

BO_ 2566808576 VDMA_FE64_General_Purpose_Messag: 8 Vector__XXX
 SG_ General_Purpose_Message_2_5_RawP : 0|64@1+ (1,0) [0|18446744073709551615] "" Vector__XXX

BO_ 2566808832 VDMA_FE65_General_Purpose_Messag: 8 Vector__XXX
 SG_ General_Purpose_Message_1_6_RawP : 0|64@1+ (1,0) [0|18446744073709551615] "" Vector__XXX

BO_ 2566809088 VDMA_FE66_Battery_Main_Switch_In: 8 Vector__XXX
 SG_ Battery_Main_Switch_Information_ : 0|64@1+ (1,0) [0|18446744073709551615] "" Vector__XXX

BO_ 2566809344 VDMA_FE67_Climate_Control_Config: 8 Vector__XXX
 SG_ Climate_Control_Configuration_Ra : 0|64@1+ (1,0) [0|18446744073709551615] "" Vector__XXX

BO_ 2566809600 VDMA_FE68_Vehicle_Fluids: 8 Vector__XXX
 SG_ Vehicle_Fluids_RawPayload : 0|64@1+ (1,0) [0|18446744073709551615] "" Vector__XXX

BO_ 2566809856 VDMA_FE69_Engine_Temperature_3: 8 Vector__XXX
 SG_ Engine_Temperature_3_RawPayload : 0|64@1+ (1,0) [0|18446744073709551615] "" Vector__XXX

BO_ 2566810112 VDMA_FE6A_Engine_Fuel_Lube_Syste: 8 Vector__XXX
 SG_ Engine_Fuel_Lube_Systems_RawPayl : 0|64@1+ (1,0) [0|18446744073709551615] "" Vector__XXX

BO_ 2566810368 VDMA_FE6B_Driver_s_Identificatio: 8 Vector__XXX
 SG_ Driver_s_Identification_RawPaylo : 0|64@1+ (1,0) [0|18446744073709551615] "" Vector__XXX

BO_ 2566810880 VDMA_FE6D_Heater_Information: 8 Vector__XXX
 SG_ Heater_Information_RawPayload : 0|64@1+ (1,0) [0|18446744073709551615] "" Vector__XXX

BO_ 2566811136 VDMA_FE6E_High_Resolution_Wheel_: 8 Vector__XXX
 SG_ High_Resolution_Wheel_Speed_RawP : 0|64@1+ (1,0) [0|18446744073709551615] "" Vector__XXX

BO_ 2566811392 VDMA_FE6F_Adaptive_Cruise_Contro: 8 Vector__XXX
 SG_ Adaptive_Cruise_Control_1_RawPay : 0|64@1+ (1,0) [0|18446744073709551615] "" Vector__XXX

BO_ 2566811648 VDMA_FE70_Combination_Vehicle_We: 8 Vector__XXX
 SG_ Combination_Vehicle_Weight_RawPa : 0|64@1+ (1,0) [0|18446744073709551615] "" Vector__XXX

BO_ 2566811904 VDMA_FE71_Laser_Tracer_Position: 8 Vector__XXX
 SG_ Laser_Tracer_Position_RawPayload : 0|64@1+ (1,0) [0|18446744073709551615] "" Vector__XXX

BO_ 2566812160 VDMA_FE72_Laser_Leveling_System_: 8 Vector__XXX
 SG_ Laser_Leveling_System_Blade_Cont : 0|64@1+ (1,0) [0|18446744073709551615] "" Vector__XXX

BO_ 2566812416 VDMA_FE73_Laser_Receiver_Mast_Po: 8 Vector__XXX
 SG_ Laser_Receiver_Mast_Position_Raw : 0|64@1+ (1,0) [0|18446744073709551615] "" Vector__XXX

BO_ 2566812672 VDMA_FE74_Modify_Leveling_System: 8 Vector__XXX
 SG_ Modify_Leveling_System_Control_S : 0|64@1+ (1,0) [0|18446744073709551615] "" Vector__XXX

BO_ 2566812928 VDMA_FE75_Laser_Leveling_System_: 8 Vector__XXX
 SG_ Laser_Leveling_System_Vertical_D : 0|64@1+ (1,0) [0|18446744073709551615] "" Vector__XXX

BO_ 2566813184 VDMA_FE76_Laser_Leveling_System_: 8 Vector__XXX
 SG_ Laser_Leveling_System_Vertical_P : 0|64@1+ (1,0) [0|18446744073709551615] "" Vector__XXX

BO_ 2566813440 VDMA_FE77_Auxiliary_Pressures: 8 Vector__XXX
 SG_ Auxiliary_Pressures_RawPayload : 0|64@1+ (1,0) [0|18446744073709551615] "" Vector__XXX

BO_ 2566813696 VDMA_FE78_Tire_Pressure_Control_: 8 Vector__XXX
 SG_ Tire_Pressure_Control_Unit_Mode_ : 0|64@1+ (1,0) [0|18446744073709551615] "" Vector__XXX

BO_ 2566813952 VDMA_FE79_Tire_Pressure_Control_: 8 Vector__XXX
 SG_ Tire_Pressure_Control_Unit_Targe : 0|64@1+ (1,0) [0|18446744073709551615] "" Vector__XXX

BO_ 2566814208 VDMA_FE7A_Tire_Pressure_Control_: 8 Vector__XXX
 SG_ Tire_Pressure_Control_Unit_Curre : 0|64@1+ (1,0) [0|18446744073709551615] "" Vector__XXX

BO_ 2566814464 VDMA_FE7B_Combustion_Time_1: 8 Vector__XXX
 SG_ Combustion_Time_1_RawPayload : 0|64@1+ (1,0) [0|18446744073709551615] "" Vector__XXX

BO_ 2566814720 VDMA_FE7C_Combustion_Time_2: 8 Vector__XXX
 SG_ Combustion_Time_2_RawPayload : 0|64@1+ (1,0) [0|18446744073709551615] "" Vector__XXX

BO_ 2566814976 VDMA_FE7D_Combustion_Time_3: 8 Vector__XXX
 SG_ Combustion_Time_3_RawPayload : 0|64@1+ (1,0) [0|18446744073709551615] "" Vector__XXX

BO_ 2566815232 VDMA_FE7E_Combustion_Time_4: 8 Vector__XXX
 SG_ Combustion_Time_4_RawPayload : 0|64@1+ (1,0) [0|18446744073709551615] "" Vector__XXX

BO_ 2566815488 VDMA_FE7F_Combustion_Time_5: 8 Vector__XXX
 SG_ Combustion_Time_5_RawPayload : 0|64@1+ (1,0) [0|18446744073709551615] "" Vector__XXX

BO_ 2566815744 VDMA_FE80_Combustion_Time_6: 8 Vector__XXX
 SG_ Combustion_Time_6_RawPayload : 0|64@1+ (1,0) [0|18446744073709551615] "" Vector__XXX

BO_ 2566816000 VDMA_FE81_Fuel_Information_2_Gas: 8 Vector__XXX
 SG_ Fuel_Information_2_Gaseous_RawPa : 0|64@1+ (1,0) [0|18446744073709551615] "" Vector__XXX

BO_ 2566816256 VDMA_FE82_Ignition_Timing_1: 8 Vector__XXX
 SG_ Ignition_Timing_1_RawPayload : 0|64@1+ (1,0) [0|18446744073709551615] "" Vector__XXX

BO_ 2566816512 VDMA_FE83_Ignition_Timing_2: 8 Vector__XXX
 SG_ Ignition_Timing_2_RawPayload : 0|64@1+ (1,0) [0|18446744073709551615] "" Vector__XXX

BO_ 2566816768 VDMA_FE84_Ignition_Timing_3: 8 Vector__XXX
 SG_ Ignition_Timing_3_RawPayload : 0|64@1+ (1,0) [0|18446744073709551615] "" Vector__XXX

BO_ 2566817024 VDMA_FE85_Ignition_Timing_4: 8 Vector__XXX
 SG_ Ignition_Timing_4_RawPayload : 0|64@1+ (1,0) [0|18446744073709551615] "" Vector__XXX

BO_ 2566817280 VDMA_FE86_Ignition_Timing_5: 8 Vector__XXX
 SG_ Ignition_Timing_5_RawPayload : 0|64@1+ (1,0) [0|18446744073709551615] "" Vector__XXX

BO_ 2566817536 VDMA_FE87_Ignition_Timing_6: 8 Vector__XXX
 SG_ Ignition_Timing_6_RawPayload : 0|64@1+ (1,0) [0|18446744073709551615] "" Vector__XXX

BO_ 2566817792 VDMA_FE88_Ignition_Transformer_S: 8 Vector__XXX
 SG_ Ignition_Transformer_Secondary_O : 0|64@1+ (1,0) [0|18446744073709551615] "" Vector__XXX

BO_ 2566818048 VDMA_FE89_Ignition_Transformer_S: 8 Vector__XXX
 SG_ Ignition_Transformer_Secondary_O : 0|64@1+ (1,0) [0|18446744073709551615] "" Vector__XXX

BO_ 2566818304 VDMA_FE8A_Ignition_Transformer_S: 8 Vector__XXX
 SG_ Ignition_Transformer_Secondary_O : 0|64@1+ (1,0) [0|18446744073709551615] "" Vector__XXX

BO_ 2566818560 VDMA_FE8B_Gaseous_Fuel_Pressure_: 8 Vector__XXX
 SG_ Gaseous_Fuel_Pressure_1_RawPaylo : 0|64@1+ (1,0) [0|18446744073709551615] "" Vector__XXX

BO_ 2566818816 VDMA_FE8C_Auxiliary_Analog_Infor: 8 Vector__XXX
 SG_ Auxiliary_Analog_Information_Raw : 0|64@1+ (1,0) [0|18446744073709551615] "" Vector__XXX

BO_ 2566819072 VDMA_FE8D_Vehicle_Electrical_Pow: 8 Vector__XXX
 SG_ Vehicle_Electrical_Power_2_RawPa : 0|64@1+ (1,0) [0|18446744073709551615] "" Vector__XXX

BO_ 2566819328 VDMA_FE8E_Service_2: 8 Vector__XXX
 SG_ Service_2_RawPayload : 0|64@1+ (1,0) [0|18446744073709551615] "" Vector__XXX

BO_ 2566819584 VDMA_FE8F_Supply_Pressure_2: 8 Vector__XXX
 SG_ Supply_Pressure_2_RawPayload : 0|64@1+ (1,0) [0|18446744073709551615] "" Vector__XXX

BO_ 2566819840 VDMA_FE90_Engine_Torque_History: 8 Vector__XXX
 SG_ Engine_Torque_History_RawPayload : 0|64@1+ (1,0) [0|18446744073709551615] "" Vector__XXX

BO_ 2566820096 VDMA_FE91_Fuel_Leakage: 8 Vector__XXX
 SG_ Fuel_Leakage_RawPayload : 0|64@1+ (1,0) [0|18446744073709551615] "" Vector__XXX

BO_ 2566820352 VDMA_FE92_Engine_Information_1: 8 Vector__XXX
 SG_ Engine_Information_1_RawPayload : 0|64@1+ (1,0) [0|18446744073709551615] "" Vector__XXX

BO_ 2566820608 VDMA_FE93_Engine_Electrical_Syst: 8 Vector__XXX
 SG_ Engine_Electrical_System_Module_ : 0|64@1+ (1,0) [0|18446744073709551615] "" Vector__XXX

BO_ 2566820864 VDMA_FE94_Engine_Auxiliary_Coola: 8 Vector__XXX
 SG_ Engine_Auxiliary_Coolant_RawPayl : 0|64@1+ (1,0) [0|18446744073709551615] "" Vector__XXX

BO_ 2566821120 VDMA_FE95_Rebuild_Information: 8 Vector__XXX
 SG_ Rebuild_Information_RawPayload : 0|64@1+ (1,0) [0|18446744073709551615] "" Vector__XXX

BO_ 2566821376 VDMA_FE96_Turbocharger_Wastegate: 8 Vector__XXX
 SG_ Turbocharger_Wastegate_RawPayloa : 0|64@1+ (1,0) [0|18446744073709551615] "" Vector__XXX

BO_ 2566821632 VDMA_FE97_Turbocharger_Informati: 8 Vector__XXX
 SG_ Turbocharger_Information_5_RawPa : 0|64@1+ (1,0) [0|18446744073709551615] "" Vector__XXX

BO_ 2566821888 VDMA_FE98_Turbocharger_Informati: 8 Vector__XXX
 SG_ Turbocharger_Information_4_RawPa : 0|64@1+ (1,0) [0|18446744073709551615] "" Vector__XXX

BO_ 2566822144 VDMA_FE99_Turbocharger_Informati: 8 Vector__XXX
 SG_ Turbocharger_Information_3_RawPa : 0|64@1+ (1,0) [0|18446744073709551615] "" Vector__XXX

BO_ 2566822400 VDMA_FE9A_Turbocharger_Informati: 8 Vector__XXX
 SG_ Turbocharger_Information_2_RawPa : 0|64@1+ (1,0) [0|18446744073709551615] "" Vector__XXX

BO_ 2566822656 VDMA_FE9B_Turbocharger_Informati: 8 Vector__XXX
 SG_ Turbocharger_Information_1_RawPa : 0|64@1+ (1,0) [0|18446744073709551615] "" Vector__XXX

BO_ 2566822912 VDMA_FE9C_Main_Bearing_Temperatu: 8 Vector__XXX
 SG_ Main_Bearing_Temperature_3_RawPa : 0|64@1+ (1,0) [0|18446744073709551615] "" Vector__XXX

BO_ 2566823168 VDMA_FE9D_Main_Bearing_Temperatu: 8 Vector__XXX
 SG_ Main_Bearing_Temperature_2_RawPa : 0|64@1+ (1,0) [0|18446744073709551615] "" Vector__XXX

BO_ 2566823424 VDMA_FE9E_Main_Bearing_Temperatu: 8 Vector__XXX
 SG_ Main_Bearing_Temperature_1_RawPa : 0|64@1+ (1,0) [0|18446744073709551615] "" Vector__XXX

BO_ 2566823680 VDMA_FE9F_Exhaust_Port_Temperatu: 8 Vector__XXX
 SG_ Exhaust_Port_Temperature_5_RawPa : 0|64@1+ (1,0) [0|18446744073709551615] "" Vector__XXX

BO_ 2566823936 VDMA_FEA0_Exhaust_Port_Temperatu: 8 Vector__XXX
 SG_ Exhaust_Port_Temperature_4_RawPa : 0|64@1+ (1,0) [0|18446744073709551615] "" Vector__XXX

BO_ 2566824192 VDMA_FEA1_Exhaust_Port_Temperatu: 8 Vector__XXX
 SG_ Exhaust_Port_Temperature_3_RawPa : 0|64@1+ (1,0) [0|18446744073709551615] "" Vector__XXX

BO_ 2566824448 VDMA_FEA2_Exhaust_Port_Temperatu: 8 Vector__XXX
 SG_ Exhaust_Port_Temperature_2_RawPa : 0|64@1+ (1,0) [0|18446744073709551615] "" Vector__XXX

BO_ 2566824704 VDMA_FEA3_Exhaust_Port_Temperatu: 8 Vector__XXX
 SG_ Exhaust_Port_Temperature_1_RawPa : 0|64@1+ (1,0) [0|18446744073709551615] "" Vector__XXX

BO_ 2566824960 VDMA_FEA4_Engine_Temperature_2: 8 Vector__XXX
 SG_ Engine_Temperature_2_RawPayload : 0|64@1+ (1,0) [0|18446744073709551615] "" Vector__XXX

BO_ 2566825216 VDMA_FEA5_Intake_Manifold_Inform: 8 Vector__XXX
 SG_ Intake_Manifold_Information_2_Ra : 0|64@1+ (1,0) [0|18446744073709551615] "" Vector__XXX

BO_ 2566825472 VDMA_FEA6_Intake_Manifold_Inform: 8 Vector__XXX
 SG_ Intake_Manifold_Information_1_Ra : 0|64@1+ (1,0) [0|18446744073709551615] "" Vector__XXX

BO_ 2566825728 VDMA_FEA7_Alternator_Temperature: 8 Vector__XXX
 SG_ Alternator_Temperature_1_RawPayl : 0|64@1+ (1,0) [0|18446744073709551615] "" Vector__XXX

BO_ 2566825984 VDMA_FEA8_Articulation_Control: 8 Vector__XXX
 SG_ Articulation_Control_RawPayload : 0|64@1+ (1,0) [0|18446744073709551615] "" Vector__XXX

BO_ 2566826240 VDMA_FEA9_Exhaust_Oxygen_1: 8 Vector__XXX
 SG_ Exhaust_Oxygen_1_RawPayload : 0|64@1+ (1,0) [0|18446744073709551615] "" Vector__XXX

BO_ 2566826496 VDMA_FEAA_Alternate_Fuel_2: 8 Vector__XXX
 SG_ Alternate_Fuel_2_RawPayload : 0|64@1+ (1,0) [0|18446744073709551615] "" Vector__XXX

BO_ 2566826752 VDMA_FEAB_Electronic_Transmissio: 8 Vector__XXX
 SG_ Electronic_Transmission_Controll : 0|64@1+ (1,0) [0|18446744073709551615] "" Vector__XXX

BO_ 2566827008 VDMA_FEAC_Wheel_Brake_Lining_Rem: 8 Vector__XXX
 SG_ Wheel_Brake_Lining_Remaining_Inf : 0|64@1+ (1,0) [0|18446744073709551615] "" Vector__XXX

BO_ 2566827264 VDMA_FEAD_Wheel_Application_Pres: 8 Vector__XXX
 SG_ Wheel_Application_Pressure_High_ : 0|64@1+ (1,0) [0|18446744073709551615] "" Vector__XXX

BO_ 2566827520 VDMA_FEAE_Air_Supply_Pressure: 8 Vector__XXX
 SG_ Air_Supply_Pressure_RawPayload : 0|64@1+ (1,0) [0|18446744073709551615] "" Vector__XXX

BO_ 2566827776 VDMA_FEAF_Fuel_Consumption_Gaseo: 8 Vector__XXX
 SG_ Fuel_Consumption_Gaseous_RawPayl : 0|64@1+ (1,0) [0|18446744073709551615] "" Vector__XXX

BO_ 2566828032 VDMA_FEB0_Trip_Time_Information_: 8 Vector__XXX
 SG_ Trip_Time_Information_2_RawPaylo : 0|64@1+ (1,0) [0|18446744073709551615] "" Vector__XXX

BO_ 2566828288 VDMA_FEB1_ECU_History: 8 Vector__XXX
 SG_ ECU_History_RawPayload : 0|64@1+ (1,0) [0|18446744073709551615] "" Vector__XXX

BO_ 2566828544 VDMA_FEB2_Fuel_Information_1_Gas: 8 Vector__XXX
 SG_ Fuel_Information_1_Gaseous_RawPa : 0|64@1+ (1,0) [0|18446744073709551615] "" Vector__XXX

BO_ 2566828800 VDMA_FEB3_Fuel_Information_1_Liq: 8 Vector__XXX
 SG_ Fuel_Information_1_Liquid_RawPay : 0|64@1+ (1,0) [0|18446744073709551615] "" Vector__XXX

BO_ 2566829056 VDMA_FEB4_Trip_Time_Information_: 8 Vector__XXX
 SG_ Trip_Time_Information_1_RawPaylo : 0|64@1+ (1,0) [0|18446744073709551615] "" Vector__XXX

BO_ 2566829312 VDMA_FEB5_Trip_Shutdown_Informat: 8 Vector__XXX
 SG_ Trip_Shutdown_Information_RawPay : 0|64@1+ (1,0) [0|18446744073709551615] "" Vector__XXX

BO_ 2566829568 VDMA_FEB6_Trip_Vehicle_Speed_Cru: 8 Vector__XXX
 SG_ Trip_Vehicle_Speed_Cruise_Distan : 0|64@1+ (1,0) [0|18446744073709551615] "" Vector__XXX

BO_ 2566829824 VDMA_FEB7_Engine_Speed_Load_Fact: 8 Vector__XXX
 SG_ Engine_Speed_Load_Factor_Informa : 0|64@1+ (1,0) [0|18446744073709551615] "" Vector__XXX

BO_ 2566830080 VDMA_FEB8_Trip_Fuel_Information_: 8 Vector__XXX
 SG_ Trip_Fuel_Information_Gaseous_Ra : 0|64@1+ (1,0) [0|18446744073709551615] "" Vector__XXX

BO_ 2566830336 VDMA_FEB9_Trip_Fuel_Information_: 8 Vector__XXX
 SG_ Trip_Fuel_Information_Liquid_Raw : 0|64@1+ (1,0) [0|18446744073709551615] "" Vector__XXX

BO_ 2566830592 VDMA_FEBA_Trip_Distance_Informat: 8 Vector__XXX
 SG_ Trip_Distance_Information_RawPay : 0|64@1+ (1,0) [0|18446744073709551615] "" Vector__XXX

BO_ 2566830848 VDMA_FEBB_Trip_Fan_Information: 8 Vector__XXX
 SG_ Trip_Fan_Information_RawPayload : 0|64@1+ (1,0) [0|18446744073709551615] "" Vector__XXX

BO_ 2566831104 VDMA_FEBC_Compression_Service_Br: 8 Vector__XXX
 SG_ Compression_Service_Brake_Inform : 0|64@1+ (1,0) [0|18446744073709551615] "" Vector__XXX

BO_ 2566831360 VDMA_FEBD_Fan_Drive_1: 8 Vector__XXX
 SG_ Fan_Drive_1_RawPayload : 0|64@1+ (1,0) [0|18446744073709551615] "" Vector__XXX

BO_ 2566831616 VDMA_FEBE_Electronic_Engine_Cont: 8 Vector__XXX
 SG_ Electronic_Engine_Controller_4_R : 0|64@1+ (1,0) [0|18446744073709551615] "" Vector__XXX

BO_ 2566831872 VDMA_FEBF_Wheel_Speed_Informatio: 8 Vector__XXX
 SG_ Wheel_Speed_Information_RawPaylo : 0|64@1+ (1,0) [0|18446744073709551615] "" Vector__XXX

BO_ 2566832128 VDMA_FEC0_Service_Information: 8 Vector__XXX
 SG_ Service_Information_RawPayload : 0|64@1+ (1,0) [0|18446744073709551615] "" Vector__XXX

BO_ 2566832640 VDMA_FEC2_Electronic_Retarder_Co: 8 Vector__XXX
 SG_ Electronic_Retarder_Controller_2 : 0|64@1+ (1,0) [0|18446744073709551615] "" Vector__XXX

BO_ 2566832896 VDMA_FEC3_Electronic_Transmissio: 8 Vector__XXX
 SG_ Electronic_Transmission_Controll : 0|64@1+ (1,0) [0|18446744073709551615] "" Vector__XXX

BO_ 2566833152 VDMA_FEC4_Electronic_Brake_Syste: 8 Vector__XXX
 SG_ Electronic_Brake_System_2_2_RawP : 0|64@1+ (1,0) [0|18446744073709551615] "" Vector__XXX

BO_ 2566833408 VDMA_FEC5_Electronic_Transmissio: 8 Vector__XXX
 SG_ Electronic_Transmission_Controll : 0|64@1+ (1,0) [0|18446744073709551615] "" Vector__XXX

BO_ 2566833664 VDMA_FEC6_Electronic_Brake_Syste: 8 Vector__XXX
 SG_ Electronic_Brake_System_2_3_RawP : 0|64@1+ (1,0) [0|18446744073709551615] "" Vector__XXX

BO_ 2566833920 VDMA_FEC7_Electronic_Transmissio: 8 Vector__XXX
 SG_ Electronic_Transmission_Controll : 0|64@1+ (1,0) [0|18446744073709551615] "" Vector__XXX

BO_ 2566834176 VDMA_FEC8_General_Purpose_Messag: 8 Vector__XXX
 SG_ General_Purpose_Message_2_2_RawP : 0|64@1+ (1,0) [0|18446744073709551615] "" Vector__XXX

BO_ 2566834432 VDMA_FEC9_Electronic_Brake_Syste: 8 Vector__XXX
 SG_ Electronic_Brake_System_1_2_RawP : 0|64@1+ (1,0) [0|18446744073709551615] "" Vector__XXX

BO_ 2566835456 VDMA_FECD_Freeze_Frame_Parameter: 8 Vector__XXX
 SG_ Freeze_Frame_Parameters_RawPaylo : 0|64@1+ (1,0) [0|18446744073709551615] "" Vector__XXX

BO_ 2566835712 VDMA_FECE_Diagnostic_Readiness_1: 8 Vector__XXX
 SG_ Diagnostic_Readiness_1_RawPayloa : 0|64@1+ (1,0) [0|18446744073709551615] "" Vector__XXX

BO_ 2566835968 VDMA_FECF_Emission_Related_Pendi: 8 Vector__XXX
 SG_ Emission_Related_Pending_Diagnos : 0|64@1+ (1,0) [0|18446744073709551615] "" Vector__XXX

BO_ 2566836224 VDMA_FED0_Test_Results_for_Non_c: 8 Vector__XXX
 SG_ Test_Results_for_Non_continuousl : 0|64@1+ (1,0) [0|18446744073709551615] "" Vector__XXX

BO_ 2566836480 VDMA_FED1_Oxygen_Sensor_Test_Res: 8 Vector__XXX
 SG_ Oxygen_Sensor_Test_Results_RawPa : 0|64@1+ (1,0) [0|18446744073709551615] "" Vector__XXX

BO_ 2566836736 VDMA_FED2_Non_Continuously_Monit: 8 Vector__XXX
 SG_ Non_Continuously_Monitored_Syste : 0|64@1+ (1,0) [0|18446744073709551615] "" Vector__XXX

BO_ 2566837248 VDMA_FED4_Emission_Related_MIL_O: 8 Vector__XXX
 SG_ Emission_Related_MIL_On_Diagnost : 0|64@1+ (1,0) [0|18446744073709551615] "" Vector__XXX

BO_ 2566837504 VDMA_FED5_Alternator_Information: 8 Vector__XXX
 SG_ Alternator_Information_1_RawPayl : 0|64@1+ (1,0) [0|18446744073709551615] "" Vector__XXX

BO_ 2566837760 VDMA_FED6_Hybrid_or_EV_System_In: 8 Vector__XXX
 SG_ Hybrid_or_EV_System_Inputs_1_Raw : 0|64@1+ (1,0) [0|18446744073709551615] "" Vector__XXX

BO_ 2566838528 VDMA_FED9_Auxiliary_Input_Output: 8 Vector__XXX
 SG_ Auxiliary_Input_Output_Status_1_ : 0|64@1+ (1,0) [0|18446744073709551615] "" Vector__XXX

BO_ 2566839040 VDMA_FEDB_Engine_Fluid_Level_Pre: 8 Vector__XXX
 SG_ Engine_Fluid_Level_Pressure_2_Ra : 0|64@1+ (1,0) [0|18446744073709551615] "" Vector__XXX

BO_ 2566839296 VDMA_FEDC_Idle_Operation: 8 Vector__XXX
 SG_ Idle_Operation_RawPayload : 0|64@1+ (1,0) [0|18446744073709551615] "" Vector__XXX

BO_ 2566839552 VDMA_FEDD_Turbocharger: 8 Vector__XXX
 SG_ Turbocharger_RawPayload : 0|64@1+ (1,0) [0|18446744073709551615] "" Vector__XXX

BO_ 2566839808 VDMA_FEDE_Engine_Air_Start_Press: 8 Vector__XXX
 SG_ Engine_Air_Start_Pressure_RawPay : 0|64@1+ (1,0) [0|18446744073709551615] "" Vector__XXX

BO_ 2566840320 VDMA_FEE0_Vehicle_Distance: 8 Vector__XXX
 SG_ Vehicle_Distance_RawPayload : 0|64@1+ (1,0) [0|18446744073709551615] "" Vector__XXX

BO_ 2566840576 VDMA_FEE1_Retarder_Configuration: 8 Vector__XXX
 SG_ Retarder_Configuration_RawPayloa : 0|64@1+ (1,0) [0|18446744073709551615] "" Vector__XXX

BO_ 2566840832 VDMA_FEE2_Transmission_Configura: 8 Vector__XXX
 SG_ Transmission_Configuration_RawPa : 0|64@1+ (1,0) [0|18446744073709551615] "" Vector__XXX

BO_ 2566841344 VDMA_FEE4_Shutdown: 8 Vector__XXX
 SG_ Shutdown_RawPayload : 0|64@1+ (1,0) [0|18446744073709551615] "" Vector__XXX

BO_ 2566842112 VDMA_FEE7_Vehicle_Hours: 8 Vector__XXX
 SG_ Vehicle_Hours_RawPayload : 0|64@1+ (1,0) [0|18446744073709551615] "" Vector__XXX

BO_ 2566842368 VDMA_FEE8_Vehicle_Direction_Spee: 8 Vector__XXX
 SG_ Vehicle_Direction_Speed_RawPaylo : 0|64@1+ (1,0) [0|18446744073709551615] "" Vector__XXX

BO_ 2566842624 VDMA_FEE9_Fuel_Consumption_Liqui: 8 Vector__XXX
 SG_ Fuel_Consumption_Liquid_1_RawPay : 0|64@1+ (1,0) [0|18446744073709551615] "" Vector__XXX

BO_ 2566842880 VDMA_FEEA_Vehicle_Weight: 8 Vector__XXX
 SG_ Vehicle_Weight_RawPayload : 0|64@1+ (1,0) [0|18446744073709551615] "" Vector__XXX

BO_ 2566843648 VDMA_FEED_Cruise_Control_Vehicle: 8 Vector__XXX
 SG_ Cruise_Control_Vehicle_Speed_Set : 0|64@1+ (1,0) [0|18446744073709551615] "" Vector__XXX

BO_ 2566844416 VDMA_FEF0_Power_Takeoff_Informat: 8 Vector__XXX
 SG_ Power_Takeoff_Information_1_RawP : 0|64@1+ (1,0) [0|18446744073709551615] "" Vector__XXX

BO_ 2566845184 VDMA_FEF3_Vehicle_Position_1: 8 Vector__XXX
 SG_ Vehicle_Position_1_RawPayload : 0|64@1+ (1,0) [0|18446744073709551615] "" Vector__XXX

BO_ 2566845440 VDMA_FEF4_Tire_Condition_Message: 8 Vector__XXX
 SG_ Tire_Condition_Message_1_RawPayl : 0|64@1+ (1,0) [0|18446744073709551615] "" Vector__XXX

BO_ 2566845696 VDMA_FEF5_Ambient_Conditions: 8 Vector__XXX
 SG_ Ambient_Conditions_RawPayload : 0|64@1+ (1,0) [0|18446744073709551615] "" Vector__XXX

BO_ 2566846720 VDMA_FEF9_Axle_Information: 8 Vector__XXX
 SG_ Axle_Information_RawPayload : 0|64@1+ (1,0) [0|18446744073709551615] "" Vector__XXX

BO_ 2566846976 VDMA_FEFA_Brakes_1: 8 Vector__XXX
 SG_ Brakes_1_RawPayload : 0|64@1+ (1,0) [0|18446744073709551615] "" Vector__XXX

BO_ 2566847232 VDMA_FEFB_Retarder_fluids: 8 Vector__XXX
 SG_ Retarder_fluids_RawPayload : 0|64@1+ (1,0) [0|18446744073709551615] "" Vector__XXX

BO_ 2566847488 VDMA_FEFC_Dash_Display_1: 8 Vector__XXX
 SG_ Dash_Display_1_RawPayload : 0|64@1+ (1,0) [0|18446744073709551615] "" Vector__XXX

BO_ 2566847744 VDMA_FEFD_Alternate_Fuel_1: 8 Vector__XXX
 SG_ Alternate_Fuel_1_RawPayload : 0|64@1+ (1,0) [0|18446744073709551615] "" Vector__XXX

BO_ 2566848000 VDMA_FEFE_Auxiliary_Water_Pump_P: 8 Vector__XXX
 SG_ Auxiliary_Water_Pump_Pressure_Ra : 0|64@1+ (1,0) [0|18446744073709551615] "" Vector__XXX

BO_ 2566848256 VDMA_FEFF_Operator_indicators: 8 Vector__XXX
 SG_ Operator_indicators_RawPayload : 0|64@1+ (1,0) [0|18446744073709551615] "" Vector__XXX

BO_ 2582446080 VDMA_1ED00_NMEA_Request_Command_: 8 Vector__XXX
 SG_ NMEA_Request_Command_Acknowledge : 0|64@1+ (1,0) [0|18446744073709551615] "" Vector__XXX

BO_ 2582511616 VDMA_1EE00_PGN_List_Transmit_Rec: 8 Vector__XXX
 SG_ PGN_List_Transmit_Receive_PGN_s_ : 0|64@1+ (1,0) [0|18446744073709551615] "" Vector__XXX

BO_ 2582644480 VDMA_1F007_Alert: 8 Vector__XXX
 SG_ Alert_RawPayload : 0|64@1+ (1,0) [0|18446744073709551615] "" Vector__XXX

BO_ 2582644736 VDMA_1F008_Alert_Response: 8 Vector__XXX
 SG_ Alert_Response_RawPayload : 0|64@1+ (1,0) [0|18446744073709551615] "" Vector__XXX

BO_ 2582644992 VDMA_1F009_Alert_Text: 8 Vector__XXX
 SG_ Alert_Text_RawPayload : 0|64@1+ (1,0) [0|18446744073709551615] "" Vector__XXX

BO_ 2582645248 VDMA_1F00A_Alert_Configuration: 8 Vector__XXX
 SG_ Alert_Configuration_RawPayload : 0|64@1+ (1,0) [0|18446744073709551615] "" Vector__XXX

BO_ 2582645504 VDMA_1F00B_Alert_Threshold: 8 Vector__XXX
 SG_ Alert_Threshold_RawPayload : 0|64@1+ (1,0) [0|18446744073709551615] "" Vector__XXX

BO_ 2582645760 VDMA_1F00C_Alert_Value: 8 Vector__XXX
 SG_ Alert_Value_RawPayload : 0|64@1+ (1,0) [0|18446744073709551615] "" Vector__XXX

BO_ 2582646784 VDMA_1F010_System_Time: 8 Vector__XXX
 SG_ System_Time_RawPayload : 0|64@1+ (1,0) [0|18446744073709551615] "" Vector__XXX

BO_ 2582647040 VDMA_1F011_Heartbeat: 8 Vector__XXX
 SG_ Heartbeat_RawPayload : 0|64@1+ (1,0) [0|18446744073709551615] "" Vector__XXX

BO_ 2582647808 VDMA_1F014_Product_Information: 8 Vector__XXX
 SG_ Product_Information_RawPayload : 0|64@1+ (1,0) [0|18446744073709551615] "" Vector__XXX

BO_ 2582648320 VDMA_1F016_Configuration_Informa: 8 Vector__XXX
 SG_ Configuration_Information_RawPay : 0|64@1+ (1,0) [0|18446744073709551615] "" Vector__XXX

BO_ 2582649088 VDMA_1F019_Cyclic_Alert_List_IEC: 8 Vector__XXX
 SG_ Cyclic_Alert_List_IEC_61924_2_Ra : 0|64@1+ (1,0) [0|18446744073709551615] "" Vector__XXX

BO_ 2582649344 VDMA_1F01A_Responsibility_Transf: 8 Vector__XXX
 SG_ Responsibility_Transfer_Function : 0|64@1+ (1,0) [0|18446744073709551615] "" Vector__XXX

BO_ 2582708480 VDMA_1F101_Man_Overboard_Notific: 8 Vector__XXX
 SG_ Man_Overboard_Notification_MOB_R : 0|64@1+ (1,0) [0|18446744073709551615] "" Vector__XXX

BO_ 2582709504 VDMA_1F105_Heading_Track_Control: 8 Vector__XXX
 SG_ Heading_Track_Control_RawPayload : 0|64@1+ (1,0) [0|18446744073709551615] "" Vector__XXX

BO_ 2582711552 VDMA_1F10D_Rudder: 8 Vector__XXX
 SG_ Rudder_RawPayload : 0|64@1+ (1,0) [0|18446744073709551615] "" Vector__XXX

BO_ 2582713344 VDMA_1F114_Heave: 8 Vector__XXX
 SG_ Heave_RawPayload : 0|64@1+ (1,0) [0|18446744073709551615] "" Vector__XXX

BO_ 2582714624 VDMA_1F119_Attitude: 8 Vector__XXX
 SG_ Attitude_RawPayload : 0|64@1+ (1,0) [0|18446744073709551615] "" Vector__XXX

BO_ 2582714880 VDMA_1F11A_Magnetic_Variation: 8 Vector__XXX
 SG_ Magnetic_Variation_RawPayload : 0|64@1+ (1,0) [0|18446744073709551615] "" Vector__XXX

BO_ 2582773760 VDMA_1F200_Engine_Parameters_Rap: 8 Vector__XXX
 SG_ Engine_Parameters_Rapid_Update_R : 0|64@1+ (1,0) [0|18446744073709551615] "" Vector__XXX

BO_ 2582774016 VDMA_1F201_Engine_Parameters_Dyn: 8 Vector__XXX
 SG_ Engine_Parameters_Dynamic_RawPay : 0|64@1+ (1,0) [0|18446744073709551615] "" Vector__XXX

BO_ 2582774272 VDMA_1F202_Electric_Drive_Status: 8 Vector__XXX
 SG_ Electric_Drive_Status_Dynamic_Ra : 0|64@1+ (1,0) [0|18446744073709551615] "" Vector__XXX

BO_ 2582774528 VDMA_1F203_Electric_Energy_Stora: 8 Vector__XXX
 SG_ Electric_Energy_Storage_Status_D : 0|64@1+ (1,0) [0|18446744073709551615] "" Vector__XXX

BO_ 2582775040 VDMA_1F205_Transmission_Paramete: 8 Vector__XXX
 SG_ Transmission_Parameters_Dynamic_ : 0|64@1+ (1,0) [0|18446744073709551615] "" Vector__XXX

BO_ 2582775296 VDMA_1F206_Electric_Drive_Inform: 8 Vector__XXX
 SG_ Electric_Drive_Information_RawPa : 0|64@1+ (1,0) [0|18446744073709551615] "" Vector__XXX

BO_ 2582775552 VDMA_1F207_Electric_Energy_Stora: 8 Vector__XXX
 SG_ Electric_Energy_Storage_Informat : 0|64@1+ (1,0) [0|18446744073709551615] "" Vector__XXX

BO_ 2582775808 VDMA_1F208_Trip_Parameters_Vesse: 8 Vector__XXX
 SG_ Trip_Parameters_Vessel_RawPayloa : 0|64@1+ (1,0) [0|18446744073709551615] "" Vector__XXX

BO_ 2582776064 VDMA_1F209_Trip_Parameters_Small: 8 Vector__XXX
 SG_ Trip_Parameters_Small_Craft_RawP : 0|64@1+ (1,0) [0|18446744073709551615] "" Vector__XXX

BO_ 2582776320 VDMA_1F20A_Engine_Parameters_Sta: 8 Vector__XXX
 SG_ Engine_Parameters_Static_RawPayl : 0|64@1+ (1,0) [0|18446744073709551615] "" Vector__XXX

BO_ 2582776832 VDMA_1F20C_Load_Controller_Conne: 8 Vector__XXX
 SG_ Load_Controller_Connection_State : 0|64@1+ (1,0) [0|18446744073709551615] "" Vector__XXX

BO_ 2582777088 VDMA_1F20D_Binary_Switch_Bank_St: 8 Vector__XXX
 SG_ Binary_Switch_Bank_Status_RawPay : 0|64@1+ (1,0) [0|18446744073709551615] "" Vector__XXX

BO_ 2582777344 VDMA_1F20E_Switch_Bank_Control: 8 Vector__XXX
 SG_ Switch_Bank_Control_RawPayload : 0|64@1+ (1,0) [0|18446744073709551615] "" Vector__XXX

BO_ 2582777600 VDMA_1F20F_AC_Input_Status: 8 Vector__XXX
 SG_ AC_Input_Status_RawPayload : 0|64@1+ (1,0) [0|18446744073709551615] "" Vector__XXX

BO_ 2582777856 VDMA_1F210_AC_Output_Status: 8 Vector__XXX
 SG_ AC_Output_Status_RawPayload : 0|64@1+ (1,0) [0|18446744073709551615] "" Vector__XXX

BO_ 2582778112 VDMA_1F211_Fluid_Level: 8 Vector__XXX
 SG_ Fluid_Level_RawPayload : 0|64@1+ (1,0) [0|18446744073709551615] "" Vector__XXX

BO_ 2582778368 VDMA_1F212_DC_Detailed_Status: 8 Vector__XXX
 SG_ DC_Detailed_Status_RawPayload : 0|64@1+ (1,0) [0|18446744073709551615] "" Vector__XXX

BO_ 2582778624 VDMA_1F213_Charger_Status: 8 Vector__XXX
 SG_ Charger_Status_RawPayload : 0|64@1+ (1,0) [0|18446744073709551615] "" Vector__XXX

BO_ 2582778880 VDMA_1F214_Battery_Status: 8 Vector__XXX
 SG_ Battery_Status_RawPayload : 0|64@1+ (1,0) [0|18446744073709551615] "" Vector__XXX

BO_ 2582779136 VDMA_1F215_Inverter_Status: 8 Vector__XXX
 SG_ Inverter_Status_RawPayload : 0|64@1+ (1,0) [0|18446744073709551615] "" Vector__XXX

BO_ 2582779392 VDMA_1F216_Charger_Configuration: 8 Vector__XXX
 SG_ Charger_Configuration_Status_Raw : 0|64@1+ (1,0) [0|18446744073709551615] "" Vector__XXX

BO_ 2582779648 VDMA_1F217_Inverter_Configuratio: 8 Vector__XXX
 SG_ Inverter_Configuration_Status_Ra : 0|64@1+ (1,0) [0|18446744073709551615] "" Vector__XXX

BO_ 2582779904 VDMA_1F218_AGS_Configuration_Sta: 8 Vector__XXX
 SG_ AGS_Configuration_Status_RawPayl : 0|64@1+ (1,0) [0|18446744073709551615] "" Vector__XXX

BO_ 2582780160 VDMA_1F219_Battery_Configuration: 8 Vector__XXX
 SG_ Battery_Configuration_Status_Raw : 0|64@1+ (1,0) [0|18446744073709551615] "" Vector__XXX

BO_ 2582780416 VDMA_1F21A_AGS_Status: 8 Vector__XXX
 SG_ AGS_Status_RawPayload : 0|64@1+ (1,0) [0|18446744073709551615] "" Vector__XXX

BO_ 2582839296 VDMA_1F300_AC_Power_Current_Phas: 8 Vector__XXX
 SG_ AC_Power_Current_Phase_A_RawPayl : 0|64@1+ (1,0) [0|18446744073709551615] "" Vector__XXX

BO_ 2582839552 VDMA_1F301_AC_Power_Current_Phas: 8 Vector__XXX
 SG_ AC_Power_Current_Phase_B_RawPayl : 0|64@1+ (1,0) [0|18446744073709551615] "" Vector__XXX

BO_ 2582839808 VDMA_1F302_AC_Power_Current_Phas: 8 Vector__XXX
 SG_ AC_Power_Current_Phase_C_RawPayl : 0|64@1+ (1,0) [0|18446744073709551615] "" Vector__XXX

BO_ 2582840064 VDMA_1F303_AC_Voltage_Frequency_: 8 Vector__XXX
 SG_ AC_Voltage_Frequency_Phase_A_Raw : 0|64@1+ (1,0) [0|18446744073709551615] "" Vector__XXX

BO_ 2582840320 VDMA_1F304_AC_Voltage_Frequency_: 8 Vector__XXX
 SG_ AC_Voltage_Frequency_Phase_B_Raw : 0|64@1+ (1,0) [0|18446744073709551615] "" Vector__XXX

CM_ BO_ 2566769664  "Source: isobus.net VDMA Data Dictionary (https://www.isobus.net/isobus/pGNAndSPN/15407?type=PGN)";
CM_ BO_ 2566769920  "Source: isobus.net VDMA Data Dictionary (https://www.isobus.net/isobus/pGNAndSPN/15416?type=PGN)";
CM_ BO_ 2566770176  "Source: isobus.net VDMA Data Dictionary (https://www.isobus.net/isobus/pGNAndSPN/15417?type=PGN)";
CM_ BO_ 2566770432  "Source: isobus.net VDMA Data Dictionary (https://www.isobus.net/isobus/pGNAndSPN/15418?type=PGN)";
CM_ BO_ 2566770688  "Source: isobus.net VDMA Data Dictionary (https://www.isobus.net/isobus/pGNAndSPN/15425?type=PGN)";
CM_ BO_ 2566770944  "Source: isobus.net VDMA Data Dictionary (https://www.isobus.net/isobus/pGNAndSPN/15428?type=PGN)";
CM_ BO_ 2566771200  "Source: isobus.net VDMA Data Dictionary (https://www.isobus.net/isobus/pGNAndSPN/15430?type=PGN)";
CM_ BO_ 2566771456  "Source: isobus.net VDMA Data Dictionary (https://www.isobus.net/isobus/pGNAndSPN/15434?type=PGN)";
CM_ BO_ 2566771712  "Source: isobus.net VDMA Data Dictionary (https://www.isobus.net/isobus/pGNAndSPN/15452?type=PGN)";
CM_ BO_ 2566771968  "Source: isobus.net VDMA Data Dictionary (https://www.isobus.net/isobus/pGNAndSPN/15459?type=PGN)";
CM_ BO_ 2566772224  "Source: isobus.net VDMA Data Dictionary (https://www.isobus.net/isobus/pGNAndSPN/15481?type=PGN)";
CM_ BO_ 2566772480  "Source: isobus.net VDMA Data Dictionary (https://www.isobus.net/isobus/pGNAndSPN/15500?type=PGN)";
CM_ BO_ 2566772736  "Source: isobus.net VDMA Data Dictionary (https://www.isobus.net/isobus/pGNAndSPN/15522?type=PGN)";
CM_ BO_ 2566772992  "Source: isobus.net VDMA Data Dictionary (https://www.isobus.net/isobus/pGNAndSPN/15541?type=PGN)";
CM_ BO_ 2566773248  "Source: isobus.net VDMA Data Dictionary (https://www.isobus.net/isobus/pGNAndSPN/15563?type=PGN)";
CM_ BO_ 2566773504  "Source: isobus.net VDMA Data Dictionary (https://www.isobus.net/isobus/pGNAndSPN/15582?type=PGN)";
CM_ BO_ 2566773760  "Source: isobus.net VDMA Data Dictionary (https://www.isobus.net/isobus/pGNAndSPN/15586?type=PGN)";
CM_ BO_ 2566774016  "Source: isobus.net VDMA Data Dictionary (https://www.isobus.net/isobus/pGNAndSPN/15587?type=PGN)";
CM_ BO_ 2566774272  "Source: isobus.net VDMA Data Dictionary (https://www.isobus.net/isobus/pGNAndSPN/15588?type=PGN)";
CM_ BO_ 2566774528  "Source: isobus.net VDMA Data Dictionary (https://www.isobus.net/isobus/pGNAndSPN/15589?type=PGN)";
CM_ BO_ 2566774784  "Source: isobus.net VDMA Data Dictionary (https://www.isobus.net/isobus/pGNAndSPN/15594?type=PGN)";
CM_ BO_ 2566775040  "Source: isobus.net VDMA Data Dictionary (https://www.isobus.net/isobus/pGNAndSPN/15603?type=PGN)";
CM_ BO_ 2566775296  "Source: isobus.net VDMA Data Dictionary (https://www.isobus.net/isobus/pGNAndSPN/15610?type=PGN)";
CM_ BO_ 2566775552  "Source: isobus.net VDMA Data Dictionary (https://www.isobus.net/isobus/pGNAndSPN/15611?type=PGN)";
CM_ BO_ 2566775808  "Source: isobus.net VDMA Data Dictionary (https://www.isobus.net/isobus/pGNAndSPN/15616?type=PGN)";
CM_ BO_ 2566776064  "Source: isobus.net VDMA Data Dictionary (https://www.isobus.net/isobus/pGNAndSPN/15624?type=PGN)";
CM_ BO_ 2566776320  "Source: isobus.net VDMA Data Dictionary (https://www.isobus.net/isobus/pGNAndSPN/15632?type=PGN)";
CM_ BO_ 2566776576  "Source: isobus.net VDMA Data Dictionary (https://www.isobus.net/isobus/pGNAndSPN/15638?type=PGN)";
CM_ BO_ 2566776832  "Source: isobus.net VDMA Data Dictionary (https://www.isobus.net/isobus/pGNAndSPN/15644?type=PGN)";
CM_ BO_ 2566777088  "Source: isobus.net VDMA Data Dictionary (https://www.isobus.net/isobus/pGNAndSPN/15647?type=PGN)";
CM_ BO_ 2566777344  "Source: isobus.net VDMA Data Dictionary (https://www.isobus.net/isobus/pGNAndSPN/15650?type=PGN)";
CM_ BO_ 2566777600  "Source: isobus.net VDMA Data Dictionary (https://www.isobus.net/isobus/pGNAndSPN/15653?type=PGN)";
CM_ BO_ 2566777856  "Source: isobus.net VDMA Data Dictionary (https://www.isobus.net/isobus/pGNAndSPN/15656?type=PGN)";
CM_ BO_ 2566778112  "Source: isobus.net VDMA Data Dictionary (https://www.isobus.net/isobus/pGNAndSPN/15658?type=PGN)";
CM_ BO_ 2566778368  "Source: isobus.net VDMA Data Dictionary (https://www.isobus.net/isobus/pGNAndSPN/15661?type=PGN)";
CM_ BO_ 2566778624  "Source: isobus.net VDMA Data Dictionary (https://www.isobus.net/isobus/pGNAndSPN/15663?type=PGN)";
CM_ BO_ 2566778880  "Source: isobus.net VDMA Data Dictionary (https://www.isobus.net/isobus/pGNAndSPN/15667?type=PGN)";
CM_ BO_ 2566779136  "Source: isobus.net VDMA Data Dictionary (https://www.isobus.net/isobus/pGNAndSPN/15670?type=PGN)";
CM_ BO_ 2566779392  "Source: isobus.net VDMA Data Dictionary (https://www.isobus.net/isobus/pGNAndSPN/15672?type=PGN)";
CM_ BO_ 2566779648  "Source: isobus.net VDMA Data Dictionary (https://www.isobus.net/isobus/pGNAndSPN/15676?type=PGN)";
CM_ BO_ 2566779904  "Source: isobus.net VDMA Data Dictionary (https://www.isobus.net/isobus/pGNAndSPN/15679?type=PGN)";
CM_ BO_ 2566780160  "Source: isobus.net VDMA Data Dictionary (https://www.isobus.net/isobus/pGNAndSPN/15681?type=PGN)";
CM_ BO_ 2566780416  "Source: isobus.net VDMA Data Dictionary (https://www.isobus.net/isobus/pGNAndSPN/15685?type=PGN)";
CM_ BO_ 2566780672  "Source: isobus.net VDMA Data Dictionary (https://www.isobus.net/isobus/pGNAndSPN/15688?type=PGN)";
CM_ BO_ 2566780928  "Source: isobus.net VDMA Data Dictionary (https://www.isobus.net/isobus/pGNAndSPN/15690?type=PGN)";
CM_ BO_ 2566781184  "Source: isobus.net VDMA Data Dictionary (https://www.isobus.net/isobus/pGNAndSPN/15694?type=PGN)";
CM_ BO_ 2566781440  "Source: isobus.net VDMA Data Dictionary (https://www.isobus.net/isobus/pGNAndSPN/15696?type=PGN)";
CM_ BO_ 2566781696  "Source: isobus.net VDMA Data Dictionary (https://www.isobus.net/isobus/pGNAndSPN/15699?type=PGN)";
CM_ BO_ 2566781952  "Source: isobus.net VDMA Data Dictionary (https://www.isobus.net/isobus/pGNAndSPN/15701?type=PGN)";
CM_ BO_ 2566782208  "Source: isobus.net VDMA Data Dictionary (https://www.isobus.net/isobus/pGNAndSPN/15705?type=PGN)";
CM_ BO_ 2566782464  "Source: isobus.net VDMA Data Dictionary (https://www.isobus.net/isobus/pGNAndSPN/15708?type=PGN)";
CM_ BO_ 2566782720  "Source: isobus.net VDMA Data Dictionary (https://www.isobus.net/isobus/pGNAndSPN/15710?type=PGN)";
CM_ BO_ 2566782976  "Source: isobus.net VDMA Data Dictionary (https://www.isobus.net/isobus/pGNAndSPN/15714?type=PGN)";
CM_ BO_ 2566783232  "Source: isobus.net VDMA Data Dictionary (https://www.isobus.net/isobus/pGNAndSPN/15717?type=PGN)";
CM_ BO_ 2566783488  "Source: isobus.net VDMA Data Dictionary (https://www.isobus.net/isobus/pGNAndSPN/15719?type=PGN)";
CM_ BO_ 2566783744  "Source: isobus.net VDMA Data Dictionary (https://www.isobus.net/isobus/pGNAndSPN/15723?type=PGN)";
CM_ BO_ 2566784000  "Source: isobus.net VDMA Data Dictionary (https://www.isobus.net/isobus/pGNAndSPN/15726?type=PGN)";
CM_ BO_ 2566784256  "Source: isobus.net VDMA Data Dictionary (https://www.isobus.net/isobus/pGNAndSPN/15728?type=PGN)";
CM_ BO_ 2566784512  "Source: isobus.net VDMA Data Dictionary (https://www.isobus.net/isobus/pGNAndSPN/15732?type=PGN)";
CM_ BO_ 2566784768  "Source: isobus.net VDMA Data Dictionary (https://www.isobus.net/isobus/pGNAndSPN/15736?type=PGN)";
CM_ BO_ 2566785024  "Source: isobus.net VDMA Data Dictionary (https://www.isobus.net/isobus/pGNAndSPN/15782?type=PGN)";
CM_ BO_ 2566785280  "Source: isobus.net VDMA Data Dictionary (https://www.isobus.net/isobus/pGNAndSPN/15828?type=PGN)";
CM_ BO_ 2566785536  "Source: isobus.net VDMA Data Dictionary (https://www.isobus.net/isobus/pGNAndSPN/15829?type=PGN)";
CM_ BO_ 2566785792  "Source: isobus.net VDMA Data Dictionary (https://www.isobus.net/isobus/pGNAndSPN/15831?type=PGN)";
CM_ BO_ 2566786048  "Source: isobus.net VDMA Data Dictionary (https://www.isobus.net/isobus/pGNAndSPN/15832?type=PGN)";
CM_ BO_ 2566786560  "Source: isobus.net VDMA Data Dictionary (https://www.isobus.net/isobus/pGNAndSPN/15835?type=PGN)";
CM_ BO_ 2566787072  "Source: isobus.net VDMA Data Dictionary (https://www.isobus.net/isobus/pGNAndSPN/15855?type=PGN)";
CM_ BO_ 2566787328  "Source: isobus.net VDMA Data Dictionary (https://www.isobus.net/isobus/pGNAndSPN/15862?type=PGN)";
CM_ BO_ 2566787584  "Source: isobus.net VDMA Data Dictionary (https://www.isobus.net/isobus/pGNAndSPN/15869?type=PGN)";
CM_ BO_ 2566787840  "Source: isobus.net VDMA Data Dictionary (https://www.isobus.net/isobus/pGNAndSPN/15876?type=PGN)";
CM_ BO_ 2566788096  "Source: isobus.net VDMA Data Dictionary (https://www.isobus.net/isobus/pGNAndSPN/15883?type=PGN)";
CM_ BO_ 2566788352  "Source: isobus.net VDMA Data Dictionary (https://www.isobus.net/isobus/pGNAndSPN/15890?type=PGN)";
CM_ BO_ 2566788608  "Source: isobus.net VDMA Data Dictionary (https://www.isobus.net/isobus/pGNAndSPN/15897?type=PGN)";
CM_ BO_ 2566788864  "Source: isobus.net VDMA Data Dictionary (https://www.isobus.net/isobus/pGNAndSPN/15904?type=PGN)";
CM_ BO_ 2566789120  "Source: isobus.net VDMA Data Dictionary (https://www.isobus.net/isobus/pGNAndSPN/15911?type=PGN)";
CM_ BO_ 2566789376  "Source: isobus.net VDMA Data Dictionary (https://www.isobus.net/isobus/pGNAndSPN/15918?type=PGN)";
CM_ BO_ 2566789632  "Source: isobus.net VDMA Data Dictionary (https://www.isobus.net/isobus/pGNAndSPN/15925?type=PGN)";
CM_ BO_ 2566789888  "Source: isobus.net VDMA Data Dictionary (https://www.isobus.net/isobus/pGNAndSPN/15932?type=PGN)";
CM_ BO_ 2566790144  "Source: isobus.net VDMA Data Dictionary (https://www.isobus.net/isobus/pGNAndSPN/15939?type=PGN)";
CM_ BO_ 2566790400  "Source: isobus.net VDMA Data Dictionary (https://www.isobus.net/isobus/pGNAndSPN/15946?type=PGN)";
CM_ BO_ 2566790656  "Source: isobus.net VDMA Data Dictionary (https://www.isobus.net/isobus/pGNAndSPN/15953?type=PGN)";
CM_ BO_ 2566790912  "Source: isobus.net VDMA Data Dictionary (https://www.isobus.net/isobus/pGNAndSPN/15960?type=PGN)";
CM_ BO_ 2566791168  "Source: isobus.net VDMA Data Dictionary (https://www.isobus.net/isobus/pGNAndSPN/15966?type=PGN)";
CM_ BO_ 2566791424  "Source: isobus.net VDMA Data Dictionary (https://www.isobus.net/isobus/pGNAndSPN/15972?type=PGN)";
CM_ BO_ 2566791680  "Source: isobus.net VDMA Data Dictionary (https://www.isobus.net/isobus/pGNAndSPN/15978?type=PGN)";
CM_ BO_ 2566791936  "Source: isobus.net VDMA Data Dictionary (https://www.isobus.net/isobus/pGNAndSPN/15984?type=PGN)";
CM_ BO_ 2566792192  "Source: isobus.net VDMA Data Dictionary (https://www.isobus.net/isobus/pGNAndSPN/15990?type=PGN)";
CM_ BO_ 2566792448  "Source: isobus.net VDMA Data Dictionary (https://www.isobus.net/isobus/pGNAndSPN/15996?type=PGN)";
CM_ BO_ 2566792704  "Source: isobus.net VDMA Data Dictionary (https://www.isobus.net/isobus/pGNAndSPN/16002?type=PGN)";
CM_ BO_ 2566792960  "Source: isobus.net VDMA Data Dictionary (https://www.isobus.net/isobus/pGNAndSPN/16008?type=PGN)";
CM_ BO_ 2566793216  "Source: isobus.net VDMA Data Dictionary (https://www.isobus.net/isobus/pGNAndSPN/16014?type=PGN)";
CM_ BO_ 2566793472  "Source: isobus.net VDMA Data Dictionary (https://www.isobus.net/isobus/pGNAndSPN/16020?type=PGN)";
CM_ BO_ 2566793728  "Source: isobus.net VDMA Data Dictionary (https://www.isobus.net/isobus/pGNAndSPN/16026?type=PGN)";
CM_ BO_ 2566793984  "Source: isobus.net VDMA Data Dictionary (https://www.isobus.net/isobus/pGNAndSPN/16032?type=PGN)";
CM_ BO_ 2566794240  "Source: isobus.net VDMA Data Dictionary (https://www.isobus.net/isobus/pGNAndSPN/16038?type=PGN)";
CM_ BO_ 2566794496  "Source: isobus.net VDMA Data Dictionary (https://www.isobus.net/isobus/pGNAndSPN/16044?type=PGN)";
CM_ BO_ 2566794752  "Source: isobus.net VDMA Data Dictionary (https://www.isobus.net/isobus/pGNAndSPN/16050?type=PGN)";
CM_ BO_ 2566795008  "Source: isobus.net VDMA Data Dictionary (https://www.isobus.net/isobus/pGNAndSPN/16056?type=PGN)";
CM_ BO_ 2566795264  "Source: isobus.net VDMA Data Dictionary (https://www.isobus.net/isobus/pGNAndSPN/16061?type=PGN)";
CM_ BO_ 2566795520  "Source: isobus.net VDMA Data Dictionary (https://www.isobus.net/isobus/pGNAndSPN/16066?type=PGN)";
CM_ BO_ 2566795776  "Source: isobus.net VDMA Data Dictionary (https://www.isobus.net/isobus/pGNAndSPN/16071?type=PGN)";
CM_ BO_ 2566796032  "Source: isobus.net VDMA Data Dictionary (https://www.isobus.net/isobus/pGNAndSPN/16076?type=PGN)";
CM_ BO_ 2566796288  "Source: isobus.net VDMA Data Dictionary (https://www.isobus.net/isobus/pGNAndSPN/16081?type=PGN)";
CM_ BO_ 2566796544  "Source: isobus.net VDMA Data Dictionary (https://www.isobus.net/isobus/pGNAndSPN/16086?type=PGN)";
CM_ BO_ 2566796800  "Source: isobus.net VDMA Data Dictionary (https://www.isobus.net/isobus/pGNAndSPN/16091?type=PGN)";
CM_ BO_ 2566797056  "Source: isobus.net VDMA Data Dictionary (https://www.isobus.net/isobus/pGNAndSPN/16096?type=PGN)";
CM_ BO_ 2566797312  "Source: isobus.net VDMA Data Dictionary (https://www.isobus.net/isobus/pGNAndSPN/16101?type=PGN)";
CM_ BO_ 2566797568  "Source: isobus.net VDMA Data Dictionary (https://www.isobus.net/isobus/pGNAndSPN/16106?type=PGN)";
CM_ BO_ 2566797824  "Source: isobus.net VDMA Data Dictionary (https://www.isobus.net/isobus/pGNAndSPN/16111?type=PGN)";
CM_ BO_ 2566798080  "Source: isobus.net VDMA Data Dictionary (https://www.isobus.net/isobus/pGNAndSPN/16116?type=PGN)";
CM_ BO_ 2566798336  "Source: isobus.net VDMA Data Dictionary (https://www.isobus.net/isobus/pGNAndSPN/16121?type=PGN)";
CM_ BO_ 2566798592  "Source: isobus.net VDMA Data Dictionary (https://www.isobus.net/isobus/pGNAndSPN/16126?type=PGN)";
CM_ BO_ 2566798848  "Source: isobus.net VDMA Data Dictionary (https://www.isobus.net/isobus/pGNAndSPN/16131?type=PGN)";
CM_ BO_ 2566799104  "Source: isobus.net VDMA Data Dictionary (https://www.isobus.net/isobus/pGNAndSPN/16136?type=PGN)";
CM_ BO_ 2566799360  "Source: isobus.net VDMA Data Dictionary (https://www.isobus.net/isobus/pGNAndSPN/16167?type=PGN)";
CM_ BO_ 2566799616  "Source: isobus.net VDMA Data Dictionary (https://www.isobus.net/isobus/pGNAndSPN/16199?type=PGN)";
CM_ BO_ 2566799872  "Source: isobus.net VDMA Data Dictionary (https://www.isobus.net/isobus/pGNAndSPN/16209?type=PGN)";
CM_ BO_ 2566800128  "Source: isobus.net VDMA Data Dictionary (https://www.isobus.net/isobus/pGNAndSPN/16219?type=PGN)";
CM_ BO_ 2566800384  "Source: isobus.net VDMA Data Dictionary (https://www.isobus.net/isobus/pGNAndSPN/16229?type=PGN)";
CM_ BO_ 2566800640  "Source: isobus.net VDMA Data Dictionary (https://www.isobus.net/isobus/pGNAndSPN/16235?type=PGN)";
CM_ BO_ 2566800896  "Source: isobus.net VDMA Data Dictionary (https://www.isobus.net/isobus/pGNAndSPN/16241?type=PGN)";
CM_ BO_ 2566801920  "Source: isobus.net VDMA Data Dictionary (https://www.isobus.net/isobus/pGNAndSPN/16285?type=PGN)";
CM_ BO_ 2566802176  "Source: isobus.net VDMA Data Dictionary (https://www.isobus.net/isobus/pGNAndSPN/16290?type=PGN)";
CM_ BO_ 2566802432  "Source: isobus.net VDMA Data Dictionary (https://www.isobus.net/isobus/pGNAndSPN/16298?type=PGN)";
CM_ BO_ 2566802688  "Source: isobus.net VDMA Data Dictionary (https://www.isobus.net/isobus/pGNAndSPN/16300?type=PGN)";
CM_ BO_ 2566802944  "Source: isobus.net VDMA Data Dictionary (https://www.isobus.net/isobus/pGNAndSPN/16303?type=PGN)";
CM_ BO_ 2566803200  "Source: isobus.net VDMA Data Dictionary (https://www.isobus.net/isobus/pGNAndSPN/16311?type=PGN)";
CM_ BO_ 2566803456  "Source: isobus.net VDMA Data Dictionary (https://www.isobus.net/isobus/pGNAndSPN/16315?type=PGN)";
CM_ BO_ 2566803712  "Source: isobus.net VDMA Data Dictionary (https://www.isobus.net/isobus/pGNAndSPN/16317?type=PGN)";
CM_ BO_ 2566803968  "Source: isobus.net VDMA Data Dictionary (https://www.isobus.net/isobus/pGNAndSPN/16321?type=PGN)";
CM_ BO_ 2566804224  "Source: isobus.net VDMA Data Dictionary (https://www.isobus.net/isobus/pGNAndSPN/16329?type=PGN)";
CM_ BO_ 2566804480  "Source: isobus.net VDMA Data Dictionary (https://www.isobus.net/isobus/pGNAndSPN/16337?type=PGN)";
CM_ BO_ 2566804736  "Source: isobus.net VDMA Data Dictionary (https://www.isobus.net/isobus/pGNAndSPN/16340?type=PGN)";
CM_ BO_ 2566804992  "Source: isobus.net VDMA Data Dictionary (https://www.isobus.net/isobus/pGNAndSPN/16349?type=PGN)";
CM_ BO_ 2566805248  "Source: isobus.net VDMA Data Dictionary (https://www.isobus.net/isobus/pGNAndSPN/16355?type=PGN)";
CM_ BO_ 2566805504  "Source: isobus.net VDMA Data Dictionary (https://www.isobus.net/isobus/pGNAndSPN/16359?type=PGN)";
CM_ BO_ 2566805760  "Source: isobus.net VDMA Data Dictionary (https://www.isobus.net/isobus/pGNAndSPN/16363?type=PGN)";
CM_ BO_ 2566806016  "Source: isobus.net VDMA Data Dictionary (https://www.isobus.net/isobus/pGNAndSPN/16388?type=PGN)";
CM_ BO_ 2566806272  "Source: isobus.net VDMA Data Dictionary (https://www.isobus.net/isobus/pGNAndSPN/16397?type=PGN)";
CM_ BO_ 2566806528  "Source: isobus.net VDMA Data Dictionary (https://www.isobus.net/isobus/pGNAndSPN/16398?type=PGN)";
CM_ BO_ 2566806784  "Source: isobus.net VDMA Data Dictionary (https://www.isobus.net/isobus/pGNAndSPN/16399?type=PGN)";
CM_ BO_ 2566807040  "Source: isobus.net VDMA Data Dictionary (https://www.isobus.net/isobus/pGNAndSPN/16400?type=PGN)";
CM_ BO_ 2566807296  "Source: isobus.net VDMA Data Dictionary (https://www.isobus.net/isobus/pGNAndSPN/16401?type=PGN)";
CM_ BO_ 2566807552  "Source: isobus.net VDMA Data Dictionary (https://www.isobus.net/isobus/pGNAndSPN/16402?type=PGN)";
CM_ BO_ 2566807808  "Source: isobus.net VDMA Data Dictionary (https://www.isobus.net/isobus/pGNAndSPN/16403?type=PGN)";
CM_ BO_ 2566808064  "Source: isobus.net VDMA Data Dictionary (https://www.isobus.net/isobus/pGNAndSPN/16404?type=PGN)";
CM_ BO_ 2566808320  "Source: isobus.net VDMA Data Dictionary (https://www.isobus.net/isobus/pGNAndSPN/16405?type=PGN)";
CM_ BO_ 2566808576  "Source: isobus.net VDMA Data Dictionary (https://www.isobus.net/isobus/pGNAndSPN/16406?type=PGN)";
CM_ BO_ 2566808832  "Source: isobus.net VDMA Data Dictionary (https://www.isobus.net/isobus/pGNAndSPN/16407?type=PGN)";
CM_ BO_ 2566809088  "Source: isobus.net VDMA Data Dictionary (https://www.isobus.net/isobus/pGNAndSPN/16408?type=PGN)";
CM_ BO_ 2566809344  "Source: isobus.net VDMA Data Dictionary (https://www.isobus.net/isobus/pGNAndSPN/16409?type=PGN)";
CM_ BO_ 2566809600  "Source: isobus.net VDMA Data Dictionary (https://www.isobus.net/isobus/pGNAndSPN/16413?type=PGN)";
CM_ BO_ 2566809856  "Source: isobus.net VDMA Data Dictionary (https://www.isobus.net/isobus/pGNAndSPN/16417?type=PGN)";
CM_ BO_ 2566810112  "Source: isobus.net VDMA Data Dictionary (https://www.isobus.net/isobus/pGNAndSPN/16430?type=PGN)";
CM_ BO_ 2566810368  "Source: isobus.net VDMA Data Dictionary (https://www.isobus.net/isobus/pGNAndSPN/16432?type=PGN)";
CM_ BO_ 2566810880  "Source: isobus.net VDMA Data Dictionary (https://www.isobus.net/isobus/pGNAndSPN/16455?type=PGN)";
CM_ BO_ 2566811136  "Source: isobus.net VDMA Data Dictionary (https://www.isobus.net/isobus/pGNAndSPN/16459?type=PGN)";
CM_ BO_ 2566811392  "Source: isobus.net VDMA Data Dictionary (https://www.isobus.net/isobus/pGNAndSPN/16469?type=PGN)";
CM_ BO_ 2566811648  "Source: isobus.net VDMA Data Dictionary (https://www.isobus.net/isobus/pGNAndSPN/16472?type=PGN)";
CM_ BO_ 2566811904  "Source: isobus.net VDMA Data Dictionary (https://www.isobus.net/isobus/pGNAndSPN/16477?type=PGN)";
CM_ BO_ 2566812160  "Source: isobus.net VDMA Data Dictionary (https://www.isobus.net/isobus/pGNAndSPN/16482?type=PGN)";
CM_ BO_ 2566812416  "Source: isobus.net VDMA Data Dictionary (https://www.isobus.net/isobus/pGNAndSPN/16483?type=PGN)";
CM_ BO_ 2566812672  "Source: isobus.net VDMA Data Dictionary (https://www.isobus.net/isobus/pGNAndSPN/16485?type=PGN)";
CM_ BO_ 2566812928  "Source: isobus.net VDMA Data Dictionary (https://www.isobus.net/isobus/pGNAndSPN/16489?type=PGN)";
CM_ BO_ 2566813184  "Source: isobus.net VDMA Data Dictionary (https://www.isobus.net/isobus/pGNAndSPN/16494?type=PGN)";
CM_ BO_ 2566813440  "Source: isobus.net VDMA Data Dictionary (https://www.isobus.net/isobus/pGNAndSPN/16497?type=PGN)";
CM_ BO_ 2566813696  "Source: isobus.net VDMA Data Dictionary (https://www.isobus.net/isobus/pGNAndSPN/16508?type=PGN)";
CM_ BO_ 2566813952  "Source: isobus.net VDMA Data Dictionary (https://www.isobus.net/isobus/pGNAndSPN/16511?type=PGN)";
CM_ BO_ 2566814208  "Source: isobus.net VDMA Data Dictionary (https://www.isobus.net/isobus/pGNAndSPN/16514?type=PGN)";
CM_ BO_ 2566814464  "Source: isobus.net VDMA Data Dictionary (https://www.isobus.net/isobus/pGNAndSPN/16518?type=PGN)";
CM_ BO_ 2566814720  "Source: isobus.net VDMA Data Dictionary (https://www.isobus.net/isobus/pGNAndSPN/16522?type=PGN)";
CM_ BO_ 2566814976  "Source: isobus.net VDMA Data Dictionary (https://www.isobus.net/isobus/pGNAndSPN/16526?type=PGN)";
CM_ BO_ 2566815232  "Source: isobus.net VDMA Data Dictionary (https://www.isobus.net/isobus/pGNAndSPN/16530?type=PGN)";
CM_ BO_ 2566815488  "Source: isobus.net VDMA Data Dictionary (https://www.isobus.net/isobus/pGNAndSPN/16534?type=PGN)";
CM_ BO_ 2566815744  "Source: isobus.net VDMA Data Dictionary (https://www.isobus.net/isobus/pGNAndSPN/16536?type=PGN)";
CM_ BO_ 2566816000  "Source: isobus.net VDMA Data Dictionary (https://www.isobus.net/isobus/pGNAndSPN/16542?type=PGN)";
CM_ BO_ 2566816256  "Source: isobus.net VDMA Data Dictionary (https://www.isobus.net/isobus/pGNAndSPN/16546?type=PGN)";
CM_ BO_ 2566816512  "Source: isobus.net VDMA Data Dictionary (https://www.isobus.net/isobus/pGNAndSPN/16550?type=PGN)";
CM_ BO_ 2566816768  "Source: isobus.net VDMA Data Dictionary (https://www.isobus.net/isobus/pGNAndSPN/16554?type=PGN)";
CM_ BO_ 2566817024  "Source: isobus.net VDMA Data Dictionary (https://www.isobus.net/isobus/pGNAndSPN/16558?type=PGN)";
CM_ BO_ 2566817280  "Source: isobus.net VDMA Data Dictionary (https://www.isobus.net/isobus/pGNAndSPN/16562?type=PGN)";
CM_ BO_ 2566817536  "Source: isobus.net VDMA Data Dictionary (https://www.isobus.net/isobus/pGNAndSPN/16566?type=PGN)";
CM_ BO_ 2566817792  "Source: isobus.net VDMA Data Dictionary (https://www.isobus.net/isobus/pGNAndSPN/16574?type=PGN)";
CM_ BO_ 2566818048  "Source: isobus.net VDMA Data Dictionary (https://www.isobus.net/isobus/pGNAndSPN/16582?type=PGN)";
CM_ BO_ 2566818304  "Source: isobus.net VDMA Data Dictionary (https://www.isobus.net/isobus/pGNAndSPN/16586?type=PGN)";
CM_ BO_ 2566818560  "Source: isobus.net VDMA Data Dictionary (https://www.isobus.net/isobus/pGNAndSPN/16590?type=PGN)";
CM_ BO_ 2566818816  "Source: isobus.net VDMA Data Dictionary (https://www.isobus.net/isobus/pGNAndSPN/16597?type=PGN)";
CM_ BO_ 2566819072  "Source: isobus.net VDMA Data Dictionary (https://www.isobus.net/isobus/pGNAndSPN/16601?type=PGN)";
CM_ BO_ 2566819328  "Source: isobus.net VDMA Data Dictionary (https://www.isobus.net/isobus/pGNAndSPN/16603?type=PGN)";
CM_ BO_ 2566819584  "Source: isobus.net VDMA Data Dictionary (https://www.isobus.net/isobus/pGNAndSPN/16604?type=PGN)";
CM_ BO_ 2566819840  "Source: isobus.net VDMA Data Dictionary (https://www.isobus.net/isobus/pGNAndSPN/16623?type=PGN)";
CM_ BO_ 2566820096  "Source: isobus.net VDMA Data Dictionary (https://www.isobus.net/isobus/pGNAndSPN/16626?type=PGN)";
CM_ BO_ 2566820352  "Source: isobus.net VDMA Data Dictionary (https://www.isobus.net/isobus/pGNAndSPN/16631?type=PGN)";
CM_ BO_ 2566820608  "Source: isobus.net VDMA Data Dictionary (https://www.isobus.net/isobus/pGNAndSPN/16634?type=PGN)";
CM_ BO_ 2566820864  "Source: isobus.net VDMA Data Dictionary (https://www.isobus.net/isobus/pGNAndSPN/16642?type=PGN)";
CM_ BO_ 2566821120  "Source: isobus.net VDMA Data Dictionary (https://www.isobus.net/isobus/pGNAndSPN/16643?type=PGN)";
CM_ BO_ 2566821376  "Source: isobus.net VDMA Data Dictionary (https://www.isobus.net/isobus/pGNAndSPN/16652?type=PGN)";
CM_ BO_ 2566821632  "Source: isobus.net VDMA Data Dictionary (https://www.isobus.net/isobus/pGNAndSPN/16656?type=PGN)";
CM_ BO_ 2566821888  "Source: isobus.net VDMA Data Dictionary (https://www.isobus.net/isobus/pGNAndSPN/16660?type=PGN)";
CM_ BO_ 2566822144  "Source: isobus.net VDMA Data Dictionary (https://www.isobus.net/isobus/pGNAndSPN/16664?type=PGN)";
CM_ BO_ 2566822400  "Source: isobus.net VDMA Data Dictionary (https://www.isobus.net/isobus/pGNAndSPN/16668?type=PGN)";
CM_ BO_ 2566822656  "Source: isobus.net VDMA Data Dictionary (https://www.isobus.net/isobus/pGNAndSPN/16672?type=PGN)";
CM_ BO_ 2566822912  "Source: isobus.net VDMA Data Dictionary (https://www.isobus.net/isobus/pGNAndSPN/16676?type=PGN)";
CM_ BO_ 2566823168  "Source: isobus.net VDMA Data Dictionary (https://www.isobus.net/isobus/pGNAndSPN/16680?type=PGN)";
CM_ BO_ 2566823424  "Source: isobus.net VDMA Data Dictionary (https://www.isobus.net/isobus/pGNAndSPN/16684?type=PGN)";
CM_ BO_ 2566823680  "Source: isobus.net VDMA Data Dictionary (https://www.isobus.net/isobus/pGNAndSPN/16688?type=PGN)";
CM_ BO_ 2566823936  "Source: isobus.net VDMA Data Dictionary (https://www.isobus.net/isobus/pGNAndSPN/16692?type=PGN)";
CM_ BO_ 2566824192  "Source: isobus.net VDMA Data Dictionary (https://www.isobus.net/isobus/pGNAndSPN/16696?type=PGN)";
CM_ BO_ 2566824448  "Source: isobus.net VDMA Data Dictionary (https://www.isobus.net/isobus/pGNAndSPN/16700?type=PGN)";
CM_ BO_ 2566824704  "Source: isobus.net VDMA Data Dictionary (https://www.isobus.net/isobus/pGNAndSPN/16704?type=PGN)";
CM_ BO_ 2566824960  "Source: isobus.net VDMA Data Dictionary (https://www.isobus.net/isobus/pGNAndSPN/16708?type=PGN)";
CM_ BO_ 2566825216  "Source: isobus.net VDMA Data Dictionary (https://www.isobus.net/isobus/pGNAndSPN/16715?type=PGN)";
CM_ BO_ 2566825472  "Source: isobus.net VDMA Data Dictionary (https://www.isobus.net/isobus/pGNAndSPN/16719?type=PGN)";
CM_ BO_ 2566825728  "Source: isobus.net VDMA Data Dictionary (https://www.isobus.net/isobus/pGNAndSPN/16727?type=PGN)";
CM_ BO_ 2566825984  "Source: isobus.net VDMA Data Dictionary (https://www.isobus.net/isobus/pGNAndSPN/16729?type=PGN)";
CM_ BO_ 2566826240  "Source: isobus.net VDMA Data Dictionary (https://www.isobus.net/isobus/pGNAndSPN/16734?type=PGN)";
CM_ BO_ 2566826496  "Source: isobus.net VDMA Data Dictionary (https://www.isobus.net/isobus/pGNAndSPN/16739?type=PGN)";
CM_ BO_ 2566826752  "Source: isobus.net VDMA Data Dictionary (https://www.isobus.net/isobus/pGNAndSPN/16743?type=PGN)";
CM_ BO_ 2566827008  "Source: isobus.net VDMA Data Dictionary (https://www.isobus.net/isobus/pGNAndSPN/16751?type=PGN)";
CM_ BO_ 2566827264  "Source: isobus.net VDMA Data Dictionary (https://www.isobus.net/isobus/pGNAndSPN/16759?type=PGN)";
CM_ BO_ 2566827520  "Source: isobus.net VDMA Data Dictionary (https://www.isobus.net/isobus/pGNAndSPN/16767?type=PGN)";
CM_ BO_ 2566827776  "Source: isobus.net VDMA Data Dictionary (https://www.isobus.net/isobus/pGNAndSPN/16769?type=PGN)";
CM_ BO_ 2566828032  "Source: isobus.net VDMA Data Dictionary (https://www.isobus.net/isobus/pGNAndSPN/16774?type=PGN)";
CM_ BO_ 2566828288  "Source: isobus.net VDMA Data Dictionary (https://www.isobus.net/isobus/pGNAndSPN/16776?type=PGN)";
CM_ BO_ 2566828544  "Source: isobus.net VDMA Data Dictionary (https://www.isobus.net/isobus/pGNAndSPN/16779?type=PGN)";
CM_ BO_ 2566828800  "Source: isobus.net VDMA Data Dictionary (https://www.isobus.net/isobus/pGNAndSPN/16782?type=PGN)";
CM_ BO_ 2566829056  "Source: isobus.net VDMA Data Dictionary (https://www.isobus.net/isobus/pGNAndSPN/16786?type=PGN)";
CM_ BO_ 2566829312  "Source: isobus.net VDMA Data Dictionary (https://www.isobus.net/isobus/pGNAndSPN/16790?type=PGN)";
CM_ BO_ 2566829568  "Source: isobus.net VDMA Data Dictionary (https://www.isobus.net/isobus/pGNAndSPN/16792?type=PGN)";
CM_ BO_ 2566829824  "Source: isobus.net VDMA Data Dictionary (https://www.isobus.net/isobus/pGNAndSPN/16797?type=PGN)";
CM_ BO_ 2566830080  "Source: isobus.net VDMA Data Dictionary (https://www.isobus.net/isobus/pGNAndSPN/16803?type=PGN)";
CM_ BO_ 2566830336  "Source: isobus.net VDMA Data Dictionary (https://www.isobus.net/isobus/pGNAndSPN/16809?type=PGN)";
CM_ BO_ 2566830592  "Source: isobus.net VDMA Data Dictionary (https://www.isobus.net/isobus/pGNAndSPN/16812?type=PGN)";
CM_ BO_ 2566830848  "Source: isobus.net VDMA Data Dictionary (https://www.isobus.net/isobus/pGNAndSPN/16816?type=PGN)";
CM_ BO_ 2566831104  "Source: isobus.net VDMA Data Dictionary (https://www.isobus.net/isobus/pGNAndSPN/16820?type=PGN)";
CM_ BO_ 2566831360  "Source: isobus.net VDMA Data Dictionary (https://www.isobus.net/isobus/pGNAndSPN/16827?type=PGN)";
CM_ BO_ 2566831616  "Source: isobus.net VDMA Data Dictionary (https://www.isobus.net/isobus/pGNAndSPN/16833?type=PGN)";
CM_ BO_ 2566831872  "Source: isobus.net VDMA Data Dictionary (https://www.isobus.net/isobus/pGNAndSPN/16840?type=PGN)";
CM_ BO_ 2566832128  "Source: isobus.net VDMA Data Dictionary (https://www.isobus.net/isobus/pGNAndSPN/16846?type=PGN)";
CM_ BO_ 2566832640  "Source: isobus.net VDMA Data Dictionary (https://www.isobus.net/isobus/pGNAndSPN/16856?type=PGN)";
CM_ BO_ 2566832896  "Source: isobus.net VDMA Data Dictionary (https://www.isobus.net/isobus/pGNAndSPN/16862?type=PGN)";
CM_ BO_ 2566833152  "Source: isobus.net VDMA Data Dictionary (https://www.isobus.net/isobus/pGNAndSPN/16863?type=PGN)";
CM_ BO_ 2566833408  "Source: isobus.net VDMA Data Dictionary (https://www.isobus.net/isobus/pGNAndSPN/16865?type=PGN)";
CM_ BO_ 2566833664  "Source: isobus.net VDMA Data Dictionary (https://www.isobus.net/isobus/pGNAndSPN/16866?type=PGN)";
CM_ BO_ 2566833920  "Source: isobus.net VDMA Data Dictionary (https://www.isobus.net/isobus/pGNAndSPN/16883?type=PGN)";
CM_ BO_ 2566834176  "Source: isobus.net VDMA Data Dictionary (https://www.isobus.net/isobus/pGNAndSPN/16884?type=PGN)";
CM_ BO_ 2566834432  "Source: isobus.net VDMA Data Dictionary (https://www.isobus.net/isobus/pGNAndSPN/16885?type=PGN)";
CM_ BO_ 2566835456  "Source: isobus.net VDMA Data Dictionary (https://www.isobus.net/isobus/pGNAndSPN/16900?type=PGN)";
CM_ BO_ 2566835712  "Source: isobus.net VDMA Data Dictionary (https://www.isobus.net/isobus/pGNAndSPN/16906?type=PGN)";
CM_ BO_ 2566835968  "Source: isobus.net VDMA Data Dictionary (https://www.isobus.net/isobus/pGNAndSPN/16918?type=PGN)";
CM_ BO_ 2566836224  "Source: isobus.net VDMA Data Dictionary (https://www.isobus.net/isobus/pGNAndSPN/16923?type=PGN)";
CM_ BO_ 2566836480  "Source: isobus.net VDMA Data Dictionary (https://www.isobus.net/isobus/pGNAndSPN/16924?type=PGN)";
CM_ BO_ 2566836736  "Source: isobus.net VDMA Data Dictionary (https://www.isobus.net/isobus/pGNAndSPN/16925?type=PGN)";
CM_ BO_ 2566837248  "Source: isobus.net VDMA Data Dictionary (https://www.isobus.net/isobus/pGNAndSPN/16938?type=PGN)";
CM_ BO_ 2566837504  "Source: isobus.net VDMA Data Dictionary (https://www.isobus.net/isobus/pGNAndSPN/16950?type=PGN)";
CM_ BO_ 2566837760  "Source: isobus.net VDMA Data Dictionary (https://www.isobus.net/isobus/pGNAndSPN/16966?type=PGN)";
CM_ BO_ 2566838528  "Source: isobus.net VDMA Data Dictionary (https://www.isobus.net/isobus/pGNAndSPN/16986?type=PGN)";
CM_ BO_ 2566839040  "Source: isobus.net VDMA Data Dictionary (https://www.isobus.net/isobus/pGNAndSPN/16992?type=PGN)";
CM_ BO_ 2566839296  "Source: isobus.net VDMA Data Dictionary (https://www.isobus.net/isobus/pGNAndSPN/16994?type=PGN)";
CM_ BO_ 2566839552  "Source: isobus.net VDMA Data Dictionary (https://www.isobus.net/isobus/pGNAndSPN/16998?type=PGN)";
CM_ BO_ 2566839808  "Source: isobus.net VDMA Data Dictionary (https://www.isobus.net/isobus/pGNAndSPN/17001?type=PGN)";
CM_ BO_ 2566840320  "Source: isobus.net VDMA Data Dictionary (https://www.isobus.net/isobus/pGNAndSPN/17012?type=PGN)";
CM_ BO_ 2566840576  "Source: isobus.net VDMA Data Dictionary (https://www.isobus.net/isobus/pGNAndSPN/17026?type=PGN)";
CM_ BO_ 2566840832  "Source: isobus.net VDMA Data Dictionary (https://www.isobus.net/isobus/pGNAndSPN/17029?type=PGN)";
CM_ BO_ 2566841344  "Source: isobus.net VDMA Data Dictionary (https://www.isobus.net/isobus/pGNAndSPN/17081?type=PGN)";
CM_ BO_ 2566842112  "Source: isobus.net VDMA Data Dictionary (https://www.isobus.net/isobus/pGNAndSPN/17093?type=PGN)";
CM_ BO_ 2566842368  "Source: isobus.net VDMA Data Dictionary (https://www.isobus.net/isobus/pGNAndSPN/17097?type=PGN)";
CM_ BO_ 2566842624  "Source: isobus.net VDMA Data Dictionary (https://www.isobus.net/isobus/pGNAndSPN/17099?type=PGN)";
CM_ BO_ 2566842880  "Source: isobus.net VDMA Data Dictionary (https://www.isobus.net/isobus/pGNAndSPN/17103?type=PGN)";
CM_ BO_ 2566843648  "Source: isobus.net VDMA Data Dictionary (https://www.isobus.net/isobus/pGNAndSPN/17118?type=PGN)";
CM_ BO_ 2566844416  "Source: isobus.net VDMA Data Dictionary (https://www.isobus.net/isobus/pGNAndSPN/17145?type=PGN)";
CM_ BO_ 2566845184  "Source: isobus.net VDMA Data Dictionary (https://www.isobus.net/isobus/pGNAndSPN/17172?type=PGN)";
CM_ BO_ 2566845440  "Source: isobus.net VDMA Data Dictionary (https://www.isobus.net/isobus/pGNAndSPN/17181?type=PGN)";
CM_ BO_ 2566845696  "Source: isobus.net VDMA Data Dictionary (https://www.isobus.net/isobus/pGNAndSPN/17186?type=PGN)";
CM_ BO_ 2566846720  "Source: isobus.net VDMA Data Dictionary (https://www.isobus.net/isobus/pGNAndSPN/17212?type=PGN)";
CM_ BO_ 2566846976  "Source: isobus.net VDMA Data Dictionary (https://www.isobus.net/isobus/pGNAndSPN/17219?type=PGN)";
CM_ BO_ 2566847232  "Source: isobus.net VDMA Data Dictionary (https://www.isobus.net/isobus/pGNAndSPN/17223?type=PGN)";
CM_ BO_ 2566847488  "Source: isobus.net VDMA Data Dictionary (https://www.isobus.net/isobus/pGNAndSPN/17230?type=PGN)";
CM_ BO_ 2566847744  "Source: isobus.net VDMA Data Dictionary (https://www.isobus.net/isobus/pGNAndSPN/17235?type=PGN)";
CM_ BO_ 2566848000  "Source: isobus.net VDMA Data Dictionary (https://www.isobus.net/isobus/pGNAndSPN/17236?type=PGN)";
CM_ BO_ 2566848256  "Source: isobus.net VDMA Data Dictionary (https://www.isobus.net/isobus/pGNAndSPN/17252?type=PGN)";
CM_ BO_ 2582446080  "Source: isobus.net VDMA Data Dictionary (https://www.isobus.net/isobus/pGNAndSPN/17509?type=PGN)";
CM_ BO_ 2582511616  "Source: isobus.net VDMA Data Dictionary (https://www.isobus.net/isobus/pGNAndSPN/17510?type=PGN)";
CM_ BO_ 2582644480  "Source: isobus.net VDMA Data Dictionary (https://www.isobus.net/isobus/pGNAndSPN/17512?type=PGN)";
CM_ BO_ 2582644736  "Source: isobus.net VDMA Data Dictionary (https://www.isobus.net/isobus/pGNAndSPN/17513?type=PGN)";
CM_ BO_ 2582644992  "Source: isobus.net VDMA Data Dictionary (https://www.isobus.net/isobus/pGNAndSPN/17514?type=PGN)";
CM_ BO_ 2582645248  "Source: isobus.net VDMA Data Dictionary (https://www.isobus.net/isobus/pGNAndSPN/17515?type=PGN)";
CM_ BO_ 2582645504  "Source: isobus.net VDMA Data Dictionary (https://www.isobus.net/isobus/pGNAndSPN/17516?type=PGN)";
CM_ BO_ 2582645760  "Source: isobus.net VDMA Data Dictionary (https://www.isobus.net/isobus/pGNAndSPN/17517?type=PGN)";
CM_ BO_ 2582646784  "Source: isobus.net VDMA Data Dictionary (https://www.isobus.net/isobus/pGNAndSPN/17518?type=PGN)";
CM_ BO_ 2582647040  "Source: isobus.net VDMA Data Dictionary (https://www.isobus.net/isobus/pGNAndSPN/17519?type=PGN)";
CM_ BO_ 2582647808  "Source: isobus.net VDMA Data Dictionary (https://www.isobus.net/isobus/pGNAndSPN/17520?type=PGN)";
CM_ BO_ 2582648320  "Source: isobus.net VDMA Data Dictionary (https://www.isobus.net/isobus/pGNAndSPN/17521?type=PGN)";
CM_ BO_ 2582649088  "Source: isobus.net VDMA Data Dictionary (https://www.isobus.net/isobus/pGNAndSPN/17522?type=PGN)";
CM_ BO_ 2582649344  "Source: isobus.net VDMA Data Dictionary (https://www.isobus.net/isobus/pGNAndSPN/17523?type=PGN)";
CM_ BO_ 2582708480  "Source: isobus.net VDMA Data Dictionary (https://www.isobus.net/isobus/pGNAndSPN/17524?type=PGN)";
CM_ BO_ 2582709504  "Source: isobus.net VDMA Data Dictionary (https://www.isobus.net/isobus/pGNAndSPN/17525?type=PGN)";
CM_ BO_ 2582711552  "Source: isobus.net VDMA Data Dictionary (https://www.isobus.net/isobus/pGNAndSPN/17526?type=PGN)";
CM_ BO_ 2582713344  "Source: isobus.net VDMA Data Dictionary (https://www.isobus.net/isobus/pGNAndSPN/17529?type=PGN)";
CM_ BO_ 2582714624  "Source: isobus.net VDMA Data Dictionary (https://www.isobus.net/isobus/pGNAndSPN/17530?type=PGN)";
CM_ BO_ 2582714880  "Source: isobus.net VDMA Data Dictionary (https://www.isobus.net/isobus/pGNAndSPN/17531?type=PGN)";
CM_ BO_ 2582773760  "Source: isobus.net VDMA Data Dictionary (https://www.isobus.net/isobus/pGNAndSPN/17532?type=PGN)";
CM_ BO_ 2582774016  "Source: isobus.net VDMA Data Dictionary (https://www.isobus.net/isobus/pGNAndSPN/17533?type=PGN)";
CM_ BO_ 2582774272  "Source: isobus.net VDMA Data Dictionary (https://www.isobus.net/isobus/pGNAndSPN/17534?type=PGN)";
CM_ BO_ 2582774528  "Source: isobus.net VDMA Data Dictionary (https://www.isobus.net/isobus/pGNAndSPN/17535?type=PGN)";
CM_ BO_ 2582775040  "Source: isobus.net VDMA Data Dictionary (https://www.isobus.net/isobus/pGNAndSPN/17536?type=PGN)";
CM_ BO_ 2582775296  "Source: isobus.net VDMA Data Dictionary (https://www.isobus.net/isobus/pGNAndSPN/17537?type=PGN)";
CM_ BO_ 2582775552  "Source: isobus.net VDMA Data Dictionary (https://www.isobus.net/isobus/pGNAndSPN/17538?type=PGN)";
CM_ BO_ 2582775808  "Source: isobus.net VDMA Data Dictionary (https://www.isobus.net/isobus/pGNAndSPN/17539?type=PGN)";
CM_ BO_ 2582776064  "Source: isobus.net VDMA Data Dictionary (https://www.isobus.net/isobus/pGNAndSPN/17540?type=PGN)";
CM_ BO_ 2582776320  "Source: isobus.net VDMA Data Dictionary (https://www.isobus.net/isobus/pGNAndSPN/17541?type=PGN)";
CM_ BO_ 2582776832  "Source: isobus.net VDMA Data Dictionary (https://www.isobus.net/isobus/pGNAndSPN/17542?type=PGN)";
CM_ BO_ 2582777088  "Source: isobus.net VDMA Data Dictionary (https://www.isobus.net/isobus/pGNAndSPN/17543?type=PGN)";
CM_ BO_ 2582777344  "Source: isobus.net VDMA Data Dictionary (https://www.isobus.net/isobus/pGNAndSPN/17544?type=PGN)";
CM_ BO_ 2582777600  "Source: isobus.net VDMA Data Dictionary (https://www.isobus.net/isobus/pGNAndSPN/17545?type=PGN)";
CM_ BO_ 2582777856  "Source: isobus.net VDMA Data Dictionary (https://www.isobus.net/isobus/pGNAndSPN/17546?type=PGN)";
CM_ BO_ 2582778112  "Source: isobus.net VDMA Data Dictionary (https://www.isobus.net/isobus/pGNAndSPN/17547?type=PGN)";
CM_ BO_ 2582778368  "Source: isobus.net VDMA Data Dictionary (https://www.isobus.net/isobus/pGNAndSPN/17548?type=PGN)";
CM_ BO_ 2582778624  "Source: isobus.net VDMA Data Dictionary (https://www.isobus.net/isobus/pGNAndSPN/17549?type=PGN)";
CM_ BO_ 2582778880  "Source: isobus.net VDMA Data Dictionary (https://www.isobus.net/isobus/pGNAndSPN/17550?type=PGN)";
CM_ BO_ 2582779136  "Source: isobus.net VDMA Data Dictionary (https://www.isobus.net/isobus/pGNAndSPN/17551?type=PGN)";
CM_ BO_ 2582779392  "Source: isobus.net VDMA Data Dictionary (https://www.isobus.net/isobus/pGNAndSPN/17552?type=PGN)";
CM_ BO_ 2582779648  "Source: isobus.net VDMA Data Dictionary (https://www.isobus.net/isobus/pGNAndSPN/17553?type=PGN)";
CM_ BO_ 2582779904  "Source: isobus.net VDMA Data Dictionary (https://www.isobus.net/isobus/pGNAndSPN/17554?type=PGN)";
CM_ BO_ 2582780160  "Source: isobus.net VDMA Data Dictionary (https://www.isobus.net/isobus/pGNAndSPN/17555?type=PGN)";
CM_ BO_ 2582780416  "Source: isobus.net VDMA Data Dictionary (https://www.isobus.net/isobus/pGNAndSPN/17556?type=PGN)";
CM_ BO_ 2582839296  "Source: isobus.net VDMA Data Dictionary (https://www.isobus.net/isobus/pGNAndSPN/17557?type=PGN)";
CM_ BO_ 2582839552  "Source: isobus.net VDMA Data Dictionary (https://www.isobus.net/isobus/pGNAndSPN/17558?type=PGN)";
CM_ BO_ 2582839808  "Source: isobus.net VDMA Data Dictionary (https://www.isobus.net/isobus/pGNAndSPN/17559?type=PGN)";
CM_ BO_ 2582840064  "Source: isobus.net VDMA Data Dictionary (https://www.isobus.net/isobus/pGNAndSPN/17560?type=PGN)";
CM_ BO_ 2582840320  "Source: isobus.net VDMA Data Dictionary (https://www.isobus.net/isobus/pGNAndSPN/17561?type=PGN)";
CM_ SG_ 2566769664 Operators_External_Light_Control "Generic 8-byte raw payload. Detail page: https://www.isobus.net/isobus/pGNAndSPN/15407?type=PGN. Signal-level enrichment via PR welcome  see CONTRIBUTING.md.";
CM_ SG_ 2566769920 Operator_Wiper_and_Washer_Contro "Generic 8-byte raw payload. Detail page: https://www.isobus.net/isobus/pGNAndSPN/15416?type=PGN. Signal-level enrichment via PR welcome  see CONTRIBUTING.md.";
CM_ SG_ 2566770176 Working_Set_Member_Message_Obsol "Generic 8-byte raw payload. Detail page: https://www.isobus.net/isobus/pGNAndSPN/15417?type=PGN. Signal-level enrichment via PR welcome  see CONTRIBUTING.md.";
CM_ SG_ 2566770432 Working_Set_Master_Message_Obsol "Generic 8-byte raw payload. Detail page: https://www.isobus.net/isobus/pGNAndSPN/15418?type=PGN. Signal-level enrichment via PR welcome  see CONTRIBUTING.md.";
CM_ SG_ 2566770688 Intake_Exhaust_Conditions_2_RawP "Generic 8-byte raw payload. Detail page: https://www.isobus.net/isobus/pGNAndSPN/15425?type=PGN. Signal-level enrichment via PR welcome  see CONTRIBUTING.md.";
CM_ SG_ 2566770944 FMS_standard_Interface_Identity_ "Generic 8-byte raw payload. Detail page: https://www.isobus.net/isobus/pGNAndSPN/15428?type=PGN. Signal-level enrichment via PR welcome  see CONTRIBUTING.md.";
CM_ SG_ 2566771200 ECU_Performance_RawPayload "Generic 8-byte raw payload. Detail page: https://www.isobus.net/isobus/pGNAndSPN/15430?type=PGN. Signal-level enrichment via PR welcome  see CONTRIBUTING.md.";
CM_ SG_ 2566771456 Turbocharger_Information_6_RawPa "Generic 8-byte raw payload. Detail page: https://www.isobus.net/isobus/pGNAndSPN/15434?type=PGN. Signal-level enrichment via PR welcome  see CONTRIBUTING.md.";
CM_ SG_ 2566771712 Cab_Message_3_RawPayload "Generic 8-byte raw payload. Detail page: https://www.isobus.net/isobus/pGNAndSPN/15452?type=PGN. Signal-level enrichment via PR welcome  see CONTRIBUTING.md.";
CM_ SG_ 2566771968 Electronic_Engine_Controller_5_R "Generic 8-byte raw payload. Detail page: https://www.isobus.net/isobus/pGNAndSPN/15459?type=PGN. Signal-level enrichment via PR welcome  see CONTRIBUTING.md.";
CM_ SG_ 2566772224 Basic_Joystick_Message_1_RawPayl "Generic 8-byte raw payload. Detail page: https://www.isobus.net/isobus/pGNAndSPN/15481?type=PGN. Signal-level enrichment via PR welcome  see CONTRIBUTING.md.";
CM_ SG_ 2566772480 Extended_Joystick_Message_1_RawP "Generic 8-byte raw payload. Detail page: https://www.isobus.net/isobus/pGNAndSPN/15500?type=PGN. Signal-level enrichment via PR welcome  see CONTRIBUTING.md.";
CM_ SG_ 2566772736 Basic_Joystick_Message_2_RawPayl "Generic 8-byte raw payload. Detail page: https://www.isobus.net/isobus/pGNAndSPN/15522?type=PGN. Signal-level enrichment via PR welcome  see CONTRIBUTING.md.";
CM_ SG_ 2566772992 Extended_Joystick_Message_2_RawP "Generic 8-byte raw payload. Detail page: https://www.isobus.net/isobus/pGNAndSPN/15541?type=PGN. Signal-level enrichment via PR welcome  see CONTRIBUTING.md.";
CM_ SG_ 2566773248 Basic_Joystick_Message_3_RawPayl "Generic 8-byte raw payload. Detail page: https://www.isobus.net/isobus/pGNAndSPN/15563?type=PGN. Signal-level enrichment via PR welcome  see CONTRIBUTING.md.";
CM_ SG_ 2566773504 Extended_Joystick_Message_3_RawP "Generic 8-byte raw payload. Detail page: https://www.isobus.net/isobus/pGNAndSPN/15582?type=PGN. Signal-level enrichment via PR welcome  see CONTRIBUTING.md.";
CM_ SG_ 2566773760 Marine_Control_Information_RawPa "Generic 8-byte raw payload. Detail page: https://www.isobus.net/isobus/pGNAndSPN/15586?type=PGN. Signal-level enrichment via PR welcome  see CONTRIBUTING.md.";
CM_ SG_ 2566774016 Military_Application_Message_1_1 "Generic 8-byte raw payload. Detail page: https://www.isobus.net/isobus/pGNAndSPN/15587?type=PGN. Signal-level enrichment via PR welcome  see CONTRIBUTING.md.";
CM_ SG_ 2566774272 Military_Application_Message_2_1 "Generic 8-byte raw payload. Detail page: https://www.isobus.net/isobus/pGNAndSPN/15588?type=PGN. Signal-level enrichment via PR welcome  see CONTRIBUTING.md.";
CM_ SG_ 2566774528 Front_Wheel_Drive_Status_RawPayl "Generic 8-byte raw payload. Detail page: https://www.isobus.net/isobus/pGNAndSPN/15589?type=PGN. Signal-level enrichment via PR welcome  see CONTRIBUTING.md.";
CM_ SG_ 2566774784 Ambient_Conditions_2_RawPayload "Generic 8-byte raw payload. Detail page: https://www.isobus.net/isobus/pGNAndSPN/15594?type=PGN. Signal-level enrichment via PR welcome  see CONTRIBUTING.md.";
CM_ SG_ 2566775040 Cab_Climate_System_Information_1 "Generic 8-byte raw payload. Detail page: https://www.isobus.net/isobus/pGNAndSPN/15603?type=PGN. Signal-level enrichment via PR welcome  see CONTRIBUTING.md.";
CM_ SG_ 2566775296 Supply_Pressure_Demand_RawPayloa "Generic 8-byte raw payload. Detail page: https://www.isobus.net/isobus/pGNAndSPN/15610?type=PGN. Signal-level enrichment via PR welcome  see CONTRIBUTING.md.";
CM_ SG_ 2566775552 Equipment_Operation_and_Control_ "Generic 8-byte raw payload. Detail page: https://www.isobus.net/isobus/pGNAndSPN/15611?type=PGN. Signal-level enrichment via PR welcome  see CONTRIBUTING.md.";
CM_ SG_ 2566775808 Equipment_Performance_Data_RawPa "Generic 8-byte raw payload. Detail page: https://www.isobus.net/isobus/pGNAndSPN/15616?type=PGN. Signal-level enrichment via PR welcome  see CONTRIBUTING.md.";
CM_ SG_ 2566776064 Maximum_Vehicle_Speed_Limit_Stat "Generic 8-byte raw payload. Detail page: https://www.isobus.net/isobus/pGNAndSPN/15624?type=PGN. Signal-level enrichment via PR welcome  see CONTRIBUTING.md.";
CM_ SG_ 2566776320 Hydraulic_Braking_System_RawPayl "Generic 8-byte raw payload. Detail page: https://www.isobus.net/isobus/pGNAndSPN/15632?type=PGN. Signal-level enrichment via PR welcome  see CONTRIBUTING.md.";
CM_ SG_ 2566776576 Bus_1_Utility_Sync_Check_Status_ "Generic 8-byte raw payload. Detail page: https://www.isobus.net/isobus/pGNAndSPN/15638?type=PGN. Signal-level enrichment via PR welcome  see CONTRIBUTING.md.";
CM_ SG_ 2566776832 Bus_1_Generator_Sync_Check_Statu "Generic 8-byte raw payload. Detail page: https://www.isobus.net/isobus/pGNAndSPN/15644?type=PGN. Signal-level enrichment via PR welcome  see CONTRIBUTING.md.";
CM_ SG_ 2566777088 Bus_1_Phase_C_Basic_AC_Quantitie "Generic 8-byte raw payload. Detail page: https://www.isobus.net/isobus/pGNAndSPN/15647?type=PGN. Signal-level enrichment via PR welcome  see CONTRIBUTING.md.";
CM_ SG_ 2566777344 Bus_1_Phase_B_Basic_AC_Quantitie "Generic 8-byte raw payload. Detail page: https://www.isobus.net/isobus/pGNAndSPN/15650?type=PGN. Signal-level enrichment via PR welcome  see CONTRIBUTING.md.";
CM_ SG_ 2566777600 Bus_1_Phase_A_Basic_AC_Quantitie "Generic 8-byte raw payload. Detail page: https://www.isobus.net/isobus/pGNAndSPN/15653?type=PGN. Signal-level enrichment via PR welcome  see CONTRIBUTING.md.";
CM_ SG_ 2566777856 Bus_1_Average_Basic_AC_Quantitie "Generic 8-byte raw payload. Detail page: https://www.isobus.net/isobus/pGNAndSPN/15656?type=PGN. Signal-level enrichment via PR welcome  see CONTRIBUTING.md.";
CM_ SG_ 2566778112 Utility_Total_AC_Energy_RawPaylo "Generic 8-byte raw payload. Detail page: https://www.isobus.net/isobus/pGNAndSPN/15658?type=PGN. Signal-level enrichment via PR welcome  see CONTRIBUTING.md.";
CM_ SG_ 2566778368 Utility_Phase_C_AC_Reactive_Powe "Generic 8-byte raw payload. Detail page: https://www.isobus.net/isobus/pGNAndSPN/15661?type=PGN. Signal-level enrichment via PR welcome  see CONTRIBUTING.md.";
CM_ SG_ 2566778624 Utility_Phase_C_AC_Power_RawPayl "Generic 8-byte raw payload. Detail page: https://www.isobus.net/isobus/pGNAndSPN/15663?type=PGN. Signal-level enrichment via PR welcome  see CONTRIBUTING.md.";
CM_ SG_ 2566778880 Utility_Phase_C_AC_Basic_Quantit "Generic 8-byte raw payload. Detail page: https://www.isobus.net/isobus/pGNAndSPN/15667?type=PGN. Signal-level enrichment via PR welcome  see CONTRIBUTING.md.";
CM_ SG_ 2566779136 Utility_Phase_B_AC_Reactive_Powe "Generic 8-byte raw payload. Detail page: https://www.isobus.net/isobus/pGNAndSPN/15670?type=PGN. Signal-level enrichment via PR welcome  see CONTRIBUTING.md.";
CM_ SG_ 2566779392 Utility_Phase_B_AC_Power_RawPayl "Generic 8-byte raw payload. Detail page: https://www.isobus.net/isobus/pGNAndSPN/15672?type=PGN. Signal-level enrichment via PR welcome  see CONTRIBUTING.md.";
CM_ SG_ 2566779648 Utility_Phase_B_AC_Basic_Quantit "Generic 8-byte raw payload. Detail page: https://www.isobus.net/isobus/pGNAndSPN/15676?type=PGN. Signal-level enrichment via PR welcome  see CONTRIBUTING.md.";
CM_ SG_ 2566779904 Utility_Phase_A_AC_Reactive_Powe "Generic 8-byte raw payload. Detail page: https://www.isobus.net/isobus/pGNAndSPN/15679?type=PGN. Signal-level enrichment via PR welcome  see CONTRIBUTING.md.";
CM_ SG_ 2566780160 Utility_Phase_A_AC_Power_RawPayl "Generic 8-byte raw payload. Detail page: https://www.isobus.net/isobus/pGNAndSPN/15681?type=PGN. Signal-level enrichment via PR welcome  see CONTRIBUTING.md.";
CM_ SG_ 2566780416 Utility_Phase_A_Basic_AC_Quantit "Generic 8-byte raw payload. Detail page: https://www.isobus.net/isobus/pGNAndSPN/15685?type=PGN. Signal-level enrichment via PR welcome  see CONTRIBUTING.md.";
CM_ SG_ 2566780672 Utility_Total_AC_Reactive_Power_ "Generic 8-byte raw payload. Detail page: https://www.isobus.net/isobus/pGNAndSPN/15688?type=PGN. Signal-level enrichment via PR welcome  see CONTRIBUTING.md.";
CM_ SG_ 2566780928 Utility_Total_AC_Power_RawPayloa "Generic 8-byte raw payload. Detail page: https://www.isobus.net/isobus/pGNAndSPN/15690?type=PGN. Signal-level enrichment via PR welcome  see CONTRIBUTING.md.";
CM_ SG_ 2566781184 Utility_Average_Basic_AC_Quantit "Generic 8-byte raw payload. Detail page: https://www.isobus.net/isobus/pGNAndSPN/15694?type=PGN. Signal-level enrichment via PR welcome  see CONTRIBUTING.md.";
CM_ SG_ 2566781440 Generator_Total_AC_Energy_RawPay "Generic 8-byte raw payload. Detail page: https://www.isobus.net/isobus/pGNAndSPN/15696?type=PGN. Signal-level enrichment via PR welcome  see CONTRIBUTING.md.";
CM_ SG_ 2566781696 Generator_Phase_C_AC_Reactive_Po "Generic 8-byte raw payload. Detail page: https://www.isobus.net/isobus/pGNAndSPN/15699?type=PGN. Signal-level enrichment via PR welcome  see CONTRIBUTING.md.";
CM_ SG_ 2566781952 Generator_Phase_C_AC_Power_RawPa "Generic 8-byte raw payload. Detail page: https://www.isobus.net/isobus/pGNAndSPN/15701?type=PGN. Signal-level enrichment via PR welcome  see CONTRIBUTING.md.";
CM_ SG_ 2566782208 Generator_Phase_C_Basic_AC_Quant "Generic 8-byte raw payload. Detail page: https://www.isobus.net/isobus/pGNAndSPN/15705?type=PGN. Signal-level enrichment via PR welcome  see CONTRIBUTING.md.";
CM_ SG_ 2566782464 Generator_Phase_B_AC_Reactive_Po "Generic 8-byte raw payload. Detail page: https://www.isobus.net/isobus/pGNAndSPN/15708?type=PGN. Signal-level enrichment via PR welcome  see CONTRIBUTING.md.";
CM_ SG_ 2566782720 Generator_Phase_B_AC_Power_RawPa "Generic 8-byte raw payload. Detail page: https://www.isobus.net/isobus/pGNAndSPN/15710?type=PGN. Signal-level enrichment via PR welcome  see CONTRIBUTING.md.";
CM_ SG_ 2566782976 Generator_Phase_B_Basic_AC_Quant "Generic 8-byte raw payload. Detail page: https://www.isobus.net/isobus/pGNAndSPN/15714?type=PGN. Signal-level enrichment via PR welcome  see CONTRIBUTING.md.";
CM_ SG_ 2566783232 Generator_Phase_A_AC_Reactive_Po "Generic 8-byte raw payload. Detail page: https://www.isobus.net/isobus/pGNAndSPN/15717?type=PGN. Signal-level enrichment via PR welcome  see CONTRIBUTING.md.";
CM_ SG_ 2566783488 Generator_Phase_A_AC_Power_RawPa "Generic 8-byte raw payload. Detail page: https://www.isobus.net/isobus/pGNAndSPN/15719?type=PGN. Signal-level enrichment via PR welcome  see CONTRIBUTING.md.";
CM_ SG_ 2566783744 Generator_Phase_A_Basic_AC_Quant "Generic 8-byte raw payload. Detail page: https://www.isobus.net/isobus/pGNAndSPN/15723?type=PGN. Signal-level enrichment via PR welcome  see CONTRIBUTING.md.";
CM_ SG_ 2566784000 Generator_Total_AC_Reactive_Powe "Generic 8-byte raw payload. Detail page: https://www.isobus.net/isobus/pGNAndSPN/15726?type=PGN. Signal-level enrichment via PR welcome  see CONTRIBUTING.md.";
CM_ SG_ 2566784256 Generator_Total_AC_Power_RawPayl "Generic 8-byte raw payload. Detail page: https://www.isobus.net/isobus/pGNAndSPN/15728?type=PGN. Signal-level enrichment via PR welcome  see CONTRIBUTING.md.";
CM_ SG_ 2566784512 Generator_Average_Basic_AC_Quant "Generic 8-byte raw payload. Detail page: https://www.isobus.net/isobus/pGNAndSPN/15732?type=PGN. Signal-level enrichment via PR welcome  see CONTRIBUTING.md.";
CM_ SG_ 2566784768 Exhaust_Temperature_RawPayload "Generic 8-byte raw payload. Detail page: https://www.isobus.net/isobus/pGNAndSPN/15736?type=PGN. Signal-level enrichment via PR welcome  see CONTRIBUTING.md.";
CM_ SG_ 2566785024 Required_Tractor_Facilities_mess "Generic 8-byte raw payload. Detail page: https://www.isobus.net/isobus/pGNAndSPN/15782?type=PGN. Signal-level enrichment via PR welcome  see CONTRIBUTING.md.";
CM_ SG_ 2566785280 Tractor_Facilities_response_mess "Generic 8-byte raw payload. Detail page: https://www.isobus.net/isobus/pGNAndSPN/15828?type=PGN. Signal-level enrichment via PR welcome  see CONTRIBUTING.md.";
CM_ SG_ 2566785536 Tractor_control_command_tractor_ "Generic 8-byte raw payload. Detail page: https://www.isobus.net/isobus/pGNAndSPN/15829?type=PGN. Signal-level enrichment via PR welcome  see CONTRIBUTING.md.";
CM_ SG_ 2566785792 Tractor_control_mode_command_Raw "Generic 8-byte raw payload. Detail page: https://www.isobus.net/isobus/pGNAndSPN/15831?type=PGN. Signal-level enrichment via PR welcome  see CONTRIBUTING.md.";
CM_ SG_ 2566786048 Working_Set_Member_RawPayload "Generic 8-byte raw payload. Detail page: https://www.isobus.net/isobus/pGNAndSPN/15832?type=PGN. Signal-level enrichment via PR welcome  see CONTRIBUTING.md.";
CM_ SG_ 2566786560 Response_for_Repetition_Rate_Raw "Generic 8-byte raw payload. Detail page: https://www.isobus.net/isobus/pGNAndSPN/15835?type=PGN. Signal-level enrichment via PR welcome  see CONTRIBUTING.md.";
CM_ SG_ 2566787072 Auxiliary_valve_0_estimated_flow "Generic 8-byte raw payload. Detail page: https://www.isobus.net/isobus/pGNAndSPN/15855?type=PGN. Signal-level enrichment via PR welcome  see CONTRIBUTING.md.";
CM_ SG_ 2566787328 Auxiliary_valve_1_estimated_flow "Generic 8-byte raw payload. Detail page: https://www.isobus.net/isobus/pGNAndSPN/15862?type=PGN. Signal-level enrichment via PR welcome  see CONTRIBUTING.md.";
CM_ SG_ 2566787584 Auxiliary_valve_2_estimated_flow "Generic 8-byte raw payload. Detail page: https://www.isobus.net/isobus/pGNAndSPN/15869?type=PGN. Signal-level enrichment via PR welcome  see CONTRIBUTING.md.";
CM_ SG_ 2566787840 Auxiliary_valve_3_estimated_flow "Generic 8-byte raw payload. Detail page: https://www.isobus.net/isobus/pGNAndSPN/15876?type=PGN. Signal-level enrichment via PR welcome  see CONTRIBUTING.md.";
CM_ SG_ 2566788096 Auxiliary_valve_4_estimated_flow "Generic 8-byte raw payload. Detail page: https://www.isobus.net/isobus/pGNAndSPN/15883?type=PGN. Signal-level enrichment via PR welcome  see CONTRIBUTING.md.";
CM_ SG_ 2566788352 Auxiliary_valve_5_estimated_flow "Generic 8-byte raw payload. Detail page: https://www.isobus.net/isobus/pGNAndSPN/15890?type=PGN. Signal-level enrichment via PR welcome  see CONTRIBUTING.md.";
CM_ SG_ 2566788608 Auxiliary_valve_6_estimated_flow "Generic 8-byte raw payload. Detail page: https://www.isobus.net/isobus/pGNAndSPN/15897?type=PGN. Signal-level enrichment via PR welcome  see CONTRIBUTING.md.";
CM_ SG_ 2566788864 Auxiliary_valve_7_estimated_flow "Generic 8-byte raw payload. Detail page: https://www.isobus.net/isobus/pGNAndSPN/15904?type=PGN. Signal-level enrichment via PR welcome  see CONTRIBUTING.md.";
CM_ SG_ 2566789120 Auxiliary_valve_8_estimated_flow "Generic 8-byte raw payload. Detail page: https://www.isobus.net/isobus/pGNAndSPN/15911?type=PGN. Signal-level enrichment via PR welcome  see CONTRIBUTING.md.";
CM_ SG_ 2566789376 Auxiliary_valve_9_estimated_flow "Generic 8-byte raw payload. Detail page: https://www.isobus.net/isobus/pGNAndSPN/15918?type=PGN. Signal-level enrichment via PR welcome  see CONTRIBUTING.md.";
CM_ SG_ 2566789632 Auxiliary_valve_10_estimated_flo "Generic 8-byte raw payload. Detail page: https://www.isobus.net/isobus/pGNAndSPN/15925?type=PGN. Signal-level enrichment via PR welcome  see CONTRIBUTING.md.";
CM_ SG_ 2566789888 Auxiliary_valve_11_estimated_flo "Generic 8-byte raw payload. Detail page: https://www.isobus.net/isobus/pGNAndSPN/15932?type=PGN. Signal-level enrichment via PR welcome  see CONTRIBUTING.md.";
CM_ SG_ 2566790144 Auxiliary_valve_12_estimated_flo "Generic 8-byte raw payload. Detail page: https://www.isobus.net/isobus/pGNAndSPN/15939?type=PGN. Signal-level enrichment via PR welcome  see CONTRIBUTING.md.";
CM_ SG_ 2566790400 Auxiliary_valve_13_estimated_flo "Generic 8-byte raw payload. Detail page: https://www.isobus.net/isobus/pGNAndSPN/15946?type=PGN. Signal-level enrichment via PR welcome  see CONTRIBUTING.md.";
CM_ SG_ 2566790656 Auxiliary_valve_14_estimated_flo "Generic 8-byte raw payload. Detail page: https://www.isobus.net/isobus/pGNAndSPN/15953?type=PGN. Signal-level enrichment via PR welcome  see CONTRIBUTING.md.";
CM_ SG_ 2566790912 Auxiliary_valve_15_estimated_flo "Generic 8-byte raw payload. Detail page: https://www.isobus.net/isobus/pGNAndSPN/15960?type=PGN. Signal-level enrichment via PR welcome  see CONTRIBUTING.md.";
CM_ SG_ 2566791168 Auxiliary_valve_0_measured_flow_ "Generic 8-byte raw payload. Detail page: https://www.isobus.net/isobus/pGNAndSPN/15966?type=PGN. Signal-level enrichment via PR welcome  see CONTRIBUTING.md.";
CM_ SG_ 2566791424 Auxiliary_valve_1_measured_flow_ "Generic 8-byte raw payload. Detail page: https://www.isobus.net/isobus/pGNAndSPN/15972?type=PGN. Signal-level enrichment via PR welcome  see CONTRIBUTING.md.";
CM_ SG_ 2566791680 Auxiliary_valve_2_measured_flow_ "Generic 8-byte raw payload. Detail page: https://www.isobus.net/isobus/pGNAndSPN/15978?type=PGN. Signal-level enrichment via PR welcome  see CONTRIBUTING.md.";
CM_ SG_ 2566791936 Auxiliary_valve_3_measured_flow_ "Generic 8-byte raw payload. Detail page: https://www.isobus.net/isobus/pGNAndSPN/15984?type=PGN. Signal-level enrichment via PR welcome  see CONTRIBUTING.md.";
CM_ SG_ 2566792192 Auxiliary_valve_4_measured_flow_ "Generic 8-byte raw payload. Detail page: https://www.isobus.net/isobus/pGNAndSPN/15990?type=PGN. Signal-level enrichment via PR welcome  see CONTRIBUTING.md.";
CM_ SG_ 2566792448 Auxiliary_valve_5_measured_flow_ "Generic 8-byte raw payload. Detail page: https://www.isobus.net/isobus/pGNAndSPN/15996?type=PGN. Signal-level enrichment via PR welcome  see CONTRIBUTING.md.";
CM_ SG_ 2566792704 Auxiliary_valve_6_measured_flow_ "Generic 8-byte raw payload. Detail page: https://www.isobus.net/isobus/pGNAndSPN/16002?type=PGN. Signal-level enrichment via PR welcome  see CONTRIBUTING.md.";
CM_ SG_ 2566792960 Auxiliary_valve_7_measured_flow_ "Generic 8-byte raw payload. Detail page: https://www.isobus.net/isobus/pGNAndSPN/16008?type=PGN. Signal-level enrichment via PR welcome  see CONTRIBUTING.md.";
CM_ SG_ 2566793216 Auxiliary_valve_8_measured_flow_ "Generic 8-byte raw payload. Detail page: https://www.isobus.net/isobus/pGNAndSPN/16014?type=PGN. Signal-level enrichment via PR welcome  see CONTRIBUTING.md.";
CM_ SG_ 2566793472 Auxiliary_valve_9_measured_flow_ "Generic 8-byte raw payload. Detail page: https://www.isobus.net/isobus/pGNAndSPN/16020?type=PGN. Signal-level enrichment via PR welcome  see CONTRIBUTING.md.";
CM_ SG_ 2566793728 Auxiliary_valve_10_measured_flow "Generic 8-byte raw payload. Detail page: https://www.isobus.net/isobus/pGNAndSPN/16026?type=PGN. Signal-level enrichment via PR welcome  see CONTRIBUTING.md.";
CM_ SG_ 2566793984 Auxiliary_valve_11_measured_flow "Generic 8-byte raw payload. Detail page: https://www.isobus.net/isobus/pGNAndSPN/16032?type=PGN. Signal-level enrichment via PR welcome  see CONTRIBUTING.md.";
CM_ SG_ 2566794240 Auxiliary_valve_12_measured_flow "Generic 8-byte raw payload. Detail page: https://www.isobus.net/isobus/pGNAndSPN/16038?type=PGN. Signal-level enrichment via PR welcome  see CONTRIBUTING.md.";
CM_ SG_ 2566794496 Auxiliary_valve_13_measured_flow "Generic 8-byte raw payload. Detail page: https://www.isobus.net/isobus/pGNAndSPN/16044?type=PGN. Signal-level enrichment via PR welcome  see CONTRIBUTING.md.";
CM_ SG_ 2566794752 Auxiliary_valve_14_measured_flow "Generic 8-byte raw payload. Detail page: https://www.isobus.net/isobus/pGNAndSPN/16050?type=PGN. Signal-level enrichment via PR welcome  see CONTRIBUTING.md.";
CM_ SG_ 2566795008 Auxiliary_valve_15_measured_flow "Generic 8-byte raw payload. Detail page: https://www.isobus.net/isobus/pGNAndSPN/16056?type=PGN. Signal-level enrichment via PR welcome  see CONTRIBUTING.md.";
CM_ SG_ 2566795264 Auxiliary_valve_0_command_RawPay "Generic 8-byte raw payload. Detail page: https://www.isobus.net/isobus/pGNAndSPN/16061?type=PGN. Signal-level enrichment via PR welcome  see CONTRIBUTING.md.";
CM_ SG_ 2566795520 Auxiliary_valve_1_command_RawPay "Generic 8-byte raw payload. Detail page: https://www.isobus.net/isobus/pGNAndSPN/16066?type=PGN. Signal-level enrichment via PR welcome  see CONTRIBUTING.md.";
CM_ SG_ 2566795776 Auxiliary_valve_2_command_RawPay "Generic 8-byte raw payload. Detail page: https://www.isobus.net/isobus/pGNAndSPN/16071?type=PGN. Signal-level enrichment via PR welcome  see CONTRIBUTING.md.";
CM_ SG_ 2566796032 Auxiliary_valve_3_command_RawPay "Generic 8-byte raw payload. Detail page: https://www.isobus.net/isobus/pGNAndSPN/16076?type=PGN. Signal-level enrichment via PR welcome  see CONTRIBUTING.md.";
CM_ SG_ 2566796288 Auxiliary_valve_4_command_RawPay "Generic 8-byte raw payload. Detail page: https://www.isobus.net/isobus/pGNAndSPN/16081?type=PGN. Signal-level enrichment via PR welcome  see CONTRIBUTING.md.";
CM_ SG_ 2566796544 Auxiliary_valve_5_command_RawPay "Generic 8-byte raw payload. Detail page: https://www.isobus.net/isobus/pGNAndSPN/16086?type=PGN. Signal-level enrichment via PR welcome  see CONTRIBUTING.md.";
CM_ SG_ 2566796800 Auxiliary_valve_6_command_RawPay "Generic 8-byte raw payload. Detail page: https://www.isobus.net/isobus/pGNAndSPN/16091?type=PGN. Signal-level enrichment via PR welcome  see CONTRIBUTING.md.";
CM_ SG_ 2566797056 Auxiliary_valve_7_command_RawPay "Generic 8-byte raw payload. Detail page: https://www.isobus.net/isobus/pGNAndSPN/16096?type=PGN. Signal-level enrichment via PR welcome  see CONTRIBUTING.md.";
CM_ SG_ 2566797312 Auxiliary_valve_8_command_RawPay "Generic 8-byte raw payload. Detail page: https://www.isobus.net/isobus/pGNAndSPN/16101?type=PGN. Signal-level enrichment via PR welcome  see CONTRIBUTING.md.";
CM_ SG_ 2566797568 Auxiliary_valve_9_command_RawPay "Generic 8-byte raw payload. Detail page: https://www.isobus.net/isobus/pGNAndSPN/16106?type=PGN. Signal-level enrichment via PR welcome  see CONTRIBUTING.md.";
CM_ SG_ 2566797824 Auxiliary_valve_10_command_RawPa "Generic 8-byte raw payload. Detail page: https://www.isobus.net/isobus/pGNAndSPN/16111?type=PGN. Signal-level enrichment via PR welcome  see CONTRIBUTING.md.";
CM_ SG_ 2566798080 Auxiliary_valve_11_command_RawPa "Generic 8-byte raw payload. Detail page: https://www.isobus.net/isobus/pGNAndSPN/16116?type=PGN. Signal-level enrichment via PR welcome  see CONTRIBUTING.md.";
CM_ SG_ 2566798336 Auxiliary_valve_12_command_RawPa "Generic 8-byte raw payload. Detail page: https://www.isobus.net/isobus/pGNAndSPN/16121?type=PGN. Signal-level enrichment via PR welcome  see CONTRIBUTING.md.";
CM_ SG_ 2566798592 Auxiliary_valve_13_command_RawPa "Generic 8-byte raw payload. Detail page: https://www.isobus.net/isobus/pGNAndSPN/16126?type=PGN. Signal-level enrichment via PR welcome  see CONTRIBUTING.md.";
CM_ SG_ 2566798848 Auxiliary_valve_14_command_RawPa "Generic 8-byte raw payload. Detail page: https://www.isobus.net/isobus/pGNAndSPN/16131?type=PGN. Signal-level enrichment via PR welcome  see CONTRIBUTING.md.";
CM_ SG_ 2566799104 Auxiliary_valve_15_command_RawPa "Generic 8-byte raw payload. Detail page: https://www.isobus.net/isobus/pGNAndSPN/16136?type=PGN. Signal-level enrichment via PR welcome  see CONTRIBUTING.md.";
CM_ SG_ 2566799360 Lighting_Data_RawPayload "Generic 8-byte raw payload. Detail page: https://www.isobus.net/isobus/pGNAndSPN/16167?type=PGN. Signal-level enrichment via PR welcome  see CONTRIBUTING.md.";
CM_ SG_ 2566799616 Lighting_command_RawPayload "Generic 8-byte raw payload. Detail page: https://www.isobus.net/isobus/pGNAndSPN/16199?type=PGN. Signal-level enrichment via PR welcome  see CONTRIBUTING.md.";
CM_ SG_ 2566799872 Hitch_and_PTO_commands_RawPayloa "Generic 8-byte raw payload. Detail page: https://www.isobus.net/isobus/pGNAndSPN/16209?type=PGN. Signal-level enrichment via PR welcome  see CONTRIBUTING.md.";
CM_ SG_ 2566800128 Primary_or_Rear_Power_Take_off_O "Generic 8-byte raw payload. Detail page: https://www.isobus.net/isobus/pGNAndSPN/16219?type=PGN. Signal-level enrichment via PR welcome  see CONTRIBUTING.md.";
CM_ SG_ 2566800384 Secondary_or_Front_Power_Take_of "Generic 8-byte raw payload. Detail page: https://www.isobus.net/isobus/pGNAndSPN/16229?type=PGN. Signal-level enrichment via PR welcome  see CONTRIBUTING.md.";
CM_ SG_ 2566800640 Primary_or_Rear_Hitch_Status_Raw "Generic 8-byte raw payload. Detail page: https://www.isobus.net/isobus/pGNAndSPN/16235?type=PGN. Signal-level enrichment via PR welcome  see CONTRIBUTING.md.";
CM_ SG_ 2566800896 Secondary_or_Front_Hitch_Status_ "Generic 8-byte raw payload. Detail page: https://www.isobus.net/isobus/pGNAndSPN/16241?type=PGN. Signal-level enrichment via PR welcome  see CONTRIBUTING.md.";
CM_ SG_ 2566801920 Electronic_Transmission_Controll "Generic 8-byte raw payload. Detail page: https://www.isobus.net/isobus/pGNAndSPN/16285?type=PGN. Signal-level enrichment via PR welcome  see CONTRIBUTING.md.";
CM_ SG_ 2566802176 Transmission_Configuration_2_Raw "Generic 8-byte raw payload. Detail page: https://www.isobus.net/isobus/pGNAndSPN/16290?type=PGN. Signal-level enrichment via PR welcome  see CONTRIBUTING.md.";
CM_ SG_ 2566802432 Military_Lighting_Command_RawPay "Generic 8-byte raw payload. Detail page: https://www.isobus.net/isobus/pGNAndSPN/16298?type=PGN. Signal-level enrichment via PR welcome  see CONTRIBUTING.md.";
CM_ SG_ 2566802688 Total_Averaged_Information_RawPa "Generic 8-byte raw payload. Detail page: https://www.isobus.net/isobus/pGNAndSPN/16300?type=PGN. Signal-level enrichment via PR welcome  see CONTRIBUTING.md.";
CM_ SG_ 2566802944 Door_Control_1_RawPayload "Generic 8-byte raw payload. Detail page: https://www.isobus.net/isobus/pGNAndSPN/16303?type=PGN. Signal-level enrichment via PR welcome  see CONTRIBUTING.md.";
CM_ SG_ 2566803200 Vehicle_Dynamic_Stability_Contro "Generic 8-byte raw payload. Detail page: https://www.isobus.net/isobus/pGNAndSPN/16311?type=PGN. Signal-level enrichment via PR welcome  see CONTRIBUTING.md.";
CM_ SG_ 2566803456 Battery_Temperature_RawPayload "Generic 8-byte raw payload. Detail page: https://www.isobus.net/isobus/pGNAndSPN/16315?type=PGN. Signal-level enrichment via PR welcome  see CONTRIBUTING.md.";
CM_ SG_ 2566803712 Adaptive_Cruise_Control_Operator "Generic 8-byte raw payload. Detail page: https://www.isobus.net/isobus/pGNAndSPN/16317?type=PGN. Signal-level enrichment via PR welcome  see CONTRIBUTING.md.";
CM_ SG_ 2566803968 Vehicle_Electrical_Power_3_RawPa "Generic 8-byte raw payload. Detail page: https://www.isobus.net/isobus/pGNAndSPN/16321?type=PGN. Signal-level enrichment via PR welcome  see CONTRIBUTING.md.";
CM_ SG_ 2566804224 Retarder_Continuous_Torque_Speed "Generic 8-byte raw payload. Detail page: https://www.isobus.net/isobus/pGNAndSPN/16329?type=PGN. Signal-level enrichment via PR welcome  see CONTRIBUTING.md.";
CM_ SG_ 2566804480 Engine_Continuous_Torque_Speed_L "Generic 8-byte raw payload. Detail page: https://www.isobus.net/isobus/pGNAndSPN/16337?type=PGN. Signal-level enrichment via PR welcome  see CONTRIBUTING.md.";
CM_ SG_ 2566804736 Gaseous_Fuel_Properties_RawPaylo "Generic 8-byte raw payload. Detail page: https://www.isobus.net/isobus/pGNAndSPN/16340?type=PGN. Signal-level enrichment via PR welcome  see CONTRIBUTING.md.";
CM_ SG_ 2566804992 Aftertreatment_1_Diesel_Exhaust_ "Generic 8-byte raw payload. Detail page: https://www.isobus.net/isobus/pGNAndSPN/16349?type=PGN. Signal-level enrichment via PR welcome  see CONTRIBUTING.md.";
CM_ SG_ 2566805248 Air_Suspension_Control_5_RawPayl "Generic 8-byte raw payload. Detail page: https://www.isobus.net/isobus/pGNAndSPN/16355?type=PGN. Signal-level enrichment via PR welcome  see CONTRIBUTING.md.";
CM_ SG_ 2566805504 Air_Suspension_Control_4_RawPayl "Generic 8-byte raw payload. Detail page: https://www.isobus.net/isobus/pGNAndSPN/16359?type=PGN. Signal-level enrichment via PR welcome  see CONTRIBUTING.md.";
CM_ SG_ 2566805760 Air_Suspension_Control_3_RawPayl "Generic 8-byte raw payload. Detail page: https://www.isobus.net/isobus/pGNAndSPN/16363?type=PGN. Signal-level enrichment via PR welcome  see CONTRIBUTING.md.";
CM_ SG_ 2566806016 Air_Suspension_Control_1_RawPayl "Generic 8-byte raw payload. Detail page: https://www.isobus.net/isobus/pGNAndSPN/16388?type=PGN. Signal-level enrichment via PR welcome  see CONTRIBUTING.md.";
CM_ SG_ 2566806272 Forward_Lane_Image_2_RawPayload "Generic 8-byte raw payload. Detail page: https://www.isobus.net/isobus/pGNAndSPN/16397?type=PGN. Signal-level enrichment via PR welcome  see CONTRIBUTING.md.";
CM_ SG_ 2566806528 Running_Gear_Equipment_2_2_RawPa "Generic 8-byte raw payload. Detail page: https://www.isobus.net/isobus/pGNAndSPN/16398?type=PGN. Signal-level enrichment via PR welcome  see CONTRIBUTING.md.";
CM_ SG_ 2566806784 General_Purpose_Message_1_2_RawP "Generic 8-byte raw payload. Detail page: https://www.isobus.net/isobus/pGNAndSPN/16399?type=PGN. Signal-level enrichment via PR welcome  see CONTRIBUTING.md.";
CM_ SG_ 2566807040 Running_Gear_Equipment_2_3_RawPa "Generic 8-byte raw payload. Detail page: https://www.isobus.net/isobus/pGNAndSPN/16400?type=PGN. Signal-level enrichment via PR welcome  see CONTRIBUTING.md.";
CM_ SG_ 2566807296 General_Purpose_Message_1_3_RawP "Generic 8-byte raw payload. Detail page: https://www.isobus.net/isobus/pGNAndSPN/16401?type=PGN. Signal-level enrichment via PR welcome  see CONTRIBUTING.md.";
CM_ SG_ 2566807552 General_Purpose_Message_2_3_RawP "Generic 8-byte raw payload. Detail page: https://www.isobus.net/isobus/pGNAndSPN/16402?type=PGN. Signal-level enrichment via PR welcome  see CONTRIBUTING.md.";
CM_ SG_ 2566807808 General_Purpose_Message_1_4_RawP "Generic 8-byte raw payload. Detail page: https://www.isobus.net/isobus/pGNAndSPN/16403?type=PGN. Signal-level enrichment via PR welcome  see CONTRIBUTING.md.";
CM_ SG_ 2566808064 General_Purpose_Message_2_4_RawP "Generic 8-byte raw payload. Detail page: https://www.isobus.net/isobus/pGNAndSPN/16404?type=PGN. Signal-level enrichment via PR welcome  see CONTRIBUTING.md.";
CM_ SG_ 2566808320 General_Purpose_Message_1_5_RawP "Generic 8-byte raw payload. Detail page: https://www.isobus.net/isobus/pGNAndSPN/16405?type=PGN. Signal-level enrichment via PR welcome  see CONTRIBUTING.md.";
CM_ SG_ 2566808576 General_Purpose_Message_2_5_RawP "Generic 8-byte raw payload. Detail page: https://www.isobus.net/isobus/pGNAndSPN/16406?type=PGN. Signal-level enrichment via PR welcome  see CONTRIBUTING.md.";
CM_ SG_ 2566808832 General_Purpose_Message_1_6_RawP "Generic 8-byte raw payload. Detail page: https://www.isobus.net/isobus/pGNAndSPN/16407?type=PGN. Signal-level enrichment via PR welcome  see CONTRIBUTING.md.";
CM_ SG_ 2566809088 Battery_Main_Switch_Information_ "Generic 8-byte raw payload. Detail page: https://www.isobus.net/isobus/pGNAndSPN/16408?type=PGN. Signal-level enrichment via PR welcome  see CONTRIBUTING.md.";
CM_ SG_ 2566809344 Climate_Control_Configuration_Ra "Generic 8-byte raw payload. Detail page: https://www.isobus.net/isobus/pGNAndSPN/16409?type=PGN. Signal-level enrichment via PR welcome  see CONTRIBUTING.md.";
CM_ SG_ 2566809600 Vehicle_Fluids_RawPayload "Generic 8-byte raw payload. Detail page: https://www.isobus.net/isobus/pGNAndSPN/16413?type=PGN. Signal-level enrichment via PR welcome  see CONTRIBUTING.md.";
CM_ SG_ 2566809856 Engine_Temperature_3_RawPayload "Generic 8-byte raw payload. Detail page: https://www.isobus.net/isobus/pGNAndSPN/16417?type=PGN. Signal-level enrichment via PR welcome  see CONTRIBUTING.md.";
CM_ SG_ 2566810112 Engine_Fuel_Lube_Systems_RawPayl "Generic 8-byte raw payload. Detail page: https://www.isobus.net/isobus/pGNAndSPN/16430?type=PGN. Signal-level enrichment via PR welcome  see CONTRIBUTING.md.";
CM_ SG_ 2566810368 Driver_s_Identification_RawPaylo "Generic 8-byte raw payload. Detail page: https://www.isobus.net/isobus/pGNAndSPN/16432?type=PGN. Signal-level enrichment via PR welcome  see CONTRIBUTING.md.";
CM_ SG_ 2566810880 Heater_Information_RawPayload "Generic 8-byte raw payload. Detail page: https://www.isobus.net/isobus/pGNAndSPN/16455?type=PGN. Signal-level enrichment via PR welcome  see CONTRIBUTING.md.";
CM_ SG_ 2566811136 High_Resolution_Wheel_Speed_RawP "Generic 8-byte raw payload. Detail page: https://www.isobus.net/isobus/pGNAndSPN/16459?type=PGN. Signal-level enrichment via PR welcome  see CONTRIBUTING.md.";
CM_ SG_ 2566811392 Adaptive_Cruise_Control_1_RawPay "Generic 8-byte raw payload. Detail page: https://www.isobus.net/isobus/pGNAndSPN/16469?type=PGN. Signal-level enrichment via PR welcome  see CONTRIBUTING.md.";
CM_ SG_ 2566811648 Combination_Vehicle_Weight_RawPa "Generic 8-byte raw payload. Detail page: https://www.isobus.net/isobus/pGNAndSPN/16472?type=PGN. Signal-level enrichment via PR welcome  see CONTRIBUTING.md.";
CM_ SG_ 2566811904 Laser_Tracer_Position_RawPayload "Generic 8-byte raw payload. Detail page: https://www.isobus.net/isobus/pGNAndSPN/16477?type=PGN. Signal-level enrichment via PR welcome  see CONTRIBUTING.md.";
CM_ SG_ 2566812160 Laser_Leveling_System_Blade_Cont "Generic 8-byte raw payload. Detail page: https://www.isobus.net/isobus/pGNAndSPN/16482?type=PGN. Signal-level enrichment via PR welcome  see CONTRIBUTING.md.";
CM_ SG_ 2566812416 Laser_Receiver_Mast_Position_Raw "Generic 8-byte raw payload. Detail page: https://www.isobus.net/isobus/pGNAndSPN/16483?type=PGN. Signal-level enrichment via PR welcome  see CONTRIBUTING.md.";
CM_ SG_ 2566812672 Modify_Leveling_System_Control_S "Generic 8-byte raw payload. Detail page: https://www.isobus.net/isobus/pGNAndSPN/16485?type=PGN. Signal-level enrichment via PR welcome  see CONTRIBUTING.md.";
CM_ SG_ 2566812928 Laser_Leveling_System_Vertical_D "Generic 8-byte raw payload. Detail page: https://www.isobus.net/isobus/pGNAndSPN/16489?type=PGN. Signal-level enrichment via PR welcome  see CONTRIBUTING.md.";
CM_ SG_ 2566813184 Laser_Leveling_System_Vertical_P "Generic 8-byte raw payload. Detail page: https://www.isobus.net/isobus/pGNAndSPN/16494?type=PGN. Signal-level enrichment via PR welcome  see CONTRIBUTING.md.";
CM_ SG_ 2566813440 Auxiliary_Pressures_RawPayload "Generic 8-byte raw payload. Detail page: https://www.isobus.net/isobus/pGNAndSPN/16497?type=PGN. Signal-level enrichment via PR welcome  see CONTRIBUTING.md.";
CM_ SG_ 2566813696 Tire_Pressure_Control_Unit_Mode_ "Generic 8-byte raw payload. Detail page: https://www.isobus.net/isobus/pGNAndSPN/16508?type=PGN. Signal-level enrichment via PR welcome  see CONTRIBUTING.md.";
CM_ SG_ 2566813952 Tire_Pressure_Control_Unit_Targe "Generic 8-byte raw payload. Detail page: https://www.isobus.net/isobus/pGNAndSPN/16511?type=PGN. Signal-level enrichment via PR welcome  see CONTRIBUTING.md.";
CM_ SG_ 2566814208 Tire_Pressure_Control_Unit_Curre "Generic 8-byte raw payload. Detail page: https://www.isobus.net/isobus/pGNAndSPN/16514?type=PGN. Signal-level enrichment via PR welcome  see CONTRIBUTING.md.";
CM_ SG_ 2566814464 Combustion_Time_1_RawPayload "Generic 8-byte raw payload. Detail page: https://www.isobus.net/isobus/pGNAndSPN/16518?type=PGN. Signal-level enrichment via PR welcome  see CONTRIBUTING.md.";
CM_ SG_ 2566814720 Combustion_Time_2_RawPayload "Generic 8-byte raw payload. Detail page: https://www.isobus.net/isobus/pGNAndSPN/16522?type=PGN. Signal-level enrichment via PR welcome  see CONTRIBUTING.md.";
CM_ SG_ 2566814976 Combustion_Time_3_RawPayload "Generic 8-byte raw payload. Detail page: https://www.isobus.net/isobus/pGNAndSPN/16526?type=PGN. Signal-level enrichment via PR welcome  see CONTRIBUTING.md.";
CM_ SG_ 2566815232 Combustion_Time_4_RawPayload "Generic 8-byte raw payload. Detail page: https://www.isobus.net/isobus/pGNAndSPN/16530?type=PGN. Signal-level enrichment via PR welcome  see CONTRIBUTING.md.";
CM_ SG_ 2566815488 Combustion_Time_5_RawPayload "Generic 8-byte raw payload. Detail page: https://www.isobus.net/isobus/pGNAndSPN/16534?type=PGN. Signal-level enrichment via PR welcome  see CONTRIBUTING.md.";
CM_ SG_ 2566815744 Combustion_Time_6_RawPayload "Generic 8-byte raw payload. Detail page: https://www.isobus.net/isobus/pGNAndSPN/16536?type=PGN. Signal-level enrichment via PR welcome  see CONTRIBUTING.md.";
CM_ SG_ 2566816000 Fuel_Information_2_Gaseous_RawPa "Generic 8-byte raw payload. Detail page: https://www.isobus.net/isobus/pGNAndSPN/16542?type=PGN. Signal-level enrichment via PR welcome  see CONTRIBUTING.md.";
CM_ SG_ 2566816256 Ignition_Timing_1_RawPayload "Generic 8-byte raw payload. Detail page: https://www.isobus.net/isobus/pGNAndSPN/16546?type=PGN. Signal-level enrichment via PR welcome  see CONTRIBUTING.md.";
CM_ SG_ 2566816512 Ignition_Timing_2_RawPayload "Generic 8-byte raw payload. Detail page: https://www.isobus.net/isobus/pGNAndSPN/16550?type=PGN. Signal-level enrichment via PR welcome  see CONTRIBUTING.md.";
CM_ SG_ 2566816768 Ignition_Timing_3_RawPayload "Generic 8-byte raw payload. Detail page: https://www.isobus.net/isobus/pGNAndSPN/16554?type=PGN. Signal-level enrichment via PR welcome  see CONTRIBUTING.md.";
CM_ SG_ 2566817024 Ignition_Timing_4_RawPayload "Generic 8-byte raw payload. Detail page: https://www.isobus.net/isobus/pGNAndSPN/16558?type=PGN. Signal-level enrichment via PR welcome  see CONTRIBUTING.md.";
CM_ SG_ 2566817280 Ignition_Timing_5_RawPayload "Generic 8-byte raw payload. Detail page: https://www.isobus.net/isobus/pGNAndSPN/16562?type=PGN. Signal-level enrichment via PR welcome  see CONTRIBUTING.md.";
CM_ SG_ 2566817536 Ignition_Timing_6_RawPayload "Generic 8-byte raw payload. Detail page: https://www.isobus.net/isobus/pGNAndSPN/16566?type=PGN. Signal-level enrichment via PR welcome  see CONTRIBUTING.md.";
CM_ SG_ 2566817792 Ignition_Transformer_Secondary_O "Generic 8-byte raw payload. Detail page: https://www.isobus.net/isobus/pGNAndSPN/16574?type=PGN. Signal-level enrichment via PR welcome  see CONTRIBUTING.md.";
CM_ SG_ 2566818048 Ignition_Transformer_Secondary_O "Generic 8-byte raw payload. Detail page: https://www.isobus.net/isobus/pGNAndSPN/16582?type=PGN. Signal-level enrichment via PR welcome  see CONTRIBUTING.md.";
CM_ SG_ 2566818304 Ignition_Transformer_Secondary_O "Generic 8-byte raw payload. Detail page: https://www.isobus.net/isobus/pGNAndSPN/16586?type=PGN. Signal-level enrichment via PR welcome  see CONTRIBUTING.md.";
CM_ SG_ 2566818560 Gaseous_Fuel_Pressure_1_RawPaylo "Generic 8-byte raw payload. Detail page: https://www.isobus.net/isobus/pGNAndSPN/16590?type=PGN. Signal-level enrichment via PR welcome  see CONTRIBUTING.md.";
CM_ SG_ 2566818816 Auxiliary_Analog_Information_Raw "Generic 8-byte raw payload. Detail page: https://www.isobus.net/isobus/pGNAndSPN/16597?type=PGN. Signal-level enrichment via PR welcome  see CONTRIBUTING.md.";
CM_ SG_ 2566819072 Vehicle_Electrical_Power_2_RawPa "Generic 8-byte raw payload. Detail page: https://www.isobus.net/isobus/pGNAndSPN/16601?type=PGN. Signal-level enrichment via PR welcome  see CONTRIBUTING.md.";
CM_ SG_ 2566819328 Service_2_RawPayload "Generic 8-byte raw payload. Detail page: https://www.isobus.net/isobus/pGNAndSPN/16603?type=PGN. Signal-level enrichment via PR welcome  see CONTRIBUTING.md.";
CM_ SG_ 2566819584 Supply_Pressure_2_RawPayload "Generic 8-byte raw payload. Detail page: https://www.isobus.net/isobus/pGNAndSPN/16604?type=PGN. Signal-level enrichment via PR welcome  see CONTRIBUTING.md.";
CM_ SG_ 2566819840 Engine_Torque_History_RawPayload "Generic 8-byte raw payload. Detail page: https://www.isobus.net/isobus/pGNAndSPN/16623?type=PGN. Signal-level enrichment via PR welcome  see CONTRIBUTING.md.";
CM_ SG_ 2566820096 Fuel_Leakage_RawPayload "Generic 8-byte raw payload. Detail page: https://www.isobus.net/isobus/pGNAndSPN/16626?type=PGN. Signal-level enrichment via PR welcome  see CONTRIBUTING.md.";
CM_ SG_ 2566820352 Engine_Information_1_RawPayload "Generic 8-byte raw payload. Detail page: https://www.isobus.net/isobus/pGNAndSPN/16631?type=PGN. Signal-level enrichment via PR welcome  see CONTRIBUTING.md.";
CM_ SG_ 2566820608 Engine_Electrical_System_Module_ "Generic 8-byte raw payload. Detail page: https://www.isobus.net/isobus/pGNAndSPN/16634?type=PGN. Signal-level enrichment via PR welcome  see CONTRIBUTING.md.";
CM_ SG_ 2566820864 Engine_Auxiliary_Coolant_RawPayl "Generic 8-byte raw payload. Detail page: https://www.isobus.net/isobus/pGNAndSPN/16642?type=PGN. Signal-level enrichment via PR welcome  see CONTRIBUTING.md.";
CM_ SG_ 2566821120 Rebuild_Information_RawPayload "Generic 8-byte raw payload. Detail page: https://www.isobus.net/isobus/pGNAndSPN/16643?type=PGN. Signal-level enrichment via PR welcome  see CONTRIBUTING.md.";
CM_ SG_ 2566821376 Turbocharger_Wastegate_RawPayloa "Generic 8-byte raw payload. Detail page: https://www.isobus.net/isobus/pGNAndSPN/16652?type=PGN. Signal-level enrichment via PR welcome  see CONTRIBUTING.md.";
CM_ SG_ 2566821632 Turbocharger_Information_5_RawPa "Generic 8-byte raw payload. Detail page: https://www.isobus.net/isobus/pGNAndSPN/16656?type=PGN. Signal-level enrichment via PR welcome  see CONTRIBUTING.md.";
CM_ SG_ 2566821888 Turbocharger_Information_4_RawPa "Generic 8-byte raw payload. Detail page: https://www.isobus.net/isobus/pGNAndSPN/16660?type=PGN. Signal-level enrichment via PR welcome  see CONTRIBUTING.md.";
CM_ SG_ 2566822144 Turbocharger_Information_3_RawPa "Generic 8-byte raw payload. Detail page: https://www.isobus.net/isobus/pGNAndSPN/16664?type=PGN. Signal-level enrichment via PR welcome  see CONTRIBUTING.md.";
CM_ SG_ 2566822400 Turbocharger_Information_2_RawPa "Generic 8-byte raw payload. Detail page: https://www.isobus.net/isobus/pGNAndSPN/16668?type=PGN. Signal-level enrichment via PR welcome  see CONTRIBUTING.md.";
CM_ SG_ 2566822656 Turbocharger_Information_1_RawPa "Generic 8-byte raw payload. Detail page: https://www.isobus.net/isobus/pGNAndSPN/16672?type=PGN. Signal-level enrichment via PR welcome  see CONTRIBUTING.md.";
CM_ SG_ 2566822912 Main_Bearing_Temperature_3_RawPa "Generic 8-byte raw payload. Detail page: https://www.isobus.net/isobus/pGNAndSPN/16676?type=PGN. Signal-level enrichment via PR welcome  see CONTRIBUTING.md.";
CM_ SG_ 2566823168 Main_Bearing_Temperature_2_RawPa "Generic 8-byte raw payload. Detail page: https://www.isobus.net/isobus/pGNAndSPN/16680?type=PGN. Signal-level enrichment via PR welcome  see CONTRIBUTING.md.";
CM_ SG_ 2566823424 Main_Bearing_Temperature_1_RawPa "Generic 8-byte raw payload. Detail page: https://www.isobus.net/isobus/pGNAndSPN/16684?type=PGN. Signal-level enrichment via PR welcome  see CONTRIBUTING.md.";
CM_ SG_ 2566823680 Exhaust_Port_Temperature_5_RawPa "Generic 8-byte raw payload. Detail page: https://www.isobus.net/isobus/pGNAndSPN/16688?type=PGN. Signal-level enrichment via PR welcome  see CONTRIBUTING.md.";
CM_ SG_ 2566823936 Exhaust_Port_Temperature_4_RawPa "Generic 8-byte raw payload. Detail page: https://www.isobus.net/isobus/pGNAndSPN/16692?type=PGN. Signal-level enrichment via PR welcome  see CONTRIBUTING.md.";
CM_ SG_ 2566824192 Exhaust_Port_Temperature_3_RawPa "Generic 8-byte raw payload. Detail page: https://www.isobus.net/isobus/pGNAndSPN/16696?type=PGN. Signal-level enrichment via PR welcome  see CONTRIBUTING.md.";
CM_ SG_ 2566824448 Exhaust_Port_Temperature_2_RawPa "Generic 8-byte raw payload. Detail page: https://www.isobus.net/isobus/pGNAndSPN/16700?type=PGN. Signal-level enrichment via PR welcome  see CONTRIBUTING.md.";
CM_ SG_ 2566824704 Exhaust_Port_Temperature_1_RawPa "Generic 8-byte raw payload. Detail page: https://www.isobus.net/isobus/pGNAndSPN/16704?type=PGN. Signal-level enrichment via PR welcome  see CONTRIBUTING.md.";
CM_ SG_ 2566824960 Engine_Temperature_2_RawPayload "Generic 8-byte raw payload. Detail page: https://www.isobus.net/isobus/pGNAndSPN/16708?type=PGN. Signal-level enrichment via PR welcome  see CONTRIBUTING.md.";
CM_ SG_ 2566825216 Intake_Manifold_Information_2_Ra "Generic 8-byte raw payload. Detail page: https://www.isobus.net/isobus/pGNAndSPN/16715?type=PGN. Signal-level enrichment via PR welcome  see CONTRIBUTING.md.";
CM_ SG_ 2566825472 Intake_Manifold_Information_1_Ra "Generic 8-byte raw payload. Detail page: https://www.isobus.net/isobus/pGNAndSPN/16719?type=PGN. Signal-level enrichment via PR welcome  see CONTRIBUTING.md.";
CM_ SG_ 2566825728 Alternator_Temperature_1_RawPayl "Generic 8-byte raw payload. Detail page: https://www.isobus.net/isobus/pGNAndSPN/16727?type=PGN. Signal-level enrichment via PR welcome  see CONTRIBUTING.md.";
CM_ SG_ 2566825984 Articulation_Control_RawPayload "Generic 8-byte raw payload. Detail page: https://www.isobus.net/isobus/pGNAndSPN/16729?type=PGN. Signal-level enrichment via PR welcome  see CONTRIBUTING.md.";
CM_ SG_ 2566826240 Exhaust_Oxygen_1_RawPayload "Generic 8-byte raw payload. Detail page: https://www.isobus.net/isobus/pGNAndSPN/16734?type=PGN. Signal-level enrichment via PR welcome  see CONTRIBUTING.md.";
CM_ SG_ 2566826496 Alternate_Fuel_2_RawPayload "Generic 8-byte raw payload. Detail page: https://www.isobus.net/isobus/pGNAndSPN/16739?type=PGN. Signal-level enrichment via PR welcome  see CONTRIBUTING.md.";
CM_ SG_ 2566826752 Electronic_Transmission_Controll "Generic 8-byte raw payload. Detail page: https://www.isobus.net/isobus/pGNAndSPN/16743?type=PGN. Signal-level enrichment via PR welcome  see CONTRIBUTING.md.";
CM_ SG_ 2566827008 Wheel_Brake_Lining_Remaining_Inf "Generic 8-byte raw payload. Detail page: https://www.isobus.net/isobus/pGNAndSPN/16751?type=PGN. Signal-level enrichment via PR welcome  see CONTRIBUTING.md.";
CM_ SG_ 2566827264 Wheel_Application_Pressure_High_ "Generic 8-byte raw payload. Detail page: https://www.isobus.net/isobus/pGNAndSPN/16759?type=PGN. Signal-level enrichment via PR welcome  see CONTRIBUTING.md.";
CM_ SG_ 2566827520 Air_Supply_Pressure_RawPayload "Generic 8-byte raw payload. Detail page: https://www.isobus.net/isobus/pGNAndSPN/16767?type=PGN. Signal-level enrichment via PR welcome  see CONTRIBUTING.md.";
CM_ SG_ 2566827776 Fuel_Consumption_Gaseous_RawPayl "Generic 8-byte raw payload. Detail page: https://www.isobus.net/isobus/pGNAndSPN/16769?type=PGN. Signal-level enrichment via PR welcome  see CONTRIBUTING.md.";
CM_ SG_ 2566828032 Trip_Time_Information_2_RawPaylo "Generic 8-byte raw payload. Detail page: https://www.isobus.net/isobus/pGNAndSPN/16774?type=PGN. Signal-level enrichment via PR welcome  see CONTRIBUTING.md.";
CM_ SG_ 2566828288 ECU_History_RawPayload "Generic 8-byte raw payload. Detail page: https://www.isobus.net/isobus/pGNAndSPN/16776?type=PGN. Signal-level enrichment via PR welcome  see CONTRIBUTING.md.";
CM_ SG_ 2566828544 Fuel_Information_1_Gaseous_RawPa "Generic 8-byte raw payload. Detail page: https://www.isobus.net/isobus/pGNAndSPN/16779?type=PGN. Signal-level enrichment via PR welcome  see CONTRIBUTING.md.";
CM_ SG_ 2566828800 Fuel_Information_1_Liquid_RawPay "Generic 8-byte raw payload. Detail page: https://www.isobus.net/isobus/pGNAndSPN/16782?type=PGN. Signal-level enrichment via PR welcome  see CONTRIBUTING.md.";
CM_ SG_ 2566829056 Trip_Time_Information_1_RawPaylo "Generic 8-byte raw payload. Detail page: https://www.isobus.net/isobus/pGNAndSPN/16786?type=PGN. Signal-level enrichment via PR welcome  see CONTRIBUTING.md.";
CM_ SG_ 2566829312 Trip_Shutdown_Information_RawPay "Generic 8-byte raw payload. Detail page: https://www.isobus.net/isobus/pGNAndSPN/16790?type=PGN. Signal-level enrichment via PR welcome  see CONTRIBUTING.md.";
CM_ SG_ 2566829568 Trip_Vehicle_Speed_Cruise_Distan "Generic 8-byte raw payload. Detail page: https://www.isobus.net/isobus/pGNAndSPN/16792?type=PGN. Signal-level enrichment via PR welcome  see CONTRIBUTING.md.";
CM_ SG_ 2566829824 Engine_Speed_Load_Factor_Informa "Generic 8-byte raw payload. Detail page: https://www.isobus.net/isobus/pGNAndSPN/16797?type=PGN. Signal-level enrichment via PR welcome  see CONTRIBUTING.md.";
CM_ SG_ 2566830080 Trip_Fuel_Information_Gaseous_Ra "Generic 8-byte raw payload. Detail page: https://www.isobus.net/isobus/pGNAndSPN/16803?type=PGN. Signal-level enrichment via PR welcome  see CONTRIBUTING.md.";
CM_ SG_ 2566830336 Trip_Fuel_Information_Liquid_Raw "Generic 8-byte raw payload. Detail page: https://www.isobus.net/isobus/pGNAndSPN/16809?type=PGN. Signal-level enrichment via PR welcome  see CONTRIBUTING.md.";
CM_ SG_ 2566830592 Trip_Distance_Information_RawPay "Generic 8-byte raw payload. Detail page: https://www.isobus.net/isobus/pGNAndSPN/16812?type=PGN. Signal-level enrichment via PR welcome  see CONTRIBUTING.md.";
CM_ SG_ 2566830848 Trip_Fan_Information_RawPayload "Generic 8-byte raw payload. Detail page: https://www.isobus.net/isobus/pGNAndSPN/16816?type=PGN. Signal-level enrichment via PR welcome  see CONTRIBUTING.md.";
CM_ SG_ 2566831104 Compression_Service_Brake_Inform "Generic 8-byte raw payload. Detail page: https://www.isobus.net/isobus/pGNAndSPN/16820?type=PGN. Signal-level enrichment via PR welcome  see CONTRIBUTING.md.";
CM_ SG_ 2566831360 Fan_Drive_1_RawPayload "Generic 8-byte raw payload. Detail page: https://www.isobus.net/isobus/pGNAndSPN/16827?type=PGN. Signal-level enrichment via PR welcome  see CONTRIBUTING.md.";
CM_ SG_ 2566831616 Electronic_Engine_Controller_4_R "Generic 8-byte raw payload. Detail page: https://www.isobus.net/isobus/pGNAndSPN/16833?type=PGN. Signal-level enrichment via PR welcome  see CONTRIBUTING.md.";
CM_ SG_ 2566831872 Wheel_Speed_Information_RawPaylo "Generic 8-byte raw payload. Detail page: https://www.isobus.net/isobus/pGNAndSPN/16840?type=PGN. Signal-level enrichment via PR welcome  see CONTRIBUTING.md.";
CM_ SG_ 2566832128 Service_Information_RawPayload "Generic 8-byte raw payload. Detail page: https://www.isobus.net/isobus/pGNAndSPN/16846?type=PGN. Signal-level enrichment via PR welcome  see CONTRIBUTING.md.";
CM_ SG_ 2566832640 Electronic_Retarder_Controller_2 "Generic 8-byte raw payload. Detail page: https://www.isobus.net/isobus/pGNAndSPN/16856?type=PGN. Signal-level enrichment via PR welcome  see CONTRIBUTING.md.";
CM_ SG_ 2566832896 Electronic_Transmission_Controll "Generic 8-byte raw payload. Detail page: https://www.isobus.net/isobus/pGNAndSPN/16862?type=PGN. Signal-level enrichment via PR welcome  see CONTRIBUTING.md.";
CM_ SG_ 2566833152 Electronic_Brake_System_2_2_RawP "Generic 8-byte raw payload. Detail page: https://www.isobus.net/isobus/pGNAndSPN/16863?type=PGN. Signal-level enrichment via PR welcome  see CONTRIBUTING.md.";
CM_ SG_ 2566833408 Electronic_Transmission_Controll "Generic 8-byte raw payload. Detail page: https://www.isobus.net/isobus/pGNAndSPN/16865?type=PGN. Signal-level enrichment via PR welcome  see CONTRIBUTING.md.";
CM_ SG_ 2566833664 Electronic_Brake_System_2_3_RawP "Generic 8-byte raw payload. Detail page: https://www.isobus.net/isobus/pGNAndSPN/16866?type=PGN. Signal-level enrichment via PR welcome  see CONTRIBUTING.md.";
CM_ SG_ 2566833920 Electronic_Transmission_Controll "Generic 8-byte raw payload. Detail page: https://www.isobus.net/isobus/pGNAndSPN/16883?type=PGN. Signal-level enrichment via PR welcome  see CONTRIBUTING.md.";
CM_ SG_ 2566834176 General_Purpose_Message_2_2_RawP "Generic 8-byte raw payload. Detail page: https://www.isobus.net/isobus/pGNAndSPN/16884?type=PGN. Signal-level enrichment via PR welcome  see CONTRIBUTING.md.";
CM_ SG_ 2566834432 Electronic_Brake_System_1_2_RawP "Generic 8-byte raw payload. Detail page: https://www.isobus.net/isobus/pGNAndSPN/16885?type=PGN. Signal-level enrichment via PR welcome  see CONTRIBUTING.md.";
CM_ SG_ 2566835456 Freeze_Frame_Parameters_RawPaylo "Generic 8-byte raw payload. Detail page: https://www.isobus.net/isobus/pGNAndSPN/16900?type=PGN. Signal-level enrichment via PR welcome  see CONTRIBUTING.md.";
CM_ SG_ 2566835712 Diagnostic_Readiness_1_RawPayloa "Generic 8-byte raw payload. Detail page: https://www.isobus.net/isobus/pGNAndSPN/16906?type=PGN. Signal-level enrichment via PR welcome  see CONTRIBUTING.md.";
CM_ SG_ 2566835968 Emission_Related_Pending_Diagnos "Generic 8-byte raw payload. Detail page: https://www.isobus.net/isobus/pGNAndSPN/16918?type=PGN. Signal-level enrichment via PR welcome  see CONTRIBUTING.md.";
CM_ SG_ 2566836224 Test_Results_for_Non_continuousl "Generic 8-byte raw payload. Detail page: https://www.isobus.net/isobus/pGNAndSPN/16923?type=PGN. Signal-level enrichment via PR welcome  see CONTRIBUTING.md.";
CM_ SG_ 2566836480 Oxygen_Sensor_Test_Results_RawPa "Generic 8-byte raw payload. Detail page: https://www.isobus.net/isobus/pGNAndSPN/16924?type=PGN. Signal-level enrichment via PR welcome  see CONTRIBUTING.md.";
CM_ SG_ 2566836736 Non_Continuously_Monitored_Syste "Generic 8-byte raw payload. Detail page: https://www.isobus.net/isobus/pGNAndSPN/16925?type=PGN. Signal-level enrichment via PR welcome  see CONTRIBUTING.md.";
CM_ SG_ 2566837248 Emission_Related_MIL_On_Diagnost "Generic 8-byte raw payload. Detail page: https://www.isobus.net/isobus/pGNAndSPN/16938?type=PGN. Signal-level enrichment via PR welcome  see CONTRIBUTING.md.";
CM_ SG_ 2566837504 Alternator_Information_1_RawPayl "Generic 8-byte raw payload. Detail page: https://www.isobus.net/isobus/pGNAndSPN/16950?type=PGN. Signal-level enrichment via PR welcome  see CONTRIBUTING.md.";
CM_ SG_ 2566837760 Hybrid_or_EV_System_Inputs_1_Raw "Generic 8-byte raw payload. Detail page: https://www.isobus.net/isobus/pGNAndSPN/16966?type=PGN. Signal-level enrichment via PR welcome  see CONTRIBUTING.md.";
CM_ SG_ 2566838528 Auxiliary_Input_Output_Status_1_ "Generic 8-byte raw payload. Detail page: https://www.isobus.net/isobus/pGNAndSPN/16986?type=PGN. Signal-level enrichment via PR welcome  see CONTRIBUTING.md.";
CM_ SG_ 2566839040 Engine_Fluid_Level_Pressure_2_Ra "Generic 8-byte raw payload. Detail page: https://www.isobus.net/isobus/pGNAndSPN/16992?type=PGN. Signal-level enrichment via PR welcome  see CONTRIBUTING.md.";
CM_ SG_ 2566839296 Idle_Operation_RawPayload "Generic 8-byte raw payload. Detail page: https://www.isobus.net/isobus/pGNAndSPN/16994?type=PGN. Signal-level enrichment via PR welcome  see CONTRIBUTING.md.";
CM_ SG_ 2566839552 Turbocharger_RawPayload "Generic 8-byte raw payload. Detail page: https://www.isobus.net/isobus/pGNAndSPN/16998?type=PGN. Signal-level enrichment via PR welcome  see CONTRIBUTING.md.";
CM_ SG_ 2566839808 Engine_Air_Start_Pressure_RawPay "Generic 8-byte raw payload. Detail page: https://www.isobus.net/isobus/pGNAndSPN/17001?type=PGN. Signal-level enrichment via PR welcome  see CONTRIBUTING.md.";
CM_ SG_ 2566840320 Vehicle_Distance_RawPayload "Generic 8-byte raw payload. Detail page: https://www.isobus.net/isobus/pGNAndSPN/17012?type=PGN. Signal-level enrichment via PR welcome  see CONTRIBUTING.md.";
CM_ SG_ 2566840576 Retarder_Configuration_RawPayloa "Generic 8-byte raw payload. Detail page: https://www.isobus.net/isobus/pGNAndSPN/17026?type=PGN. Signal-level enrichment via PR welcome  see CONTRIBUTING.md.";
CM_ SG_ 2566840832 Transmission_Configuration_RawPa "Generic 8-byte raw payload. Detail page: https://www.isobus.net/isobus/pGNAndSPN/17029?type=PGN. Signal-level enrichment via PR welcome  see CONTRIBUTING.md.";
CM_ SG_ 2566841344 Shutdown_RawPayload "Generic 8-byte raw payload. Detail page: https://www.isobus.net/isobus/pGNAndSPN/17081?type=PGN. Signal-level enrichment via PR welcome  see CONTRIBUTING.md.";
CM_ SG_ 2566842112 Vehicle_Hours_RawPayload "Generic 8-byte raw payload. Detail page: https://www.isobus.net/isobus/pGNAndSPN/17093?type=PGN. Signal-level enrichment via PR welcome  see CONTRIBUTING.md.";
CM_ SG_ 2566842368 Vehicle_Direction_Speed_RawPaylo "Generic 8-byte raw payload. Detail page: https://www.isobus.net/isobus/pGNAndSPN/17097?type=PGN. Signal-level enrichment via PR welcome  see CONTRIBUTING.md.";
CM_ SG_ 2566842624 Fuel_Consumption_Liquid_1_RawPay "Generic 8-byte raw payload. Detail page: https://www.isobus.net/isobus/pGNAndSPN/17099?type=PGN. Signal-level enrichment via PR welcome  see CONTRIBUTING.md.";
CM_ SG_ 2566842880 Vehicle_Weight_RawPayload "Generic 8-byte raw payload. Detail page: https://www.isobus.net/isobus/pGNAndSPN/17103?type=PGN. Signal-level enrichment via PR welcome  see CONTRIBUTING.md.";
CM_ SG_ 2566843648 Cruise_Control_Vehicle_Speed_Set "Generic 8-byte raw payload. Detail page: https://www.isobus.net/isobus/pGNAndSPN/17118?type=PGN. Signal-level enrichment via PR welcome  see CONTRIBUTING.md.";
CM_ SG_ 2566844416 Power_Takeoff_Information_1_RawP "Generic 8-byte raw payload. Detail page: https://www.isobus.net/isobus/pGNAndSPN/17145?type=PGN. Signal-level enrichment via PR welcome  see CONTRIBUTING.md.";
CM_ SG_ 2566845184 Vehicle_Position_1_RawPayload "Generic 8-byte raw payload. Detail page: https://www.isobus.net/isobus/pGNAndSPN/17172?type=PGN. Signal-level enrichment via PR welcome  see CONTRIBUTING.md.";
CM_ SG_ 2566845440 Tire_Condition_Message_1_RawPayl "Generic 8-byte raw payload. Detail page: https://www.isobus.net/isobus/pGNAndSPN/17181?type=PGN. Signal-level enrichment via PR welcome  see CONTRIBUTING.md.";
CM_ SG_ 2566845696 Ambient_Conditions_RawPayload "Generic 8-byte raw payload. Detail page: https://www.isobus.net/isobus/pGNAndSPN/17186?type=PGN. Signal-level enrichment via PR welcome  see CONTRIBUTING.md.";
CM_ SG_ 2566846720 Axle_Information_RawPayload "Generic 8-byte raw payload. Detail page: https://www.isobus.net/isobus/pGNAndSPN/17212?type=PGN. Signal-level enrichment via PR welcome  see CONTRIBUTING.md.";
CM_ SG_ 2566846976 Brakes_1_RawPayload "Generic 8-byte raw payload. Detail page: https://www.isobus.net/isobus/pGNAndSPN/17219?type=PGN. Signal-level enrichment via PR welcome  see CONTRIBUTING.md.";
CM_ SG_ 2566847232 Retarder_fluids_RawPayload "Generic 8-byte raw payload. Detail page: https://www.isobus.net/isobus/pGNAndSPN/17223?type=PGN. Signal-level enrichment via PR welcome  see CONTRIBUTING.md.";
CM_ SG_ 2566847488 Dash_Display_1_RawPayload "Generic 8-byte raw payload. Detail page: https://www.isobus.net/isobus/pGNAndSPN/17230?type=PGN. Signal-level enrichment via PR welcome  see CONTRIBUTING.md.";
CM_ SG_ 2566847744 Alternate_Fuel_1_RawPayload "Generic 8-byte raw payload. Detail page: https://www.isobus.net/isobus/pGNAndSPN/17235?type=PGN. Signal-level enrichment via PR welcome  see CONTRIBUTING.md.";
CM_ SG_ 2566848000 Auxiliary_Water_Pump_Pressure_Ra "Generic 8-byte raw payload. Detail page: https://www.isobus.net/isobus/pGNAndSPN/17236?type=PGN. Signal-level enrichment via PR welcome  see CONTRIBUTING.md.";
CM_ SG_ 2566848256 Operator_indicators_RawPayload "Generic 8-byte raw payload. Detail page: https://www.isobus.net/isobus/pGNAndSPN/17252?type=PGN. Signal-level enrichment via PR welcome  see CONTRIBUTING.md.";
CM_ SG_ 2582446080 NMEA_Request_Command_Acknowledge "Generic 8-byte raw payload. Detail page: https://www.isobus.net/isobus/pGNAndSPN/17509?type=PGN. Signal-level enrichment via PR welcome  see CONTRIBUTING.md.";
CM_ SG_ 2582511616 PGN_List_Transmit_Receive_PGN_s_ "Generic 8-byte raw payload. Detail page: https://www.isobus.net/isobus/pGNAndSPN/17510?type=PGN. Signal-level enrichment via PR welcome  see CONTRIBUTING.md.";
CM_ SG_ 2582644480 Alert_RawPayload "Generic 8-byte raw payload. Detail page: https://www.isobus.net/isobus/pGNAndSPN/17512?type=PGN. Signal-level enrichment via PR welcome  see CONTRIBUTING.md.";
CM_ SG_ 2582644736 Alert_Response_RawPayload "Generic 8-byte raw payload. Detail page: https://www.isobus.net/isobus/pGNAndSPN/17513?type=PGN. Signal-level enrichment via PR welcome  see CONTRIBUTING.md.";
CM_ SG_ 2582644992 Alert_Text_RawPayload "Generic 8-byte raw payload. Detail page: https://www.isobus.net/isobus/pGNAndSPN/17514?type=PGN. Signal-level enrichment via PR welcome  see CONTRIBUTING.md.";
CM_ SG_ 2582645248 Alert_Configuration_RawPayload "Generic 8-byte raw payload. Detail page: https://www.isobus.net/isobus/pGNAndSPN/17515?type=PGN. Signal-level enrichment via PR welcome  see CONTRIBUTING.md.";
CM_ SG_ 2582645504 Alert_Threshold_RawPayload "Generic 8-byte raw payload. Detail page: https://www.isobus.net/isobus/pGNAndSPN/17516?type=PGN. Signal-level enrichment via PR welcome  see CONTRIBUTING.md.";
CM_ SG_ 2582645760 Alert_Value_RawPayload "Generic 8-byte raw payload. Detail page: https://www.isobus.net/isobus/pGNAndSPN/17517?type=PGN. Signal-level enrichment via PR welcome  see CONTRIBUTING.md.";
CM_ SG_ 2582646784 System_Time_RawPayload "Generic 8-byte raw payload. Detail page: https://www.isobus.net/isobus/pGNAndSPN/17518?type=PGN. Signal-level enrichment via PR welcome  see CONTRIBUTING.md.";
CM_ SG_ 2582647040 Heartbeat_RawPayload "Generic 8-byte raw payload. Detail page: https://www.isobus.net/isobus/pGNAndSPN/17519?type=PGN. Signal-level enrichment via PR welcome  see CONTRIBUTING.md.";
CM_ SG_ 2582647808 Product_Information_RawPayload "Generic 8-byte raw payload. Detail page: https://www.isobus.net/isobus/pGNAndSPN/17520?type=PGN. Signal-level enrichment via PR welcome  see CONTRIBUTING.md.";
CM_ SG_ 2582648320 Configuration_Information_RawPay "Generic 8-byte raw payload. Detail page: https://www.isobus.net/isobus/pGNAndSPN/17521?type=PGN. Signal-level enrichment via PR welcome  see CONTRIBUTING.md.";
CM_ SG_ 2582649088 Cyclic_Alert_List_IEC_61924_2_Ra "Generic 8-byte raw payload. Detail page: https://www.isobus.net/isobus/pGNAndSPN/17522?type=PGN. Signal-level enrichment via PR welcome  see CONTRIBUTING.md.";
CM_ SG_ 2582649344 Responsibility_Transfer_Function "Generic 8-byte raw payload. Detail page: https://www.isobus.net/isobus/pGNAndSPN/17523?type=PGN. Signal-level enrichment via PR welcome  see CONTRIBUTING.md.";
CM_ SG_ 2582708480 Man_Overboard_Notification_MOB_R "Generic 8-byte raw payload. Detail page: https://www.isobus.net/isobus/pGNAndSPN/17524?type=PGN. Signal-level enrichment via PR welcome  see CONTRIBUTING.md.";
CM_ SG_ 2582709504 Heading_Track_Control_RawPayload "Generic 8-byte raw payload. Detail page: https://www.isobus.net/isobus/pGNAndSPN/17525?type=PGN. Signal-level enrichment via PR welcome  see CONTRIBUTING.md.";
CM_ SG_ 2582711552 Rudder_RawPayload "Generic 8-byte raw payload. Detail page: https://www.isobus.net/isobus/pGNAndSPN/17526?type=PGN. Signal-level enrichment via PR welcome  see CONTRIBUTING.md.";
CM_ SG_ 2582713344 Heave_RawPayload "Generic 8-byte raw payload. Detail page: https://www.isobus.net/isobus/pGNAndSPN/17529?type=PGN. Signal-level enrichment via PR welcome  see CONTRIBUTING.md.";
CM_ SG_ 2582714624 Attitude_RawPayload "Generic 8-byte raw payload. Detail page: https://www.isobus.net/isobus/pGNAndSPN/17530?type=PGN. Signal-level enrichment via PR welcome  see CONTRIBUTING.md.";
CM_ SG_ 2582714880 Magnetic_Variation_RawPayload "Generic 8-byte raw payload. Detail page: https://www.isobus.net/isobus/pGNAndSPN/17531?type=PGN. Signal-level enrichment via PR welcome  see CONTRIBUTING.md.";
CM_ SG_ 2582773760 Engine_Parameters_Rapid_Update_R "Generic 8-byte raw payload. Detail page: https://www.isobus.net/isobus/pGNAndSPN/17532?type=PGN. Signal-level enrichment via PR welcome  see CONTRIBUTING.md.";
CM_ SG_ 2582774016 Engine_Parameters_Dynamic_RawPay "Generic 8-byte raw payload. Detail page: https://www.isobus.net/isobus/pGNAndSPN/17533?type=PGN. Signal-level enrichment via PR welcome  see CONTRIBUTING.md.";
CM_ SG_ 2582774272 Electric_Drive_Status_Dynamic_Ra "Generic 8-byte raw payload. Detail page: https://www.isobus.net/isobus/pGNAndSPN/17534?type=PGN. Signal-level enrichment via PR welcome  see CONTRIBUTING.md.";
CM_ SG_ 2582774528 Electric_Energy_Storage_Status_D "Generic 8-byte raw payload. Detail page: https://www.isobus.net/isobus/pGNAndSPN/17535?type=PGN. Signal-level enrichment via PR welcome  see CONTRIBUTING.md.";
CM_ SG_ 2582775040 Transmission_Parameters_Dynamic_ "Generic 8-byte raw payload. Detail page: https://www.isobus.net/isobus/pGNAndSPN/17536?type=PGN. Signal-level enrichment via PR welcome  see CONTRIBUTING.md.";
CM_ SG_ 2582775296 Electric_Drive_Information_RawPa "Generic 8-byte raw payload. Detail page: https://www.isobus.net/isobus/pGNAndSPN/17537?type=PGN. Signal-level enrichment via PR welcome  see CONTRIBUTING.md.";
CM_ SG_ 2582775552 Electric_Energy_Storage_Informat "Generic 8-byte raw payload. Detail page: https://www.isobus.net/isobus/pGNAndSPN/17538?type=PGN. Signal-level enrichment via PR welcome  see CONTRIBUTING.md.";
CM_ SG_ 2582775808 Trip_Parameters_Vessel_RawPayloa "Generic 8-byte raw payload. Detail page: https://www.isobus.net/isobus/pGNAndSPN/17539?type=PGN. Signal-level enrichment via PR welcome  see CONTRIBUTING.md.";
CM_ SG_ 2582776064 Trip_Parameters_Small_Craft_RawP "Generic 8-byte raw payload. Detail page: https://www.isobus.net/isobus/pGNAndSPN/17540?type=PGN. Signal-level enrichment via PR welcome  see CONTRIBUTING.md.";
CM_ SG_ 2582776320 Engine_Parameters_Static_RawPayl "Generic 8-byte raw payload. Detail page: https://www.isobus.net/isobus/pGNAndSPN/17541?type=PGN. Signal-level enrichment via PR welcome  see CONTRIBUTING.md.";
CM_ SG_ 2582776832 Load_Controller_Connection_State "Generic 8-byte raw payload. Detail page: https://www.isobus.net/isobus/pGNAndSPN/17542?type=PGN. Signal-level enrichment via PR welcome  see CONTRIBUTING.md.";
CM_ SG_ 2582777088 Binary_Switch_Bank_Status_RawPay "Generic 8-byte raw payload. Detail page: https://www.isobus.net/isobus/pGNAndSPN/17543?type=PGN. Signal-level enrichment via PR welcome  see CONTRIBUTING.md.";
CM_ SG_ 2582777344 Switch_Bank_Control_RawPayload "Generic 8-byte raw payload. Detail page: https://www.isobus.net/isobus/pGNAndSPN/17544?type=PGN. Signal-level enrichment via PR welcome  see CONTRIBUTING.md.";
CM_ SG_ 2582777600 AC_Input_Status_RawPayload "Generic 8-byte raw payload. Detail page: https://www.isobus.net/isobus/pGNAndSPN/17545?type=PGN. Signal-level enrichment via PR welcome  see CONTRIBUTING.md.";
CM_ SG_ 2582777856 AC_Output_Status_RawPayload "Generic 8-byte raw payload. Detail page: https://www.isobus.net/isobus/pGNAndSPN/17546?type=PGN. Signal-level enrichment via PR welcome  see CONTRIBUTING.md.";
CM_ SG_ 2582778112 Fluid_Level_RawPayload "Generic 8-byte raw payload. Detail page: https://www.isobus.net/isobus/pGNAndSPN/17547?type=PGN. Signal-level enrichment via PR welcome  see CONTRIBUTING.md.";
CM_ SG_ 2582778368 DC_Detailed_Status_RawPayload "Generic 8-byte raw payload. Detail page: https://www.isobus.net/isobus/pGNAndSPN/17548?type=PGN. Signal-level enrichment via PR welcome  see CONTRIBUTING.md.";
CM_ SG_ 2582778624 Charger_Status_RawPayload "Generic 8-byte raw payload. Detail page: https://www.isobus.net/isobus/pGNAndSPN/17549?type=PGN. Signal-level enrichment via PR welcome  see CONTRIBUTING.md.";
CM_ SG_ 2582778880 Battery_Status_RawPayload "Generic 8-byte raw payload. Detail page: https://www.isobus.net/isobus/pGNAndSPN/17550?type=PGN. Signal-level enrichment via PR welcome  see CONTRIBUTING.md.";
CM_ SG_ 2582779136 Inverter_Status_RawPayload "Generic 8-byte raw payload. Detail page: https://www.isobus.net/isobus/pGNAndSPN/17551?type=PGN. Signal-level enrichment via PR welcome  see CONTRIBUTING.md.";
CM_ SG_ 2582779392 Charger_Configuration_Status_Raw "Generic 8-byte raw payload. Detail page: https://www.isobus.net/isobus/pGNAndSPN/17552?type=PGN. Signal-level enrichment via PR welcome  see CONTRIBUTING.md.";
CM_ SG_ 2582779648 Inverter_Configuration_Status_Ra "Generic 8-byte raw payload. Detail page: https://www.isobus.net/isobus/pGNAndSPN/17553?type=PGN. Signal-level enrichment via PR welcome  see CONTRIBUTING.md.";
CM_ SG_ 2582779904 AGS_Configuration_Status_RawPayl "Generic 8-byte raw payload. Detail page: https://www.isobus.net/isobus/pGNAndSPN/17554?type=PGN. Signal-level enrichment via PR welcome  see CONTRIBUTING.md.";
CM_ SG_ 2582780160 Battery_Configuration_Status_Raw "Generic 8-byte raw payload. Detail page: https://www.isobus.net/isobus/pGNAndSPN/17555?type=PGN. Signal-level enrichment via PR welcome  see CONTRIBUTING.md.";
CM_ SG_ 2582780416 AGS_Status_RawPayload "Generic 8-byte raw payload. Detail page: https://www.isobus.net/isobus/pGNAndSPN/17556?type=PGN. Signal-level enrichment via PR welcome  see CONTRIBUTING.md.";
CM_ SG_ 2582839296 AC_Power_Current_Phase_A_RawPayl "Generic 8-byte raw payload. Detail page: https://www.isobus.net/isobus/pGNAndSPN/17557?type=PGN. Signal-level enrichment via PR welcome  see CONTRIBUTING.md.";
CM_ SG_ 2582839552 AC_Power_Current_Phase_B_RawPayl "Generic 8-byte raw payload. Detail page: https://www.isobus.net/isobus/pGNAndSPN/17558?type=PGN. Signal-level enrichment via PR welcome  see CONTRIBUTING.md.";
CM_ SG_ 2582839808 AC_Power_Current_Phase_C_RawPayl "Generic 8-byte raw payload. Detail page: https://www.isobus.net/isobus/pGNAndSPN/17559?type=PGN. Signal-level enrichment via PR welcome  see CONTRIBUTING.md.";
CM_ SG_ 2582840064 AC_Voltage_Frequency_Phase_A_Raw "Generic 8-byte raw payload. Detail page: https://www.isobus.net/isobus/pGNAndSPN/17560?type=PGN. Signal-level enrichment via PR welcome  see CONTRIBUTING.md.";
CM_ SG_ 2582840320 AC_Voltage_Frequency_Phase_B_Raw "Generic 8-byte raw payload. Detail page: https://www.isobus.net/isobus/pGNAndSPN/17561?type=PGN. Signal-level enrichment via PR welcome  see CONTRIBUTING.md.";

BA_DEF_ BO_ "SystemMessageLongSymbol" STRING;
BA_DEF_ SG_ "SystemSignalLongSymbol" STRING;
BA_ "SystemMessageLongSymbol" BO_ 2566769664 "VDMA_FDCC_Operators_External_Light_Control";
BA_ "SystemMessageLongSymbol" BO_ 2566769920 "VDMA_FDCD_Operator_Wiper_and_Washer_Contro";
BA_ "SystemMessageLongSymbol" BO_ 2566770176 "VDMA_FDCE_Working_Set_Member_Message_Obsol";
BA_ "SystemMessageLongSymbol" BO_ 2566770432 "VDMA_FDCF_Working_Set_Master_Message_Obsol";
BA_ "SystemMessageLongSymbol" BO_ 2566770688 "VDMA_FDD0_Intake_Exhaust_Conditions_2";
BA_ "SystemMessageLongSymbol" BO_ 2566770944 "VDMA_FDD1_FMS_standard_Interface_Identity_";
BA_ "SystemMessageLongSymbol" BO_ 2566771456 "VDMA_FDD3_Turbocharger_Information_6";
BA_ "SystemMessageLongSymbol" BO_ 2566771968 "VDMA_FDD5_Electronic_Engine_Controller_5";
BA_ "SystemMessageLongSymbol" BO_ 2566772224 "VDMA_FDD6_Basic_Joystick_Message_1";
BA_ "SystemMessageLongSymbol" BO_ 2566772480 "VDMA_FDD7_Extended_Joystick_Message_1";
BA_ "SystemMessageLongSymbol" BO_ 2566772736 "VDMA_FDD8_Basic_Joystick_Message_2";
BA_ "SystemMessageLongSymbol" BO_ 2566772992 "VDMA_FDD9_Extended_Joystick_Message_2";
BA_ "SystemMessageLongSymbol" BO_ 2566773248 "VDMA_FDDA_Basic_Joystick_Message_3";
BA_ "SystemMessageLongSymbol" BO_ 2566773504 "VDMA_FDDB_Extended_Joystick_Message_3";
BA_ "SystemMessageLongSymbol" BO_ 2566773760 "VDMA_FDDC_Marine_Control_Information";
BA_ "SystemMessageLongSymbol" BO_ 2566774016 "VDMA_FDDD_Military_Application_Message_1_1";
BA_ "SystemMessageLongSymbol" BO_ 2566774272 "VDMA_FDDE_Military_Application_Message_2_1";
BA_ "SystemMessageLongSymbol" BO_ 2566774528 "VDMA_FDDF_Front_Wheel_Drive_Status";
BA_ "SystemMessageLongSymbol" BO_ 2566775040 "VDMA_FDE1_Cab_Climate_System_Information_1";
BA_ "SystemMessageLongSymbol" BO_ 2566775552 "VDMA_FDE3_Equipment_Operation_and_Control";
BA_ "SystemMessageLongSymbol" BO_ 2566775808 "VDMA_FDE4_Equipment_Performance_Data";
BA_ "SystemMessageLongSymbol" BO_ 2566776064 "VDMA_FDE5_Maximum_Vehicle_Speed_Limit_Stat";
BA_ "SystemMessageLongSymbol" BO_ 2566776320 "VDMA_FDE6_Hydraulic_Braking_System";
BA_ "SystemMessageLongSymbol" BO_ 2566776576 "VDMA_FDE7_Bus_1_Utility_Sync_Check_Status";
BA_ "SystemMessageLongSymbol" BO_ 2566776832 "VDMA_FDE8_Bus_1_Generator_Sync_Check_Statu";
BA_ "SystemMessageLongSymbol" BO_ 2566777088 "VDMA_FDE9_Bus_1_Phase_C_Basic_AC_Quantitie";
BA_ "SystemMessageLongSymbol" BO_ 2566777344 "VDMA_FDEA_Bus_1_Phase_B_Basic_AC_Quantitie";
BA_ "SystemMessageLongSymbol" BO_ 2566777600 "VDMA_FDEB_Bus_1_Phase_A_Basic_AC_Quantitie";
BA_ "SystemMessageLongSymbol" BO_ 2566777856 "VDMA_FDEC_Bus_1_Average_Basic_AC_Quantitie";
BA_ "SystemMessageLongSymbol" BO_ 2566778112 "VDMA_FDED_Utility_Total_AC_Energy";
BA_ "SystemMessageLongSymbol" BO_ 2566778368 "VDMA_FDEE_Utility_Phase_C_AC_Reactive_Powe";
BA_ "SystemMessageLongSymbol" BO_ 2566778624 "VDMA_FDEF_Utility_Phase_C_AC_Power";
BA_ "SystemMessageLongSymbol" BO_ 2566778880 "VDMA_FDF0_Utility_Phase_C_AC_Basic_Quantit";
BA_ "SystemMessageLongSymbol" BO_ 2566779136 "VDMA_FDF1_Utility_Phase_B_AC_Reactive_Powe";
BA_ "SystemMessageLongSymbol" BO_ 2566779392 "VDMA_FDF2_Utility_Phase_B_AC_Power";
BA_ "SystemMessageLongSymbol" BO_ 2566779648 "VDMA_FDF3_Utility_Phase_B_AC_Basic_Quantit";
BA_ "SystemMessageLongSymbol" BO_ 2566779904 "VDMA_FDF4_Utility_Phase_A_AC_Reactive_Powe";
BA_ "SystemMessageLongSymbol" BO_ 2566780160 "VDMA_FDF5_Utility_Phase_A_AC_Power";
BA_ "SystemMessageLongSymbol" BO_ 2566780416 "VDMA_FDF6_Utility_Phase_A_Basic_AC_Quantit";
BA_ "SystemMessageLongSymbol" BO_ 2566780672 "VDMA_FDF7_Utility_Total_AC_Reactive_Power";
BA_ "SystemMessageLongSymbol" BO_ 2566781184 "VDMA_FDF9_Utility_Average_Basic_AC_Quantit";
BA_ "SystemMessageLongSymbol" BO_ 2566781440 "VDMA_FDFA_Generator_Total_AC_Energy";
BA_ "SystemMessageLongSymbol" BO_ 2566781696 "VDMA_FDFB_Generator_Phase_C_AC_Reactive_Po";
BA_ "SystemMessageLongSymbol" BO_ 2566781952 "VDMA_FDFC_Generator_Phase_C_AC_Power";
BA_ "SystemMessageLongSymbol" BO_ 2566782208 "VDMA_FDFD_Generator_Phase_C_Basic_AC_Quant";
BA_ "SystemMessageLongSymbol" BO_ 2566782464 "VDMA_FDFE_Generator_Phase_B_AC_Reactive_Po";
BA_ "SystemMessageLongSymbol" BO_ 2566782720 "VDMA_FDFF_Generator_Phase_B_AC_Power";
BA_ "SystemMessageLongSymbol" BO_ 2566782976 "VDMA_FE00_Generator_Phase_B_Basic_AC_Quant";
BA_ "SystemMessageLongSymbol" BO_ 2566783232 "VDMA_FE01_Generator_Phase_A_AC_Reactive_Po";
BA_ "SystemMessageLongSymbol" BO_ 2566783488 "VDMA_FE02_Generator_Phase_A_AC_Power";
BA_ "SystemMessageLongSymbol" BO_ 2566783744 "VDMA_FE03_Generator_Phase_A_Basic_AC_Quant";
BA_ "SystemMessageLongSymbol" BO_ 2566784000 "VDMA_FE04_Generator_Total_AC_Reactive_Powe";
BA_ "SystemMessageLongSymbol" BO_ 2566784256 "VDMA_FE05_Generator_Total_AC_Power";
BA_ "SystemMessageLongSymbol" BO_ 2566784512 "VDMA_FE06_Generator_Average_Basic_AC_Quant";
BA_ "SystemMessageLongSymbol" BO_ 2566785024 "VDMA_FE08_Required_Tractor_Facilities_mess";
BA_ "SystemMessageLongSymbol" BO_ 2566785280 "VDMA_FE09_Tractor_Facilities_response_mess";
BA_ "SystemMessageLongSymbol" BO_ 2566785536 "VDMA_FE0A_Tractor_control_command_tractor_";
BA_ "SystemMessageLongSymbol" BO_ 2566785792 "VDMA_FE0B_Tractor_control_mode_command";
BA_ "SystemMessageLongSymbol" BO_ 2566786560 "VDMA_FE0E_Response_for_Repetition_Rate";
BA_ "SystemMessageLongSymbol" BO_ 2566787072 "VDMA_FE10_Auxiliary_valve_0_estimated_flow";
BA_ "SystemMessageLongSymbol" BO_ 2566787328 "VDMA_FE11_Auxiliary_valve_1_estimated_flow";
BA_ "SystemMessageLongSymbol" BO_ 2566787584 "VDMA_FE12_Auxiliary_valve_2_estimated_flow";
BA_ "SystemMessageLongSymbol" BO_ 2566787840 "VDMA_FE13_Auxiliary_valve_3_estimated_flow";
BA_ "SystemMessageLongSymbol" BO_ 2566788096 "VDMA_FE14_Auxiliary_valve_4_estimated_flow";
BA_ "SystemMessageLongSymbol" BO_ 2566788352 "VDMA_FE15_Auxiliary_valve_5_estimated_flow";
BA_ "SystemMessageLongSymbol" BO_ 2566788608 "VDMA_FE16_Auxiliary_valve_6_estimated_flow";
BA_ "SystemMessageLongSymbol" BO_ 2566788864 "VDMA_FE17_Auxiliary_valve_7_estimated_flow";
BA_ "SystemMessageLongSymbol" BO_ 2566789120 "VDMA_FE18_Auxiliary_valve_8_estimated_flow";
BA_ "SystemMessageLongSymbol" BO_ 2566789376 "VDMA_FE19_Auxiliary_valve_9_estimated_flow";
BA_ "SystemMessageLongSymbol" BO_ 2566789632 "VDMA_FE1A_Auxiliary_valve_10_estimated_flo";
BA_ "SystemMessageLongSymbol" BO_ 2566789888 "VDMA_FE1B_Auxiliary_valve_11_estimated_flo";
BA_ "SystemMessageLongSymbol" BO_ 2566790144 "VDMA_FE1C_Auxiliary_valve_12_estimated_flo";
BA_ "SystemMessageLongSymbol" BO_ 2566790400 "VDMA_FE1D_Auxiliary_valve_13_estimated_flo";
BA_ "SystemMessageLongSymbol" BO_ 2566790656 "VDMA_FE1E_Auxiliary_valve_14_estimated_flo";
BA_ "SystemMessageLongSymbol" BO_ 2566790912 "VDMA_FE1F_Auxiliary_valve_15_estimated_flo";
BA_ "SystemMessageLongSymbol" BO_ 2566791168 "VDMA_FE20_Auxiliary_valve_0_measured_flow";
BA_ "SystemMessageLongSymbol" BO_ 2566791424 "VDMA_FE21_Auxiliary_valve_1_measured_flow";
BA_ "SystemMessageLongSymbol" BO_ 2566791680 "VDMA_FE22_Auxiliary_valve_2_measured_flow";
BA_ "SystemMessageLongSymbol" BO_ 2566791936 "VDMA_FE23_Auxiliary_valve_3_measured_flow";
BA_ "SystemMessageLongSymbol" BO_ 2566792192 "VDMA_FE24_Auxiliary_valve_4_measured_flow";
BA_ "SystemMessageLongSymbol" BO_ 2566792448 "VDMA_FE25_Auxiliary_valve_5_measured_flow";
BA_ "SystemMessageLongSymbol" BO_ 2566792704 "VDMA_FE26_Auxiliary_valve_6_measured_flow";
BA_ "SystemMessageLongSymbol" BO_ 2566792960 "VDMA_FE27_Auxiliary_valve_7_measured_flow";
BA_ "SystemMessageLongSymbol" BO_ 2566793216 "VDMA_FE28_Auxiliary_valve_8_measured_flow";
BA_ "SystemMessageLongSymbol" BO_ 2566793472 "VDMA_FE29_Auxiliary_valve_9_measured_flow";
BA_ "SystemMessageLongSymbol" BO_ 2566793728 "VDMA_FE2A_Auxiliary_valve_10_measured_flow";
BA_ "SystemMessageLongSymbol" BO_ 2566793984 "VDMA_FE2B_Auxiliary_valve_11_measured_flow";
BA_ "SystemMessageLongSymbol" BO_ 2566794240 "VDMA_FE2C_Auxiliary_valve_12_measured_flow";
BA_ "SystemMessageLongSymbol" BO_ 2566794496 "VDMA_FE2D_Auxiliary_valve_13_measured_flow";
BA_ "SystemMessageLongSymbol" BO_ 2566794752 "VDMA_FE2E_Auxiliary_valve_14_measured_flow";
BA_ "SystemMessageLongSymbol" BO_ 2566795008 "VDMA_FE2F_Auxiliary_valve_15_measured_flow";
BA_ "SystemMessageLongSymbol" BO_ 2566795264 "VDMA_FE30_Auxiliary_valve_0_command";
BA_ "SystemMessageLongSymbol" BO_ 2566795520 "VDMA_FE31_Auxiliary_valve_1_command";
BA_ "SystemMessageLongSymbol" BO_ 2566795776 "VDMA_FE32_Auxiliary_valve_2_command";
BA_ "SystemMessageLongSymbol" BO_ 2566796032 "VDMA_FE33_Auxiliary_valve_3_command";
BA_ "SystemMessageLongSymbol" BO_ 2566796288 "VDMA_FE34_Auxiliary_valve_4_command";
BA_ "SystemMessageLongSymbol" BO_ 2566796544 "VDMA_FE35_Auxiliary_valve_5_command";
BA_ "SystemMessageLongSymbol" BO_ 2566796800 "VDMA_FE36_Auxiliary_valve_6_command";
BA_ "SystemMessageLongSymbol" BO_ 2566797056 "VDMA_FE37_Auxiliary_valve_7_command";
BA_ "SystemMessageLongSymbol" BO_ 2566797312 "VDMA_FE38_Auxiliary_valve_8_command";
BA_ "SystemMessageLongSymbol" BO_ 2566797568 "VDMA_FE39_Auxiliary_valve_9_command";
BA_ "SystemMessageLongSymbol" BO_ 2566797824 "VDMA_FE3A_Auxiliary_valve_10_command";
BA_ "SystemMessageLongSymbol" BO_ 2566798080 "VDMA_FE3B_Auxiliary_valve_11_command";
BA_ "SystemMessageLongSymbol" BO_ 2566798336 "VDMA_FE3C_Auxiliary_valve_12_command";
BA_ "SystemMessageLongSymbol" BO_ 2566798592 "VDMA_FE3D_Auxiliary_valve_13_command";
BA_ "SystemMessageLongSymbol" BO_ 2566798848 "VDMA_FE3E_Auxiliary_valve_14_command";
BA_ "SystemMessageLongSymbol" BO_ 2566799104 "VDMA_FE3F_Auxiliary_valve_15_command";
BA_ "SystemMessageLongSymbol" BO_ 2566800128 "VDMA_FE43_Primary_or_Rear_Power_Take_off_O";
BA_ "SystemMessageLongSymbol" BO_ 2566800384 "VDMA_FE44_Secondary_or_Front_Power_Take_of";
BA_ "SystemMessageLongSymbol" BO_ 2566800640 "VDMA_FE45_Primary_or_Rear_Hitch_Status";
BA_ "SystemMessageLongSymbol" BO_ 2566800896 "VDMA_FE46_Secondary_or_Front_Hitch_Status";
BA_ "SystemMessageLongSymbol" BO_ 2566801920 "VDMA_FE4A_Electronic_Transmission_Controll";
BA_ "SystemMessageLongSymbol" BO_ 2566802176 "VDMA_FE4B_Transmission_Configuration_2";
BA_ "SystemMessageLongSymbol" BO_ 2566802432 "VDMA_FE4C_Military_Lighting_Command";
BA_ "SystemMessageLongSymbol" BO_ 2566802688 "VDMA_FE4D_Total_Averaged_Information";
BA_ "SystemMessageLongSymbol" BO_ 2566803200 "VDMA_FE4F_Vehicle_Dynamic_Stability_Contro";
BA_ "SystemMessageLongSymbol" BO_ 2566803712 "VDMA_FE51_Adaptive_Cruise_Control_Operator";
BA_ "SystemMessageLongSymbol" BO_ 2566803968 "VDMA_FE52_Vehicle_Electrical_Power_3";
BA_ "SystemMessageLongSymbol" BO_ 2566804224 "VDMA_FE53_Retarder_Continuous_Torque_Speed";
BA_ "SystemMessageLongSymbol" BO_ 2566804480 "VDMA_FE54_Engine_Continuous_Torque_Speed_L";
BA_ "SystemMessageLongSymbol" BO_ 2566804736 "VDMA_FE55_Gaseous_Fuel_Properties";
BA_ "SystemMessageLongSymbol" BO_ 2566804992 "VDMA_FE56_Aftertreatment_1_Diesel_Exhaust_";
BA_ "SystemMessageLongSymbol" BO_ 2566805248 "VDMA_FE57_Air_Suspension_Control_5";
BA_ "SystemMessageLongSymbol" BO_ 2566805504 "VDMA_FE58_Air_Suspension_Control_4";
BA_ "SystemMessageLongSymbol" BO_ 2566805760 "VDMA_FE59_Air_Suspension_Control_3";
BA_ "SystemMessageLongSymbol" BO_ 2566806016 "VDMA_FE5A_Air_Suspension_Control_1";
BA_ "SystemMessageLongSymbol" BO_ 2566806528 "VDMA_FE5C_Running_Gear_Equipment_2_2";
BA_ "SystemMessageLongSymbol" BO_ 2566806784 "VDMA_FE5D_General_Purpose_Message_1_2";
BA_ "SystemMessageLongSymbol" BO_ 2566807040 "VDMA_FE5E_Running_Gear_Equipment_2_3";
BA_ "SystemMessageLongSymbol" BO_ 2566807296 "VDMA_FE5F_General_Purpose_Message_1_3";
BA_ "SystemMessageLongSymbol" BO_ 2566807552 "VDMA_FE60_General_Purpose_Message_2_3";
BA_ "SystemMessageLongSymbol" BO_ 2566807808 "VDMA_FE61_General_Purpose_Message_1_4";
BA_ "SystemMessageLongSymbol" BO_ 2566808064 "VDMA_FE62_General_Purpose_Message_2_4";
BA_ "SystemMessageLongSymbol" BO_ 2566808320 "VDMA_FE63_General_Purpose_Message_1_5";
BA_ "SystemMessageLongSymbol" BO_ 2566808576 "VDMA_FE64_General_Purpose_Message_2_5";
BA_ "SystemMessageLongSymbol" BO_ 2566808832 "VDMA_FE65_General_Purpose_Message_1_6";
BA_ "SystemMessageLongSymbol" BO_ 2566809088 "VDMA_FE66_Battery_Main_Switch_Information";
BA_ "SystemMessageLongSymbol" BO_ 2566809344 "VDMA_FE67_Climate_Control_Configuration";
BA_ "SystemMessageLongSymbol" BO_ 2566810112 "VDMA_FE6A_Engine_Fuel_Lube_Systems";
BA_ "SystemMessageLongSymbol" BO_ 2566810368 "VDMA_FE6B_Driver_s_Identification";
BA_ "SystemMessageLongSymbol" BO_ 2566811136 "VDMA_FE6E_High_Resolution_Wheel_Speed";
BA_ "SystemMessageLongSymbol" BO_ 2566811392 "VDMA_FE6F_Adaptive_Cruise_Control_1";
BA_ "SystemMessageLongSymbol" BO_ 2566811648 "VDMA_FE70_Combination_Vehicle_Weight";
BA_ "SystemMessageLongSymbol" BO_ 2566812160 "VDMA_FE72_Laser_Leveling_System_Blade_Cont";
BA_ "SystemMessageLongSymbol" BO_ 2566812416 "VDMA_FE73_Laser_Receiver_Mast_Position";
BA_ "SystemMessageLongSymbol" BO_ 2566812672 "VDMA_FE74_Modify_Leveling_System_Control_S";
BA_ "SystemMessageLongSymbol" BO_ 2566812928 "VDMA_FE75_Laser_Leveling_System_Vertical_D";
BA_ "SystemMessageLongSymbol" BO_ 2566813184 "VDMA_FE76_Laser_Leveling_System_Vertical_P";
BA_ "SystemMessageLongSymbol" BO_ 2566813696 "VDMA_FE78_Tire_Pressure_Control_Unit_Mode_";
BA_ "SystemMessageLongSymbol" BO_ 2566813952 "VDMA_FE79_Tire_Pressure_Control_Unit_Targe";
BA_ "SystemMessageLongSymbol" BO_ 2566814208 "VDMA_FE7A_Tire_Pressure_Control_Unit_Curre";
BA_ "SystemMessageLongSymbol" BO_ 2566816000 "VDMA_FE81_Fuel_Information_2_Gaseous";
BA_ "SystemMessageLongSymbol" BO_ 2566817792 "VDMA_FE88_Ignition_Transformer_Secondary_O";
BA_ "SystemMessageLongSymbol" BO_ 2566818048 "VDMA_FE89_Ignition_Transformer_Secondary_O";
BA_ "SystemMessageLongSymbol" BO_ 2566818304 "VDMA_FE8A_Ignition_Transformer_Secondary_O";
BA_ "SystemMessageLongSymbol" BO_ 2566818560 "VDMA_FE8B_Gaseous_Fuel_Pressure_1";
BA_ "SystemMessageLongSymbol" BO_ 2566818816 "VDMA_FE8C_Auxiliary_Analog_Information";
BA_ "SystemMessageLongSymbol" BO_ 2566819072 "VDMA_FE8D_Vehicle_Electrical_Power_2";
BA_ "SystemMessageLongSymbol" BO_ 2566820608 "VDMA_FE93_Engine_Electrical_System_Module_";
BA_ "SystemMessageLongSymbol" BO_ 2566820864 "VDMA_FE94_Engine_Auxiliary_Coolant";
BA_ "SystemMessageLongSymbol" BO_ 2566821632 "VDMA_FE97_Turbocharger_Information_5";
BA_ "SystemMessageLongSymbol" BO_ 2566821888 "VDMA_FE98_Turbocharger_Information_4";
BA_ "SystemMessageLongSymbol" BO_ 2566822144 "VDMA_FE99_Turbocharger_Information_3";
BA_ "SystemMessageLongSymbol" BO_ 2566822400 "VDMA_FE9A_Turbocharger_Information_2";
BA_ "SystemMessageLongSymbol" BO_ 2566822656 "VDMA_FE9B_Turbocharger_Information_1";
BA_ "SystemMessageLongSymbol" BO_ 2566822912 "VDMA_FE9C_Main_Bearing_Temperature_3";
BA_ "SystemMessageLongSymbol" BO_ 2566823168 "VDMA_FE9D_Main_Bearing_Temperature_2";
BA_ "SystemMessageLongSymbol" BO_ 2566823424 "VDMA_FE9E_Main_Bearing_Temperature_1";
BA_ "SystemMessageLongSymbol" BO_ 2566823680 "VDMA_FE9F_Exhaust_Port_Temperature_5";
BA_ "SystemMessageLongSymbol" BO_ 2566823936 "VDMA_FEA0_Exhaust_Port_Temperature_4";
BA_ "SystemMessageLongSymbol" BO_ 2566824192 "VDMA_FEA1_Exhaust_Port_Temperature_3";
BA_ "SystemMessageLongSymbol" BO_ 2566824448 "VDMA_FEA2_Exhaust_Port_Temperature_2";
BA_ "SystemMessageLongSymbol" BO_ 2566824704 "VDMA_FEA3_Exhaust_Port_Temperature_1";
BA_ "SystemMessageLongSymbol" BO_ 2566825216 "VDMA_FEA5_Intake_Manifold_Information_2";
BA_ "SystemMessageLongSymbol" BO_ 2566825472 "VDMA_FEA6_Intake_Manifold_Information_1";
BA_ "SystemMessageLongSymbol" BO_ 2566825728 "VDMA_FEA7_Alternator_Temperature_1";
BA_ "SystemMessageLongSymbol" BO_ 2566826752 "VDMA_FEAB_Electronic_Transmission_Controll";
BA_ "SystemMessageLongSymbol" BO_ 2566827008 "VDMA_FEAC_Wheel_Brake_Lining_Remaining_Inf";
BA_ "SystemMessageLongSymbol" BO_ 2566827264 "VDMA_FEAD_Wheel_Application_Pressure_High_";
BA_ "SystemMessageLongSymbol" BO_ 2566827776 "VDMA_FEAF_Fuel_Consumption_Gaseous";
BA_ "SystemMessageLongSymbol" BO_ 2566828032 "VDMA_FEB0_Trip_Time_Information_2";
BA_ "SystemMessageLongSymbol" BO_ 2566828544 "VDMA_FEB2_Fuel_Information_1_Gaseous";
BA_ "SystemMessageLongSymbol" BO_ 2566828800 "VDMA_FEB3_Fuel_Information_1_Liquid";
BA_ "SystemMessageLongSymbol" BO_ 2566829056 "VDMA_FEB4_Trip_Time_Information_1";
BA_ "SystemMessageLongSymbol" BO_ 2566829312 "VDMA_FEB5_Trip_Shutdown_Information";
BA_ "SystemMessageLongSymbol" BO_ 2566829568 "VDMA_FEB6_Trip_Vehicle_Speed_Cruise_Distan";
BA_ "SystemMessageLongSymbol" BO_ 2566829824 "VDMA_FEB7_Engine_Speed_Load_Factor_Informa";
BA_ "SystemMessageLongSymbol" BO_ 2566830080 "VDMA_FEB8_Trip_Fuel_Information_Gaseous";
BA_ "SystemMessageLongSymbol" BO_ 2566830336 "VDMA_FEB9_Trip_Fuel_Information_Liquid";
BA_ "SystemMessageLongSymbol" BO_ 2566830592 "VDMA_FEBA_Trip_Distance_Information";
BA_ "SystemMessageLongSymbol" BO_ 2566831104 "VDMA_FEBC_Compression_Service_Brake_Inform";
BA_ "SystemMessageLongSymbol" BO_ 2566831616 "VDMA_FEBE_Electronic_Engine_Controller_4";
BA_ "SystemMessageLongSymbol" BO_ 2566831872 "VDMA_FEBF_Wheel_Speed_Information";
BA_ "SystemMessageLongSymbol" BO_ 2566832640 "VDMA_FEC2_Electronic_Retarder_Controller_2";
BA_ "SystemMessageLongSymbol" BO_ 2566832896 "VDMA_FEC3_Electronic_Transmission_Controll";
BA_ "SystemMessageLongSymbol" BO_ 2566833152 "VDMA_FEC4_Electronic_Brake_System_2_2";
BA_ "SystemMessageLongSymbol" BO_ 2566833408 "VDMA_FEC5_Electronic_Transmission_Controll";
BA_ "SystemMessageLongSymbol" BO_ 2566833664 "VDMA_FEC6_Electronic_Brake_System_2_3";
BA_ "SystemMessageLongSymbol" BO_ 2566833920 "VDMA_FEC7_Electronic_Transmission_Controll";
BA_ "SystemMessageLongSymbol" BO_ 2566834176 "VDMA_FEC8_General_Purpose_Message_2_2";
BA_ "SystemMessageLongSymbol" BO_ 2566834432 "VDMA_FEC9_Electronic_Brake_System_1_2";
BA_ "SystemMessageLongSymbol" BO_ 2566835456 "VDMA_FECD_Freeze_Frame_Parameters";
BA_ "SystemMessageLongSymbol" BO_ 2566835968 "VDMA_FECF_Emission_Related_Pending_Diagnos";
BA_ "SystemMessageLongSymbol" BO_ 2566836224 "VDMA_FED0_Test_Results_for_Non_continuousl";
BA_ "SystemMessageLongSymbol" BO_ 2566836480 "VDMA_FED1_Oxygen_Sensor_Test_Results";
BA_ "SystemMessageLongSymbol" BO_ 2566836736 "VDMA_FED2_Non_Continuously_Monitored_Syste";
BA_ "SystemMessageLongSymbol" BO_ 2566837248 "VDMA_FED4_Emission_Related_MIL_On_Diagnost";
BA_ "SystemMessageLongSymbol" BO_ 2566837504 "VDMA_FED5_Alternator_Information_1";
BA_ "SystemMessageLongSymbol" BO_ 2566837760 "VDMA_FED6_Hybrid_or_EV_System_Inputs_1";
BA_ "SystemMessageLongSymbol" BO_ 2566838528 "VDMA_FED9_Auxiliary_Input_Output_Status_1";
BA_ "SystemMessageLongSymbol" BO_ 2566839040 "VDMA_FEDB_Engine_Fluid_Level_Pressure_2";
BA_ "SystemMessageLongSymbol" BO_ 2566839808 "VDMA_FEDE_Engine_Air_Start_Pressure";
BA_ "SystemMessageLongSymbol" BO_ 2566840832 "VDMA_FEE2_Transmission_Configuration";
BA_ "SystemMessageLongSymbol" BO_ 2566842368 "VDMA_FEE8_Vehicle_Direction_Speed";
BA_ "SystemMessageLongSymbol" BO_ 2566842624 "VDMA_FEE9_Fuel_Consumption_Liquid_1";
BA_ "SystemMessageLongSymbol" BO_ 2566843648 "VDMA_FEED_Cruise_Control_Vehicle_Speed_Set";
BA_ "SystemMessageLongSymbol" BO_ 2566844416 "VDMA_FEF0_Power_Takeoff_Information_1";
BA_ "SystemMessageLongSymbol" BO_ 2566845440 "VDMA_FEF4_Tire_Condition_Message_1";
BA_ "SystemMessageLongSymbol" BO_ 2566848000 "VDMA_FEFE_Auxiliary_Water_Pump_Pressure";
BA_ "SystemMessageLongSymbol" BO_ 2582446080 "VDMA_1ED00_NMEA_Request_Command_Acknowledge";
BA_ "SystemMessageLongSymbol" BO_ 2582511616 "VDMA_1EE00_PGN_List_Transmit_Receive_PGN_s_";
BA_ "SystemMessageLongSymbol" BO_ 2582648320 "VDMA_1F016_Configuration_Information";
BA_ "SystemMessageLongSymbol" BO_ 2582649088 "VDMA_1F019_Cyclic_Alert_List_IEC_61924_2";
BA_ "SystemMessageLongSymbol" BO_ 2582649344 "VDMA_1F01A_Responsibility_Transfer_Function";
BA_ "SystemMessageLongSymbol" BO_ 2582708480 "VDMA_1F101_Man_Overboard_Notification_MOB";
BA_ "SystemMessageLongSymbol" BO_ 2582773760 "VDMA_1F200_Engine_Parameters_Rapid_Update";
BA_ "SystemMessageLongSymbol" BO_ 2582774016 "VDMA_1F201_Engine_Parameters_Dynamic";
BA_ "SystemMessageLongSymbol" BO_ 2582774272 "VDMA_1F202_Electric_Drive_Status_Dynamic";
BA_ "SystemMessageLongSymbol" BO_ 2582774528 "VDMA_1F203_Electric_Energy_Storage_Status_D";
BA_ "SystemMessageLongSymbol" BO_ 2582775040 "VDMA_1F205_Transmission_Parameters_Dynamic";
BA_ "SystemMessageLongSymbol" BO_ 2582775296 "VDMA_1F206_Electric_Drive_Information";
BA_ "SystemMessageLongSymbol" BO_ 2582775552 "VDMA_1F207_Electric_Energy_Storage_Informat";
BA_ "SystemMessageLongSymbol" BO_ 2582775808 "VDMA_1F208_Trip_Parameters_Vessel";
BA_ "SystemMessageLongSymbol" BO_ 2582776064 "VDMA_1F209_Trip_Parameters_Small_Craft";
BA_ "SystemMessageLongSymbol" BO_ 2582776320 "VDMA_1F20A_Engine_Parameters_Static";
BA_ "SystemMessageLongSymbol" BO_ 2582776832 "VDMA_1F20C_Load_Controller_Connection_State";
BA_ "SystemMessageLongSymbol" BO_ 2582777088 "VDMA_1F20D_Binary_Switch_Bank_Status";
BA_ "SystemMessageLongSymbol" BO_ 2582779392 "VDMA_1F216_Charger_Configuration_Status";
BA_ "SystemMessageLongSymbol" BO_ 2582779648 "VDMA_1F217_Inverter_Configuration_Status";
BA_ "SystemMessageLongSymbol" BO_ 2582779904 "VDMA_1F218_AGS_Configuration_Status";
BA_ "SystemMessageLongSymbol" BO_ 2582780160 "VDMA_1F219_Battery_Configuration_Status";
BA_ "SystemMessageLongSymbol" BO_ 2582839296 "VDMA_1F300_AC_Power_Current_Phase_A";
BA_ "SystemMessageLongSymbol" BO_ 2582839552 "VDMA_1F301_AC_Power_Current_Phase_B";
BA_ "SystemMessageLongSymbol" BO_ 2582839808 "VDMA_1F302_AC_Power_Current_Phase_C";
BA_ "SystemMessageLongSymbol" BO_ 2582840064 "VDMA_1F303_AC_Voltage_Frequency_Phase_A";
BA_ "SystemMessageLongSymbol" BO_ 2582840320 "VDMA_1F304_AC_Voltage_Frequency_Phase_B";
