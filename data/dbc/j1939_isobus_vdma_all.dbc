VERSION "created by canmatrix"

NS_ :

BS_:

BU_:

BA_DEF_ BO_ "SystemMessageLongSymbol" STRING;
BA_DEF_ SG_ "GenSigStartValue" FLOAT 0 100000000000;
BA_DEF_ SG_ "SystemSignalLongSymbol" STRING;

VERSION "created by canmatrix"

NS_ :

BS_:

BU_:

BA_DEF_ BO_ "SystemMessageLongSymbol" STRING;
BA_DEF_ SG_ "GenSigStartValue" FLOAT 0 100000000000;
BA_DEF_ SG_ "SystemSignalLongSymbol" STRING;

VERSION "created by canmatrix"

NS_ :

BS_:

BU_:

BO_ 2566053120 VDMA_F2DD_High_Voltage_Energy_St: 8 Vector__XXX
 SG_ High_Voltage_Energy_Storage_Pack : 0|64@1+ (1,0) [0|18446744073709551615] "" Vector__XXX

BO_ 2566053376 VDMA_F2DE_High_Voltage_Energy_St: 8 Vector__XXX
 SG_ High_Voltage_Energy_Storage_Pack : 0|64@1+ (1,0) [0|18446744073709551615] "" Vector__XXX

BO_ 2566053632 VDMA_F2DF_High_Voltage_Energy_St: 8 Vector__XXX
 SG_ High_Voltage_Energy_Storage_Pack : 0|64@1+ (1,0) [0|18446744073709551615] "" Vector__XXX

BO_ 2566053888 VDMA_F2E0_High_Voltage_Energy_St: 8 Vector__XXX
 SG_ High_Voltage_Energy_Storage_Pack : 0|64@1+ (1,0) [0|18446744073709551615] "" Vector__XXX

BO_ 2566054144 VDMA_F2E1_High_Voltage_Energy_St: 8 Vector__XXX
 SG_ High_Voltage_Energy_Storage_Pack : 0|64@1+ (1,0) [0|18446744073709551615] "" Vector__XXX

BO_ 2566054400 VDMA_F2E2_High_Voltage_Energy_St: 8 Vector__XXX
 SG_ High_Voltage_Energy_Storage_Pack : 0|64@1+ (1,0) [0|18446744073709551615] "" Vector__XXX

BO_ 2566054656 VDMA_F2E3_High_Voltage_Energy_St: 8 Vector__XXX
 SG_ High_Voltage_Energy_Storage_Pack : 0|64@1+ (1,0) [0|18446744073709551615] "" Vector__XXX

BO_ 2566054912 VDMA_F2E4_High_Voltage_Energy_St: 8 Vector__XXX
 SG_ High_Voltage_Energy_Storage_Pack : 0|64@1+ (1,0) [0|18446744073709551615] "" Vector__XXX

BO_ 2566055168 VDMA_F2E5_High_Voltage_Energy_St: 8 Vector__XXX
 SG_ High_Voltage_Energy_Storage_Pack : 0|64@1+ (1,0) [0|18446744073709551615] "" Vector__XXX

BO_ 2566055424 VDMA_F2E6_High_Voltage_Energy_St: 8 Vector__XXX
 SG_ High_Voltage_Energy_Storage_Pack : 0|64@1+ (1,0) [0|18446744073709551615] "" Vector__XXX

BO_ 2566055680 VDMA_F2E7_High_Voltage_Energy_St: 8 Vector__XXX
 SG_ High_Voltage_Energy_Storage_Pack : 0|64@1+ (1,0) [0|18446744073709551615] "" Vector__XXX

BO_ 2566055936 VDMA_F2E8_High_Voltage_Energy_St: 8 Vector__XXX
 SG_ High_Voltage_Energy_Storage_Pack : 0|64@1+ (1,0) [0|18446744073709551615] "" Vector__XXX

BO_ 2566056192 VDMA_F2E9_High_Voltage_Energy_St: 8 Vector__XXX
 SG_ High_Voltage_Energy_Storage_Pack : 0|64@1+ (1,0) [0|18446744073709551615] "" Vector__XXX

BO_ 2566056448 VDMA_F2EA_High_Voltage_Energy_St: 8 Vector__XXX
 SG_ High_Voltage_Energy_Storage_Pack : 0|64@1+ (1,0) [0|18446744073709551615] "" Vector__XXX

BO_ 2566056704 VDMA_F2EB_High_Voltage_Energy_St: 8 Vector__XXX
 SG_ High_Voltage_Energy_Storage_Pack : 0|64@1+ (1,0) [0|18446744073709551615] "" Vector__XXX

BO_ 2566056960 VDMA_F2EC_High_Voltage_Energy_St: 8 Vector__XXX
 SG_ High_Voltage_Energy_Storage_Pack : 0|64@1+ (1,0) [0|18446744073709551615] "" Vector__XXX

BO_ 2566057216 VDMA_F2ED_High_Voltage_Energy_St: 8 Vector__XXX
 SG_ High_Voltage_Energy_Storage_Pack : 0|64@1+ (1,0) [0|18446744073709551615] "" Vector__XXX

BO_ 2566057472 VDMA_F2EE_High_Voltage_Energy_St: 8 Vector__XXX
 SG_ High_Voltage_Energy_Storage_Pack : 0|64@1+ (1,0) [0|18446744073709551615] "" Vector__XXX

BO_ 2566057728 VDMA_F2EF_High_Voltage_Energy_St: 8 Vector__XXX
 SG_ High_Voltage_Energy_Storage_Pack : 0|64@1+ (1,0) [0|18446744073709551615] "" Vector__XXX

BO_ 2566057984 VDMA_F2F0_High_Voltage_Energy_St: 8 Vector__XXX
 SG_ High_Voltage_Energy_Storage_Pack : 0|64@1+ (1,0) [0|18446744073709551615] "" Vector__XXX

BO_ 2566058240 VDMA_F2F1_High_Voltage_Energy_St: 8 Vector__XXX
 SG_ High_Voltage_Energy_Storage_Pack : 0|64@1+ (1,0) [0|18446744073709551615] "" Vector__XXX

BO_ 2566058496 VDMA_F2F2_High_Voltage_Energy_St: 8 Vector__XXX
 SG_ High_Voltage_Energy_Storage_Pack : 0|64@1+ (1,0) [0|18446744073709551615] "" Vector__XXX

BO_ 2566058752 VDMA_F2F3_High_Voltage_Energy_St: 8 Vector__XXX
 SG_ High_Voltage_Energy_Storage_Pack : 0|64@1+ (1,0) [0|18446744073709551615] "" Vector__XXX

BO_ 2566059008 VDMA_F2F4_High_Voltage_Energy_St: 8 Vector__XXX
 SG_ High_Voltage_Energy_Storage_Pack : 0|64@1+ (1,0) [0|18446744073709551615] "" Vector__XXX

BO_ 2566059264 VDMA_F2F5_High_Voltage_Energy_St: 8 Vector__XXX
 SG_ High_Voltage_Energy_Storage_Pack : 0|64@1+ (1,0) [0|18446744073709551615] "" Vector__XXX

BO_ 2566059520 VDMA_F2F6_High_Voltage_Energy_St: 8 Vector__XXX
 SG_ High_Voltage_Energy_Storage_Pack : 0|64@1+ (1,0) [0|18446744073709551615] "" Vector__XXX

BO_ 2566059776 VDMA_F2F7_High_Voltage_Energy_St: 8 Vector__XXX
 SG_ High_Voltage_Energy_Storage_Pack : 0|64@1+ (1,0) [0|18446744073709551615] "" Vector__XXX

BO_ 2566060032 VDMA_F2F8_High_Voltage_Energy_St: 8 Vector__XXX
 SG_ High_Voltage_Energy_Storage_Pack : 0|64@1+ (1,0) [0|18446744073709551615] "" Vector__XXX

BO_ 2566060288 VDMA_F2F9_High_Voltage_Energy_St: 8 Vector__XXX
 SG_ High_Voltage_Energy_Storage_Pack : 0|64@1+ (1,0) [0|18446744073709551615] "" Vector__XXX

BO_ 2566060544 VDMA_F2FA_High_Voltage_Energy_St: 8 Vector__XXX
 SG_ High_Voltage_Energy_Storage_Pack : 0|64@1+ (1,0) [0|18446744073709551615] "" Vector__XXX

BO_ 2566060800 VDMA_F2FB_High_Voltage_Energy_St: 8 Vector__XXX
 SG_ High_Voltage_Energy_Storage_Pack : 0|64@1+ (1,0) [0|18446744073709551615] "" Vector__XXX

BO_ 2566061056 VDMA_F2FC_High_Voltage_Energy_St: 8 Vector__XXX
 SG_ High_Voltage_Energy_Storage_Pack : 0|64@1+ (1,0) [0|18446744073709551615] "" Vector__XXX

BO_ 2566061312 VDMA_F2FD_High_Voltage_Energy_St: 8 Vector__XXX
 SG_ High_Voltage_Energy_Storage_Pack : 0|64@1+ (1,0) [0|18446744073709551615] "" Vector__XXX

BO_ 2566061568 VDMA_F2FE_High_Voltage_Energy_St: 8 Vector__XXX
 SG_ High_Voltage_Energy_Storage_Pack : 0|64@1+ (1,0) [0|18446744073709551615] "" Vector__XXX

BO_ 2566061824 VDMA_F2FF_High_Voltage_Energy_St: 8 Vector__XXX
 SG_ High_Voltage_Energy_Storage_Pack : 0|64@1+ (1,0) [0|18446744073709551615] "" Vector__XXX

BO_ 2566062080 VDMA_F300_High_Voltage_Energy_St: 8 Vector__XXX
 SG_ High_Voltage_Energy_Storage_Pack : 0|64@1+ (1,0) [0|18446744073709551615] "" Vector__XXX

BO_ 2566062336 VDMA_F301_High_Voltage_Energy_St: 8 Vector__XXX
 SG_ High_Voltage_Energy_Storage_Pack : 0|64@1+ (1,0) [0|18446744073709551615] "" Vector__XXX

BO_ 2566062592 VDMA_F302_High_Voltage_Energy_St: 8 Vector__XXX
 SG_ High_Voltage_Energy_Storage_Pack : 0|64@1+ (1,0) [0|18446744073709551615] "" Vector__XXX

BO_ 2566062848 VDMA_F303_High_Voltage_Energy_St: 8 Vector__XXX
 SG_ High_Voltage_Energy_Storage_Pack : 0|64@1+ (1,0) [0|18446744073709551615] "" Vector__XXX

BO_ 2566063104 VDMA_F304_High_Voltage_Energy_St: 8 Vector__XXX
 SG_ High_Voltage_Energy_Storage_Pack : 0|64@1+ (1,0) [0|18446744073709551615] "" Vector__XXX

BO_ 2566063360 VDMA_F305_High_Voltage_Energy_St: 8 Vector__XXX
 SG_ High_Voltage_Energy_Storage_Pack : 0|64@1+ (1,0) [0|18446744073709551615] "" Vector__XXX

BO_ 2566063616 VDMA_F306_High_Voltage_Energy_St: 8 Vector__XXX
 SG_ High_Voltage_Energy_Storage_Pack : 0|64@1+ (1,0) [0|18446744073709551615] "" Vector__XXX

BO_ 2566063872 VDMA_F307_High_Voltage_Energy_St: 8 Vector__XXX
 SG_ High_Voltage_Energy_Storage_Pack : 0|64@1+ (1,0) [0|18446744073709551615] "" Vector__XXX

BO_ 2566064128 VDMA_F308_High_Voltage_Energy_St: 8 Vector__XXX
 SG_ High_Voltage_Energy_Storage_Pack : 0|64@1+ (1,0) [0|18446744073709551615] "" Vector__XXX

BO_ 2566064384 VDMA_F309_High_Voltage_Energy_St: 8 Vector__XXX
 SG_ High_Voltage_Energy_Storage_Pack : 0|64@1+ (1,0) [0|18446744073709551615] "" Vector__XXX

BO_ 2566064640 VDMA_F30A_High_Voltage_Energy_St: 8 Vector__XXX
 SG_ High_Voltage_Energy_Storage_Pack : 0|64@1+ (1,0) [0|18446744073709551615] "" Vector__XXX

BO_ 2566064896 VDMA_F30B_High_Voltage_Energy_St: 8 Vector__XXX
 SG_ High_Voltage_Energy_Storage_Pack : 0|64@1+ (1,0) [0|18446744073709551615] "" Vector__XXX

BO_ 2566065152 VDMA_F30C_High_Voltage_Energy_St: 8 Vector__XXX
 SG_ High_Voltage_Energy_Storage_Pack : 0|64@1+ (1,0) [0|18446744073709551615] "" Vector__XXX

BO_ 2566065408 VDMA_F30D_High_Voltage_Energy_St: 8 Vector__XXX
 SG_ High_Voltage_Energy_Storage_Pack : 0|64@1+ (1,0) [0|18446744073709551615] "" Vector__XXX

BO_ 2566065664 VDMA_F30E_High_Voltage_Energy_St: 8 Vector__XXX
 SG_ High_Voltage_Energy_Storage_Pack : 0|64@1+ (1,0) [0|18446744073709551615] "" Vector__XXX

BO_ 2566065920 VDMA_F30F_High_Voltage_Energy_St: 8 Vector__XXX
 SG_ High_Voltage_Energy_Storage_Pack : 0|64@1+ (1,0) [0|18446744073709551615] "" Vector__XXX

BO_ 2566066176 VDMA_F310_High_Voltage_Energy_St: 8 Vector__XXX
 SG_ High_Voltage_Energy_Storage_Pack : 0|64@1+ (1,0) [0|18446744073709551615] "" Vector__XXX

BO_ 2566066432 VDMA_F311_High_Voltage_Energy_St: 8 Vector__XXX
 SG_ High_Voltage_Energy_Storage_Pack : 0|64@1+ (1,0) [0|18446744073709551615] "" Vector__XXX

BO_ 2566066688 VDMA_F312_High_Voltage_Energy_St: 8 Vector__XXX
 SG_ High_Voltage_Energy_Storage_Pack : 0|64@1+ (1,0) [0|18446744073709551615] "" Vector__XXX

BO_ 2566066944 VDMA_F313_High_Voltage_Energy_St: 8 Vector__XXX
 SG_ High_Voltage_Energy_Storage_Pack : 0|64@1+ (1,0) [0|18446744073709551615] "" Vector__XXX

BO_ 2566067200 VDMA_F314_High_Voltage_Energy_St: 8 Vector__XXX
 SG_ High_Voltage_Energy_Storage_Pack : 0|64@1+ (1,0) [0|18446744073709551615] "" Vector__XXX

BO_ 2566067456 VDMA_F315_High_Voltage_Energy_St: 8 Vector__XXX
 SG_ High_Voltage_Energy_Storage_Pack : 0|64@1+ (1,0) [0|18446744073709551615] "" Vector__XXX

BO_ 2566067712 VDMA_F316_High_Voltage_Energy_St: 8 Vector__XXX
 SG_ High_Voltage_Energy_Storage_Pack : 0|64@1+ (1,0) [0|18446744073709551615] "" Vector__XXX

BO_ 2566067968 VDMA_F317_High_Voltage_Energy_St: 8 Vector__XXX
 SG_ High_Voltage_Energy_Storage_Pack : 0|64@1+ (1,0) [0|18446744073709551615] "" Vector__XXX

BO_ 2566068224 VDMA_F318_High_Voltage_Energy_St: 8 Vector__XXX
 SG_ High_Voltage_Energy_Storage_Pack : 0|64@1+ (1,0) [0|18446744073709551615] "" Vector__XXX

BO_ 2566068480 VDMA_F319_High_Voltage_Energy_St: 8 Vector__XXX
 SG_ High_Voltage_Energy_Storage_Pack : 0|64@1+ (1,0) [0|18446744073709551615] "" Vector__XXX

BO_ 2566068736 VDMA_F31A_High_Voltage_Energy_St: 8 Vector__XXX
 SG_ High_Voltage_Energy_Storage_Pack : 0|64@1+ (1,0) [0|18446744073709551615] "" Vector__XXX

BO_ 2566068992 VDMA_F31B_High_Voltage_Energy_St: 8 Vector__XXX
 SG_ High_Voltage_Energy_Storage_Pack : 0|64@1+ (1,0) [0|18446744073709551615] "" Vector__XXX

BO_ 2566069248 VDMA_F31C_High_Voltage_Energy_St: 8 Vector__XXX
 SG_ High_Voltage_Energy_Storage_Pack : 0|64@1+ (1,0) [0|18446744073709551615] "" Vector__XXX

BO_ 2566069504 VDMA_F31D_High_Voltage_Energy_St: 8 Vector__XXX
 SG_ High_Voltage_Energy_Storage_Pack : 0|64@1+ (1,0) [0|18446744073709551615] "" Vector__XXX

BO_ 2566069760 VDMA_F31E_High_Voltage_Energy_St: 8 Vector__XXX
 SG_ High_Voltage_Energy_Storage_Pack : 0|64@1+ (1,0) [0|18446744073709551615] "" Vector__XXX

BO_ 2566070016 VDMA_F31F_High_Voltage_Energy_St: 8 Vector__XXX
 SG_ High_Voltage_Energy_Storage_Pack : 0|64@1+ (1,0) [0|18446744073709551615] "" Vector__XXX

BO_ 2566070272 VDMA_F320_High_Voltage_Energy_St: 8 Vector__XXX
 SG_ High_Voltage_Energy_Storage_Pack : 0|64@1+ (1,0) [0|18446744073709551615] "" Vector__XXX

BO_ 2566070528 VDMA_F321_High_Voltage_Energy_St: 8 Vector__XXX
 SG_ High_Voltage_Energy_Storage_Pack : 0|64@1+ (1,0) [0|18446744073709551615] "" Vector__XXX

BO_ 2566070784 VDMA_F322_High_Voltage_Energy_St: 8 Vector__XXX
 SG_ High_Voltage_Energy_Storage_Pack : 0|64@1+ (1,0) [0|18446744073709551615] "" Vector__XXX

BO_ 2566071040 VDMA_F323_High_Voltage_Energy_St: 8 Vector__XXX
 SG_ High_Voltage_Energy_Storage_Pack : 0|64@1+ (1,0) [0|18446744073709551615] "" Vector__XXX

BO_ 2566071296 VDMA_F324_High_Voltage_Energy_St: 8 Vector__XXX
 SG_ High_Voltage_Energy_Storage_Pack : 0|64@1+ (1,0) [0|18446744073709551615] "" Vector__XXX

BO_ 2566071552 VDMA_F325_High_Voltage_Energy_St: 8 Vector__XXX
 SG_ High_Voltage_Energy_Storage_Pack : 0|64@1+ (1,0) [0|18446744073709551615] "" Vector__XXX

BO_ 2566071808 VDMA_F326_High_Voltage_Energy_St: 8 Vector__XXX
 SG_ High_Voltage_Energy_Storage_Pack : 0|64@1+ (1,0) [0|18446744073709551615] "" Vector__XXX

BO_ 2566072064 VDMA_F327_High_Voltage_Energy_St: 8 Vector__XXX
 SG_ High_Voltage_Energy_Storage_Pack : 0|64@1+ (1,0) [0|18446744073709551615] "" Vector__XXX

BO_ 2566072320 VDMA_F328_High_Voltage_Energy_St: 8 Vector__XXX
 SG_ High_Voltage_Energy_Storage_Pack : 0|64@1+ (1,0) [0|18446744073709551615] "" Vector__XXX

BO_ 2566072576 VDMA_F329_High_Voltage_Energy_St: 8 Vector__XXX
 SG_ High_Voltage_Energy_Storage_Pack : 0|64@1+ (1,0) [0|18446744073709551615] "" Vector__XXX

BO_ 2566072832 VDMA_F32A_High_Voltage_Energy_St: 8 Vector__XXX
 SG_ High_Voltage_Energy_Storage_Pack : 0|64@1+ (1,0) [0|18446744073709551615] "" Vector__XXX

BO_ 2566073088 VDMA_F32B_High_Voltage_Energy_St: 8 Vector__XXX
 SG_ High_Voltage_Energy_Storage_Pack : 0|64@1+ (1,0) [0|18446744073709551615] "" Vector__XXX

BO_ 2566073344 VDMA_F32C_High_Voltage_Energy_St: 8 Vector__XXX
 SG_ High_Voltage_Energy_Storage_Pack : 0|64@1+ (1,0) [0|18446744073709551615] "" Vector__XXX

BO_ 2566073600 VDMA_F32D_High_Voltage_Energy_St: 8 Vector__XXX
 SG_ High_Voltage_Energy_Storage_Pack : 0|64@1+ (1,0) [0|18446744073709551615] "" Vector__XXX

BO_ 2566073856 VDMA_F32E_High_Voltage_Energy_St: 8 Vector__XXX
 SG_ High_Voltage_Energy_Storage_Pack : 0|64@1+ (1,0) [0|18446744073709551615] "" Vector__XXX

BO_ 2566074112 VDMA_F32F_High_Voltage_Energy_St: 8 Vector__XXX
 SG_ High_Voltage_Energy_Storage_Pack : 0|64@1+ (1,0) [0|18446744073709551615] "" Vector__XXX

BO_ 2566074368 VDMA_F330_High_Voltage_Energy_St: 8 Vector__XXX
 SG_ High_Voltage_Energy_Storage_Pack : 0|64@1+ (1,0) [0|18446744073709551615] "" Vector__XXX

BO_ 2566074624 VDMA_F331_High_Voltage_Energy_St: 8 Vector__XXX
 SG_ High_Voltage_Energy_Storage_Pack : 0|64@1+ (1,0) [0|18446744073709551615] "" Vector__XXX

BO_ 2566074880 VDMA_F332_High_Voltage_Energy_St: 8 Vector__XXX
 SG_ High_Voltage_Energy_Storage_Pack : 0|64@1+ (1,0) [0|18446744073709551615] "" Vector__XXX

BO_ 2566075136 VDMA_F333_High_Voltage_Energy_St: 8 Vector__XXX
 SG_ High_Voltage_Energy_Storage_Pack : 0|64@1+ (1,0) [0|18446744073709551615] "" Vector__XXX

BO_ 2566075392 VDMA_F334_High_Voltage_Energy_St: 8 Vector__XXX
 SG_ High_Voltage_Energy_Storage_Pack : 0|64@1+ (1,0) [0|18446744073709551615] "" Vector__XXX

BO_ 2566075648 VDMA_F335_High_Voltage_Energy_St: 8 Vector__XXX
 SG_ High_Voltage_Energy_Storage_Pack : 0|64@1+ (1,0) [0|18446744073709551615] "" Vector__XXX

BO_ 2566075904 VDMA_F336_High_Voltage_Energy_St: 8 Vector__XXX
 SG_ High_Voltage_Energy_Storage_Pack : 0|64@1+ (1,0) [0|18446744073709551615] "" Vector__XXX

BO_ 2566076160 VDMA_F337_High_Voltage_Energy_St: 8 Vector__XXX
 SG_ High_Voltage_Energy_Storage_Pack : 0|64@1+ (1,0) [0|18446744073709551615] "" Vector__XXX

BO_ 2566076416 VDMA_F338_High_Voltage_Energy_St: 8 Vector__XXX
 SG_ High_Voltage_Energy_Storage_Pack : 0|64@1+ (1,0) [0|18446744073709551615] "" Vector__XXX

BO_ 2566076672 VDMA_F339_High_Voltage_Energy_St: 8 Vector__XXX
 SG_ High_Voltage_Energy_Storage_Pack : 0|64@1+ (1,0) [0|18446744073709551615] "" Vector__XXX

BO_ 2566076928 VDMA_F33A_High_Voltage_Energy_St: 8 Vector__XXX
 SG_ High_Voltage_Energy_Storage_Pack : 0|64@1+ (1,0) [0|18446744073709551615] "" Vector__XXX

BO_ 2566077184 VDMA_F33B_High_Voltage_Energy_St: 8 Vector__XXX
 SG_ High_Voltage_Energy_Storage_Pack : 0|64@1+ (1,0) [0|18446744073709551615] "" Vector__XXX

BO_ 2566077440 VDMA_F33C_High_Voltage_Energy_St: 8 Vector__XXX
 SG_ High_Voltage_Energy_Storage_Pack : 0|64@1+ (1,0) [0|18446744073709551615] "" Vector__XXX

BO_ 2566077696 VDMA_F33D_High_Voltage_Energy_St: 8 Vector__XXX
 SG_ High_Voltage_Energy_Storage_Pack : 0|64@1+ (1,0) [0|18446744073709551615] "" Vector__XXX

BO_ 2566077952 VDMA_F33E_High_Voltage_Energy_St: 8 Vector__XXX
 SG_ High_Voltage_Energy_Storage_Pack : 0|64@1+ (1,0) [0|18446744073709551615] "" Vector__XXX

BO_ 2566078208 VDMA_F33F_High_Voltage_Energy_St: 8 Vector__XXX
 SG_ High_Voltage_Energy_Storage_Pack : 0|64@1+ (1,0) [0|18446744073709551615] "" Vector__XXX

BO_ 2566078464 VDMA_F340_High_Voltage_Energy_St: 8 Vector__XXX
 SG_ High_Voltage_Energy_Storage_Pack : 0|64@1+ (1,0) [0|18446744073709551615] "" Vector__XXX

BO_ 2566078720 VDMA_F341_External_Steering_Requ: 8 Vector__XXX
 SG_ External_Steering_Request_RawPay : 0|64@1+ (1,0) [0|18446744073709551615] "" Vector__XXX

BO_ 2566078976 VDMA_F342_Active_Steering_System: 8 Vector__XXX
 SG_ Active_Steering_System_Controlle : 0|64@1+ (1,0) [0|18446744073709551615] "" Vector__XXX

BO_ 2566079232 VDMA_F343_Electronic_Park_Brake_: 8 Vector__XXX
 SG_ Electronic_Park_Brake_Controller : 0|64@1+ (1,0) [0|18446744073709551615] "" Vector__XXX

BO_ 2566079488 VDMA_F344_Electronic_Park_Brake_: 8 Vector__XXX
 SG_ Electronic_Park_Brake_Controller : 0|64@1+ (1,0) [0|18446744073709551615] "" Vector__XXX

BO_ 2566079744 VDMA_F345_Genset_Frequency_Limit: 8 Vector__XXX
 SG_ Genset_Frequency_Limitation_RawP : 0|64@1+ (1,0) [0|18446744073709551615] "" Vector__XXX

BO_ 2566080000 VDMA_F346_Genset_Power_Limitatio: 8 Vector__XXX
 SG_ Genset_Power_Limitation_RawPaylo : 0|64@1+ (1,0) [0|18446744073709551615] "" Vector__XXX

BO_ 2566080256 VDMA_F347_Genset_Real_Power_Cont: 8 Vector__XXX
 SG_ Genset_Real_Power_Control_RawPay : 0|64@1+ (1,0) [0|18446744073709551615] "" Vector__XXX

BO_ 2566080512 VDMA_F348_Genset_Reactive_Power: 8 Vector__XXX
 SG_ Genset_Reactive_Power_RawPayload : 0|64@1+ (1,0) [0|18446744073709551615] "" Vector__XXX

BO_ 2566080768 VDMA_F349_Fuel_Cell_Compartment_: 8 Vector__XXX
 SG_ Fuel_Cell_Compartment_Informatio : 0|64@1+ (1,0) [0|18446744073709551615] "" Vector__XXX

BO_ 2566081024 VDMA_F34A_Genset_Real_Power_Setp: 8 Vector__XXX
 SG_ Genset_Real_Power_Setpoint_Deman : 0|64@1+ (1,0) [0|18446744073709551615] "" Vector__XXX

BO_ 2566081280 VDMA_F34B_Genset_Real_Power_Cont: 8 Vector__XXX
 SG_ Genset_Real_Power_Control_2_RawP : 0|64@1+ (1,0) [0|18446744073709551615] "" Vector__XXX

BO_ 2566081536 VDMA_F34C_High_Voltage_Energy_St: 8 Vector__XXX
 SG_ High_Voltage_Energy_Storage_Pack : 0|64@1+ (1,0) [0|18446744073709551615] "" Vector__XXX

BO_ 2566081792 VDMA_F34D_High_Voltage_Energy_St: 8 Vector__XXX
 SG_ High_Voltage_Energy_Storage_Pack : 0|64@1+ (1,0) [0|18446744073709551615] "" Vector__XXX

BO_ 2566082048 VDMA_F34E_High_Voltage_Energy_St: 8 Vector__XXX
 SG_ High_Voltage_Energy_Storage_Pack : 0|64@1+ (1,0) [0|18446744073709551615] "" Vector__XXX

BO_ 2566082304 VDMA_F34F_High_Voltage_Energy_St: 8 Vector__XXX
 SG_ High_Voltage_Energy_Storage_Pack : 0|64@1+ (1,0) [0|18446744073709551615] "" Vector__XXX

BO_ 2566082560 VDMA_F350_High_Voltage_Energy_St: 8 Vector__XXX
 SG_ High_Voltage_Energy_Storage_Pack : 0|64@1+ (1,0) [0|18446744073709551615] "" Vector__XXX

BO_ 2566082816 VDMA_F351_High_Voltage_Energy_St: 8 Vector__XXX
 SG_ High_Voltage_Energy_Storage_Pack : 0|64@1+ (1,0) [0|18446744073709551615] "" Vector__XXX

BO_ 2566083072 VDMA_F352_High_Voltage_Energy_St: 8 Vector__XXX
 SG_ High_Voltage_Energy_Storage_Pack : 0|64@1+ (1,0) [0|18446744073709551615] "" Vector__XXX

BO_ 2566083328 VDMA_F353_High_Voltage_Energy_St: 8 Vector__XXX
 SG_ High_Voltage_Energy_Storage_Pack : 0|64@1+ (1,0) [0|18446744073709551615] "" Vector__XXX

BO_ 2566083584 VDMA_F354_High_Voltage_Energy_St: 8 Vector__XXX
 SG_ High_Voltage_Energy_Storage_Pack : 0|64@1+ (1,0) [0|18446744073709551615] "" Vector__XXX

BO_ 2566083840 VDMA_F355_High_Voltage_Energy_St: 8 Vector__XXX
 SG_ High_Voltage_Energy_Storage_Pack : 0|64@1+ (1,0) [0|18446744073709551615] "" Vector__XXX

BO_ 2566084096 VDMA_F356_High_Voltage_Energy_St: 8 Vector__XXX
 SG_ High_Voltage_Energy_Storage_Pack : 0|64@1+ (1,0) [0|18446744073709551615] "" Vector__XXX

BO_ 2566084352 VDMA_F357_High_Voltage_Energy_St: 8 Vector__XXX
 SG_ High_Voltage_Energy_Storage_Pack : 0|64@1+ (1,0) [0|18446744073709551615] "" Vector__XXX

BO_ 2566084608 VDMA_F358_High_Voltage_Energy_St: 8 Vector__XXX
 SG_ High_Voltage_Energy_Storage_Pack : 0|64@1+ (1,0) [0|18446744073709551615] "" Vector__XXX

BO_ 2566084864 VDMA_F359_High_Voltage_Energy_St: 8 Vector__XXX
 SG_ High_Voltage_Energy_Storage_Pack : 0|64@1+ (1,0) [0|18446744073709551615] "" Vector__XXX

BO_ 2566085120 VDMA_F35A_High_Voltage_Energy_St: 8 Vector__XXX
 SG_ High_Voltage_Energy_Storage_Pack : 0|64@1+ (1,0) [0|18446744073709551615] "" Vector__XXX

BO_ 2566085376 VDMA_F35B_High_Voltage_Energy_St: 8 Vector__XXX
 SG_ High_Voltage_Energy_Storage_Pack : 0|64@1+ (1,0) [0|18446744073709551615] "" Vector__XXX

BO_ 2566085632 VDMA_F35C_High_Voltage_Energy_St: 8 Vector__XXX
 SG_ High_Voltage_Energy_Storage_Pack : 0|64@1+ (1,0) [0|18446744073709551615] "" Vector__XXX

BO_ 2566085888 VDMA_F35D_High_Voltage_Energy_St: 8 Vector__XXX
 SG_ High_Voltage_Energy_Storage_Pack : 0|64@1+ (1,0) [0|18446744073709551615] "" Vector__XXX

BO_ 2566086144 VDMA_F35E_High_Voltage_Energy_St: 8 Vector__XXX
 SG_ High_Voltage_Energy_Storage_Pack : 0|64@1+ (1,0) [0|18446744073709551615] "" Vector__XXX

BO_ 2566086400 VDMA_F35F_High_Voltage_Energy_St: 8 Vector__XXX
 SG_ High_Voltage_Energy_Storage_Pack : 0|64@1+ (1,0) [0|18446744073709551615] "" Vector__XXX

BO_ 2566086656 VDMA_F360_High_Voltage_Energy_St: 8 Vector__XXX
 SG_ High_Voltage_Energy_Storage_Pack : 0|64@1+ (1,0) [0|18446744073709551615] "" Vector__XXX

BO_ 2566086912 VDMA_F361_High_Voltage_Energy_St: 8 Vector__XXX
 SG_ High_Voltage_Energy_Storage_Pack : 0|64@1+ (1,0) [0|18446744073709551615] "" Vector__XXX

BO_ 2566087168 VDMA_F362_High_Voltage_Energy_St: 8 Vector__XXX
 SG_ High_Voltage_Energy_Storage_Pack : 0|64@1+ (1,0) [0|18446744073709551615] "" Vector__XXX

BO_ 2566087424 VDMA_F363_High_Voltage_Energy_St: 8 Vector__XXX
 SG_ High_Voltage_Energy_Storage_Pack : 0|64@1+ (1,0) [0|18446744073709551615] "" Vector__XXX

BO_ 2566087680 VDMA_F364_Tracked_Vehicle_Data: 8 Vector__XXX
 SG_ Tracked_Vehicle_Data_RawPayload : 0|64@1+ (1,0) [0|18446744073709551615] "" Vector__XXX

BO_ 2566087936 VDMA_F365_Electrified_Accessory_: 8 Vector__XXX
 SG_ Electrified_Accessory_Propulsion : 0|64@1+ (1,0) [0|18446744073709551615] "" Vector__XXX

BO_ 2566088192 VDMA_F366_Electrified_Accessory_: 8 Vector__XXX
 SG_ Electrified_Accessory_Propulsion : 0|64@1+ (1,0) [0|18446744073709551615] "" Vector__XXX

BO_ 2566088448 VDMA_F367_Electrified_Accessory_: 8 Vector__XXX
 SG_ Electrified_Accessory_Propulsion : 0|64@1+ (1,0) [0|18446744073709551615] "" Vector__XXX

BO_ 2566088704 VDMA_F368_Electrified_Accessory_: 8 Vector__XXX
 SG_ Electrified_Accessory_Power_Elec : 0|64@1+ (1,0) [0|18446744073709551615] "" Vector__XXX

BO_ 2566088960 VDMA_F369_Electrified_Accessory_: 8 Vector__XXX
 SG_ Electrified_Accessory_Power_Elec : 0|64@1+ (1,0) [0|18446744073709551615] "" Vector__XXX

BO_ 2566089216 VDMA_F36A_Electrified_Accessory_: 8 Vector__XXX
 SG_ Electrified_Accessory_Power_Elec : 0|64@1+ (1,0) [0|18446744073709551615] "" Vector__XXX

BO_ 2566089472 VDMA_F36B_Electrified_Accessory_: 8 Vector__XXX
 SG_ Electrified_Accessory_Propulsion : 0|64@1+ (1,0) [0|18446744073709551615] "" Vector__XXX

BO_ 2566089728 VDMA_F36C_Electrified_Accessory_: 8 Vector__XXX
 SG_ Electrified_Accessory_Propulsion : 0|64@1+ (1,0) [0|18446744073709551615] "" Vector__XXX

BO_ 2566089984 VDMA_F36D_Electrified_Accessory_: 8 Vector__XXX
 SG_ Electrified_Accessory_Power_Elec : 0|64@1+ (1,0) [0|18446744073709551615] "" Vector__XXX

BO_ 2566090240 VDMA_F36E_Electrified_Accessory_: 8 Vector__XXX
 SG_ Electrified_Accessory_Generator_ : 0|64@1+ (1,0) [0|18446744073709551615] "" Vector__XXX

BO_ 2566090496 VDMA_F36F_Electrified_Accessory_: 8 Vector__XXX
 SG_ Electrified_Accessory_Generator_ : 0|64@1+ (1,0) [0|18446744073709551615] "" Vector__XXX

BO_ 2566090752 VDMA_F370_Electrified_Accessory_: 8 Vector__XXX
 SG_ Electrified_Accessory_Motor_Stat : 0|64@1+ (1,0) [0|18446744073709551615] "" Vector__XXX

BO_ 2566091008 VDMA_F371_Fuel_Cell_System_Contr: 8 Vector__XXX
 SG_ Fuel_Cell_System_Controller_Info : 0|64@1+ (1,0) [0|18446744073709551615] "" Vector__XXX

BO_ 2566091264 VDMA_F372_Fuel_Cell_System_Minim: 8 Vector__XXX
 SG_ Fuel_Cell_System_Minimum_Power_I : 0|64@1+ (1,0) [0|18446744073709551615] "" Vector__XXX

BO_ 2566091520 VDMA_F373_Fuel_Cell_System_Maxim: 8 Vector__XXX
 SG_ Fuel_Cell_System_Maximum_Power_I : 0|64@1+ (1,0) [0|18446744073709551615] "" Vector__XXX

BO_ 2566091776 VDMA_F374_Fuel_Cell_System_Minim: 8 Vector__XXX
 SG_ Fuel_Cell_System_Minimum_Current : 0|64@1+ (1,0) [0|18446744073709551615] "" Vector__XXX

BO_ 2566092032 VDMA_F375_Fuel_Cell_System_Maxim: 8 Vector__XXX
 SG_ Fuel_Cell_System_Maximum_Current : 0|64@1+ (1,0) [0|18446744073709551615] "" Vector__XXX

BO_ 2566092288 VDMA_F376_Hydrogen_Storage_Syste: 8 Vector__XXX
 SG_ Hydrogen_Storage_System_Informat : 0|64@1+ (1,0) [0|18446744073709551615] "" Vector__XXX

BO_ 2566092544 VDMA_F377_Fuel_Cell_System_Opera: 8 Vector__XXX
 SG_ Fuel_Cell_System_Operating_State : 0|64@1+ (1,0) [0|18446744073709551615] "" Vector__XXX

BO_ 2566092800 VDMA_F378_Fuel_Cell_System_Opera: 8 Vector__XXX
 SG_ Fuel_Cell_System_Operations_Requ : 0|64@1+ (1,0) [0|18446744073709551615] "" Vector__XXX

BO_ 2566093056 VDMA_F379_Fuel_Cell_Stack_Inform: 8 Vector__XXX
 SG_ Fuel_Cell_Stack_Information_RawP : 0|64@1+ (1,0) [0|18446744073709551615] "" Vector__XXX

BO_ 2566093312 VDMA_F37A_Fuel_Cell_System_Coola: 8 Vector__XXX
 SG_ Fuel_Cell_System_Coolant_Fan_1_S : 0|64@1+ (1,0) [0|18446744073709551615] "" Vector__XXX

BO_ 2566093568 VDMA_F37B_Fuel_Cell_System_Coola: 8 Vector__XXX
 SG_ Fuel_Cell_System_Coolant_Fan_2_S : 0|64@1+ (1,0) [0|18446744073709551615] "" Vector__XXX

BO_ 2566093824 VDMA_F37C_Fuel_Cell_System_Coola: 8 Vector__XXX
 SG_ Fuel_Cell_System_Coolant_Fan_3_S : 0|64@1+ (1,0) [0|18446744073709551615] "" Vector__XXX

BO_ 2566094080 VDMA_F37D_Fuel_Cell_System_Coola: 8 Vector__XXX
 SG_ Fuel_Cell_System_Coolant_Fan_4_S : 0|64@1+ (1,0) [0|18446744073709551615] "" Vector__XXX

BO_ 2566094336 VDMA_F37E_HVESS_Coolant_Pump_1_S: 8 Vector__XXX
 SG_ HVESS_Coolant_Pump_1_Status_2_Ra : 0|64@1+ (1,0) [0|18446744073709551615] "" Vector__XXX

BO_ 2566094592 VDMA_F37F_HVESS_Coolant_Pump_2_S: 8 Vector__XXX
 SG_ HVESS_Coolant_Pump_2_Status_2_Ra : 0|64@1+ (1,0) [0|18446744073709551615] "" Vector__XXX

BO_ 2566094848 VDMA_F380_High_Voltage_Energy_St: 8 Vector__XXX
 SG_ High_Voltage_Energy_Storage_Syst : 0|64@1+ (1,0) [0|18446744073709551615] "" Vector__XXX

BO_ 2566095104 VDMA_F381_PTO_Drive_Engagement_2: 8 Vector__XXX
 SG_ PTO_Drive_Engagement_2_RawPayloa : 0|64@1+ (1,0) [0|18446744073709551615] "" Vector__XXX

BO_ 2566095360 VDMA_F382_Fuel_Cell_System_Hydro: 8 Vector__XXX
 SG_ Fuel_Cell_System_Hydrogen_Pressu : 0|64@1+ (1,0) [0|18446744073709551615] "" Vector__XXX

BO_ 2566095616 VDMA_F383_Engine_Gas_Flow_Rate_2: 8 Vector__XXX
 SG_ Engine_Gas_Flow_Rate_2_RawPayloa : 0|64@1+ (1,0) [0|18446744073709551615] "" Vector__XXX

BO_ 2566095872 VDMA_F384_Engine_Supercharger_In: 8 Vector__XXX
 SG_ Engine_Supercharger_Information_ : 0|64@1+ (1,0) [0|18446744073709551615] "" Vector__XXX

BO_ 2566096128 VDMA_F385_Engine_Disconnect_Clut: 8 Vector__XXX
 SG_ Engine_Disconnect_Clutch_RawPayl : 0|64@1+ (1,0) [0|18446744073709551615] "" Vector__XXX

BO_ 2566478080 VDMA_F959_GNSS_Correction_Data: 8 Vector__XXX
 SG_ GNSS_Correction_Data_RawPayload : 0|64@1+ (1,0) [0|18446744073709551615] "" Vector__XXX

BO_ 2566478336 VDMA_F95A_Engine_Crankcase_Venti: 8 Vector__XXX
 SG_ Engine_Crankcase_Ventilation_Hea : 0|64@1+ (1,0) [0|18446744073709551615] "" Vector__XXX

BO_ 2566478592 VDMA_F95B_Engine_Crankcase_Venti: 8 Vector__XXX
 SG_ Engine_Crankcase_Ventilation_Hea : 0|64@1+ (1,0) [0|18446744073709551615] "" Vector__XXX

BO_ 2566478848 VDMA_F95C_Engine_Crankcase_Venti: 8 Vector__XXX
 SG_ Engine_Crankcase_Ventilation_Hea : 0|64@1+ (1,0) [0|18446744073709551615] "" Vector__XXX

BO_ 2566479104 VDMA_F95D_Air_Fuel_Ratio_2: 8 Vector__XXX
 SG_ Air_Fuel_Ratio_2_RawPayload : 0|64@1+ (1,0) [0|18446744073709551615] "" Vector__XXX

BO_ 2566479360 VDMA_F95E_OBFCM_Engine_Output_En: 8 Vector__XXX
 SG_ OBFCM_Engine_Output_Energy_Stati : 0|64@1+ (1,0) [0|18446744073709551615] "" Vector__XXX

BO_ 2566479616 VDMA_F95F_OBFCM_Vehicle_Distance: 8 Vector__XXX
 SG_ OBFCM_Vehicle_Distance_Static_Da : 0|64@1+ (1,0) [0|18446744073709551615] "" Vector__XXX

BO_ 2566479872 VDMA_F960_OBFCM_Fuel_2_Static_Da: 8 Vector__XXX
 SG_ OBFCM_Fuel_2_Static_Data_RawPayl : 0|64@1+ (1,0) [0|18446744073709551615] "" Vector__XXX

BO_ 2566480128 VDMA_F961_OBFCM_Fuel_1_Static_Da: 8 Vector__XXX
 SG_ OBFCM_Fuel_1_Static_Data_RawPayl : 0|64@1+ (1,0) [0|18446744073709551615] "" Vector__XXX

BO_ 2566480384 VDMA_F962_OBFCM_Counters: 8 Vector__XXX
 SG_ OBFCM_Counters_RawPayload : 0|64@1+ (1,0) [0|18446744073709551615] "" Vector__XXX

BO_ 2566480640 VDMA_F963_OBFCM_Accumulators: 8 Vector__XXX
 SG_ OBFCM_Accumulators_RawPayload : 0|64@1+ (1,0) [0|18446744073709551615] "" Vector__XXX

BO_ 2566480896 VDMA_F964_OBFCM_Fuel_Consumption: 8 Vector__XXX
 SG_ OBFCM_Fuel_Consumption_RawPayloa : 0|64@1+ (1,0) [0|18446744073709551615] "" Vector__XXX

BO_ 2566481152 VDMA_F965_Engine_VVT_System_Data: 8 Vector__XXX
 SG_ Engine_VVT_System_Data_RawPayloa : 0|64@1+ (1,0) [0|18446744073709551615] "" Vector__XXX

BO_ 2566481408 VDMA_F966_Maintenance_Informatio: 8 Vector__XXX
 SG_ Maintenance_Information_2_RawPay : 0|64@1+ (1,0) [0|18446744073709551615] "" Vector__XXX

BO_ 2566481664 VDMA_F967_Alternate_Fuel_7: 8 Vector__XXX
 SG_ Alternate_Fuel_7_RawPayload : 0|64@1+ (1,0) [0|18446744073709551615] "" Vector__XXX

BO_ 2566481920 VDMA_F968_Engine_Catalyst_Divert: 8 Vector__XXX
 SG_ Engine_Catalyst_Diverter_Actuato : 0|64@1+ (1,0) [0|18446744073709551615] "" Vector__XXX

BO_ 2566482176 VDMA_F969_Electronic_Logging_Dev: 8 Vector__XXX
 SG_ Electronic_Logging_Device_Hours_ : 0|64@1+ (1,0) [0|18446744073709551615] "" Vector__XXX

BO_ 2566482432 VDMA_F96A_ER_DC_DC_Converter_4_R: 8 Vector__XXX
 SG_ ER_DC_DC_Converter_4_References_ : 0|64@1+ (1,0) [0|18446744073709551615] "" Vector__XXX

BO_ 2566482688 VDMA_F96B_ER_DC_DC_Converter_4_P: 8 Vector__XXX
 SG_ ER_DC_DC_Converter_4_Power_Limit : 0|64@1+ (1,0) [0|18446744073709551615] "" Vector__XXX

BO_ 2566482944 VDMA_F96C_ER_DC_DC_Converter_4_C: 8 Vector__XXX
 SG_ ER_DC_DC_Converter_4_Current_Lim : 0|64@1+ (1,0) [0|18446744073709551615] "" Vector__XXX

BO_ 2566483200 VDMA_F96D_ER_DC_DC_Converter_4_V: 8 Vector__XXX
 SG_ ER_DC_DC_Converter_4_Voltage_Lim : 0|64@1+ (1,0) [0|18446744073709551615] "" Vector__XXX

BO_ 2566483456 VDMA_F96E_ER_DC_DC_Converter_4_T: 8 Vector__XXX
 SG_ ER_DC_DC_Converter_4_Temperature : 0|64@1+ (1,0) [0|18446744073709551615] "" Vector__XXX

BO_ 2566483712 VDMA_F96F_ER_DC_DC_Converter_4_P: 8 Vector__XXX
 SG_ ER_DC_DC_Converter_4_Power_Limit : 0|64@1+ (1,0) [0|18446744073709551615] "" Vector__XXX

BO_ 2566483968 VDMA_F970_ER_DC_DC_Converter_4_C: 8 Vector__XXX
 SG_ ER_DC_DC_Converter_4_Current_Lim : 0|64@1+ (1,0) [0|18446744073709551615] "" Vector__XXX

BO_ 2566484224 VDMA_F971_ER_DC_DC_Converter_4_V: 8 Vector__XXX
 SG_ ER_DC_DC_Converter_4_Voltage_Lim : 0|64@1+ (1,0) [0|18446744073709551615] "" Vector__XXX

BO_ 2566484480 VDMA_F972_ER_DC_DC_Converter_4_L: 8 Vector__XXX
 SG_ ER_DC_DC_Converter_4_Low_Voltage : 0|64@1+ (1,0) [0|18446744073709551615] "" Vector__XXX

BO_ 2566484736 VDMA_F973_ER_DC_DC_Converter_4_P: 8 Vector__XXX
 SG_ ER_DC_DC_Converter_4_Power_and_C : 0|64@1+ (1,0) [0|18446744073709551615] "" Vector__XXX

BO_ 2566484992 VDMA_F974_ER_DC_DC_Converter_4_V: 8 Vector__XXX
 SG_ ER_DC_DC_Converter_4_Voltage_and : 0|64@1+ (1,0) [0|18446744073709551615] "" Vector__XXX

BO_ 2566485248 VDMA_F975_ER_DC_DC_Converter_4_O: 8 Vector__XXX
 SG_ ER_DC_DC_Converter_4_Operating_S : 0|64@1+ (1,0) [0|18446744073709551615] "" Vector__XXX

BO_ 2566485504 VDMA_F976_ER_DC_DC_Converter_4_C: 8 Vector__XXX
 SG_ ER_DC_DC_Converter_4_Control_Raw : 0|64@1+ (1,0) [0|18446744073709551615] "" Vector__XXX

BO_ 2566485760 VDMA_F977_ER_DC_DC_Converter_3_R: 8 Vector__XXX
 SG_ ER_DC_DC_Converter_3_References_ : 0|64@1+ (1,0) [0|18446744073709551615] "" Vector__XXX

BO_ 2566486016 VDMA_F978_ER_DC_DC_Converter_3_P: 8 Vector__XXX
 SG_ ER_DC_DC_Converter_3_Power_Limit : 0|64@1+ (1,0) [0|18446744073709551615] "" Vector__XXX

BO_ 2566486272 VDMA_F979_ER_DC_DC_Converter_3_C: 8 Vector__XXX
 SG_ ER_DC_DC_Converter_3_Current_Lim : 0|64@1+ (1,0) [0|18446744073709551615] "" Vector__XXX

BO_ 2566486528 VDMA_F97A_ER_DC_DC_Converter_3_V: 8 Vector__XXX
 SG_ ER_DC_DC_Converter_3_Voltage_Lim : 0|64@1+ (1,0) [0|18446744073709551615] "" Vector__XXX

BO_ 2566486784 VDMA_F97B_ER_DC_DC_Converter_3_T: 8 Vector__XXX
 SG_ ER_DC_DC_Converter_3_Temperature : 0|64@1+ (1,0) [0|18446744073709551615] "" Vector__XXX

BO_ 2566487040 VDMA_F97C_ER_DC_DC_Converter_3_P: 8 Vector__XXX
 SG_ ER_DC_DC_Converter_3_Power_Limit : 0|64@1+ (1,0) [0|18446744073709551615] "" Vector__XXX

BO_ 2566487296 VDMA_F97D_ER_DC_DC_Converter_3_C: 8 Vector__XXX
 SG_ ER_DC_DC_Converter_3_Current_Lim : 0|64@1+ (1,0) [0|18446744073709551615] "" Vector__XXX

BO_ 2566487552 VDMA_F97E_ER_DC_DC_Converter_3_V: 8 Vector__XXX
 SG_ ER_DC_DC_Converter_3_Voltage_Lim : 0|64@1+ (1,0) [0|18446744073709551615] "" Vector__XXX

BO_ 2566487808 VDMA_F97F_ER_DC_DC_Converter_3_L: 8 Vector__XXX
 SG_ ER_DC_DC_Converter_3_Low_Voltage : 0|64@1+ (1,0) [0|18446744073709551615] "" Vector__XXX

BO_ 2566488064 VDMA_F980_ER_DC_DC_Converter_3_P: 8 Vector__XXX
 SG_ ER_DC_DC_Converter_3_Power_and_C : 0|64@1+ (1,0) [0|18446744073709551615] "" Vector__XXX

BO_ 2566488320 VDMA_F981_ER_DC_DC_Converter_3_V: 8 Vector__XXX
 SG_ ER_DC_DC_Converter_3_Voltage_and : 0|64@1+ (1,0) [0|18446744073709551615] "" Vector__XXX

BO_ 2566488576 VDMA_F982_ER_DC_DC_Converter_3_O: 8 Vector__XXX
 SG_ ER_DC_DC_Converter_3_Operating_S : 0|64@1+ (1,0) [0|18446744073709551615] "" Vector__XXX

BO_ 2566488832 VDMA_F983_ER_DC_DC_Converter_3_C: 8 Vector__XXX
 SG_ ER_DC_DC_Converter_3_Control_Raw : 0|64@1+ (1,0) [0|18446744073709551615] "" Vector__XXX

BO_ 2566489088 VDMA_F984_ER_DC_DC_Converter_2_R: 8 Vector__XXX
 SG_ ER_DC_DC_Converter_2_References_ : 0|64@1+ (1,0) [0|18446744073709551615] "" Vector__XXX

BO_ 2566489344 VDMA_F985_ER_DC_DC_Converter_2_P: 8 Vector__XXX
 SG_ ER_DC_DC_Converter_2_Power_Limit : 0|64@1+ (1,0) [0|18446744073709551615] "" Vector__XXX

BO_ 2566489600 VDMA_F986_ER_DC_DC_Converter_2_C: 8 Vector__XXX
 SG_ ER_DC_DC_Converter_2_Current_Lim : 0|64@1+ (1,0) [0|18446744073709551615] "" Vector__XXX

BO_ 2566489856 VDMA_F987_ER_DC_DC_Converter_2_V: 8 Vector__XXX
 SG_ ER_DC_DC_Converter_2_Voltage_Lim : 0|64@1+ (1,0) [0|18446744073709551615] "" Vector__XXX

BO_ 2566490112 VDMA_F988_ER_DC_DC_Converter_2_T: 8 Vector__XXX
 SG_ ER_DC_DC_Converter_2_Temperature : 0|64@1+ (1,0) [0|18446744073709551615] "" Vector__XXX

BO_ 2566490368 VDMA_F989_ER_DC_DC_Converter_2_P: 8 Vector__XXX
 SG_ ER_DC_DC_Converter_2_Power_Limit : 0|64@1+ (1,0) [0|18446744073709551615] "" Vector__XXX

BO_ 2566490624 VDMA_F98A_ER_DC_DC_Converter_2_C: 8 Vector__XXX
 SG_ ER_DC_DC_Converter_2_Current_Lim : 0|64@1+ (1,0) [0|18446744073709551615] "" Vector__XXX

BO_ 2566490880 VDMA_F98B_ER_DC_DC_Converter_2_V: 8 Vector__XXX
 SG_ ER_DC_DC_Converter_2_Voltage_Lim : 0|64@1+ (1,0) [0|18446744073709551615] "" Vector__XXX

BO_ 2566491136 VDMA_F98C_ER_DC_DC_Converter_2_L: 8 Vector__XXX
 SG_ ER_DC_DC_Converter_2_Low_Voltage : 0|64@1+ (1,0) [0|18446744073709551615] "" Vector__XXX

BO_ 2566491392 VDMA_F98D_ER_DC_DC_Converter_2_P: 8 Vector__XXX
 SG_ ER_DC_DC_Converter_2_Power_and_C : 0|64@1+ (1,0) [0|18446744073709551615] "" Vector__XXX

BO_ 2566491648 VDMA_F98E_ER_DC_DC_Converter_2_V: 8 Vector__XXX
 SG_ ER_DC_DC_Converter_2_Voltage_and : 0|64@1+ (1,0) [0|18446744073709551615] "" Vector__XXX

BO_ 2566491904 VDMA_F98F_ER_DC_DC_Converter_2_O: 8 Vector__XXX
 SG_ ER_DC_DC_Converter_2_Operating_S : 0|64@1+ (1,0) [0|18446744073709551615] "" Vector__XXX

BO_ 2566492160 VDMA_F990_ER_DC_DC_Converter_2_C: 8 Vector__XXX
 SG_ ER_DC_DC_Converter_2_Control_Raw : 0|64@1+ (1,0) [0|18446744073709551615] "" Vector__XXX

BO_ 2566492416 VDMA_F991_ER_DC_DC_Converter_1_R: 8 Vector__XXX
 SG_ ER_DC_DC_Converter_1_References_ : 0|64@1+ (1,0) [0|18446744073709551615] "" Vector__XXX

BO_ 2566492672 VDMA_F992_ER_DC_DC_Converter_1_P: 8 Vector__XXX
 SG_ ER_DC_DC_Converter_1_Power_Limit : 0|64@1+ (1,0) [0|18446744073709551615] "" Vector__XXX

BO_ 2566492928 VDMA_F993_ER_DC_DC_Converter_1_C: 8 Vector__XXX
 SG_ ER_DC_DC_Converter_1_Current_Lim : 0|64@1+ (1,0) [0|18446744073709551615] "" Vector__XXX

BO_ 2566493184 VDMA_F994_ER_DC_DC_Converter_1_V: 8 Vector__XXX
 SG_ ER_DC_DC_Converter_1_Voltage_Lim : 0|64@1+ (1,0) [0|18446744073709551615] "" Vector__XXX

BO_ 2566493440 VDMA_F995_ER_DC_DC_Converter_1_T: 8 Vector__XXX
 SG_ ER_DC_DC_Converter_1_Temperature : 0|64@1+ (1,0) [0|18446744073709551615] "" Vector__XXX

BO_ 2566493696 VDMA_F996_ER_DC_DC_Converter_1_P: 8 Vector__XXX
 SG_ ER_DC_DC_Converter_1_Power_Limit : 0|64@1+ (1,0) [0|18446744073709551615] "" Vector__XXX

BO_ 2566493952 VDMA_F997_ER_DC_DC_Converter_1_C: 8 Vector__XXX
 SG_ ER_DC_DC_Converter_1_Current_Lim : 0|64@1+ (1,0) [0|18446744073709551615] "" Vector__XXX

BO_ 2566494208 VDMA_F998_ER_DC_DC_Converter_1_V: 8 Vector__XXX
 SG_ ER_DC_DC_Converter_1_Voltage_Lim : 0|64@1+ (1,0) [0|18446744073709551615] "" Vector__XXX

BO_ 2566494464 VDMA_F999_ER_DC_DC_Converter_1_L: 8 Vector__XXX
 SG_ ER_DC_DC_Converter_1_Low_Voltage : 0|64@1+ (1,0) [0|18446744073709551615] "" Vector__XXX

BO_ 2566494720 VDMA_F99A_ER_DC_DC_Converter_1_P: 8 Vector__XXX
 SG_ ER_DC_DC_Converter_1_Power_and_C : 0|64@1+ (1,0) [0|18446744073709551615] "" Vector__XXX

BO_ 2566494976 VDMA_F99B_ER_DC_DC_Converter_1_V: 8 Vector__XXX
 SG_ ER_DC_DC_Converter_1_Voltage_and : 0|64@1+ (1,0) [0|18446744073709551615] "" Vector__XXX

BO_ 2566495232 VDMA_F99C_ER_DC_DC_Converter_1_O: 8 Vector__XXX
 SG_ ER_DC_DC_Converter_1_Operating_S : 0|64@1+ (1,0) [0|18446744073709551615] "" Vector__XXX

BO_ 2566495488 VDMA_F99D_ER_DC_DC_Converter_1_C: 8 Vector__XXX
 SG_ ER_DC_DC_Converter_1_Control_Raw : 0|64@1+ (1,0) [0|18446744073709551615] "" Vector__XXX

BO_ 2566495744 VDMA_F99E_Cab_Air_Quality_System: 8 Vector__XXX
 SG_ Cab_Air_Quality_System_Informati : 0|64@1+ (1,0) [0|18446744073709551615] "" Vector__XXX

BO_ 2566496000 VDMA_F99F_Cab_Air_Quality_System: 8 Vector__XXX
 SG_ Cab_Air_Quality_System_Informati : 0|64@1+ (1,0) [0|18446744073709551615] "" Vector__XXX

BO_ 2566496256 VDMA_F9A0_Well_Stimulation_Pump_: 8 Vector__XXX
 SG_ Well_Stimulation_Pump_System_6_R : 0|64@1+ (1,0) [0|18446744073709551615] "" Vector__XXX

BO_ 2566496512 VDMA_F9A1_Engine_Fuel_Lube_Syste: 8 Vector__XXX
 SG_ Engine_Fuel_Lube_Systems_4_RawPa : 0|64@1+ (1,0) [0|18446744073709551615] "" Vector__XXX

BO_ 2566496768 VDMA_F9A2_Alternate_Fuel_6: 8 Vector__XXX
 SG_ Alternate_Fuel_6_RawPayload : 0|64@1+ (1,0) [0|18446744073709551615] "" Vector__XXX

BO_ 2566497024 VDMA_F9A3_Engine_Catalyst_Divert: 8 Vector__XXX
 SG_ Engine_Catalyst_Diverter_Actuato : 0|64@1+ (1,0) [0|18446744073709551615] "" Vector__XXX

BO_ 2566497280 VDMA_F9A4_Ambient_Conditions_4: 8 Vector__XXX
 SG_ Ambient_Conditions_4_RawPayload : 0|64@1+ (1,0) [0|18446744073709551615] "" Vector__XXX

BO_ 2566497536 VDMA_F9A5_Engine_Exhaust_Particu: 8 Vector__XXX
 SG_ Engine_Exhaust_Particulate_Contr : 0|64@1+ (1,0) [0|18446744073709551615] "" Vector__XXX

BO_ 2566497792 VDMA_F9A6_Engine_Exhaust_Particu: 8 Vector__XXX
 SG_ Engine_Exhaust_Particulate_Contr : 0|64@1+ (1,0) [0|18446744073709551615] "" Vector__XXX

BO_ 2566498048 VDMA_F9A7_Aftertreatment_System_: 8 Vector__XXX
 SG_ Aftertreatment_System_Informatio : 0|64@1+ (1,0) [0|18446744073709551615] "" Vector__XXX

BO_ 2566498304 VDMA_F9A8_Aftertreatment_System_: 8 Vector__XXX
 SG_ Aftertreatment_System_Informatio : 0|64@1+ (1,0) [0|18446744073709551615] "" Vector__XXX

BO_ 2566498560 VDMA_F9A9_Aftertreatment_System_: 8 Vector__XXX
 SG_ Aftertreatment_System_Informatio : 0|64@1+ (1,0) [0|18446744073709551615] "" Vector__XXX

BO_ 2566498816 VDMA_F9AA_Aftertreatment_System_: 8 Vector__XXX
 SG_ Aftertreatment_System_Informatio : 0|64@1+ (1,0) [0|18446744073709551615] "" Vector__XXX

BO_ 2566499072 VDMA_F9AB_Aftertreatment_System_: 8 Vector__XXX
 SG_ Aftertreatment_System_Informatio : 0|64@1+ (1,0) [0|18446744073709551615] "" Vector__XXX

BO_ 2566499328 VDMA_F9AC_Aftertreatment_System_: 8 Vector__XXX
 SG_ Aftertreatment_System_Informatio : 0|64@1+ (1,0) [0|18446744073709551615] "" Vector__XXX

BO_ 2566499584 VDMA_F9AD_Aftertreatment_System_: 8 Vector__XXX
 SG_ Aftertreatment_System_Informatio : 0|64@1+ (1,0) [0|18446744073709551615] "" Vector__XXX

BO_ 2566499840 VDMA_F9AE_Aftertreatment_System_: 8 Vector__XXX
 SG_ Aftertreatment_System_Informatio : 0|64@1+ (1,0) [0|18446744073709551615] "" Vector__XXX

BO_ 2566500096 VDMA_F9AF_Aftertreatment_System_: 8 Vector__XXX
 SG_ Aftertreatment_System_Informatio : 0|64@1+ (1,0) [0|18446744073709551615] "" Vector__XXX

BO_ 2566500352 VDMA_F9B0_Aftertreatment_System_: 8 Vector__XXX
 SG_ Aftertreatment_System_Informatio : 0|64@1+ (1,0) [0|18446744073709551615] "" Vector__XXX

BO_ 2566500608 VDMA_F9B1_Aftertreatment_System_: 8 Vector__XXX
 SG_ Aftertreatment_System_Informatio : 0|64@1+ (1,0) [0|18446744073709551615] "" Vector__XXX

BO_ 2566500864 VDMA_F9B2_Aftertreatment_System_: 8 Vector__XXX
 SG_ Aftertreatment_System_Informatio : 0|64@1+ (1,0) [0|18446744073709551615] "" Vector__XXX

BO_ 2566501120 VDMA_F9B3_Route_Attributes_Profi: 8 Vector__XXX
 SG_ Route_Attributes_Profile_RawPayl : 0|64@1+ (1,0) [0|18446744073709551615] "" Vector__XXX

BO_ 2566501376 VDMA_F9B4_Genset_Supporting_Func: 8 Vector__XXX
 SG_ Genset_Supporting_Functions_2_Ra : 0|64@1+ (1,0) [0|18446744073709551615] "" Vector__XXX

BO_ 2566501632 VDMA_F9B5_Alternator_Information: 8 Vector__XXX
 SG_ Alternator_Information_2_RawPayl : 0|64@1+ (1,0) [0|18446744073709551615] "" Vector__XXX

BO_ 2566501888 VDMA_F9B6_Well_Stimulation_Pump_: 8 Vector__XXX
 SG_ Well_Stimulation_Pump_System_5_R : 0|64@1+ (1,0) [0|18446744073709551615] "" Vector__XXX

BO_ 2566502144 VDMA_F9B7_Well_Stimulation_Pump_: 8 Vector__XXX
 SG_ Well_Stimulation_Pump_System_4_R : 0|64@1+ (1,0) [0|18446744073709551615] "" Vector__XXX

BO_ 2566502400 VDMA_F9B8_Tire_Information: 8 Vector__XXX
 SG_ Tire_Information_RawPayload : 0|64@1+ (1,0) [0|18446744073709551615] "" Vector__XXX

BO_ 2566502656 VDMA_F9B9_Hydrogen_System_Status: 8 Vector__XXX
 SG_ Hydrogen_System_Status_RawPayloa : 0|64@1+ (1,0) [0|18446744073709551615] "" Vector__XXX

BO_ 2566502912 VDMA_F9BA_Route_Waypoint_GPS_Coo: 8 Vector__XXX
 SG_ Route_Waypoint_GPS_Coordinates_R : 0|64@1+ (1,0) [0|18446744073709551615] "" Vector__XXX

BO_ 2566503168 VDMA_F9BB_Route_Information: 8 Vector__XXX
 SG_ Route_Information_RawPayload : 0|64@1+ (1,0) [0|18446744073709551615] "" Vector__XXX

BO_ 2566503424 VDMA_F9BC_Engine_Fluid_Level_Pre: 8 Vector__XXX
 SG_ Engine_Fluid_Level_Pressure_15_R : 0|64@1+ (1,0) [0|18446744073709551615] "" Vector__XXX

BO_ 2566503680 VDMA_F9BD_Fuel_Cell_System_Coola: 8 Vector__XXX
 SG_ Fuel_Cell_System_Coolant_Informa : 0|64@1+ (1,0) [0|18446744073709551615] "" Vector__XXX

BO_ 2566503936 VDMA_F9BE_Transmission_Configura: 8 Vector__XXX
 SG_ Transmission_Configuration_3_Raw : 0|64@1+ (1,0) [0|18446744073709551615] "" Vector__XXX

BO_ 2566504192 VDMA_F9BF_Enrichment_Information: 8 Vector__XXX
 SG_ Enrichment_Information_RawPayloa : 0|64@1+ (1,0) [0|18446744073709551615] "" Vector__XXX

BO_ 2566504448 VDMA_F9C0_Fuel_Cell_System_Volta: 8 Vector__XXX
 SG_ Fuel_Cell_System_Voltage_Limit_C : 0|64@1+ (1,0) [0|18446744073709551615] "" Vector__XXX

BO_ 2566504960 VDMA_F9C2_Hydrogen_System_Inform: 8 Vector__XXX
 SG_ Hydrogen_System_Information_RawP : 0|64@1+ (1,0) [0|18446744073709551615] "" Vector__XXX

BO_ 2566505216 VDMA_F9C3_Auxiliary_Input_Output: 8 Vector__XXX
 SG_ Auxiliary_Input_Output_Status_17 : 0|64@1+ (1,0) [0|18446744073709551615] "" Vector__XXX

BO_ 2566505472 VDMA_F9C4_Auxiliary_Input_Output: 8 Vector__XXX
 SG_ Auxiliary_Input_Output_Status_16 : 0|64@1+ (1,0) [0|18446744073709551615] "" Vector__XXX

BO_ 2566505728 VDMA_F9C5_Auxiliary_Input_Output: 8 Vector__XXX
 SG_ Auxiliary_Input_Output_Status_15 : 0|64@1+ (1,0) [0|18446744073709551615] "" Vector__XXX

BO_ 2566505984 VDMA_F9C6_Auxiliary_Input_Output: 8 Vector__XXX
 SG_ Auxiliary_Input_Output_Status_14 : 0|64@1+ (1,0) [0|18446744073709551615] "" Vector__XXX

BO_ 2566506240 VDMA_F9C7_Auxiliary_Input_Output: 8 Vector__XXX
 SG_ Auxiliary_Input_Output_Status_13 : 0|64@1+ (1,0) [0|18446744073709551615] "" Vector__XXX

BO_ 2566506496 VDMA_F9C8_Auxiliary_Input_Output: 8 Vector__XXX
 SG_ Auxiliary_Input_Output_Status_12 : 0|64@1+ (1,0) [0|18446744073709551615] "" Vector__XXX

BO_ 2566506752 VDMA_F9C9_Auxiliary_Input_Output: 8 Vector__XXX
 SG_ Auxiliary_Input_Output_Status_11 : 0|64@1+ (1,0) [0|18446744073709551615] "" Vector__XXX

BO_ 2566507008 VDMA_F9CA_Auxiliary_Input_Output: 8 Vector__XXX
 SG_ Auxiliary_Input_Output_Status_10 : 0|64@1+ (1,0) [0|18446744073709551615] "" Vector__XXX

BO_ 2566507264 VDMA_F9CB_Auxiliary_Input_Output: 8 Vector__XXX
 SG_ Auxiliary_Input_Output_Status_9_ : 0|64@1+ (1,0) [0|18446744073709551615] "" Vector__XXX

BO_ 2566507520 VDMA_F9CC_Auxiliary_Input_Output: 8 Vector__XXX
 SG_ Auxiliary_Input_Output_Status_8_ : 0|64@1+ (1,0) [0|18446744073709551615] "" Vector__XXX

BO_ 2566507776 VDMA_F9CD_Aftertreatment_System_: 8 Vector__XXX
 SG_ Aftertreatment_System_Informatio : 0|64@1+ (1,0) [0|18446744073709551615] "" Vector__XXX

BO_ 2566508032 VDMA_F9CE_Brake_Temperature_6: 8 Vector__XXX
 SG_ Brake_Temperature_6_RawPayload : 0|64@1+ (1,0) [0|18446744073709551615] "" Vector__XXX

BO_ 2566508288 VDMA_F9CF_Brake_Temperature_5: 8 Vector__XXX
 SG_ Brake_Temperature_5_RawPayload : 0|64@1+ (1,0) [0|18446744073709551615] "" Vector__XXX

BO_ 2566508544 VDMA_F9D0_Brake_Temperature_4: 8 Vector__XXX
 SG_ Brake_Temperature_4_RawPayload : 0|64@1+ (1,0) [0|18446744073709551615] "" Vector__XXX

BO_ 2566508800 VDMA_F9D1_Brake_Temperature_3: 8 Vector__XXX
 SG_ Brake_Temperature_3_RawPayload : 0|64@1+ (1,0) [0|18446744073709551615] "" Vector__XXX

BO_ 2566509056 VDMA_F9D2_Brake_Temperature_2: 8 Vector__XXX
 SG_ Brake_Temperature_2_RawPayload : 0|64@1+ (1,0) [0|18446744073709551615] "" Vector__XXX

BO_ 2566509312 VDMA_F9D3_Brake_Temperature_1: 8 Vector__XXX
 SG_ Brake_Temperature_1_RawPayload : 0|64@1+ (1,0) [0|18446744073709551615] "" Vector__XXX

BO_ 2566509568 VDMA_F9D4_Wheel_Brake_Lining_Rem: 8 Vector__XXX
 SG_ Wheel_Brake_Lining_Remaining_Inf : 0|64@1+ (1,0) [0|18446744073709551615] "" Vector__XXX

BO_ 2566509824 VDMA_F9D5_Wheel_Brake_Lining_Rem: 8 Vector__XXX
 SG_ Wheel_Brake_Lining_Remaining_Inf : 0|64@1+ (1,0) [0|18446744073709551615] "" Vector__XXX

BO_ 2566510080 VDMA_F9D6_High_Voltage_Bus_Conta: 8 Vector__XXX
 SG_ High_Voltage_Bus_Contactor_Statu : 0|64@1+ (1,0) [0|18446744073709551615] "" Vector__XXX

BO_ 2566510336 VDMA_F9D7_High_Voltage_Bus_Conta: 8 Vector__XXX
 SG_ High_Voltage_Bus_Contactor_Statu : 0|64@1+ (1,0) [0|18446744073709551615] "" Vector__XXX

BO_ 2566510592 VDMA_F9D8_High_Voltage_Bus_Conne: 8 Vector__XXX
 SG_ High_Voltage_Bus_Connection_Comm : 0|64@1+ (1,0) [0|18446744073709551615] "" Vector__XXX

BO_ 2566510848 VDMA_F9D9_Cab_Illumination_Data: 8 Vector__XXX
 SG_ Cab_Illumination_Data_RawPayload : 0|64@1+ (1,0) [0|18446744073709551615] "" Vector__XXX

BO_ 2566511104 VDMA_F9DA_Service_Needed_DTC_Inf: 8 Vector__XXX
 SG_ Service_Needed_DTC_Information_R : 0|64@1+ (1,0) [0|18446744073709551615] "" Vector__XXX

BO_ 2566511360 VDMA_F9DB_EVSE_Status_2: 8 Vector__XXX
 SG_ EVSE_Status_2_RawPayload : 0|64@1+ (1,0) [0|18446744073709551615] "" Vector__XXX

BO_ 2566511616 VDMA_F9DC_High_Voltage_Energy_St: 8 Vector__XXX
 SG_ High_Voltage_Energy_Storage_Syst : 0|64@1+ (1,0) [0|18446744073709551615] "" Vector__XXX

BO_ 2566511872 VDMA_F9DD_High_Voltage_Energy_St: 8 Vector__XXX
 SG_ High_Voltage_Energy_Storage_Syst : 0|64@1+ (1,0) [0|18446744073709551615] "" Vector__XXX

BO_ 2566512128 VDMA_F9DE_High_Voltage_Energy_St: 8 Vector__XXX
 SG_ High_Voltage_Energy_Storage_Syst : 0|64@1+ (1,0) [0|18446744073709551615] "" Vector__XXX

BO_ 2566512384 VDMA_F9DF_HVESS_Coolant_Pump_1_S: 8 Vector__XXX
 SG_ HVESS_Coolant_Pump_1_Status_1_Ra : 0|64@1+ (1,0) [0|18446744073709551615] "" Vector__XXX

BO_ 2566512640 VDMA_F9E0_HVESS_Coolant_Pump_1_C: 8 Vector__XXX
 SG_ HVESS_Coolant_Pump_1_Command_Raw : 0|64@1+ (1,0) [0|18446744073709551615] "" Vector__XXX

BO_ 2566512896 VDMA_F9E1_HVESS_Coolant_Pump_2_S: 8 Vector__XXX
 SG_ HVESS_Coolant_Pump_2_Status_1_Ra : 0|64@1+ (1,0) [0|18446744073709551615] "" Vector__XXX

BO_ 2566513152 VDMA_F9E2_HVESS_Coolant_Pump_2_C: 8 Vector__XXX
 SG_ HVESS_Coolant_Pump_2_Command_Raw : 0|64@1+ (1,0) [0|18446744073709551615] "" Vector__XXX

BO_ 2566513408 VDMA_F9E3_Hydrogen_Sensor_Inform: 8 Vector__XXX
 SG_ Hydrogen_Sensor_Information_RawP : 0|64@1+ (1,0) [0|18446744073709551615] "" Vector__XXX

BO_ 2566513664 VDMA_F9E4_Operator_Inducement_In: 8 Vector__XXX
 SG_ Operator_Inducement_Information_ : 0|64@1+ (1,0) [0|18446744073709551615] "" Vector__XXX

BO_ 2566513920 VDMA_F9E5_Operator_Inducement_Ve: 8 Vector__XXX
 SG_ Operator_Inducement_Vehicle_Spee : 0|64@1+ (1,0) [0|18446744073709551615] "" Vector__XXX

BO_ 2566514176 VDMA_F9E6_Operator_Inducement_Ve: 8 Vector__XXX
 SG_ Operator_Inducement_Vehicle_Spee : 0|64@1+ (1,0) [0|18446744073709551615] "" Vector__XXX

BO_ 2566514432 VDMA_F9E7_Engine_Protection_Spee: 8 Vector__XXX
 SG_ Engine_Protection_Speed_Derate_I : 0|64@1+ (1,0) [0|18446744073709551615] "" Vector__XXX

BO_ 2566514688 VDMA_F9E8_Engine_Protection_Torq: 8 Vector__XXX
 SG_ Engine_Protection_Torque_Derate_ : 0|64@1+ (1,0) [0|18446744073709551615] "" Vector__XXX

BO_ 2566514944 VDMA_F9E9_Aftertreatment_System_: 8 Vector__XXX
 SG_ Aftertreatment_System_Informatio : 0|64@1+ (1,0) [0|18446744073709551615] "" Vector__XXX

BO_ 2566515200 VDMA_F9EA_SAE_J2012_3_Byte_DTC_D: 8 Vector__XXX
 SG_ SAE_J2012_3_Byte_DTC_Display_Raw : 0|64@1+ (1,0) [0|18446744073709551615] "" Vector__XXX

BO_ 2566515456 VDMA_F9EB_High_Voltage_Energy_St: 8 Vector__XXX
 SG_ High_Voltage_Energy_Storage_Syst : 0|64@1+ (1,0) [0|18446744073709551615] "" Vector__XXX

BO_ 2566515712 VDMA_F9EC_High_Voltage_Energy_St: 8 Vector__XXX
 SG_ High_Voltage_Energy_Storage_Syst : 0|64@1+ (1,0) [0|18446744073709551615] "" Vector__XXX

BO_ 2566515968 VDMA_F9ED_High_Voltage_Energy_St: 8 Vector__XXX
 SG_ High_Voltage_Energy_Storage_Syst : 0|64@1+ (1,0) [0|18446744073709551615] "" Vector__XXX

BO_ 2566516224 VDMA_F9EE_Engine_Cylinder_Averag: 8 Vector__XXX
 SG_ Engine_Cylinder_Average_Ignition : 0|64@1+ (1,0) [0|18446744073709551615] "" Vector__XXX

BO_ 2566516480 VDMA_F9EF_Engine_Cylinder_Averag: 8 Vector__XXX
 SG_ Engine_Cylinder_Average_Ignition : 0|64@1+ (1,0) [0|18446744073709551615] "" Vector__XXX

BO_ 2566516736 VDMA_F9F0_Engine_Cylinder_Averag: 8 Vector__XXX
 SG_ Engine_Cylinder_Average_Ignition : 0|64@1+ (1,0) [0|18446744073709551615] "" Vector__XXX

CM_ BO_ 2566053120  "Source: isobus.net VDMA Data Dictionary (https://www.isobus.net/isobus/pGNAndSPN/6645?type=PGN)";
CM_ BO_ 2566053376  "Source: isobus.net VDMA Data Dictionary (https://www.isobus.net/isobus/pGNAndSPN/6651?type=PGN)";
CM_ BO_ 2566053632  "Source: isobus.net VDMA Data Dictionary (https://www.isobus.net/isobus/pGNAndSPN/6668?type=PGN)";
CM_ BO_ 2566053888  "Source: isobus.net VDMA Data Dictionary (https://www.isobus.net/isobus/pGNAndSPN/6671?type=PGN)";
CM_ BO_ 2566054144  "Source: isobus.net VDMA Data Dictionary (https://www.isobus.net/isobus/pGNAndSPN/6703?type=PGN)";
CM_ BO_ 2566054400  "Source: isobus.net VDMA Data Dictionary (https://www.isobus.net/isobus/pGNAndSPN/6711?type=PGN)";
CM_ BO_ 2566054656  "Source: isobus.net VDMA Data Dictionary (https://www.isobus.net/isobus/pGNAndSPN/6716?type=PGN)";
CM_ BO_ 2566054912  "Source: isobus.net VDMA Data Dictionary (https://www.isobus.net/isobus/pGNAndSPN/6724?type=PGN)";
CM_ BO_ 2566055168  "Source: isobus.net VDMA Data Dictionary (https://www.isobus.net/isobus/pGNAndSPN/6730?type=PGN)";
CM_ BO_ 2566055424  "Source: isobus.net VDMA Data Dictionary (https://www.isobus.net/isobus/pGNAndSPN/6733?type=PGN)";
CM_ BO_ 2566055680  "Source: isobus.net VDMA Data Dictionary (https://www.isobus.net/isobus/pGNAndSPN/6745?type=PGN)";
CM_ BO_ 2566055936  "Source: isobus.net VDMA Data Dictionary (https://www.isobus.net/isobus/pGNAndSPN/6749?type=PGN)";
CM_ BO_ 2566056192  "Source: isobus.net VDMA Data Dictionary (https://www.isobus.net/isobus/pGNAndSPN/6753?type=PGN)";
CM_ BO_ 2566056448  "Source: isobus.net VDMA Data Dictionary (https://www.isobus.net/isobus/pGNAndSPN/6757?type=PGN)";
CM_ BO_ 2566056704  "Source: isobus.net VDMA Data Dictionary (https://www.isobus.net/isobus/pGNAndSPN/6760?type=PGN)";
CM_ BO_ 2566056960  "Source: isobus.net VDMA Data Dictionary (https://www.isobus.net/isobus/pGNAndSPN/6764?type=PGN)";
CM_ BO_ 2566057216  "Source: isobus.net VDMA Data Dictionary (https://www.isobus.net/isobus/pGNAndSPN/6770?type=PGN)";
CM_ BO_ 2566057472  "Source: isobus.net VDMA Data Dictionary (https://www.isobus.net/isobus/pGNAndSPN/6787?type=PGN)";
CM_ BO_ 2566057728  "Source: isobus.net VDMA Data Dictionary (https://www.isobus.net/isobus/pGNAndSPN/6790?type=PGN)";
CM_ BO_ 2566057984  "Source: isobus.net VDMA Data Dictionary (https://www.isobus.net/isobus/pGNAndSPN/6822?type=PGN)";
CM_ BO_ 2566058240  "Source: isobus.net VDMA Data Dictionary (https://www.isobus.net/isobus/pGNAndSPN/6830?type=PGN)";
CM_ BO_ 2566058496  "Source: isobus.net VDMA Data Dictionary (https://www.isobus.net/isobus/pGNAndSPN/6835?type=PGN)";
CM_ BO_ 2566058752  "Source: isobus.net VDMA Data Dictionary (https://www.isobus.net/isobus/pGNAndSPN/6843?type=PGN)";
CM_ BO_ 2566059008  "Source: isobus.net VDMA Data Dictionary (https://www.isobus.net/isobus/pGNAndSPN/6849?type=PGN)";
CM_ BO_ 2566059264  "Source: isobus.net VDMA Data Dictionary (https://www.isobus.net/isobus/pGNAndSPN/6852?type=PGN)";
CM_ BO_ 2566059520  "Source: isobus.net VDMA Data Dictionary (https://www.isobus.net/isobus/pGNAndSPN/6864?type=PGN)";
CM_ BO_ 2566059776  "Source: isobus.net VDMA Data Dictionary (https://www.isobus.net/isobus/pGNAndSPN/6868?type=PGN)";
CM_ BO_ 2566060032  "Source: isobus.net VDMA Data Dictionary (https://www.isobus.net/isobus/pGNAndSPN/6872?type=PGN)";
CM_ BO_ 2566060288  "Source: isobus.net VDMA Data Dictionary (https://www.isobus.net/isobus/pGNAndSPN/6876?type=PGN)";
CM_ BO_ 2566060544  "Source: isobus.net VDMA Data Dictionary (https://www.isobus.net/isobus/pGNAndSPN/6879?type=PGN)";
CM_ BO_ 2566060800  "Source: isobus.net VDMA Data Dictionary (https://www.isobus.net/isobus/pGNAndSPN/6883?type=PGN)";
CM_ BO_ 2566061056  "Source: isobus.net VDMA Data Dictionary (https://www.isobus.net/isobus/pGNAndSPN/6889?type=PGN)";
CM_ BO_ 2566061312  "Source: isobus.net VDMA Data Dictionary (https://www.isobus.net/isobus/pGNAndSPN/6906?type=PGN)";
CM_ BO_ 2566061568  "Source: isobus.net VDMA Data Dictionary (https://www.isobus.net/isobus/pGNAndSPN/6909?type=PGN)";
CM_ BO_ 2566061824  "Source: isobus.net VDMA Data Dictionary (https://www.isobus.net/isobus/pGNAndSPN/6941?type=PGN)";
CM_ BO_ 2566062080  "Source: isobus.net VDMA Data Dictionary (https://www.isobus.net/isobus/pGNAndSPN/6949?type=PGN)";
CM_ BO_ 2566062336  "Source: isobus.net VDMA Data Dictionary (https://www.isobus.net/isobus/pGNAndSPN/6954?type=PGN)";
CM_ BO_ 2566062592  "Source: isobus.net VDMA Data Dictionary (https://www.isobus.net/isobus/pGNAndSPN/6962?type=PGN)";
CM_ BO_ 2566062848  "Source: isobus.net VDMA Data Dictionary (https://www.isobus.net/isobus/pGNAndSPN/6968?type=PGN)";
CM_ BO_ 2566063104  "Source: isobus.net VDMA Data Dictionary (https://www.isobus.net/isobus/pGNAndSPN/6971?type=PGN)";
CM_ BO_ 2566063360  "Source: isobus.net VDMA Data Dictionary (https://www.isobus.net/isobus/pGNAndSPN/6983?type=PGN)";
CM_ BO_ 2566063616  "Source: isobus.net VDMA Data Dictionary (https://www.isobus.net/isobus/pGNAndSPN/6987?type=PGN)";
CM_ BO_ 2566063872  "Source: isobus.net VDMA Data Dictionary (https://www.isobus.net/isobus/pGNAndSPN/6991?type=PGN)";
CM_ BO_ 2566064128  "Source: isobus.net VDMA Data Dictionary (https://www.isobus.net/isobus/pGNAndSPN/6995?type=PGN)";
CM_ BO_ 2566064384  "Source: isobus.net VDMA Data Dictionary (https://www.isobus.net/isobus/pGNAndSPN/6998?type=PGN)";
CM_ BO_ 2566064640  "Source: isobus.net VDMA Data Dictionary (https://www.isobus.net/isobus/pGNAndSPN/7002?type=PGN)";
CM_ BO_ 2566064896  "Source: isobus.net VDMA Data Dictionary (https://www.isobus.net/isobus/pGNAndSPN/7008?type=PGN)";
CM_ BO_ 2566065152  "Source: isobus.net VDMA Data Dictionary (https://www.isobus.net/isobus/pGNAndSPN/7025?type=PGN)";
CM_ BO_ 2566065408  "Source: isobus.net VDMA Data Dictionary (https://www.isobus.net/isobus/pGNAndSPN/7028?type=PGN)";
CM_ BO_ 2566065664  "Source: isobus.net VDMA Data Dictionary (https://www.isobus.net/isobus/pGNAndSPN/7060?type=PGN)";
CM_ BO_ 2566065920  "Source: isobus.net VDMA Data Dictionary (https://www.isobus.net/isobus/pGNAndSPN/7068?type=PGN)";
CM_ BO_ 2566066176  "Source: isobus.net VDMA Data Dictionary (https://www.isobus.net/isobus/pGNAndSPN/7073?type=PGN)";
CM_ BO_ 2566066432  "Source: isobus.net VDMA Data Dictionary (https://www.isobus.net/isobus/pGNAndSPN/7081?type=PGN)";
CM_ BO_ 2566066688  "Source: isobus.net VDMA Data Dictionary (https://www.isobus.net/isobus/pGNAndSPN/7087?type=PGN)";
CM_ BO_ 2566066944  "Source: isobus.net VDMA Data Dictionary (https://www.isobus.net/isobus/pGNAndSPN/7090?type=PGN)";
CM_ BO_ 2566067200  "Source: isobus.net VDMA Data Dictionary (https://www.isobus.net/isobus/pGNAndSPN/7102?type=PGN)";
CM_ BO_ 2566067456  "Source: isobus.net VDMA Data Dictionary (https://www.isobus.net/isobus/pGNAndSPN/7106?type=PGN)";
CM_ BO_ 2566067712  "Source: isobus.net VDMA Data Dictionary (https://www.isobus.net/isobus/pGNAndSPN/7110?type=PGN)";
CM_ BO_ 2566067968  "Source: isobus.net VDMA Data Dictionary (https://www.isobus.net/isobus/pGNAndSPN/7114?type=PGN)";
CM_ BO_ 2566068224  "Source: isobus.net VDMA Data Dictionary (https://www.isobus.net/isobus/pGNAndSPN/7117?type=PGN)";
CM_ BO_ 2566068480  "Source: isobus.net VDMA Data Dictionary (https://www.isobus.net/isobus/pGNAndSPN/7121?type=PGN)";
CM_ BO_ 2566068736  "Source: isobus.net VDMA Data Dictionary (https://www.isobus.net/isobus/pGNAndSPN/7127?type=PGN)";
CM_ BO_ 2566068992  "Source: isobus.net VDMA Data Dictionary (https://www.isobus.net/isobus/pGNAndSPN/7144?type=PGN)";
CM_ BO_ 2566069248  "Source: isobus.net VDMA Data Dictionary (https://www.isobus.net/isobus/pGNAndSPN/7147?type=PGN)";
CM_ BO_ 2566069504  "Source: isobus.net VDMA Data Dictionary (https://www.isobus.net/isobus/pGNAndSPN/7179?type=PGN)";
CM_ BO_ 2566069760  "Source: isobus.net VDMA Data Dictionary (https://www.isobus.net/isobus/pGNAndSPN/7187?type=PGN)";
CM_ BO_ 2566070016  "Source: isobus.net VDMA Data Dictionary (https://www.isobus.net/isobus/pGNAndSPN/7192?type=PGN)";
CM_ BO_ 2566070272  "Source: isobus.net VDMA Data Dictionary (https://www.isobus.net/isobus/pGNAndSPN/7200?type=PGN)";
CM_ BO_ 2566070528  "Source: isobus.net VDMA Data Dictionary (https://www.isobus.net/isobus/pGNAndSPN/7206?type=PGN)";
CM_ BO_ 2566070784  "Source: isobus.net VDMA Data Dictionary (https://www.isobus.net/isobus/pGNAndSPN/7209?type=PGN)";
CM_ BO_ 2566071040  "Source: isobus.net VDMA Data Dictionary (https://www.isobus.net/isobus/pGNAndSPN/7221?type=PGN)";
CM_ BO_ 2566071296  "Source: isobus.net VDMA Data Dictionary (https://www.isobus.net/isobus/pGNAndSPN/7225?type=PGN)";
CM_ BO_ 2566071552  "Source: isobus.net VDMA Data Dictionary (https://www.isobus.net/isobus/pGNAndSPN/7229?type=PGN)";
CM_ BO_ 2566071808  "Source: isobus.net VDMA Data Dictionary (https://www.isobus.net/isobus/pGNAndSPN/7233?type=PGN)";
CM_ BO_ 2566072064  "Source: isobus.net VDMA Data Dictionary (https://www.isobus.net/isobus/pGNAndSPN/7236?type=PGN)";
CM_ BO_ 2566072320  "Source: isobus.net VDMA Data Dictionary (https://www.isobus.net/isobus/pGNAndSPN/7240?type=PGN)";
CM_ BO_ 2566072576  "Source: isobus.net VDMA Data Dictionary (https://www.isobus.net/isobus/pGNAndSPN/7246?type=PGN)";
CM_ BO_ 2566072832  "Source: isobus.net VDMA Data Dictionary (https://www.isobus.net/isobus/pGNAndSPN/7263?type=PGN)";
CM_ BO_ 2566073088  "Source: isobus.net VDMA Data Dictionary (https://www.isobus.net/isobus/pGNAndSPN/7266?type=PGN)";
CM_ BO_ 2566073344  "Source: isobus.net VDMA Data Dictionary (https://www.isobus.net/isobus/pGNAndSPN/7298?type=PGN)";
CM_ BO_ 2566073600  "Source: isobus.net VDMA Data Dictionary (https://www.isobus.net/isobus/pGNAndSPN/7306?type=PGN)";
CM_ BO_ 2566073856  "Source: isobus.net VDMA Data Dictionary (https://www.isobus.net/isobus/pGNAndSPN/7311?type=PGN)";
CM_ BO_ 2566074112  "Source: isobus.net VDMA Data Dictionary (https://www.isobus.net/isobus/pGNAndSPN/7319?type=PGN)";
CM_ BO_ 2566074368  "Source: isobus.net VDMA Data Dictionary (https://www.isobus.net/isobus/pGNAndSPN/7325?type=PGN)";
CM_ BO_ 2566074624  "Source: isobus.net VDMA Data Dictionary (https://www.isobus.net/isobus/pGNAndSPN/7328?type=PGN)";
CM_ BO_ 2566074880  "Source: isobus.net VDMA Data Dictionary (https://www.isobus.net/isobus/pGNAndSPN/7340?type=PGN)";
CM_ BO_ 2566075136  "Source: isobus.net VDMA Data Dictionary (https://www.isobus.net/isobus/pGNAndSPN/7344?type=PGN)";
CM_ BO_ 2566075392  "Source: isobus.net VDMA Data Dictionary (https://www.isobus.net/isobus/pGNAndSPN/7348?type=PGN)";
CM_ BO_ 2566075648  "Source: isobus.net VDMA Data Dictionary (https://www.isobus.net/isobus/pGNAndSPN/7352?type=PGN)";
CM_ BO_ 2566075904  "Source: isobus.net VDMA Data Dictionary (https://www.isobus.net/isobus/pGNAndSPN/7355?type=PGN)";
CM_ BO_ 2566076160  "Source: isobus.net VDMA Data Dictionary (https://www.isobus.net/isobus/pGNAndSPN/7359?type=PGN)";
CM_ BO_ 2566076416  "Source: isobus.net VDMA Data Dictionary (https://www.isobus.net/isobus/pGNAndSPN/7365?type=PGN)";
CM_ BO_ 2566076672  "Source: isobus.net VDMA Data Dictionary (https://www.isobus.net/isobus/pGNAndSPN/7382?type=PGN)";
CM_ BO_ 2566076928  "Source: isobus.net VDMA Data Dictionary (https://www.isobus.net/isobus/pGNAndSPN/7385?type=PGN)";
CM_ BO_ 2566077184  "Source: isobus.net VDMA Data Dictionary (https://www.isobus.net/isobus/pGNAndSPN/7417?type=PGN)";
CM_ BO_ 2566077440  "Source: isobus.net VDMA Data Dictionary (https://www.isobus.net/isobus/pGNAndSPN/7425?type=PGN)";
CM_ BO_ 2566077696  "Source: isobus.net VDMA Data Dictionary (https://www.isobus.net/isobus/pGNAndSPN/7430?type=PGN)";
CM_ BO_ 2566077952  "Source: isobus.net VDMA Data Dictionary (https://www.isobus.net/isobus/pGNAndSPN/7438?type=PGN)";
CM_ BO_ 2566078208  "Source: isobus.net VDMA Data Dictionary (https://www.isobus.net/isobus/pGNAndSPN/7444?type=PGN)";
CM_ BO_ 2566078464  "Source: isobus.net VDMA Data Dictionary (https://www.isobus.net/isobus/pGNAndSPN/7447?type=PGN)";
CM_ BO_ 2566078720  "Source: isobus.net VDMA Data Dictionary (https://www.isobus.net/isobus/pGNAndSPN/7453?type=PGN)";
CM_ BO_ 2566078976  "Source: isobus.net VDMA Data Dictionary (https://www.isobus.net/isobus/pGNAndSPN/7463?type=PGN)";
CM_ BO_ 2566079232  "Source: isobus.net VDMA Data Dictionary (https://www.isobus.net/isobus/pGNAndSPN/7479?type=PGN)";
CM_ BO_ 2566079488  "Source: isobus.net VDMA Data Dictionary (https://www.isobus.net/isobus/pGNAndSPN/7493?type=PGN)";
CM_ BO_ 2566079744  "Source: isobus.net VDMA Data Dictionary (https://www.isobus.net/isobus/pGNAndSPN/7502?type=PGN)";
CM_ BO_ 2566080000  "Source: isobus.net VDMA Data Dictionary (https://www.isobus.net/isobus/pGNAndSPN/7512?type=PGN)";
CM_ BO_ 2566080256  "Source: isobus.net VDMA Data Dictionary (https://www.isobus.net/isobus/pGNAndSPN/7520?type=PGN)";
CM_ BO_ 2566080512  "Source: isobus.net VDMA Data Dictionary (https://www.isobus.net/isobus/pGNAndSPN/7532?type=PGN)";
CM_ BO_ 2566080768  "Source: isobus.net VDMA Data Dictionary (https://www.isobus.net/isobus/pGNAndSPN/7535?type=PGN)";
CM_ BO_ 2566081024  "Source: isobus.net VDMA Data Dictionary (https://www.isobus.net/isobus/pGNAndSPN/7542?type=PGN)";
CM_ BO_ 2566081280  "Source: isobus.net VDMA Data Dictionary (https://www.isobus.net/isobus/pGNAndSPN/7553?type=PGN)";
CM_ BO_ 2566081536  "Source: isobus.net VDMA Data Dictionary (https://www.isobus.net/isobus/pGNAndSPN/7557?type=PGN)";
CM_ BO_ 2566081792  "Source: isobus.net VDMA Data Dictionary (https://www.isobus.net/isobus/pGNAndSPN/7561?type=PGN)";
CM_ BO_ 2566082048  "Source: isobus.net VDMA Data Dictionary (https://www.isobus.net/isobus/pGNAndSPN/7565?type=PGN)";
CM_ BO_ 2566082304  "Source: isobus.net VDMA Data Dictionary (https://www.isobus.net/isobus/pGNAndSPN/7569?type=PGN)";
CM_ BO_ 2566082560  "Source: isobus.net VDMA Data Dictionary (https://www.isobus.net/isobus/pGNAndSPN/7573?type=PGN)";
CM_ BO_ 2566082816  "Source: isobus.net VDMA Data Dictionary (https://www.isobus.net/isobus/pGNAndSPN/7577?type=PGN)";
CM_ BO_ 2566083072  "Source: isobus.net VDMA Data Dictionary (https://www.isobus.net/isobus/pGNAndSPN/7581?type=PGN)";
CM_ BO_ 2566083328  "Source: isobus.net VDMA Data Dictionary (https://www.isobus.net/isobus/pGNAndSPN/7585?type=PGN)";
CM_ BO_ 2566083584  "Source: isobus.net VDMA Data Dictionary (https://www.isobus.net/isobus/pGNAndSPN/7589?type=PGN)";
CM_ BO_ 2566083840  "Source: isobus.net VDMA Data Dictionary (https://www.isobus.net/isobus/pGNAndSPN/7593?type=PGN)";
CM_ BO_ 2566084096  "Source: isobus.net VDMA Data Dictionary (https://www.isobus.net/isobus/pGNAndSPN/7597?type=PGN)";
CM_ BO_ 2566084352  "Source: isobus.net VDMA Data Dictionary (https://www.isobus.net/isobus/pGNAndSPN/7601?type=PGN)";
CM_ BO_ 2566084608  "Source: isobus.net VDMA Data Dictionary (https://www.isobus.net/isobus/pGNAndSPN/7605?type=PGN)";
CM_ BO_ 2566084864  "Source: isobus.net VDMA Data Dictionary (https://www.isobus.net/isobus/pGNAndSPN/7609?type=PGN)";
CM_ BO_ 2566085120  "Source: isobus.net VDMA Data Dictionary (https://www.isobus.net/isobus/pGNAndSPN/7613?type=PGN)";
CM_ BO_ 2566085376  "Source: isobus.net VDMA Data Dictionary (https://www.isobus.net/isobus/pGNAndSPN/7617?type=PGN)";
CM_ BO_ 2566085632  "Source: isobus.net VDMA Data Dictionary (https://www.isobus.net/isobus/pGNAndSPN/7621?type=PGN)";
CM_ BO_ 2566085888  "Source: isobus.net VDMA Data Dictionary (https://www.isobus.net/isobus/pGNAndSPN/7625?type=PGN)";
CM_ BO_ 2566086144  "Source: isobus.net VDMA Data Dictionary (https://www.isobus.net/isobus/pGNAndSPN/7629?type=PGN)";
CM_ BO_ 2566086400  "Source: isobus.net VDMA Data Dictionary (https://www.isobus.net/isobus/pGNAndSPN/7633?type=PGN)";
CM_ BO_ 2566086656  "Source: isobus.net VDMA Data Dictionary (https://www.isobus.net/isobus/pGNAndSPN/7637?type=PGN)";
CM_ BO_ 2566086912  "Source: isobus.net VDMA Data Dictionary (https://www.isobus.net/isobus/pGNAndSPN/7641?type=PGN)";
CM_ BO_ 2566087168  "Source: isobus.net VDMA Data Dictionary (https://www.isobus.net/isobus/pGNAndSPN/7645?type=PGN)";
CM_ BO_ 2566087424  "Source: isobus.net VDMA Data Dictionary (https://www.isobus.net/isobus/pGNAndSPN/7649?type=PGN)";
CM_ BO_ 2566087680  "Source: isobus.net VDMA Data Dictionary (https://www.isobus.net/isobus/pGNAndSPN/7651?type=PGN)";
CM_ BO_ 2566087936  "Source: isobus.net VDMA Data Dictionary (https://www.isobus.net/isobus/pGNAndSPN/7656?type=PGN)";
CM_ BO_ 2566088192  "Source: isobus.net VDMA Data Dictionary (https://www.isobus.net/isobus/pGNAndSPN/7661?type=PGN)";
CM_ BO_ 2566088448  "Source: isobus.net VDMA Data Dictionary (https://www.isobus.net/isobus/pGNAndSPN/7666?type=PGN)";
CM_ BO_ 2566088704  "Source: isobus.net VDMA Data Dictionary (https://www.isobus.net/isobus/pGNAndSPN/7671?type=PGN)";
CM_ BO_ 2566088960  "Source: isobus.net VDMA Data Dictionary (https://www.isobus.net/isobus/pGNAndSPN/7676?type=PGN)";
CM_ BO_ 2566089216  "Source: isobus.net VDMA Data Dictionary (https://www.isobus.net/isobus/pGNAndSPN/7681?type=PGN)";
CM_ BO_ 2566089472  "Source: isobus.net VDMA Data Dictionary (https://www.isobus.net/isobus/pGNAndSPN/7686?type=PGN)";
CM_ BO_ 2566089728  "Source: isobus.net VDMA Data Dictionary (https://www.isobus.net/isobus/pGNAndSPN/7691?type=PGN)";
CM_ BO_ 2566089984  "Source: isobus.net VDMA Data Dictionary (https://www.isobus.net/isobus/pGNAndSPN/7696?type=PGN)";
CM_ BO_ 2566090240  "Source: isobus.net VDMA Data Dictionary (https://www.isobus.net/isobus/pGNAndSPN/7701?type=PGN)";
CM_ BO_ 2566090496  "Source: isobus.net VDMA Data Dictionary (https://www.isobus.net/isobus/pGNAndSPN/7706?type=PGN)";
CM_ BO_ 2566090752  "Source: isobus.net VDMA Data Dictionary (https://www.isobus.net/isobus/pGNAndSPN/7712?type=PGN)";
CM_ BO_ 2566091008  "Source: isobus.net VDMA Data Dictionary (https://www.isobus.net/isobus/pGNAndSPN/7717?type=PGN)";
CM_ BO_ 2566091264  "Source: isobus.net VDMA Data Dictionary (https://www.isobus.net/isobus/pGNAndSPN/7722?type=PGN)";
CM_ BO_ 2566091520  "Source: isobus.net VDMA Data Dictionary (https://www.isobus.net/isobus/pGNAndSPN/7727?type=PGN)";
CM_ BO_ 2566091776  "Source: isobus.net VDMA Data Dictionary (https://www.isobus.net/isobus/pGNAndSPN/7732?type=PGN)";
CM_ BO_ 2566092032  "Source: isobus.net VDMA Data Dictionary (https://www.isobus.net/isobus/pGNAndSPN/7737?type=PGN)";
CM_ BO_ 2566092288  "Source: isobus.net VDMA Data Dictionary (https://www.isobus.net/isobus/pGNAndSPN/7740?type=PGN)";
CM_ BO_ 2566092544  "Source: isobus.net VDMA Data Dictionary (https://www.isobus.net/isobus/pGNAndSPN/7748?type=PGN)";
CM_ BO_ 2566092800  "Source: isobus.net VDMA Data Dictionary (https://www.isobus.net/isobus/pGNAndSPN/7751?type=PGN)";
CM_ BO_ 2566093056  "Source: isobus.net VDMA Data Dictionary (https://www.isobus.net/isobus/pGNAndSPN/7753?type=PGN)";
CM_ BO_ 2566093312  "Source: isobus.net VDMA Data Dictionary (https://www.isobus.net/isobus/pGNAndSPN/7758?type=PGN)";
CM_ BO_ 2566093568  "Source: isobus.net VDMA Data Dictionary (https://www.isobus.net/isobus/pGNAndSPN/7763?type=PGN)";
CM_ BO_ 2566093824  "Source: isobus.net VDMA Data Dictionary (https://www.isobus.net/isobus/pGNAndSPN/7768?type=PGN)";
CM_ BO_ 2566094080  "Source: isobus.net VDMA Data Dictionary (https://www.isobus.net/isobus/pGNAndSPN/7773?type=PGN)";
CM_ BO_ 2566094336  "Source: isobus.net VDMA Data Dictionary (https://www.isobus.net/isobus/pGNAndSPN/7778?type=PGN)";
CM_ BO_ 2566094592  "Source: isobus.net VDMA Data Dictionary (https://www.isobus.net/isobus/pGNAndSPN/7783?type=PGN)";
CM_ BO_ 2566094848  "Source: isobus.net VDMA Data Dictionary (https://www.isobus.net/isobus/pGNAndSPN/7789?type=PGN)";
CM_ BO_ 2566095104  "Source: isobus.net VDMA Data Dictionary (https://www.isobus.net/isobus/pGNAndSPN/7795?type=PGN)";
CM_ BO_ 2566095360  "Source: isobus.net VDMA Data Dictionary (https://www.isobus.net/isobus/pGNAndSPN/7798?type=PGN)";
CM_ BO_ 2566095616  "Source: isobus.net VDMA Data Dictionary (https://www.isobus.net/isobus/pGNAndSPN/7801?type=PGN)";
CM_ BO_ 2566095872  "Source: isobus.net VDMA Data Dictionary (https://www.isobus.net/isobus/pGNAndSPN/7807?type=PGN)";
CM_ BO_ 2566096128  "Source: isobus.net VDMA Data Dictionary (https://www.isobus.net/isobus/pGNAndSPN/7813?type=PGN)";
CM_ BO_ 2566478080  "Source: isobus.net VDMA Data Dictionary (https://www.isobus.net/isobus/pGNAndSPN/7815?type=PGN)";
CM_ BO_ 2566478336  "Source: isobus.net VDMA Data Dictionary (https://www.isobus.net/isobus/pGNAndSPN/7817?type=PGN)";
CM_ BO_ 2566478592  "Source: isobus.net VDMA Data Dictionary (https://www.isobus.net/isobus/pGNAndSPN/7821?type=PGN)";
CM_ BO_ 2566478848  "Source: isobus.net VDMA Data Dictionary (https://www.isobus.net/isobus/pGNAndSPN/7825?type=PGN)";
CM_ BO_ 2566479104  "Source: isobus.net VDMA Data Dictionary (https://www.isobus.net/isobus/pGNAndSPN/7827?type=PGN)";
CM_ BO_ 2566479360  "Source: isobus.net VDMA Data Dictionary (https://www.isobus.net/isobus/pGNAndSPN/7982?type=PGN)";
CM_ BO_ 2566479616  "Source: isobus.net VDMA Data Dictionary (https://www.isobus.net/isobus/pGNAndSPN/8137?type=PGN)";
CM_ BO_ 2566479872  "Source: isobus.net VDMA Data Dictionary (https://www.isobus.net/isobus/pGNAndSPN/8292?type=PGN)";
CM_ BO_ 2566480128  "Source: isobus.net VDMA Data Dictionary (https://www.isobus.net/isobus/pGNAndSPN/8447?type=PGN)";
CM_ BO_ 2566480384  "Source: isobus.net VDMA Data Dictionary (https://www.isobus.net/isobus/pGNAndSPN/8449?type=PGN)";
CM_ BO_ 2566480640  "Source: isobus.net VDMA Data Dictionary (https://www.isobus.net/isobus/pGNAndSPN/8455?type=PGN)";
CM_ BO_ 2566480896  "Source: isobus.net VDMA Data Dictionary (https://www.isobus.net/isobus/pGNAndSPN/8456?type=PGN)";
CM_ BO_ 2566481152  "Source: isobus.net VDMA Data Dictionary (https://www.isobus.net/isobus/pGNAndSPN/8460?type=PGN)";
CM_ BO_ 2566481408  "Source: isobus.net VDMA Data Dictionary (https://www.isobus.net/isobus/pGNAndSPN/8461?type=PGN)";
CM_ BO_ 2566481664  "Source: isobus.net VDMA Data Dictionary (https://www.isobus.net/isobus/pGNAndSPN/8469?type=PGN)";
CM_ BO_ 2566481920  "Source: isobus.net VDMA Data Dictionary (https://www.isobus.net/isobus/pGNAndSPN/8471?type=PGN)";
CM_ BO_ 2566482176  "Source: isobus.net VDMA Data Dictionary (https://www.isobus.net/isobus/pGNAndSPN/8475?type=PGN)";
CM_ BO_ 2566482432  "Source: isobus.net VDMA Data Dictionary (https://www.isobus.net/isobus/pGNAndSPN/8480?type=PGN)";
CM_ BO_ 2566482688  "Source: isobus.net VDMA Data Dictionary (https://www.isobus.net/isobus/pGNAndSPN/8484?type=PGN)";
CM_ BO_ 2566482944  "Source: isobus.net VDMA Data Dictionary (https://www.isobus.net/isobus/pGNAndSPN/8488?type=PGN)";
CM_ BO_ 2566483200  "Source: isobus.net VDMA Data Dictionary (https://www.isobus.net/isobus/pGNAndSPN/8492?type=PGN)";
CM_ BO_ 2566483456  "Source: isobus.net VDMA Data Dictionary (https://www.isobus.net/isobus/pGNAndSPN/8497?type=PGN)";
CM_ BO_ 2566483712  "Source: isobus.net VDMA Data Dictionary (https://www.isobus.net/isobus/pGNAndSPN/8501?type=PGN)";
CM_ BO_ 2566483968  "Source: isobus.net VDMA Data Dictionary (https://www.isobus.net/isobus/pGNAndSPN/8505?type=PGN)";
CM_ BO_ 2566484224  "Source: isobus.net VDMA Data Dictionary (https://www.isobus.net/isobus/pGNAndSPN/8509?type=PGN)";
CM_ BO_ 2566484480  "Source: isobus.net VDMA Data Dictionary (https://www.isobus.net/isobus/pGNAndSPN/8511?type=PGN)";
CM_ BO_ 2566484736  "Source: isobus.net VDMA Data Dictionary (https://www.isobus.net/isobus/pGNAndSPN/8515?type=PGN)";
CM_ BO_ 2566484992  "Source: isobus.net VDMA Data Dictionary (https://www.isobus.net/isobus/pGNAndSPN/8519?type=PGN)";
CM_ BO_ 2566485248  "Source: isobus.net VDMA Data Dictionary (https://www.isobus.net/isobus/pGNAndSPN/8536?type=PGN)";
CM_ BO_ 2566485504  "Source: isobus.net VDMA Data Dictionary (https://www.isobus.net/isobus/pGNAndSPN/8540?type=PGN)";
CM_ BO_ 2566485760  "Source: isobus.net VDMA Data Dictionary (https://www.isobus.net/isobus/pGNAndSPN/8545?type=PGN)";
CM_ BO_ 2566486016  "Source: isobus.net VDMA Data Dictionary (https://www.isobus.net/isobus/pGNAndSPN/8549?type=PGN)";
CM_ BO_ 2566486272  "Source: isobus.net VDMA Data Dictionary (https://www.isobus.net/isobus/pGNAndSPN/8553?type=PGN)";
CM_ BO_ 2566486528  "Source: isobus.net VDMA Data Dictionary (https://www.isobus.net/isobus/pGNAndSPN/8557?type=PGN)";
CM_ BO_ 2566486784  "Source: isobus.net VDMA Data Dictionary (https://www.isobus.net/isobus/pGNAndSPN/8562?type=PGN)";
CM_ BO_ 2566487040  "Source: isobus.net VDMA Data Dictionary (https://www.isobus.net/isobus/pGNAndSPN/8566?type=PGN)";
CM_ BO_ 2566487296  "Source: isobus.net VDMA Data Dictionary (https://www.isobus.net/isobus/pGNAndSPN/8570?type=PGN)";
CM_ BO_ 2566487552  "Source: isobus.net VDMA Data Dictionary (https://www.isobus.net/isobus/pGNAndSPN/8574?type=PGN)";
CM_ BO_ 2566487808  "Source: isobus.net VDMA Data Dictionary (https://www.isobus.net/isobus/pGNAndSPN/8576?type=PGN)";
CM_ BO_ 2566488064  "Source: isobus.net VDMA Data Dictionary (https://www.isobus.net/isobus/pGNAndSPN/8580?type=PGN)";
CM_ BO_ 2566488320  "Source: isobus.net VDMA Data Dictionary (https://www.isobus.net/isobus/pGNAndSPN/8584?type=PGN)";
CM_ BO_ 2566488576  "Source: isobus.net VDMA Data Dictionary (https://www.isobus.net/isobus/pGNAndSPN/8601?type=PGN)";
CM_ BO_ 2566488832  "Source: isobus.net VDMA Data Dictionary (https://www.isobus.net/isobus/pGNAndSPN/8605?type=PGN)";
CM_ BO_ 2566489088  "Source: isobus.net VDMA Data Dictionary (https://www.isobus.net/isobus/pGNAndSPN/8610?type=PGN)";
CM_ BO_ 2566489344  "Source: isobus.net VDMA Data Dictionary (https://www.isobus.net/isobus/pGNAndSPN/8614?type=PGN)";
CM_ BO_ 2566489600  "Source: isobus.net VDMA Data Dictionary (https://www.isobus.net/isobus/pGNAndSPN/8618?type=PGN)";
CM_ BO_ 2566489856  "Source: isobus.net VDMA Data Dictionary (https://www.isobus.net/isobus/pGNAndSPN/8622?type=PGN)";
CM_ BO_ 2566490112  "Source: isobus.net VDMA Data Dictionary (https://www.isobus.net/isobus/pGNAndSPN/8627?type=PGN)";
CM_ BO_ 2566490368  "Source: isobus.net VDMA Data Dictionary (https://www.isobus.net/isobus/pGNAndSPN/8631?type=PGN)";
CM_ BO_ 2566490624  "Source: isobus.net VDMA Data Dictionary (https://www.isobus.net/isobus/pGNAndSPN/8635?type=PGN)";
CM_ BO_ 2566490880  "Source: isobus.net VDMA Data Dictionary (https://www.isobus.net/isobus/pGNAndSPN/8639?type=PGN)";
CM_ BO_ 2566491136  "Source: isobus.net VDMA Data Dictionary (https://www.isobus.net/isobus/pGNAndSPN/8641?type=PGN)";
CM_ BO_ 2566491392  "Source: isobus.net VDMA Data Dictionary (https://www.isobus.net/isobus/pGNAndSPN/8645?type=PGN)";
CM_ BO_ 2566491648  "Source: isobus.net VDMA Data Dictionary (https://www.isobus.net/isobus/pGNAndSPN/8649?type=PGN)";
CM_ BO_ 2566491904  "Source: isobus.net VDMA Data Dictionary (https://www.isobus.net/isobus/pGNAndSPN/8666?type=PGN)";
CM_ BO_ 2566492160  "Source: isobus.net VDMA Data Dictionary (https://www.isobus.net/isobus/pGNAndSPN/8670?type=PGN)";
CM_ BO_ 2566492416  "Source: isobus.net VDMA Data Dictionary (https://www.isobus.net/isobus/pGNAndSPN/8675?type=PGN)";
CM_ BO_ 2566492672  "Source: isobus.net VDMA Data Dictionary (https://www.isobus.net/isobus/pGNAndSPN/8679?type=PGN)";
CM_ BO_ 2566492928  "Source: isobus.net VDMA Data Dictionary (https://www.isobus.net/isobus/pGNAndSPN/8683?type=PGN)";
CM_ BO_ 2566493184  "Source: isobus.net VDMA Data Dictionary (https://www.isobus.net/isobus/pGNAndSPN/8687?type=PGN)";
CM_ BO_ 2566493440  "Source: isobus.net VDMA Data Dictionary (https://www.isobus.net/isobus/pGNAndSPN/8692?type=PGN)";
CM_ BO_ 2566493696  "Source: isobus.net VDMA Data Dictionary (https://www.isobus.net/isobus/pGNAndSPN/8696?type=PGN)";
CM_ BO_ 2566493952  "Source: isobus.net VDMA Data Dictionary (https://www.isobus.net/isobus/pGNAndSPN/8700?type=PGN)";
CM_ BO_ 2566494208  "Source: isobus.net VDMA Data Dictionary (https://www.isobus.net/isobus/pGNAndSPN/8704?type=PGN)";
CM_ BO_ 2566494464  "Source: isobus.net VDMA Data Dictionary (https://www.isobus.net/isobus/pGNAndSPN/8706?type=PGN)";
CM_ BO_ 2566494720  "Source: isobus.net VDMA Data Dictionary (https://www.isobus.net/isobus/pGNAndSPN/8710?type=PGN)";
CM_ BO_ 2566494976  "Source: isobus.net VDMA Data Dictionary (https://www.isobus.net/isobus/pGNAndSPN/8714?type=PGN)";
CM_ BO_ 2566495232  "Source: isobus.net VDMA Data Dictionary (https://www.isobus.net/isobus/pGNAndSPN/8731?type=PGN)";
CM_ BO_ 2566495488  "Source: isobus.net VDMA Data Dictionary (https://www.isobus.net/isobus/pGNAndSPN/8735?type=PGN)";
CM_ BO_ 2566495744  "Source: isobus.net VDMA Data Dictionary (https://www.isobus.net/isobus/pGNAndSPN/8739?type=PGN)";
CM_ BO_ 2566496000  "Source: isobus.net VDMA Data Dictionary (https://www.isobus.net/isobus/pGNAndSPN/8745?type=PGN)";
CM_ BO_ 2566496256  "Source: isobus.net VDMA Data Dictionary (https://www.isobus.net/isobus/pGNAndSPN/8749?type=PGN)";
CM_ BO_ 2566496512  "Source: isobus.net VDMA Data Dictionary (https://www.isobus.net/isobus/pGNAndSPN/8755?type=PGN)";
CM_ BO_ 2566496768  "Source: isobus.net VDMA Data Dictionary (https://www.isobus.net/isobus/pGNAndSPN/8760?type=PGN)";
CM_ BO_ 2566497024  "Source: isobus.net VDMA Data Dictionary (https://www.isobus.net/isobus/pGNAndSPN/8763?type=PGN)";
CM_ BO_ 2566497280  "Source: isobus.net VDMA Data Dictionary (https://www.isobus.net/isobus/pGNAndSPN/8767?type=PGN)";
CM_ BO_ 2566497536  "Source: isobus.net VDMA Data Dictionary (https://www.isobus.net/isobus/pGNAndSPN/8769?type=PGN)";
CM_ BO_ 2566497792  "Source: isobus.net VDMA Data Dictionary (https://www.isobus.net/isobus/pGNAndSPN/8771?type=PGN)";
CM_ BO_ 2566498048  "Source: isobus.net VDMA Data Dictionary (https://www.isobus.net/isobus/pGNAndSPN/8773?type=PGN)";
CM_ BO_ 2566498304  "Source: isobus.net VDMA Data Dictionary (https://www.isobus.net/isobus/pGNAndSPN/8775?type=PGN)";
CM_ BO_ 2566498560  "Source: isobus.net VDMA Data Dictionary (https://www.isobus.net/isobus/pGNAndSPN/8777?type=PGN)";
CM_ BO_ 2566498816  "Source: isobus.net VDMA Data Dictionary (https://www.isobus.net/isobus/pGNAndSPN/8779?type=PGN)";
CM_ BO_ 2566499072  "Source: isobus.net VDMA Data Dictionary (https://www.isobus.net/isobus/pGNAndSPN/8781?type=PGN)";
CM_ BO_ 2566499328  "Source: isobus.net VDMA Data Dictionary (https://www.isobus.net/isobus/pGNAndSPN/8783?type=PGN)";
CM_ BO_ 2566499584  "Source: isobus.net VDMA Data Dictionary (https://www.isobus.net/isobus/pGNAndSPN/8785?type=PGN)";
CM_ BO_ 2566499840  "Source: isobus.net VDMA Data Dictionary (https://www.isobus.net/isobus/pGNAndSPN/8787?type=PGN)";
CM_ BO_ 2566500096  "Source: isobus.net VDMA Data Dictionary (https://www.isobus.net/isobus/pGNAndSPN/8789?type=PGN)";
CM_ BO_ 2566500352  "Source: isobus.net VDMA Data Dictionary (https://www.isobus.net/isobus/pGNAndSPN/8791?type=PGN)";
CM_ BO_ 2566500608  "Source: isobus.net VDMA Data Dictionary (https://www.isobus.net/isobus/pGNAndSPN/8793?type=PGN)";
CM_ BO_ 2566500864  "Source: isobus.net VDMA Data Dictionary (https://www.isobus.net/isobus/pGNAndSPN/8795?type=PGN)";
CM_ BO_ 2566501120  "Source: isobus.net VDMA Data Dictionary (https://www.isobus.net/isobus/pGNAndSPN/8805?type=PGN)";
CM_ BO_ 2566501376  "Source: isobus.net VDMA Data Dictionary (https://www.isobus.net/isobus/pGNAndSPN/8806?type=PGN)";
CM_ BO_ 2566501632  "Source: isobus.net VDMA Data Dictionary (https://www.isobus.net/isobus/pGNAndSPN/8811?type=PGN)";
CM_ BO_ 2566501888  "Source: isobus.net VDMA Data Dictionary (https://www.isobus.net/isobus/pGNAndSPN/8815?type=PGN)";
CM_ BO_ 2566502144  "Source: isobus.net VDMA Data Dictionary (https://www.isobus.net/isobus/pGNAndSPN/8818?type=PGN)";
CM_ BO_ 2566502400  "Source: isobus.net VDMA Data Dictionary (https://www.isobus.net/isobus/pGNAndSPN/8819?type=PGN)";
CM_ BO_ 2566502656  "Source: isobus.net VDMA Data Dictionary (https://www.isobus.net/isobus/pGNAndSPN/8821?type=PGN)";
CM_ BO_ 2566502912  "Source: isobus.net VDMA Data Dictionary (https://www.isobus.net/isobus/pGNAndSPN/8824?type=PGN)";
CM_ BO_ 2566503168  "Source: isobus.net VDMA Data Dictionary (https://www.isobus.net/isobus/pGNAndSPN/8828?type=PGN)";
CM_ BO_ 2566503424  "Source: isobus.net VDMA Data Dictionary (https://www.isobus.net/isobus/pGNAndSPN/8830?type=PGN)";
CM_ BO_ 2566503680  "Source: isobus.net VDMA Data Dictionary (https://www.isobus.net/isobus/pGNAndSPN/8832?type=PGN)";
CM_ BO_ 2566503936  "Source: isobus.net VDMA Data Dictionary (https://www.isobus.net/isobus/pGNAndSPN/8852?type=PGN)";
CM_ BO_ 2566504192  "Source: isobus.net VDMA Data Dictionary (https://www.isobus.net/isobus/pGNAndSPN/8860?type=PGN)";
CM_ BO_ 2566504448  "Source: isobus.net VDMA Data Dictionary (https://www.isobus.net/isobus/pGNAndSPN/8865?type=PGN)";
CM_ BO_ 2566504960  "Source: isobus.net VDMA Data Dictionary (https://www.isobus.net/isobus/pGNAndSPN/8867?type=PGN)";
CM_ BO_ 2566505216  "Source: isobus.net VDMA Data Dictionary (https://www.isobus.net/isobus/pGNAndSPN/8871?type=PGN)";
CM_ BO_ 2566505472  "Source: isobus.net VDMA Data Dictionary (https://www.isobus.net/isobus/pGNAndSPN/8875?type=PGN)";
CM_ BO_ 2566505728  "Source: isobus.net VDMA Data Dictionary (https://www.isobus.net/isobus/pGNAndSPN/8879?type=PGN)";
CM_ BO_ 2566505984  "Source: isobus.net VDMA Data Dictionary (https://www.isobus.net/isobus/pGNAndSPN/8883?type=PGN)";
CM_ BO_ 2566506240  "Source: isobus.net VDMA Data Dictionary (https://www.isobus.net/isobus/pGNAndSPN/8887?type=PGN)";
CM_ BO_ 2566506496  "Source: isobus.net VDMA Data Dictionary (https://www.isobus.net/isobus/pGNAndSPN/8891?type=PGN)";
CM_ BO_ 2566506752  "Source: isobus.net VDMA Data Dictionary (https://www.isobus.net/isobus/pGNAndSPN/8895?type=PGN)";
CM_ BO_ 2566507008  "Source: isobus.net VDMA Data Dictionary (https://www.isobus.net/isobus/pGNAndSPN/8899?type=PGN)";
CM_ BO_ 2566507264  "Source: isobus.net VDMA Data Dictionary (https://www.isobus.net/isobus/pGNAndSPN/8903?type=PGN)";
CM_ BO_ 2566507520  "Source: isobus.net VDMA Data Dictionary (https://www.isobus.net/isobus/pGNAndSPN/8907?type=PGN)";
CM_ BO_ 2566507776  "Source: isobus.net VDMA Data Dictionary (https://www.isobus.net/isobus/pGNAndSPN/8909?type=PGN)";
CM_ BO_ 2566508032  "Source: isobus.net VDMA Data Dictionary (https://www.isobus.net/isobus/pGNAndSPN/8911?type=PGN)";
CM_ BO_ 2566508288  "Source: isobus.net VDMA Data Dictionary (https://www.isobus.net/isobus/pGNAndSPN/8915?type=PGN)";
CM_ BO_ 2566508544  "Source: isobus.net VDMA Data Dictionary (https://www.isobus.net/isobus/pGNAndSPN/8919?type=PGN)";
CM_ BO_ 2566508800  "Source: isobus.net VDMA Data Dictionary (https://www.isobus.net/isobus/pGNAndSPN/8923?type=PGN)";
CM_ BO_ 2566509056  "Source: isobus.net VDMA Data Dictionary (https://www.isobus.net/isobus/pGNAndSPN/8927?type=PGN)";
CM_ BO_ 2566509312  "Source: isobus.net VDMA Data Dictionary (https://www.isobus.net/isobus/pGNAndSPN/8931?type=PGN)";
CM_ BO_ 2566509568  "Source: isobus.net VDMA Data Dictionary (https://www.isobus.net/isobus/pGNAndSPN/8937?type=PGN)";
CM_ BO_ 2566509824  "Source: isobus.net VDMA Data Dictionary (https://www.isobus.net/isobus/pGNAndSPN/8945?type=PGN)";
CM_ BO_ 2566510080  "Source: isobus.net VDMA Data Dictionary (https://www.isobus.net/isobus/pGNAndSPN/8964?type=PGN)";
CM_ BO_ 2566510336  "Source: isobus.net VDMA Data Dictionary (https://www.isobus.net/isobus/pGNAndSPN/8991?type=PGN)";
CM_ BO_ 2566510592  "Source: isobus.net VDMA Data Dictionary (https://www.isobus.net/isobus/pGNAndSPN/9002?type=PGN)";
CM_ BO_ 2566510848  "Source: isobus.net VDMA Data Dictionary (https://www.isobus.net/isobus/pGNAndSPN/9004?type=PGN)";
CM_ BO_ 2566511104  "Source: isobus.net VDMA Data Dictionary (https://www.isobus.net/isobus/pGNAndSPN/9008?type=PGN)";
CM_ BO_ 2566511360  "Source: isobus.net VDMA Data Dictionary (https://www.isobus.net/isobus/pGNAndSPN/9012?type=PGN)";
CM_ BO_ 2566511616  "Source: isobus.net VDMA Data Dictionary (https://www.isobus.net/isobus/pGNAndSPN/9016?type=PGN)";
CM_ BO_ 2566511872  "Source: isobus.net VDMA Data Dictionary (https://www.isobus.net/isobus/pGNAndSPN/9020?type=PGN)";
CM_ BO_ 2566512128  "Source: isobus.net VDMA Data Dictionary (https://www.isobus.net/isobus/pGNAndSPN/9024?type=PGN)";
CM_ BO_ 2566512384  "Source: isobus.net VDMA Data Dictionary (https://www.isobus.net/isobus/pGNAndSPN/9032?type=PGN)";
CM_ BO_ 2566512640  "Source: isobus.net VDMA Data Dictionary (https://www.isobus.net/isobus/pGNAndSPN/9039?type=PGN)";
CM_ BO_ 2566512896  "Source: isobus.net VDMA Data Dictionary (https://www.isobus.net/isobus/pGNAndSPN/9047?type=PGN)";
CM_ BO_ 2566513152  "Source: isobus.net VDMA Data Dictionary (https://www.isobus.net/isobus/pGNAndSPN/9054?type=PGN)";
CM_ BO_ 2566513408  "Source: isobus.net VDMA Data Dictionary (https://www.isobus.net/isobus/pGNAndSPN/9058?type=PGN)";
CM_ BO_ 2566513664  "Source: isobus.net VDMA Data Dictionary (https://www.isobus.net/isobus/pGNAndSPN/9061?type=PGN)";
CM_ BO_ 2566513920  "Source: isobus.net VDMA Data Dictionary (https://www.isobus.net/isobus/pGNAndSPN/9064?type=PGN)";
CM_ BO_ 2566514176  "Source: isobus.net VDMA Data Dictionary (https://www.isobus.net/isobus/pGNAndSPN/9067?type=PGN)";
CM_ BO_ 2566514432  "Source: isobus.net VDMA Data Dictionary (https://www.isobus.net/isobus/pGNAndSPN/9073?type=PGN)";
CM_ BO_ 2566514688  "Source: isobus.net VDMA Data Dictionary (https://www.isobus.net/isobus/pGNAndSPN/9080?type=PGN)";
CM_ BO_ 2566514944  "Source: isobus.net VDMA Data Dictionary (https://www.isobus.net/isobus/pGNAndSPN/9082?type=PGN)";
CM_ BO_ 2566515200  "Source: isobus.net VDMA Data Dictionary (https://www.isobus.net/isobus/pGNAndSPN/9088?type=PGN)";
CM_ BO_ 2566515456  "Source: isobus.net VDMA Data Dictionary (https://www.isobus.net/isobus/pGNAndSPN/9098?type=PGN)";
CM_ BO_ 2566515712  "Source: isobus.net VDMA Data Dictionary (https://www.isobus.net/isobus/pGNAndSPN/9108?type=PGN)";
CM_ BO_ 2566515968  "Source: isobus.net VDMA Data Dictionary (https://www.isobus.net/isobus/pGNAndSPN/9109?type=PGN)";
CM_ BO_ 2566516224  "Source: isobus.net VDMA Data Dictionary (https://www.isobus.net/isobus/pGNAndSPN/9113?type=PGN)";
CM_ BO_ 2566516480  "Source: isobus.net VDMA Data Dictionary (https://www.isobus.net/isobus/pGNAndSPN/9117?type=PGN)";
CM_ BO_ 2566516736  "Source: isobus.net VDMA Data Dictionary (https://www.isobus.net/isobus/pGNAndSPN/9121?type=PGN)";
CM_ SG_ 2566053120 High_Voltage_Energy_Storage_Pack "Generic 8-byte raw payload. Detail page: https://www.isobus.net/isobus/pGNAndSPN/6645?type=PGN. Signal-level enrichment via PR welcome  see CONTRIBUTING.md.";
CM_ SG_ 2566053376 High_Voltage_Energy_Storage_Pack "Generic 8-byte raw payload. Detail page: https://www.isobus.net/isobus/pGNAndSPN/6651?type=PGN. Signal-level enrichment via PR welcome  see CONTRIBUTING.md.";
CM_ SG_ 2566053632 High_Voltage_Energy_Storage_Pack "Generic 8-byte raw payload. Detail page: https://www.isobus.net/isobus/pGNAndSPN/6668?type=PGN. Signal-level enrichment via PR welcome  see CONTRIBUTING.md.";
CM_ SG_ 2566053888 High_Voltage_Energy_Storage_Pack "Generic 8-byte raw payload. Detail page: https://www.isobus.net/isobus/pGNAndSPN/6671?type=PGN. Signal-level enrichment via PR welcome  see CONTRIBUTING.md.";
CM_ SG_ 2566054144 High_Voltage_Energy_Storage_Pack "Generic 8-byte raw payload. Detail page: https://www.isobus.net/isobus/pGNAndSPN/6703?type=PGN. Signal-level enrichment via PR welcome  see CONTRIBUTING.md.";
CM_ SG_ 2566054400 High_Voltage_Energy_Storage_Pack "Generic 8-byte raw payload. Detail page: https://www.isobus.net/isobus/pGNAndSPN/6711?type=PGN. Signal-level enrichment via PR welcome  see CONTRIBUTING.md.";
CM_ SG_ 2566054656 High_Voltage_Energy_Storage_Pack "Generic 8-byte raw payload. Detail page: https://www.isobus.net/isobus/pGNAndSPN/6716?type=PGN. Signal-level enrichment via PR welcome  see CONTRIBUTING.md.";
CM_ SG_ 2566054912 High_Voltage_Energy_Storage_Pack "Generic 8-byte raw payload. Detail page: https://www.isobus.net/isobus/pGNAndSPN/6724?type=PGN. Signal-level enrichment via PR welcome  see CONTRIBUTING.md.";
CM_ SG_ 2566055168 High_Voltage_Energy_Storage_Pack "Generic 8-byte raw payload. Detail page: https://www.isobus.net/isobus/pGNAndSPN/6730?type=PGN. Signal-level enrichment via PR welcome  see CONTRIBUTING.md.";
CM_ SG_ 2566055424 High_Voltage_Energy_Storage_Pack "Generic 8-byte raw payload. Detail page: https://www.isobus.net/isobus/pGNAndSPN/6733?type=PGN. Signal-level enrichment via PR welcome  see CONTRIBUTING.md.";
CM_ SG_ 2566055680 High_Voltage_Energy_Storage_Pack "Generic 8-byte raw payload. Detail page: https://www.isobus.net/isobus/pGNAndSPN/6745?type=PGN. Signal-level enrichment via PR welcome  see CONTRIBUTING.md.";
CM_ SG_ 2566055936 High_Voltage_Energy_Storage_Pack "Generic 8-byte raw payload. Detail page: https://www.isobus.net/isobus/pGNAndSPN/6749?type=PGN. Signal-level enrichment via PR welcome  see CONTRIBUTING.md.";
CM_ SG_ 2566056192 High_Voltage_Energy_Storage_Pack "Generic 8-byte raw payload. Detail page: https://www.isobus.net/isobus/pGNAndSPN/6753?type=PGN. Signal-level enrichment via PR welcome  see CONTRIBUTING.md.";
CM_ SG_ 2566056448 High_Voltage_Energy_Storage_Pack "Generic 8-byte raw payload. Detail page: https://www.isobus.net/isobus/pGNAndSPN/6757?type=PGN. Signal-level enrichment via PR welcome  see CONTRIBUTING.md.";
CM_ SG_ 2566056704 High_Voltage_Energy_Storage_Pack "Generic 8-byte raw payload. Detail page: https://www.isobus.net/isobus/pGNAndSPN/6760?type=PGN. Signal-level enrichment via PR welcome  see CONTRIBUTING.md.";
CM_ SG_ 2566056960 High_Voltage_Energy_Storage_Pack "Generic 8-byte raw payload. Detail page: https://www.isobus.net/isobus/pGNAndSPN/6764?type=PGN. Signal-level enrichment via PR welcome  see CONTRIBUTING.md.";
CM_ SG_ 2566057216 High_Voltage_Energy_Storage_Pack "Generic 8-byte raw payload. Detail page: https://www.isobus.net/isobus/pGNAndSPN/6770?type=PGN. Signal-level enrichment via PR welcome  see CONTRIBUTING.md.";
CM_ SG_ 2566057472 High_Voltage_Energy_Storage_Pack "Generic 8-byte raw payload. Detail page: https://www.isobus.net/isobus/pGNAndSPN/6787?type=PGN. Signal-level enrichment via PR welcome  see CONTRIBUTING.md.";
CM_ SG_ 2566057728 High_Voltage_Energy_Storage_Pack "Generic 8-byte raw payload. Detail page: https://www.isobus.net/isobus/pGNAndSPN/6790?type=PGN. Signal-level enrichment via PR welcome  see CONTRIBUTING.md.";
CM_ SG_ 2566057984 High_Voltage_Energy_Storage_Pack "Generic 8-byte raw payload. Detail page: https://www.isobus.net/isobus/pGNAndSPN/6822?type=PGN. Signal-level enrichment via PR welcome  see CONTRIBUTING.md.";
CM_ SG_ 2566058240 High_Voltage_Energy_Storage_Pack "Generic 8-byte raw payload. Detail page: https://www.isobus.net/isobus/pGNAndSPN/6830?type=PGN. Signal-level enrichment via PR welcome  see CONTRIBUTING.md.";
CM_ SG_ 2566058496 High_Voltage_Energy_Storage_Pack "Generic 8-byte raw payload. Detail page: https://www.isobus.net/isobus/pGNAndSPN/6835?type=PGN. Signal-level enrichment via PR welcome  see CONTRIBUTING.md.";
CM_ SG_ 2566058752 High_Voltage_Energy_Storage_Pack "Generic 8-byte raw payload. Detail page: https://www.isobus.net/isobus/pGNAndSPN/6843?type=PGN. Signal-level enrichment via PR welcome  see CONTRIBUTING.md.";
CM_ SG_ 2566059008 High_Voltage_Energy_Storage_Pack "Generic 8-byte raw payload. Detail page: https://www.isobus.net/isobus/pGNAndSPN/6849?type=PGN. Signal-level enrichment via PR welcome  see CONTRIBUTING.md.";
CM_ SG_ 2566059264 High_Voltage_Energy_Storage_Pack "Generic 8-byte raw payload. Detail page: https://www.isobus.net/isobus/pGNAndSPN/6852?type=PGN. Signal-level enrichment via PR welcome  see CONTRIBUTING.md.";
CM_ SG_ 2566059520 High_Voltage_Energy_Storage_Pack "Generic 8-byte raw payload. Detail page: https://www.isobus.net/isobus/pGNAndSPN/6864?type=PGN. Signal-level enrichment via PR welcome  see CONTRIBUTING.md.";
CM_ SG_ 2566059776 High_Voltage_Energy_Storage_Pack "Generic 8-byte raw payload. Detail page: https://www.isobus.net/isobus/pGNAndSPN/6868?type=PGN. Signal-level enrichment via PR welcome  see CONTRIBUTING.md.";
CM_ SG_ 2566060032 High_Voltage_Energy_Storage_Pack "Generic 8-byte raw payload. Detail page: https://www.isobus.net/isobus/pGNAndSPN/6872?type=PGN. Signal-level enrichment via PR welcome  see CONTRIBUTING.md.";
CM_ SG_ 2566060288 High_Voltage_Energy_Storage_Pack "Generic 8-byte raw payload. Detail page: https://www.isobus.net/isobus/pGNAndSPN/6876?type=PGN. Signal-level enrichment via PR welcome  see CONTRIBUTING.md.";
CM_ SG_ 2566060544 High_Voltage_Energy_Storage_Pack "Generic 8-byte raw payload. Detail page: https://www.isobus.net/isobus/pGNAndSPN/6879?type=PGN. Signal-level enrichment via PR welcome  see CONTRIBUTING.md.";
CM_ SG_ 2566060800 High_Voltage_Energy_Storage_Pack "Generic 8-byte raw payload. Detail page: https://www.isobus.net/isobus/pGNAndSPN/6883?type=PGN. Signal-level enrichment via PR welcome  see CONTRIBUTING.md.";
CM_ SG_ 2566061056 High_Voltage_Energy_Storage_Pack "Generic 8-byte raw payload. Detail page: https://www.isobus.net/isobus/pGNAndSPN/6889?type=PGN. Signal-level enrichment via PR welcome  see CONTRIBUTING.md.";
CM_ SG_ 2566061312 High_Voltage_Energy_Storage_Pack "Generic 8-byte raw payload. Detail page: https://www.isobus.net/isobus/pGNAndSPN/6906?type=PGN. Signal-level enrichment via PR welcome  see CONTRIBUTING.md.";
CM_ SG_ 2566061568 High_Voltage_Energy_Storage_Pack "Generic 8-byte raw payload. Detail page: https://www.isobus.net/isobus/pGNAndSPN/6909?type=PGN. Signal-level enrichment via PR welcome  see CONTRIBUTING.md.";
CM_ SG_ 2566061824 High_Voltage_Energy_Storage_Pack "Generic 8-byte raw payload. Detail page: https://www.isobus.net/isobus/pGNAndSPN/6941?type=PGN. Signal-level enrichment via PR welcome  see CONTRIBUTING.md.";
CM_ SG_ 2566062080 High_Voltage_Energy_Storage_Pack "Generic 8-byte raw payload. Detail page: https://www.isobus.net/isobus/pGNAndSPN/6949?type=PGN. Signal-level enrichment via PR welcome  see CONTRIBUTING.md.";
CM_ SG_ 2566062336 High_Voltage_Energy_Storage_Pack "Generic 8-byte raw payload. Detail page: https://www.isobus.net/isobus/pGNAndSPN/6954?type=PGN. Signal-level enrichment via PR welcome  see CONTRIBUTING.md.";
CM_ SG_ 2566062592 High_Voltage_Energy_Storage_Pack "Generic 8-byte raw payload. Detail page: https://www.isobus.net/isobus/pGNAndSPN/6962?type=PGN. Signal-level enrichment via PR welcome  see CONTRIBUTING.md.";
CM_ SG_ 2566062848 High_Voltage_Energy_Storage_Pack "Generic 8-byte raw payload. Detail page: https://www.isobus.net/isobus/pGNAndSPN/6968?type=PGN. Signal-level enrichment via PR welcome  see CONTRIBUTING.md.";
CM_ SG_ 2566063104 High_Voltage_Energy_Storage_Pack "Generic 8-byte raw payload. Detail page: https://www.isobus.net/isobus/pGNAndSPN/6971?type=PGN. Signal-level enrichment via PR welcome  see CONTRIBUTING.md.";
CM_ SG_ 2566063360 High_Voltage_Energy_Storage_Pack "Generic 8-byte raw payload. Detail page: https://www.isobus.net/isobus/pGNAndSPN/6983?type=PGN. Signal-level enrichment via PR welcome  see CONTRIBUTING.md.";
CM_ SG_ 2566063616 High_Voltage_Energy_Storage_Pack "Generic 8-byte raw payload. Detail page: https://www.isobus.net/isobus/pGNAndSPN/6987?type=PGN. Signal-level enrichment via PR welcome  see CONTRIBUTING.md.";
CM_ SG_ 2566063872 High_Voltage_Energy_Storage_Pack "Generic 8-byte raw payload. Detail page: https://www.isobus.net/isobus/pGNAndSPN/6991?type=PGN. Signal-level enrichment via PR welcome  see CONTRIBUTING.md.";
CM_ SG_ 2566064128 High_Voltage_Energy_Storage_Pack "Generic 8-byte raw payload. Detail page: https://www.isobus.net/isobus/pGNAndSPN/6995?type=PGN. Signal-level enrichment via PR welcome  see CONTRIBUTING.md.";
CM_ SG_ 2566064384 High_Voltage_Energy_Storage_Pack "Generic 8-byte raw payload. Detail page: https://www.isobus.net/isobus/pGNAndSPN/6998?type=PGN. Signal-level enrichment via PR welcome  see CONTRIBUTING.md.";
CM_ SG_ 2566064640 High_Voltage_Energy_Storage_Pack "Generic 8-byte raw payload. Detail page: https://www.isobus.net/isobus/pGNAndSPN/7002?type=PGN. Signal-level enrichment via PR welcome  see CONTRIBUTING.md.";
CM_ SG_ 2566064896 High_Voltage_Energy_Storage_Pack "Generic 8-byte raw payload. Detail page: https://www.isobus.net/isobus/pGNAndSPN/7008?type=PGN. Signal-level enrichment via PR welcome  see CONTRIBUTING.md.";
CM_ SG_ 2566065152 High_Voltage_Energy_Storage_Pack "Generic 8-byte raw payload. Detail page: https://www.isobus.net/isobus/pGNAndSPN/7025?type=PGN. Signal-level enrichment via PR welcome  see CONTRIBUTING.md.";
CM_ SG_ 2566065408 High_Voltage_Energy_Storage_Pack "Generic 8-byte raw payload. Detail page: https://www.isobus.net/isobus/pGNAndSPN/7028?type=PGN. Signal-level enrichment via PR welcome  see CONTRIBUTING.md.";
CM_ SG_ 2566065664 High_Voltage_Energy_Storage_Pack "Generic 8-byte raw payload. Detail page: https://www.isobus.net/isobus/pGNAndSPN/7060?type=PGN. Signal-level enrichment via PR welcome  see CONTRIBUTING.md.";
CM_ SG_ 2566065920 High_Voltage_Energy_Storage_Pack "Generic 8-byte raw payload. Detail page: https://www.isobus.net/isobus/pGNAndSPN/7068?type=PGN. Signal-level enrichment via PR welcome  see CONTRIBUTING.md.";
CM_ SG_ 2566066176 High_Voltage_Energy_Storage_Pack "Generic 8-byte raw payload. Detail page: https://www.isobus.net/isobus/pGNAndSPN/7073?type=PGN. Signal-level enrichment via PR welcome  see CONTRIBUTING.md.";
CM_ SG_ 2566066432 High_Voltage_Energy_Storage_Pack "Generic 8-byte raw payload. Detail page: https://www.isobus.net/isobus/pGNAndSPN/7081?type=PGN. Signal-level enrichment via PR welcome  see CONTRIBUTING.md.";
CM_ SG_ 2566066688 High_Voltage_Energy_Storage_Pack "Generic 8-byte raw payload. Detail page: https://www.isobus.net/isobus/pGNAndSPN/7087?type=PGN. Signal-level enrichment via PR welcome  see CONTRIBUTING.md.";
CM_ SG_ 2566066944 High_Voltage_Energy_Storage_Pack "Generic 8-byte raw payload. Detail page: https://www.isobus.net/isobus/pGNAndSPN/7090?type=PGN. Signal-level enrichment via PR welcome  see CONTRIBUTING.md.";
CM_ SG_ 2566067200 High_Voltage_Energy_Storage_Pack "Generic 8-byte raw payload. Detail page: https://www.isobus.net/isobus/pGNAndSPN/7102?type=PGN. Signal-level enrichment via PR welcome  see CONTRIBUTING.md.";
CM_ SG_ 2566067456 High_Voltage_Energy_Storage_Pack "Generic 8-byte raw payload. Detail page: https://www.isobus.net/isobus/pGNAndSPN/7106?type=PGN. Signal-level enrichment via PR welcome  see CONTRIBUTING.md.";
CM_ SG_ 2566067712 High_Voltage_Energy_Storage_Pack "Generic 8-byte raw payload. Detail page: https://www.isobus.net/isobus/pGNAndSPN/7110?type=PGN. Signal-level enrichment via PR welcome  see CONTRIBUTING.md.";
CM_ SG_ 2566067968 High_Voltage_Energy_Storage_Pack "Generic 8-byte raw payload. Detail page: https://www.isobus.net/isobus/pGNAndSPN/7114?type=PGN. Signal-level enrichment via PR welcome  see CONTRIBUTING.md.";
CM_ SG_ 2566068224 High_Voltage_Energy_Storage_Pack "Generic 8-byte raw payload. Detail page: https://www.isobus.net/isobus/pGNAndSPN/7117?type=PGN. Signal-level enrichment via PR welcome  see CONTRIBUTING.md.";
CM_ SG_ 2566068480 High_Voltage_Energy_Storage_Pack "Generic 8-byte raw payload. Detail page: https://www.isobus.net/isobus/pGNAndSPN/7121?type=PGN. Signal-level enrichment via PR welcome  see CONTRIBUTING.md.";
CM_ SG_ 2566068736 High_Voltage_Energy_Storage_Pack "Generic 8-byte raw payload. Detail page: https://www.isobus.net/isobus/pGNAndSPN/7127?type=PGN. Signal-level enrichment via PR welcome  see CONTRIBUTING.md.";
CM_ SG_ 2566068992 High_Voltage_Energy_Storage_Pack "Generic 8-byte raw payload. Detail page: https://www.isobus.net/isobus/pGNAndSPN/7144?type=PGN. Signal-level enrichment via PR welcome  see CONTRIBUTING.md.";
CM_ SG_ 2566069248 High_Voltage_Energy_Storage_Pack "Generic 8-byte raw payload. Detail page: https://www.isobus.net/isobus/pGNAndSPN/7147?type=PGN. Signal-level enrichment via PR welcome  see CONTRIBUTING.md.";
CM_ SG_ 2566069504 High_Voltage_Energy_Storage_Pack "Generic 8-byte raw payload. Detail page: https://www.isobus.net/isobus/pGNAndSPN/7179?type=PGN. Signal-level enrichment via PR welcome  see CONTRIBUTING.md.";
CM_ SG_ 2566069760 High_Voltage_Energy_Storage_Pack "Generic 8-byte raw payload. Detail page: https://www.isobus.net/isobus/pGNAndSPN/7187?type=PGN. Signal-level enrichment via PR welcome  see CONTRIBUTING.md.";
CM_ SG_ 2566070016 High_Voltage_Energy_Storage_Pack "Generic 8-byte raw payload. Detail page: https://www.isobus.net/isobus/pGNAndSPN/7192?type=PGN. Signal-level enrichment via PR welcome  see CONTRIBUTING.md.";
CM_ SG_ 2566070272 High_Voltage_Energy_Storage_Pack "Generic 8-byte raw payload. Detail page: https://www.isobus.net/isobus/pGNAndSPN/7200?type=PGN. Signal-level enrichment via PR welcome  see CONTRIBUTING.md.";
CM_ SG_ 2566070528 High_Voltage_Energy_Storage_Pack "Generic 8-byte raw payload. Detail page: https://www.isobus.net/isobus/pGNAndSPN/7206?type=PGN. Signal-level enrichment via PR welcome  see CONTRIBUTING.md.";
CM_ SG_ 2566070784 High_Voltage_Energy_Storage_Pack "Generic 8-byte raw payload. Detail page: https://www.isobus.net/isobus/pGNAndSPN/7209?type=PGN. Signal-level enrichment via PR welcome  see CONTRIBUTING.md.";
CM_ SG_ 2566071040 High_Voltage_Energy_Storage_Pack "Generic 8-byte raw payload. Detail page: https://www.isobus.net/isobus/pGNAndSPN/7221?type=PGN. Signal-level enrichment via PR welcome  see CONTRIBUTING.md.";
CM_ SG_ 2566071296 High_Voltage_Energy_Storage_Pack "Generic 8-byte raw payload. Detail page: https://www.isobus.net/isobus/pGNAndSPN/7225?type=PGN. Signal-level enrichment via PR welcome  see CONTRIBUTING.md.";
CM_ SG_ 2566071552 High_Voltage_Energy_Storage_Pack "Generic 8-byte raw payload. Detail page: https://www.isobus.net/isobus/pGNAndSPN/7229?type=PGN. Signal-level enrichment via PR welcome  see CONTRIBUTING.md.";
CM_ SG_ 2566071808 High_Voltage_Energy_Storage_Pack "Generic 8-byte raw payload. Detail page: https://www.isobus.net/isobus/pGNAndSPN/7233?type=PGN. Signal-level enrichment via PR welcome  see CONTRIBUTING.md.";
CM_ SG_ 2566072064 High_Voltage_Energy_Storage_Pack "Generic 8-byte raw payload. Detail page: https://www.isobus.net/isobus/pGNAndSPN/7236?type=PGN. Signal-level enrichment via PR welcome  see CONTRIBUTING.md.";
CM_ SG_ 2566072320 High_Voltage_Energy_Storage_Pack "Generic 8-byte raw payload. Detail page: https://www.isobus.net/isobus/pGNAndSPN/7240?type=PGN. Signal-level enrichment via PR welcome  see CONTRIBUTING.md.";
CM_ SG_ 2566072576 High_Voltage_Energy_Storage_Pack "Generic 8-byte raw payload. Detail page: https://www.isobus.net/isobus/pGNAndSPN/7246?type=PGN. Signal-level enrichment via PR welcome  see CONTRIBUTING.md.";
CM_ SG_ 2566072832 High_Voltage_Energy_Storage_Pack "Generic 8-byte raw payload. Detail page: https://www.isobus.net/isobus/pGNAndSPN/7263?type=PGN. Signal-level enrichment via PR welcome  see CONTRIBUTING.md.";
CM_ SG_ 2566073088 High_Voltage_Energy_Storage_Pack "Generic 8-byte raw payload. Detail page: https://www.isobus.net/isobus/pGNAndSPN/7266?type=PGN. Signal-level enrichment via PR welcome  see CONTRIBUTING.md.";
CM_ SG_ 2566073344 High_Voltage_Energy_Storage_Pack "Generic 8-byte raw payload. Detail page: https://www.isobus.net/isobus/pGNAndSPN/7298?type=PGN. Signal-level enrichment via PR welcome  see CONTRIBUTING.md.";
CM_ SG_ 2566073600 High_Voltage_Energy_Storage_Pack "Generic 8-byte raw payload. Detail page: https://www.isobus.net/isobus/pGNAndSPN/7306?type=PGN. Signal-level enrichment via PR welcome  see CONTRIBUTING.md.";
CM_ SG_ 2566073856 High_Voltage_Energy_Storage_Pack "Generic 8-byte raw payload. Detail page: https://www.isobus.net/isobus/pGNAndSPN/7311?type=PGN. Signal-level enrichment via PR welcome  see CONTRIBUTING.md.";
CM_ SG_ 2566074112 High_Voltage_Energy_Storage_Pack "Generic 8-byte raw payload. Detail page: https://www.isobus.net/isobus/pGNAndSPN/7319?type=PGN. Signal-level enrichment via PR welcome  see CONTRIBUTING.md.";
CM_ SG_ 2566074368 High_Voltage_Energy_Storage_Pack "Generic 8-byte raw payload. Detail page: https://www.isobus.net/isobus/pGNAndSPN/7325?type=PGN. Signal-level enrichment via PR welcome  see CONTRIBUTING.md.";
CM_ SG_ 2566074624 High_Voltage_Energy_Storage_Pack "Generic 8-byte raw payload. Detail page: https://www.isobus.net/isobus/pGNAndSPN/7328?type=PGN. Signal-level enrichment via PR welcome  see CONTRIBUTING.md.";
CM_ SG_ 2566074880 High_Voltage_Energy_Storage_Pack "Generic 8-byte raw payload. Detail page: https://www.isobus.net/isobus/pGNAndSPN/7340?type=PGN. Signal-level enrichment via PR welcome  see CONTRIBUTING.md.";
CM_ SG_ 2566075136 High_Voltage_Energy_Storage_Pack "Generic 8-byte raw payload. Detail page: https://www.isobus.net/isobus/pGNAndSPN/7344?type=PGN. Signal-level enrichment via PR welcome  see CONTRIBUTING.md.";
CM_ SG_ 2566075392 High_Voltage_Energy_Storage_Pack "Generic 8-byte raw payload. Detail page: https://www.isobus.net/isobus/pGNAndSPN/7348?type=PGN. Signal-level enrichment via PR welcome  see CONTRIBUTING.md.";
CM_ SG_ 2566075648 High_Voltage_Energy_Storage_Pack "Generic 8-byte raw payload. Detail page: https://www.isobus.net/isobus/pGNAndSPN/7352?type=PGN. Signal-level enrichment via PR welcome  see CONTRIBUTING.md.";
CM_ SG_ 2566075904 High_Voltage_Energy_Storage_Pack "Generic 8-byte raw payload. Detail page: https://www.isobus.net/isobus/pGNAndSPN/7355?type=PGN. Signal-level enrichment via PR welcome  see CONTRIBUTING.md.";
CM_ SG_ 2566076160 High_Voltage_Energy_Storage_Pack "Generic 8-byte raw payload. Detail page: https://www.isobus.net/isobus/pGNAndSPN/7359?type=PGN. Signal-level enrichment via PR welcome  see CONTRIBUTING.md.";
CM_ SG_ 2566076416 High_Voltage_Energy_Storage_Pack "Generic 8-byte raw payload. Detail page: https://www.isobus.net/isobus/pGNAndSPN/7365?type=PGN. Signal-level enrichment via PR welcome  see CONTRIBUTING.md.";
CM_ SG_ 2566076672 High_Voltage_Energy_Storage_Pack "Generic 8-byte raw payload. Detail page: https://www.isobus.net/isobus/pGNAndSPN/7382?type=PGN. Signal-level enrichment via PR welcome  see CONTRIBUTING.md.";
CM_ SG_ 2566076928 High_Voltage_Energy_Storage_Pack "Generic 8-byte raw payload. Detail page: https://www.isobus.net/isobus/pGNAndSPN/7385?type=PGN. Signal-level enrichment via PR welcome  see CONTRIBUTING.md.";
CM_ SG_ 2566077184 High_Voltage_Energy_Storage_Pack "Generic 8-byte raw payload. Detail page: https://www.isobus.net/isobus/pGNAndSPN/7417?type=PGN. Signal-level enrichment via PR welcome  see CONTRIBUTING.md.";
CM_ SG_ 2566077440 High_Voltage_Energy_Storage_Pack "Generic 8-byte raw payload. Detail page: https://www.isobus.net/isobus/pGNAndSPN/7425?type=PGN. Signal-level enrichment via PR welcome  see CONTRIBUTING.md.";
CM_ SG_ 2566077696 High_Voltage_Energy_Storage_Pack "Generic 8-byte raw payload. Detail page: https://www.isobus.net/isobus/pGNAndSPN/7430?type=PGN. Signal-level enrichment via PR welcome  see CONTRIBUTING.md.";
CM_ SG_ 2566077952 High_Voltage_Energy_Storage_Pack "Generic 8-byte raw payload. Detail page: https://www.isobus.net/isobus/pGNAndSPN/7438?type=PGN. Signal-level enrichment via PR welcome  see CONTRIBUTING.md.";
CM_ SG_ 2566078208 High_Voltage_Energy_Storage_Pack "Generic 8-byte raw payload. Detail page: https://www.isobus.net/isobus/pGNAndSPN/7444?type=PGN. Signal-level enrichment via PR welcome  see CONTRIBUTING.md.";
CM_ SG_ 2566078464 High_Voltage_Energy_Storage_Pack "Generic 8-byte raw payload. Detail page: https://www.isobus.net/isobus/pGNAndSPN/7447?type=PGN. Signal-level enrichment via PR welcome  see CONTRIBUTING.md.";
CM_ SG_ 2566078720 External_Steering_Request_RawPay "Generic 8-byte raw payload. Detail page: https://www.isobus.net/isobus/pGNAndSPN/7453?type=PGN. Signal-level enrichment via PR welcome  see CONTRIBUTING.md.";
CM_ SG_ 2566078976 Active_Steering_System_Controlle "Generic 8-byte raw payload. Detail page: https://www.isobus.net/isobus/pGNAndSPN/7463?type=PGN. Signal-level enrichment via PR welcome  see CONTRIBUTING.md.";
CM_ SG_ 2566079232 Electronic_Park_Brake_Controller "Generic 8-byte raw payload. Detail page: https://www.isobus.net/isobus/pGNAndSPN/7479?type=PGN. Signal-level enrichment via PR welcome  see CONTRIBUTING.md.";
CM_ SG_ 2566079488 Electronic_Park_Brake_Controller "Generic 8-byte raw payload. Detail page: https://www.isobus.net/isobus/pGNAndSPN/7493?type=PGN. Signal-level enrichment via PR welcome  see CONTRIBUTING.md.";
CM_ SG_ 2566079744 Genset_Frequency_Limitation_RawP "Generic 8-byte raw payload. Detail page: https://www.isobus.net/isobus/pGNAndSPN/7502?type=PGN. Signal-level enrichment via PR welcome  see CONTRIBUTING.md.";
CM_ SG_ 2566080000 Genset_Power_Limitation_RawPaylo "Generic 8-byte raw payload. Detail page: https://www.isobus.net/isobus/pGNAndSPN/7512?type=PGN. Signal-level enrichment via PR welcome  see CONTRIBUTING.md.";
CM_ SG_ 2566080256 Genset_Real_Power_Control_RawPay "Generic 8-byte raw payload. Detail page: https://www.isobus.net/isobus/pGNAndSPN/7520?type=PGN. Signal-level enrichment via PR welcome  see CONTRIBUTING.md.";
CM_ SG_ 2566080512 Genset_Reactive_Power_RawPayload "Generic 8-byte raw payload. Detail page: https://www.isobus.net/isobus/pGNAndSPN/7532?type=PGN. Signal-level enrichment via PR welcome  see CONTRIBUTING.md.";
CM_ SG_ 2566080768 Fuel_Cell_Compartment_Informatio "Generic 8-byte raw payload. Detail page: https://www.isobus.net/isobus/pGNAndSPN/7535?type=PGN. Signal-level enrichment via PR welcome  see CONTRIBUTING.md.";
CM_ SG_ 2566081024 Genset_Real_Power_Setpoint_Deman "Generic 8-byte raw payload. Detail page: https://www.isobus.net/isobus/pGNAndSPN/7542?type=PGN. Signal-level enrichment via PR welcome  see CONTRIBUTING.md.";
CM_ SG_ 2566081280 Genset_Real_Power_Control_2_RawP "Generic 8-byte raw payload. Detail page: https://www.isobus.net/isobus/pGNAndSPN/7553?type=PGN. Signal-level enrichment via PR welcome  see CONTRIBUTING.md.";
CM_ SG_ 2566081536 High_Voltage_Energy_Storage_Pack "Generic 8-byte raw payload. Detail page: https://www.isobus.net/isobus/pGNAndSPN/7557?type=PGN. Signal-level enrichment via PR welcome  see CONTRIBUTING.md.";
CM_ SG_ 2566081792 High_Voltage_Energy_Storage_Pack "Generic 8-byte raw payload. Detail page: https://www.isobus.net/isobus/pGNAndSPN/7561?type=PGN. Signal-level enrichment via PR welcome  see CONTRIBUTING.md.";
CM_ SG_ 2566082048 High_Voltage_Energy_Storage_Pack "Generic 8-byte raw payload. Detail page: https://www.isobus.net/isobus/pGNAndSPN/7565?type=PGN. Signal-level enrichment via PR welcome  see CONTRIBUTING.md.";
CM_ SG_ 2566082304 High_Voltage_Energy_Storage_Pack "Generic 8-byte raw payload. Detail page: https://www.isobus.net/isobus/pGNAndSPN/7569?type=PGN. Signal-level enrichment via PR welcome  see CONTRIBUTING.md.";
CM_ SG_ 2566082560 High_Voltage_Energy_Storage_Pack "Generic 8-byte raw payload. Detail page: https://www.isobus.net/isobus/pGNAndSPN/7573?type=PGN. Signal-level enrichment via PR welcome  see CONTRIBUTING.md.";
CM_ SG_ 2566082816 High_Voltage_Energy_Storage_Pack "Generic 8-byte raw payload. Detail page: https://www.isobus.net/isobus/pGNAndSPN/7577?type=PGN. Signal-level enrichment via PR welcome  see CONTRIBUTING.md.";
CM_ SG_ 2566083072 High_Voltage_Energy_Storage_Pack "Generic 8-byte raw payload. Detail page: https://www.isobus.net/isobus/pGNAndSPN/7581?type=PGN. Signal-level enrichment via PR welcome  see CONTRIBUTING.md.";
CM_ SG_ 2566083328 High_Voltage_Energy_Storage_Pack "Generic 8-byte raw payload. Detail page: https://www.isobus.net/isobus/pGNAndSPN/7585?type=PGN. Signal-level enrichment via PR welcome  see CONTRIBUTING.md.";
CM_ SG_ 2566083584 High_Voltage_Energy_Storage_Pack "Generic 8-byte raw payload. Detail page: https://www.isobus.net/isobus/pGNAndSPN/7589?type=PGN. Signal-level enrichment via PR welcome  see CONTRIBUTING.md.";
CM_ SG_ 2566083840 High_Voltage_Energy_Storage_Pack "Generic 8-byte raw payload. Detail page: https://www.isobus.net/isobus/pGNAndSPN/7593?type=PGN. Signal-level enrichment via PR welcome  see CONTRIBUTING.md.";
CM_ SG_ 2566084096 High_Voltage_Energy_Storage_Pack "Generic 8-byte raw payload. Detail page: https://www.isobus.net/isobus/pGNAndSPN/7597?type=PGN. Signal-level enrichment via PR welcome  see CONTRIBUTING.md.";
CM_ SG_ 2566084352 High_Voltage_Energy_Storage_Pack "Generic 8-byte raw payload. Detail page: https://www.isobus.net/isobus/pGNAndSPN/7601?type=PGN. Signal-level enrichment via PR welcome  see CONTRIBUTING.md.";
CM_ SG_ 2566084608 High_Voltage_Energy_Storage_Pack "Generic 8-byte raw payload. Detail page: https://www.isobus.net/isobus/pGNAndSPN/7605?type=PGN. Signal-level enrichment via PR welcome  see CONTRIBUTING.md.";
CM_ SG_ 2566084864 High_Voltage_Energy_Storage_Pack "Generic 8-byte raw payload. Detail page: https://www.isobus.net/isobus/pGNAndSPN/7609?type=PGN. Signal-level enrichment via PR welcome  see CONTRIBUTING.md.";
CM_ SG_ 2566085120 High_Voltage_Energy_Storage_Pack "Generic 8-byte raw payload. Detail page: https://www.isobus.net/isobus/pGNAndSPN/7613?type=PGN. Signal-level enrichment via PR welcome  see CONTRIBUTING.md.";
CM_ SG_ 2566085376 High_Voltage_Energy_Storage_Pack "Generic 8-byte raw payload. Detail page: https://www.isobus.net/isobus/pGNAndSPN/7617?type=PGN. Signal-level enrichment via PR welcome  see CONTRIBUTING.md.";
CM_ SG_ 2566085632 High_Voltage_Energy_Storage_Pack "Generic 8-byte raw payload. Detail page: https://www.isobus.net/isobus/pGNAndSPN/7621?type=PGN. Signal-level enrichment via PR welcome  see CONTRIBUTING.md.";
CM_ SG_ 2566085888 High_Voltage_Energy_Storage_Pack "Generic 8-byte raw payload. Detail page: https://www.isobus.net/isobus/pGNAndSPN/7625?type=PGN. Signal-level enrichment via PR welcome  see CONTRIBUTING.md.";
CM_ SG_ 2566086144 High_Voltage_Energy_Storage_Pack "Generic 8-byte raw payload. Detail page: https://www.isobus.net/isobus/pGNAndSPN/7629?type=PGN. Signal-level enrichment via PR welcome  see CONTRIBUTING.md.";
CM_ SG_ 2566086400 High_Voltage_Energy_Storage_Pack "Generic 8-byte raw payload. Detail page: https://www.isobus.net/isobus/pGNAndSPN/7633?type=PGN. Signal-level enrichment via PR welcome  see CONTRIBUTING.md.";
CM_ SG_ 2566086656 High_Voltage_Energy_Storage_Pack "Generic 8-byte raw payload. Detail page: https://www.isobus.net/isobus/pGNAndSPN/7637?type=PGN. Signal-level enrichment via PR welcome  see CONTRIBUTING.md.";
CM_ SG_ 2566086912 High_Voltage_Energy_Storage_Pack "Generic 8-byte raw payload. Detail page: https://www.isobus.net/isobus/pGNAndSPN/7641?type=PGN. Signal-level enrichment via PR welcome  see CONTRIBUTING.md.";
CM_ SG_ 2566087168 High_Voltage_Energy_Storage_Pack "Generic 8-byte raw payload. Detail page: https://www.isobus.net/isobus/pGNAndSPN/7645?type=PGN. Signal-level enrichment via PR welcome  see CONTRIBUTING.md.";
CM_ SG_ 2566087424 High_Voltage_Energy_Storage_Pack "Generic 8-byte raw payload. Detail page: https://www.isobus.net/isobus/pGNAndSPN/7649?type=PGN. Signal-level enrichment via PR welcome  see CONTRIBUTING.md.";
CM_ SG_ 2566087680 Tracked_Vehicle_Data_RawPayload "Generic 8-byte raw payload. Detail page: https://www.isobus.net/isobus/pGNAndSPN/7651?type=PGN. Signal-level enrichment via PR welcome  see CONTRIBUTING.md.";
CM_ SG_ 2566087936 Electrified_Accessory_Propulsion "Generic 8-byte raw payload. Detail page: https://www.isobus.net/isobus/pGNAndSPN/7656?type=PGN. Signal-level enrichment via PR welcome  see CONTRIBUTING.md.";
CM_ SG_ 2566088192 Electrified_Accessory_Propulsion "Generic 8-byte raw payload. Detail page: https://www.isobus.net/isobus/pGNAndSPN/7661?type=PGN. Signal-level enrichment via PR welcome  see CONTRIBUTING.md.";
CM_ SG_ 2566088448 Electrified_Accessory_Propulsion "Generic 8-byte raw payload. Detail page: https://www.isobus.net/isobus/pGNAndSPN/7666?type=PGN. Signal-level enrichment via PR welcome  see CONTRIBUTING.md.";
CM_ SG_ 2566088704 Electrified_Accessory_Power_Elec "Generic 8-byte raw payload. Detail page: https://www.isobus.net/isobus/pGNAndSPN/7671?type=PGN. Signal-level enrichment via PR welcome  see CONTRIBUTING.md.";
CM_ SG_ 2566088960 Electrified_Accessory_Power_Elec "Generic 8-byte raw payload. Detail page: https://www.isobus.net/isobus/pGNAndSPN/7676?type=PGN. Signal-level enrichment via PR welcome  see CONTRIBUTING.md.";
CM_ SG_ 2566089216 Electrified_Accessory_Power_Elec "Generic 8-byte raw payload. Detail page: https://www.isobus.net/isobus/pGNAndSPN/7681?type=PGN. Signal-level enrichment via PR welcome  see CONTRIBUTING.md.";
CM_ SG_ 2566089472 Electrified_Accessory_Propulsion "Generic 8-byte raw payload. Detail page: https://www.isobus.net/isobus/pGNAndSPN/7686?type=PGN. Signal-level enrichment via PR welcome  see CONTRIBUTING.md.";
CM_ SG_ 2566089728 Electrified_Accessory_Propulsion "Generic 8-byte raw payload. Detail page: https://www.isobus.net/isobus/pGNAndSPN/7691?type=PGN. Signal-level enrichment via PR welcome  see CONTRIBUTING.md.";
CM_ SG_ 2566089984 Electrified_Accessory_Power_Elec "Generic 8-byte raw payload. Detail page: https://www.isobus.net/isobus/pGNAndSPN/7696?type=PGN. Signal-level enrichment via PR welcome  see CONTRIBUTING.md.";
CM_ SG_ 2566090240 Electrified_Accessory_Generator_ "Generic 8-byte raw payload. Detail page: https://www.isobus.net/isobus/pGNAndSPN/7701?type=PGN. Signal-level enrichment via PR welcome  see CONTRIBUTING.md.";
CM_ SG_ 2566090496 Electrified_Accessory_Generator_ "Generic 8-byte raw payload. Detail page: https://www.isobus.net/isobus/pGNAndSPN/7706?type=PGN. Signal-level enrichment via PR welcome  see CONTRIBUTING.md.";
CM_ SG_ 2566090752 Electrified_Accessory_Motor_Stat "Generic 8-byte raw payload. Detail page: https://www.isobus.net/isobus/pGNAndSPN/7712?type=PGN. Signal-level enrichment via PR welcome  see CONTRIBUTING.md.";
CM_ SG_ 2566091008 Fuel_Cell_System_Controller_Info "Generic 8-byte raw payload. Detail page: https://www.isobus.net/isobus/pGNAndSPN/7717?type=PGN. Signal-level enrichment via PR welcome  see CONTRIBUTING.md.";
CM_ SG_ 2566091264 Fuel_Cell_System_Minimum_Power_I "Generic 8-byte raw payload. Detail page: https://www.isobus.net/isobus/pGNAndSPN/7722?type=PGN. Signal-level enrichment via PR welcome  see CONTRIBUTING.md.";
CM_ SG_ 2566091520 Fuel_Cell_System_Maximum_Power_I "Generic 8-byte raw payload. Detail page: https://www.isobus.net/isobus/pGNAndSPN/7727?type=PGN. Signal-level enrichment via PR welcome  see CONTRIBUTING.md.";
CM_ SG_ 2566091776 Fuel_Cell_System_Minimum_Current "Generic 8-byte raw payload. Detail page: https://www.isobus.net/isobus/pGNAndSPN/7732?type=PGN. Signal-level enrichment via PR welcome  see CONTRIBUTING.md.";
CM_ SG_ 2566092032 Fuel_Cell_System_Maximum_Current "Generic 8-byte raw payload. Detail page: https://www.isobus.net/isobus/pGNAndSPN/7737?type=PGN. Signal-level enrichment via PR welcome  see CONTRIBUTING.md.";
CM_ SG_ 2566092288 Hydrogen_Storage_System_Informat "Generic 8-byte raw payload. Detail page: https://www.isobus.net/isobus/pGNAndSPN/7740?type=PGN. Signal-level enrichment via PR welcome  see CONTRIBUTING.md.";
CM_ SG_ 2566092544 Fuel_Cell_System_Operating_State "Generic 8-byte raw payload. Detail page: https://www.isobus.net/isobus/pGNAndSPN/7748?type=PGN. Signal-level enrichment via PR welcome  see CONTRIBUTING.md.";
CM_ SG_ 2566092800 Fuel_Cell_System_Operations_Requ "Generic 8-byte raw payload. Detail page: https://www.isobus.net/isobus/pGNAndSPN/7751?type=PGN. Signal-level enrichment via PR welcome  see CONTRIBUTING.md.";
CM_ SG_ 2566093056 Fuel_Cell_Stack_Information_RawP "Generic 8-byte raw payload. Detail page: https://www.isobus.net/isobus/pGNAndSPN/7753?type=PGN. Signal-level enrichment via PR welcome  see CONTRIBUTING.md.";
CM_ SG_ 2566093312 Fuel_Cell_System_Coolant_Fan_1_S "Generic 8-byte raw payload. Detail page: https://www.isobus.net/isobus/pGNAndSPN/7758?type=PGN. Signal-level enrichment via PR welcome  see CONTRIBUTING.md.";
CM_ SG_ 2566093568 Fuel_Cell_System_Coolant_Fan_2_S "Generic 8-byte raw payload. Detail page: https://www.isobus.net/isobus/pGNAndSPN/7763?type=PGN. Signal-level enrichment via PR welcome  see CONTRIBUTING.md.";
CM_ SG_ 2566093824 Fuel_Cell_System_Coolant_Fan_3_S "Generic 8-byte raw payload. Detail page: https://www.isobus.net/isobus/pGNAndSPN/7768?type=PGN. Signal-level enrichment via PR welcome  see CONTRIBUTING.md.";
CM_ SG_ 2566094080 Fuel_Cell_System_Coolant_Fan_4_S "Generic 8-byte raw payload. Detail page: https://www.isobus.net/isobus/pGNAndSPN/7773?type=PGN. Signal-level enrichment via PR welcome  see CONTRIBUTING.md.";
CM_ SG_ 2566094336 HVESS_Coolant_Pump_1_Status_2_Ra "Generic 8-byte raw payload. Detail page: https://www.isobus.net/isobus/pGNAndSPN/7778?type=PGN. Signal-level enrichment via PR welcome  see CONTRIBUTING.md.";
CM_ SG_ 2566094592 HVESS_Coolant_Pump_2_Status_2_Ra "Generic 8-byte raw payload. Detail page: https://www.isobus.net/isobus/pGNAndSPN/7783?type=PGN. Signal-level enrichment via PR welcome  see CONTRIBUTING.md.";
CM_ SG_ 2566094848 High_Voltage_Energy_Storage_Syst "Generic 8-byte raw payload. Detail page: https://www.isobus.net/isobus/pGNAndSPN/7789?type=PGN. Signal-level enrichment via PR welcome  see CONTRIBUTING.md.";
CM_ SG_ 2566095104 PTO_Drive_Engagement_2_RawPayloa "Generic 8-byte raw payload. Detail page: https://www.isobus.net/isobus/pGNAndSPN/7795?type=PGN. Signal-level enrichment via PR welcome  see CONTRIBUTING.md.";
CM_ SG_ 2566095360 Fuel_Cell_System_Hydrogen_Pressu "Generic 8-byte raw payload. Detail page: https://www.isobus.net/isobus/pGNAndSPN/7798?type=PGN. Signal-level enrichment via PR welcome  see CONTRIBUTING.md.";
CM_ SG_ 2566095616 Engine_Gas_Flow_Rate_2_RawPayloa "Generic 8-byte raw payload. Detail page: https://www.isobus.net/isobus/pGNAndSPN/7801?type=PGN. Signal-level enrichment via PR welcome  see CONTRIBUTING.md.";
CM_ SG_ 2566095872 Engine_Supercharger_Information_ "Generic 8-byte raw payload. Detail page: https://www.isobus.net/isobus/pGNAndSPN/7807?type=PGN. Signal-level enrichment via PR welcome  see CONTRIBUTING.md.";
CM_ SG_ 2566096128 Engine_Disconnect_Clutch_RawPayl "Generic 8-byte raw payload. Detail page: https://www.isobus.net/isobus/pGNAndSPN/7813?type=PGN. Signal-level enrichment via PR welcome  see CONTRIBUTING.md.";
CM_ SG_ 2566478080 GNSS_Correction_Data_RawPayload "Generic 8-byte raw payload. Detail page: https://www.isobus.net/isobus/pGNAndSPN/7815?type=PGN. Signal-level enrichment via PR welcome  see CONTRIBUTING.md.";
CM_ SG_ 2566478336 Engine_Crankcase_Ventilation_Hea "Generic 8-byte raw payload. Detail page: https://www.isobus.net/isobus/pGNAndSPN/7817?type=PGN. Signal-level enrichment via PR welcome  see CONTRIBUTING.md.";
CM_ SG_ 2566478592 Engine_Crankcase_Ventilation_Hea "Generic 8-byte raw payload. Detail page: https://www.isobus.net/isobus/pGNAndSPN/7821?type=PGN. Signal-level enrichment via PR welcome  see CONTRIBUTING.md.";
CM_ SG_ 2566478848 Engine_Crankcase_Ventilation_Hea "Generic 8-byte raw payload. Detail page: https://www.isobus.net/isobus/pGNAndSPN/7825?type=PGN. Signal-level enrichment via PR welcome  see CONTRIBUTING.md.";
CM_ SG_ 2566479104 Air_Fuel_Ratio_2_RawPayload "Generic 8-byte raw payload. Detail page: https://www.isobus.net/isobus/pGNAndSPN/7827?type=PGN. Signal-level enrichment via PR welcome  see CONTRIBUTING.md.";
CM_ SG_ 2566479360 OBFCM_Engine_Output_Energy_Stati "Generic 8-byte raw payload. Detail page: https://www.isobus.net/isobus/pGNAndSPN/7982?type=PGN. Signal-level enrichment via PR welcome  see CONTRIBUTING.md.";
CM_ SG_ 2566479616 OBFCM_Vehicle_Distance_Static_Da "Generic 8-byte raw payload. Detail page: https://www.isobus.net/isobus/pGNAndSPN/8137?type=PGN. Signal-level enrichment via PR welcome  see CONTRIBUTING.md.";
CM_ SG_ 2566479872 OBFCM_Fuel_2_Static_Data_RawPayl "Generic 8-byte raw payload. Detail page: https://www.isobus.net/isobus/pGNAndSPN/8292?type=PGN. Signal-level enrichment via PR welcome  see CONTRIBUTING.md.";
CM_ SG_ 2566480128 OBFCM_Fuel_1_Static_Data_RawPayl "Generic 8-byte raw payload. Detail page: https://www.isobus.net/isobus/pGNAndSPN/8447?type=PGN. Signal-level enrichment via PR welcome  see CONTRIBUTING.md.";
CM_ SG_ 2566480384 OBFCM_Counters_RawPayload "Generic 8-byte raw payload. Detail page: https://www.isobus.net/isobus/pGNAndSPN/8449?type=PGN. Signal-level enrichment via PR welcome  see CONTRIBUTING.md.";
CM_ SG_ 2566480640 OBFCM_Accumulators_RawPayload "Generic 8-byte raw payload. Detail page: https://www.isobus.net/isobus/pGNAndSPN/8455?type=PGN. Signal-level enrichment via PR welcome  see CONTRIBUTING.md.";
CM_ SG_ 2566480896 OBFCM_Fuel_Consumption_RawPayloa "Generic 8-byte raw payload. Detail page: https://www.isobus.net/isobus/pGNAndSPN/8456?type=PGN. Signal-level enrichment via PR welcome  see CONTRIBUTING.md.";
CM_ SG_ 2566481152 Engine_VVT_System_Data_RawPayloa "Generic 8-byte raw payload. Detail page: https://www.isobus.net/isobus/pGNAndSPN/8460?type=PGN. Signal-level enrichment via PR welcome  see CONTRIBUTING.md.";
CM_ SG_ 2566481408 Maintenance_Information_2_RawPay "Generic 8-byte raw payload. Detail page: https://www.isobus.net/isobus/pGNAndSPN/8461?type=PGN. Signal-level enrichment via PR welcome  see CONTRIBUTING.md.";
CM_ SG_ 2566481664 Alternate_Fuel_7_RawPayload "Generic 8-byte raw payload. Detail page: https://www.isobus.net/isobus/pGNAndSPN/8469?type=PGN. Signal-level enrichment via PR welcome  see CONTRIBUTING.md.";
CM_ SG_ 2566481920 Engine_Catalyst_Diverter_Actuato "Generic 8-byte raw payload. Detail page: https://www.isobus.net/isobus/pGNAndSPN/8471?type=PGN. Signal-level enrichment via PR welcome  see CONTRIBUTING.md.";
CM_ SG_ 2566482176 Electronic_Logging_Device_Hours_ "Generic 8-byte raw payload. Detail page: https://www.isobus.net/isobus/pGNAndSPN/8475?type=PGN. Signal-level enrichment via PR welcome  see CONTRIBUTING.md.";
CM_ SG_ 2566482432 ER_DC_DC_Converter_4_References_ "Generic 8-byte raw payload. Detail page: https://www.isobus.net/isobus/pGNAndSPN/8480?type=PGN. Signal-level enrichment via PR welcome  see CONTRIBUTING.md.";
CM_ SG_ 2566482688 ER_DC_DC_Converter_4_Power_Limit "Generic 8-byte raw payload. Detail page: https://www.isobus.net/isobus/pGNAndSPN/8484?type=PGN. Signal-level enrichment via PR welcome  see CONTRIBUTING.md.";
CM_ SG_ 2566482944 ER_DC_DC_Converter_4_Current_Lim "Generic 8-byte raw payload. Detail page: https://www.isobus.net/isobus/pGNAndSPN/8488?type=PGN. Signal-level enrichment via PR welcome  see CONTRIBUTING.md.";
CM_ SG_ 2566483200 ER_DC_DC_Converter_4_Voltage_Lim "Generic 8-byte raw payload. Detail page: https://www.isobus.net/isobus/pGNAndSPN/8492?type=PGN. Signal-level enrichment via PR welcome  see CONTRIBUTING.md.";
CM_ SG_ 2566483456 ER_DC_DC_Converter_4_Temperature "Generic 8-byte raw payload. Detail page: https://www.isobus.net/isobus/pGNAndSPN/8497?type=PGN. Signal-level enrichment via PR welcome  see CONTRIBUTING.md.";
CM_ SG_ 2566483712 ER_DC_DC_Converter_4_Power_Limit "Generic 8-byte raw payload. Detail page: https://www.isobus.net/isobus/pGNAndSPN/8501?type=PGN. Signal-level enrichment via PR welcome  see CONTRIBUTING.md.";
CM_ SG_ 2566483968 ER_DC_DC_Converter_4_Current_Lim "Generic 8-byte raw payload. Detail page: https://www.isobus.net/isobus/pGNAndSPN/8505?type=PGN. Signal-level enrichment via PR welcome  see CONTRIBUTING.md.";
CM_ SG_ 2566484224 ER_DC_DC_Converter_4_Voltage_Lim "Generic 8-byte raw payload. Detail page: https://www.isobus.net/isobus/pGNAndSPN/8509?type=PGN. Signal-level enrichment via PR welcome  see CONTRIBUTING.md.";
CM_ SG_ 2566484480 ER_DC_DC_Converter_4_Low_Voltage "Generic 8-byte raw payload. Detail page: https://www.isobus.net/isobus/pGNAndSPN/8511?type=PGN. Signal-level enrichment via PR welcome  see CONTRIBUTING.md.";
CM_ SG_ 2566484736 ER_DC_DC_Converter_4_Power_and_C "Generic 8-byte raw payload. Detail page: https://www.isobus.net/isobus/pGNAndSPN/8515?type=PGN. Signal-level enrichment via PR welcome  see CONTRIBUTING.md.";
CM_ SG_ 2566484992 ER_DC_DC_Converter_4_Voltage_and "Generic 8-byte raw payload. Detail page: https://www.isobus.net/isobus/pGNAndSPN/8519?type=PGN. Signal-level enrichment via PR welcome  see CONTRIBUTING.md.";
CM_ SG_ 2566485248 ER_DC_DC_Converter_4_Operating_S "Generic 8-byte raw payload. Detail page: https://www.isobus.net/isobus/pGNAndSPN/8536?type=PGN. Signal-level enrichment via PR welcome  see CONTRIBUTING.md.";
CM_ SG_ 2566485504 ER_DC_DC_Converter_4_Control_Raw "Generic 8-byte raw payload. Detail page: https://www.isobus.net/isobus/pGNAndSPN/8540?type=PGN. Signal-level enrichment via PR welcome  see CONTRIBUTING.md.";
CM_ SG_ 2566485760 ER_DC_DC_Converter_3_References_ "Generic 8-byte raw payload. Detail page: https://www.isobus.net/isobus/pGNAndSPN/8545?type=PGN. Signal-level enrichment via PR welcome  see CONTRIBUTING.md.";
CM_ SG_ 2566486016 ER_DC_DC_Converter_3_Power_Limit "Generic 8-byte raw payload. Detail page: https://www.isobus.net/isobus/pGNAndSPN/8549?type=PGN. Signal-level enrichment via PR welcome  see CONTRIBUTING.md.";
CM_ SG_ 2566486272 ER_DC_DC_Converter_3_Current_Lim "Generic 8-byte raw payload. Detail page: https://www.isobus.net/isobus/pGNAndSPN/8553?type=PGN. Signal-level enrichment via PR welcome  see CONTRIBUTING.md.";
CM_ SG_ 2566486528 ER_DC_DC_Converter_3_Voltage_Lim "Generic 8-byte raw payload. Detail page: https://www.isobus.net/isobus/pGNAndSPN/8557?type=PGN. Signal-level enrichment via PR welcome  see CONTRIBUTING.md.";
CM_ SG_ 2566486784 ER_DC_DC_Converter_3_Temperature "Generic 8-byte raw payload. Detail page: https://www.isobus.net/isobus/pGNAndSPN/8562?type=PGN. Signal-level enrichment via PR welcome  see CONTRIBUTING.md.";
CM_ SG_ 2566487040 ER_DC_DC_Converter_3_Power_Limit "Generic 8-byte raw payload. Detail page: https://www.isobus.net/isobus/pGNAndSPN/8566?type=PGN. Signal-level enrichment via PR welcome  see CONTRIBUTING.md.";
CM_ SG_ 2566487296 ER_DC_DC_Converter_3_Current_Lim "Generic 8-byte raw payload. Detail page: https://www.isobus.net/isobus/pGNAndSPN/8570?type=PGN. Signal-level enrichment via PR welcome  see CONTRIBUTING.md.";
CM_ SG_ 2566487552 ER_DC_DC_Converter_3_Voltage_Lim "Generic 8-byte raw payload. Detail page: https://www.isobus.net/isobus/pGNAndSPN/8574?type=PGN. Signal-level enrichment via PR welcome  see CONTRIBUTING.md.";
CM_ SG_ 2566487808 ER_DC_DC_Converter_3_Low_Voltage "Generic 8-byte raw payload. Detail page: https://www.isobus.net/isobus/pGNAndSPN/8576?type=PGN. Signal-level enrichment via PR welcome  see CONTRIBUTING.md.";
CM_ SG_ 2566488064 ER_DC_DC_Converter_3_Power_and_C "Generic 8-byte raw payload. Detail page: https://www.isobus.net/isobus/pGNAndSPN/8580?type=PGN. Signal-level enrichment via PR welcome  see CONTRIBUTING.md.";
CM_ SG_ 2566488320 ER_DC_DC_Converter_3_Voltage_and "Generic 8-byte raw payload. Detail page: https://www.isobus.net/isobus/pGNAndSPN/8584?type=PGN. Signal-level enrichment via PR welcome  see CONTRIBUTING.md.";
CM_ SG_ 2566488576 ER_DC_DC_Converter_3_Operating_S "Generic 8-byte raw payload. Detail page: https://www.isobus.net/isobus/pGNAndSPN/8601?type=PGN. Signal-level enrichment via PR welcome  see CONTRIBUTING.md.";
CM_ SG_ 2566488832 ER_DC_DC_Converter_3_Control_Raw "Generic 8-byte raw payload. Detail page: https://www.isobus.net/isobus/pGNAndSPN/8605?type=PGN. Signal-level enrichment via PR welcome  see CONTRIBUTING.md.";
CM_ SG_ 2566489088 ER_DC_DC_Converter_2_References_ "Generic 8-byte raw payload. Detail page: https://www.isobus.net/isobus/pGNAndSPN/8610?type=PGN. Signal-level enrichment via PR welcome  see CONTRIBUTING.md.";
CM_ SG_ 2566489344 ER_DC_DC_Converter_2_Power_Limit "Generic 8-byte raw payload. Detail page: https://www.isobus.net/isobus/pGNAndSPN/8614?type=PGN. Signal-level enrichment via PR welcome  see CONTRIBUTING.md.";
CM_ SG_ 2566489600 ER_DC_DC_Converter_2_Current_Lim "Generic 8-byte raw payload. Detail page: https://www.isobus.net/isobus/pGNAndSPN/8618?type=PGN. Signal-level enrichment via PR welcome  see CONTRIBUTING.md.";
CM_ SG_ 2566489856 ER_DC_DC_Converter_2_Voltage_Lim "Generic 8-byte raw payload. Detail page: https://www.isobus.net/isobus/pGNAndSPN/8622?type=PGN. Signal-level enrichment via PR welcome  see CONTRIBUTING.md.";
CM_ SG_ 2566490112 ER_DC_DC_Converter_2_Temperature "Generic 8-byte raw payload. Detail page: https://www.isobus.net/isobus/pGNAndSPN/8627?type=PGN. Signal-level enrichment via PR welcome  see CONTRIBUTING.md.";
CM_ SG_ 2566490368 ER_DC_DC_Converter_2_Power_Limit "Generic 8-byte raw payload. Detail page: https://www.isobus.net/isobus/pGNAndSPN/8631?type=PGN. Signal-level enrichment via PR welcome  see CONTRIBUTING.md.";
CM_ SG_ 2566490624 ER_DC_DC_Converter_2_Current_Lim "Generic 8-byte raw payload. Detail page: https://www.isobus.net/isobus/pGNAndSPN/8635?type=PGN. Signal-level enrichment via PR welcome  see CONTRIBUTING.md.";
CM_ SG_ 2566490880 ER_DC_DC_Converter_2_Voltage_Lim "Generic 8-byte raw payload. Detail page: https://www.isobus.net/isobus/pGNAndSPN/8639?type=PGN. Signal-level enrichment via PR welcome  see CONTRIBUTING.md.";
CM_ SG_ 2566491136 ER_DC_DC_Converter_2_Low_Voltage "Generic 8-byte raw payload. Detail page: https://www.isobus.net/isobus/pGNAndSPN/8641?type=PGN. Signal-level enrichment via PR welcome  see CONTRIBUTING.md.";
CM_ SG_ 2566491392 ER_DC_DC_Converter_2_Power_and_C "Generic 8-byte raw payload. Detail page: https://www.isobus.net/isobus/pGNAndSPN/8645?type=PGN. Signal-level enrichment via PR welcome  see CONTRIBUTING.md.";
CM_ SG_ 2566491648 ER_DC_DC_Converter_2_Voltage_and "Generic 8-byte raw payload. Detail page: https://www.isobus.net/isobus/pGNAndSPN/8649?type=PGN. Signal-level enrichment via PR welcome  see CONTRIBUTING.md.";
CM_ SG_ 2566491904 ER_DC_DC_Converter_2_Operating_S "Generic 8-byte raw payload. Detail page: https://www.isobus.net/isobus/pGNAndSPN/8666?type=PGN. Signal-level enrichment via PR welcome  see CONTRIBUTING.md.";
CM_ SG_ 2566492160 ER_DC_DC_Converter_2_Control_Raw "Generic 8-byte raw payload. Detail page: https://www.isobus.net/isobus/pGNAndSPN/8670?type=PGN. Signal-level enrichment via PR welcome  see CONTRIBUTING.md.";
CM_ SG_ 2566492416 ER_DC_DC_Converter_1_References_ "Generic 8-byte raw payload. Detail page: https://www.isobus.net/isobus/pGNAndSPN/8675?type=PGN. Signal-level enrichment via PR welcome  see CONTRIBUTING.md.";
CM_ SG_ 2566492672 ER_DC_DC_Converter_1_Power_Limit "Generic 8-byte raw payload. Detail page: https://www.isobus.net/isobus/pGNAndSPN/8679?type=PGN. Signal-level enrichment via PR welcome  see CONTRIBUTING.md.";
CM_ SG_ 2566492928 ER_DC_DC_Converter_1_Current_Lim "Generic 8-byte raw payload. Detail page: https://www.isobus.net/isobus/pGNAndSPN/8683?type=PGN. Signal-level enrichment via PR welcome  see CONTRIBUTING.md.";
CM_ SG_ 2566493184 ER_DC_DC_Converter_1_Voltage_Lim "Generic 8-byte raw payload. Detail page: https://www.isobus.net/isobus/pGNAndSPN/8687?type=PGN. Signal-level enrichment via PR welcome  see CONTRIBUTING.md.";
CM_ SG_ 2566493440 ER_DC_DC_Converter_1_Temperature "Generic 8-byte raw payload. Detail page: https://www.isobus.net/isobus/pGNAndSPN/8692?type=PGN. Signal-level enrichment via PR welcome  see CONTRIBUTING.md.";
CM_ SG_ 2566493696 ER_DC_DC_Converter_1_Power_Limit "Generic 8-byte raw payload. Detail page: https://www.isobus.net/isobus/pGNAndSPN/8696?type=PGN. Signal-level enrichment via PR welcome  see CONTRIBUTING.md.";
CM_ SG_ 2566493952 ER_DC_DC_Converter_1_Current_Lim "Generic 8-byte raw payload. Detail page: https://www.isobus.net/isobus/pGNAndSPN/8700?type=PGN. Signal-level enrichment via PR welcome  see CONTRIBUTING.md.";
CM_ SG_ 2566494208 ER_DC_DC_Converter_1_Voltage_Lim "Generic 8-byte raw payload. Detail page: https://www.isobus.net/isobus/pGNAndSPN/8704?type=PGN. Signal-level enrichment via PR welcome  see CONTRIBUTING.md.";
CM_ SG_ 2566494464 ER_DC_DC_Converter_1_Low_Voltage "Generic 8-byte raw payload. Detail page: https://www.isobus.net/isobus/pGNAndSPN/8706?type=PGN. Signal-level enrichment via PR welcome  see CONTRIBUTING.md.";
CM_ SG_ 2566494720 ER_DC_DC_Converter_1_Power_and_C "Generic 8-byte raw payload. Detail page: https://www.isobus.net/isobus/pGNAndSPN/8710?type=PGN. Signal-level enrichment via PR welcome  see CONTRIBUTING.md.";
CM_ SG_ 2566494976 ER_DC_DC_Converter_1_Voltage_and "Generic 8-byte raw payload. Detail page: https://www.isobus.net/isobus/pGNAndSPN/8714?type=PGN. Signal-level enrichment via PR welcome  see CONTRIBUTING.md.";
CM_ SG_ 2566495232 ER_DC_DC_Converter_1_Operating_S "Generic 8-byte raw payload. Detail page: https://www.isobus.net/isobus/pGNAndSPN/8731?type=PGN. Signal-level enrichment via PR welcome  see CONTRIBUTING.md.";
CM_ SG_ 2566495488 ER_DC_DC_Converter_1_Control_Raw "Generic 8-byte raw payload. Detail page: https://www.isobus.net/isobus/pGNAndSPN/8735?type=PGN. Signal-level enrichment via PR welcome  see CONTRIBUTING.md.";
CM_ SG_ 2566495744 Cab_Air_Quality_System_Informati "Generic 8-byte raw payload. Detail page: https://www.isobus.net/isobus/pGNAndSPN/8739?type=PGN. Signal-level enrichment via PR welcome  see CONTRIBUTING.md.";
CM_ SG_ 2566496000 Cab_Air_Quality_System_Informati "Generic 8-byte raw payload. Detail page: https://www.isobus.net/isobus/pGNAndSPN/8745?type=PGN. Signal-level enrichment via PR welcome  see CONTRIBUTING.md.";
CM_ SG_ 2566496256 Well_Stimulation_Pump_System_6_R "Generic 8-byte raw payload. Detail page: https://www.isobus.net/isobus/pGNAndSPN/8749?type=PGN. Signal-level enrichment via PR welcome  see CONTRIBUTING.md.";
CM_ SG_ 2566496512 Engine_Fuel_Lube_Systems_4_RawPa "Generic 8-byte raw payload. Detail page: https://www.isobus.net/isobus/pGNAndSPN/8755?type=PGN. Signal-level enrichment via PR welcome  see CONTRIBUTING.md.";
CM_ SG_ 2566496768 Alternate_Fuel_6_RawPayload "Generic 8-byte raw payload. Detail page: https://www.isobus.net/isobus/pGNAndSPN/8760?type=PGN. Signal-level enrichment via PR welcome  see CONTRIBUTING.md.";
CM_ SG_ 2566497024 Engine_Catalyst_Diverter_Actuato "Generic 8-byte raw payload. Detail page: https://www.isobus.net/isobus/pGNAndSPN/8763?type=PGN. Signal-level enrichment via PR welcome  see CONTRIBUTING.md.";
CM_ SG_ 2566497280 Ambient_Conditions_4_RawPayload "Generic 8-byte raw payload. Detail page: https://www.isobus.net/isobus/pGNAndSPN/8767?type=PGN. Signal-level enrichment via PR welcome  see CONTRIBUTING.md.";
CM_ SG_ 2566497536 Engine_Exhaust_Particulate_Contr "Generic 8-byte raw payload. Detail page: https://www.isobus.net/isobus/pGNAndSPN/8769?type=PGN. Signal-level enrichment via PR welcome  see CONTRIBUTING.md.";
CM_ SG_ 2566497792 Engine_Exhaust_Particulate_Contr "Generic 8-byte raw payload. Detail page: https://www.isobus.net/isobus/pGNAndSPN/8771?type=PGN. Signal-level enrichment via PR welcome  see CONTRIBUTING.md.";
CM_ SG_ 2566498048 Aftertreatment_System_Informatio "Generic 8-byte raw payload. Detail page: https://www.isobus.net/isobus/pGNAndSPN/8773?type=PGN. Signal-level enrichment via PR welcome  see CONTRIBUTING.md.";
CM_ SG_ 2566498304 Aftertreatment_System_Informatio "Generic 8-byte raw payload. Detail page: https://www.isobus.net/isobus/pGNAndSPN/8775?type=PGN. Signal-level enrichment via PR welcome  see CONTRIBUTING.md.";
CM_ SG_ 2566498560 Aftertreatment_System_Informatio "Generic 8-byte raw payload. Detail page: https://www.isobus.net/isobus/pGNAndSPN/8777?type=PGN. Signal-level enrichment via PR welcome  see CONTRIBUTING.md.";
CM_ SG_ 2566498816 Aftertreatment_System_Informatio "Generic 8-byte raw payload. Detail page: https://www.isobus.net/isobus/pGNAndSPN/8779?type=PGN. Signal-level enrichment via PR welcome  see CONTRIBUTING.md.";
CM_ SG_ 2566499072 Aftertreatment_System_Informatio "Generic 8-byte raw payload. Detail page: https://www.isobus.net/isobus/pGNAndSPN/8781?type=PGN. Signal-level enrichment via PR welcome  see CONTRIBUTING.md.";
CM_ SG_ 2566499328 Aftertreatment_System_Informatio "Generic 8-byte raw payload. Detail page: https://www.isobus.net/isobus/pGNAndSPN/8783?type=PGN. Signal-level enrichment via PR welcome  see CONTRIBUTING.md.";
CM_ SG_ 2566499584 Aftertreatment_System_Informatio "Generic 8-byte raw payload. Detail page: https://www.isobus.net/isobus/pGNAndSPN/8785?type=PGN. Signal-level enrichment via PR welcome  see CONTRIBUTING.md.";
CM_ SG_ 2566499840 Aftertreatment_System_Informatio "Generic 8-byte raw payload. Detail page: https://www.isobus.net/isobus/pGNAndSPN/8787?type=PGN. Signal-level enrichment via PR welcome  see CONTRIBUTING.md.";
CM_ SG_ 2566500096 Aftertreatment_System_Informatio "Generic 8-byte raw payload. Detail page: https://www.isobus.net/isobus/pGNAndSPN/8789?type=PGN. Signal-level enrichment via PR welcome  see CONTRIBUTING.md.";
CM_ SG_ 2566500352 Aftertreatment_System_Informatio "Generic 8-byte raw payload. Detail page: https://www.isobus.net/isobus/pGNAndSPN/8791?type=PGN. Signal-level enrichment via PR welcome  see CONTRIBUTING.md.";
CM_ SG_ 2566500608 Aftertreatment_System_Informatio "Generic 8-byte raw payload. Detail page: https://www.isobus.net/isobus/pGNAndSPN/8793?type=PGN. Signal-level enrichment via PR welcome  see CONTRIBUTING.md.";
CM_ SG_ 2566500864 Aftertreatment_System_Informatio "Generic 8-byte raw payload. Detail page: https://www.isobus.net/isobus/pGNAndSPN/8795?type=PGN. Signal-level enrichment via PR welcome  see CONTRIBUTING.md.";
CM_ SG_ 2566501120 Route_Attributes_Profile_RawPayl "Generic 8-byte raw payload. Detail page: https://www.isobus.net/isobus/pGNAndSPN/8805?type=PGN. Signal-level enrichment via PR welcome  see CONTRIBUTING.md.";
CM_ SG_ 2566501376 Genset_Supporting_Functions_2_Ra "Generic 8-byte raw payload. Detail page: https://www.isobus.net/isobus/pGNAndSPN/8806?type=PGN. Signal-level enrichment via PR welcome  see CONTRIBUTING.md.";
CM_ SG_ 2566501632 Alternator_Information_2_RawPayl "Generic 8-byte raw payload. Detail page: https://www.isobus.net/isobus/pGNAndSPN/8811?type=PGN. Signal-level enrichment via PR welcome  see CONTRIBUTING.md.";
CM_ SG_ 2566501888 Well_Stimulation_Pump_System_5_R "Generic 8-byte raw payload. Detail page: https://www.isobus.net/isobus/pGNAndSPN/8815?type=PGN. Signal-level enrichment via PR welcome  see CONTRIBUTING.md.";
CM_ SG_ 2566502144 Well_Stimulation_Pump_System_4_R "Generic 8-byte raw payload. Detail page: https://www.isobus.net/isobus/pGNAndSPN/8818?type=PGN. Signal-level enrichment via PR welcome  see CONTRIBUTING.md.";
CM_ SG_ 2566502400 Tire_Information_RawPayload "Generic 8-byte raw payload. Detail page: https://www.isobus.net/isobus/pGNAndSPN/8819?type=PGN. Signal-level enrichment via PR welcome  see CONTRIBUTING.md.";
CM_ SG_ 2566502656 Hydrogen_System_Status_RawPayloa "Generic 8-byte raw payload. Detail page: https://www.isobus.net/isobus/pGNAndSPN/8821?type=PGN. Signal-level enrichment via PR welcome  see CONTRIBUTING.md.";
CM_ SG_ 2566502912 Route_Waypoint_GPS_Coordinates_R "Generic 8-byte raw payload. Detail page: https://www.isobus.net/isobus/pGNAndSPN/8824?type=PGN. Signal-level enrichment via PR welcome  see CONTRIBUTING.md.";
CM_ SG_ 2566503168 Route_Information_RawPayload "Generic 8-byte raw payload. Detail page: https://www.isobus.net/isobus/pGNAndSPN/8828?type=PGN. Signal-level enrichment via PR welcome  see CONTRIBUTING.md.";
CM_ SG_ 2566503424 Engine_Fluid_Level_Pressure_15_R "Generic 8-byte raw payload. Detail page: https://www.isobus.net/isobus/pGNAndSPN/8830?type=PGN. Signal-level enrichment via PR welcome  see CONTRIBUTING.md.";
CM_ SG_ 2566503680 Fuel_Cell_System_Coolant_Informa "Generic 8-byte raw payload. Detail page: https://www.isobus.net/isobus/pGNAndSPN/8832?type=PGN. Signal-level enrichment via PR welcome  see CONTRIBUTING.md.";
CM_ SG_ 2566503936 Transmission_Configuration_3_Raw "Generic 8-byte raw payload. Detail page: https://www.isobus.net/isobus/pGNAndSPN/8852?type=PGN. Signal-level enrichment via PR welcome  see CONTRIBUTING.md.";
CM_ SG_ 2566504192 Enrichment_Information_RawPayloa "Generic 8-byte raw payload. Detail page: https://www.isobus.net/isobus/pGNAndSPN/8860?type=PGN. Signal-level enrichment via PR welcome  see CONTRIBUTING.md.";
CM_ SG_ 2566504448 Fuel_Cell_System_Voltage_Limit_C "Generic 8-byte raw payload. Detail page: https://www.isobus.net/isobus/pGNAndSPN/8865?type=PGN. Signal-level enrichment via PR welcome  see CONTRIBUTING.md.";
CM_ SG_ 2566504960 Hydrogen_System_Information_RawP "Generic 8-byte raw payload. Detail page: https://www.isobus.net/isobus/pGNAndSPN/8867?type=PGN. Signal-level enrichment via PR welcome  see CONTRIBUTING.md.";
CM_ SG_ 2566505216 Auxiliary_Input_Output_Status_17 "Generic 8-byte raw payload. Detail page: https://www.isobus.net/isobus/pGNAndSPN/8871?type=PGN. Signal-level enrichment via PR welcome  see CONTRIBUTING.md.";
CM_ SG_ 2566505472 Auxiliary_Input_Output_Status_16 "Generic 8-byte raw payload. Detail page: https://www.isobus.net/isobus/pGNAndSPN/8875?type=PGN. Signal-level enrichment via PR welcome  see CONTRIBUTING.md.";
CM_ SG_ 2566505728 Auxiliary_Input_Output_Status_15 "Generic 8-byte raw payload. Detail page: https://www.isobus.net/isobus/pGNAndSPN/8879?type=PGN. Signal-level enrichment via PR welcome  see CONTRIBUTING.md.";
CM_ SG_ 2566505984 Auxiliary_Input_Output_Status_14 "Generic 8-byte raw payload. Detail page: https://www.isobus.net/isobus/pGNAndSPN/8883?type=PGN. Signal-level enrichment via PR welcome  see CONTRIBUTING.md.";
CM_ SG_ 2566506240 Auxiliary_Input_Output_Status_13 "Generic 8-byte raw payload. Detail page: https://www.isobus.net/isobus/pGNAndSPN/8887?type=PGN. Signal-level enrichment via PR welcome  see CONTRIBUTING.md.";
CM_ SG_ 2566506496 Auxiliary_Input_Output_Status_12 "Generic 8-byte raw payload. Detail page: https://www.isobus.net/isobus/pGNAndSPN/8891?type=PGN. Signal-level enrichment via PR welcome  see CONTRIBUTING.md.";
CM_ SG_ 2566506752 Auxiliary_Input_Output_Status_11 "Generic 8-byte raw payload. Detail page: https://www.isobus.net/isobus/pGNAndSPN/8895?type=PGN. Signal-level enrichment via PR welcome  see CONTRIBUTING.md.";
CM_ SG_ 2566507008 Auxiliary_Input_Output_Status_10 "Generic 8-byte raw payload. Detail page: https://www.isobus.net/isobus/pGNAndSPN/8899?type=PGN. Signal-level enrichment via PR welcome  see CONTRIBUTING.md.";
CM_ SG_ 2566507264 Auxiliary_Input_Output_Status_9_ "Generic 8-byte raw payload. Detail page: https://www.isobus.net/isobus/pGNAndSPN/8903?type=PGN. Signal-level enrichment via PR welcome  see CONTRIBUTING.md.";
CM_ SG_ 2566507520 Auxiliary_Input_Output_Status_8_ "Generic 8-byte raw payload. Detail page: https://www.isobus.net/isobus/pGNAndSPN/8907?type=PGN. Signal-level enrichment via PR welcome  see CONTRIBUTING.md.";
CM_ SG_ 2566507776 Aftertreatment_System_Informatio "Generic 8-byte raw payload. Detail page: https://www.isobus.net/isobus/pGNAndSPN/8909?type=PGN. Signal-level enrichment via PR welcome  see CONTRIBUTING.md.";
CM_ SG_ 2566508032 Brake_Temperature_6_RawPayload "Generic 8-byte raw payload. Detail page: https://www.isobus.net/isobus/pGNAndSPN/8911?type=PGN. Signal-level enrichment via PR welcome  see CONTRIBUTING.md.";
CM_ SG_ 2566508288 Brake_Temperature_5_RawPayload "Generic 8-byte raw payload. Detail page: https://www.isobus.net/isobus/pGNAndSPN/8915?type=PGN. Signal-level enrichment via PR welcome  see CONTRIBUTING.md.";
CM_ SG_ 2566508544 Brake_Temperature_4_RawPayload "Generic 8-byte raw payload. Detail page: https://www.isobus.net/isobus/pGNAndSPN/8919?type=PGN. Signal-level enrichment via PR welcome  see CONTRIBUTING.md.";
CM_ SG_ 2566508800 Brake_Temperature_3_RawPayload "Generic 8-byte raw payload. Detail page: https://www.isobus.net/isobus/pGNAndSPN/8923?type=PGN. Signal-level enrichment via PR welcome  see CONTRIBUTING.md.";
CM_ SG_ 2566509056 Brake_Temperature_2_RawPayload "Generic 8-byte raw payload. Detail page: https://www.isobus.net/isobus/pGNAndSPN/8927?type=PGN. Signal-level enrichment via PR welcome  see CONTRIBUTING.md.";
CM_ SG_ 2566509312 Brake_Temperature_1_RawPayload "Generic 8-byte raw payload. Detail page: https://www.isobus.net/isobus/pGNAndSPN/8931?type=PGN. Signal-level enrichment via PR welcome  see CONTRIBUTING.md.";
CM_ SG_ 2566509568 Wheel_Brake_Lining_Remaining_Inf "Generic 8-byte raw payload. Detail page: https://www.isobus.net/isobus/pGNAndSPN/8937?type=PGN. Signal-level enrichment via PR welcome  see CONTRIBUTING.md.";
CM_ SG_ 2566509824 Wheel_Brake_Lining_Remaining_Inf "Generic 8-byte raw payload. Detail page: https://www.isobus.net/isobus/pGNAndSPN/8945?type=PGN. Signal-level enrichment via PR welcome  see CONTRIBUTING.md.";
CM_ SG_ 2566510080 High_Voltage_Bus_Contactor_Statu "Generic 8-byte raw payload. Detail page: https://www.isobus.net/isobus/pGNAndSPN/8964?type=PGN. Signal-level enrichment via PR welcome  see CONTRIBUTING.md.";
CM_ SG_ 2566510336 High_Voltage_Bus_Contactor_Statu "Generic 8-byte raw payload. Detail page: https://www.isobus.net/isobus/pGNAndSPN/8991?type=PGN. Signal-level enrichment via PR welcome  see CONTRIBUTING.md.";
CM_ SG_ 2566510592 High_Voltage_Bus_Connection_Comm "Generic 8-byte raw payload. Detail page: https://www.isobus.net/isobus/pGNAndSPN/9002?type=PGN. Signal-level enrichment via PR welcome  see CONTRIBUTING.md.";
CM_ SG_ 2566510848 Cab_Illumination_Data_RawPayload "Generic 8-byte raw payload. Detail page: https://www.isobus.net/isobus/pGNAndSPN/9004?type=PGN. Signal-level enrichment via PR welcome  see CONTRIBUTING.md.";
CM_ SG_ 2566511104 Service_Needed_DTC_Information_R "Generic 8-byte raw payload. Detail page: https://www.isobus.net/isobus/pGNAndSPN/9008?type=PGN. Signal-level enrichment via PR welcome  see CONTRIBUTING.md.";
CM_ SG_ 2566511360 EVSE_Status_2_RawPayload "Generic 8-byte raw payload. Detail page: https://www.isobus.net/isobus/pGNAndSPN/9012?type=PGN. Signal-level enrichment via PR welcome  see CONTRIBUTING.md.";
CM_ SG_ 2566511616 High_Voltage_Energy_Storage_Syst "Generic 8-byte raw payload. Detail page: https://www.isobus.net/isobus/pGNAndSPN/9016?type=PGN. Signal-level enrichment via PR welcome  see CONTRIBUTING.md.";
CM_ SG_ 2566511872 High_Voltage_Energy_Storage_Syst "Generic 8-byte raw payload. Detail page: https://www.isobus.net/isobus/pGNAndSPN/9020?type=PGN. Signal-level enrichment via PR welcome  see CONTRIBUTING.md.";
CM_ SG_ 2566512128 High_Voltage_Energy_Storage_Syst "Generic 8-byte raw payload. Detail page: https://www.isobus.net/isobus/pGNAndSPN/9024?type=PGN. Signal-level enrichment via PR welcome  see CONTRIBUTING.md.";
CM_ SG_ 2566512384 HVESS_Coolant_Pump_1_Status_1_Ra "Generic 8-byte raw payload. Detail page: https://www.isobus.net/isobus/pGNAndSPN/9032?type=PGN. Signal-level enrichment via PR welcome  see CONTRIBUTING.md.";
CM_ SG_ 2566512640 HVESS_Coolant_Pump_1_Command_Raw "Generic 8-byte raw payload. Detail page: https://www.isobus.net/isobus/pGNAndSPN/9039?type=PGN. Signal-level enrichment via PR welcome  see CONTRIBUTING.md.";
CM_ SG_ 2566512896 HVESS_Coolant_Pump_2_Status_1_Ra "Generic 8-byte raw payload. Detail page: https://www.isobus.net/isobus/pGNAndSPN/9047?type=PGN. Signal-level enrichment via PR welcome  see CONTRIBUTING.md.";
CM_ SG_ 2566513152 HVESS_Coolant_Pump_2_Command_Raw "Generic 8-byte raw payload. Detail page: https://www.isobus.net/isobus/pGNAndSPN/9054?type=PGN. Signal-level enrichment via PR welcome  see CONTRIBUTING.md.";
CM_ SG_ 2566513408 Hydrogen_Sensor_Information_RawP "Generic 8-byte raw payload. Detail page: https://www.isobus.net/isobus/pGNAndSPN/9058?type=PGN. Signal-level enrichment via PR welcome  see CONTRIBUTING.md.";
CM_ SG_ 2566513664 Operator_Inducement_Information_ "Generic 8-byte raw payload. Detail page: https://www.isobus.net/isobus/pGNAndSPN/9061?type=PGN. Signal-level enrichment via PR welcome  see CONTRIBUTING.md.";
CM_ SG_ 2566513920 Operator_Inducement_Vehicle_Spee "Generic 8-byte raw payload. Detail page: https://www.isobus.net/isobus/pGNAndSPN/9064?type=PGN. Signal-level enrichment via PR welcome  see CONTRIBUTING.md.";
CM_ SG_ 2566514176 Operator_Inducement_Vehicle_Spee "Generic 8-byte raw payload. Detail page: https://www.isobus.net/isobus/pGNAndSPN/9067?type=PGN. Signal-level enrichment via PR welcome  see CONTRIBUTING.md.";
CM_ SG_ 2566514432 Engine_Protection_Speed_Derate_I "Generic 8-byte raw payload. Detail page: https://www.isobus.net/isobus/pGNAndSPN/9073?type=PGN. Signal-level enrichment via PR welcome  see CONTRIBUTING.md.";
CM_ SG_ 2566514688 Engine_Protection_Torque_Derate_ "Generic 8-byte raw payload. Detail page: https://www.isobus.net/isobus/pGNAndSPN/9080?type=PGN. Signal-level enrichment via PR welcome  see CONTRIBUTING.md.";
CM_ SG_ 2566514944 Aftertreatment_System_Informatio "Generic 8-byte raw payload. Detail page: https://www.isobus.net/isobus/pGNAndSPN/9082?type=PGN. Signal-level enrichment via PR welcome  see CONTRIBUTING.md.";
CM_ SG_ 2566515200 SAE_J2012_3_Byte_DTC_Display_Raw "Generic 8-byte raw payload. Detail page: https://www.isobus.net/isobus/pGNAndSPN/9088?type=PGN. Signal-level enrichment via PR welcome  see CONTRIBUTING.md.";
CM_ SG_ 2566515456 High_Voltage_Energy_Storage_Syst "Generic 8-byte raw payload. Detail page: https://www.isobus.net/isobus/pGNAndSPN/9098?type=PGN. Signal-level enrichment via PR welcome  see CONTRIBUTING.md.";
CM_ SG_ 2566515712 High_Voltage_Energy_Storage_Syst "Generic 8-byte raw payload. Detail page: https://www.isobus.net/isobus/pGNAndSPN/9108?type=PGN. Signal-level enrichment via PR welcome  see CONTRIBUTING.md.";
CM_ SG_ 2566515968 High_Voltage_Energy_Storage_Syst "Generic 8-byte raw payload. Detail page: https://www.isobus.net/isobus/pGNAndSPN/9109?type=PGN. Signal-level enrichment via PR welcome  see CONTRIBUTING.md.";
CM_ SG_ 2566516224 Engine_Cylinder_Average_Ignition "Generic 8-byte raw payload. Detail page: https://www.isobus.net/isobus/pGNAndSPN/9113?type=PGN. Signal-level enrichment via PR welcome  see CONTRIBUTING.md.";
CM_ SG_ 2566516480 Engine_Cylinder_Average_Ignition "Generic 8-byte raw payload. Detail page: https://www.isobus.net/isobus/pGNAndSPN/9117?type=PGN. Signal-level enrichment via PR welcome  see CONTRIBUTING.md.";
CM_ SG_ 2566516736 Engine_Cylinder_Average_Ignition "Generic 8-byte raw payload. Detail page: https://www.isobus.net/isobus/pGNAndSPN/9121?type=PGN. Signal-level enrichment via PR welcome  see CONTRIBUTING.md.";

BA_DEF_ BO_ "SystemMessageLongSymbol" STRING;
BA_DEF_ SG_ "SystemSignalLongSymbol" STRING;
BA_ "SystemMessageLongSymbol" BO_ 2566053120 "VDMA_F2DD_High_Voltage_Energy_Storage_Pack";
BA_ "SystemMessageLongSymbol" BO_ 2566053376 "VDMA_F2DE_High_Voltage_Energy_Storage_Pack";
BA_ "SystemMessageLongSymbol" BO_ 2566053632 "VDMA_F2DF_High_Voltage_Energy_Storage_Pack";
BA_ "SystemMessageLongSymbol" BO_ 2566053888 "VDMA_F2E0_High_Voltage_Energy_Storage_Pack";
BA_ "SystemMessageLongSymbol" BO_ 2566054144 "VDMA_F2E1_High_Voltage_Energy_Storage_Pack";
BA_ "SystemMessageLongSymbol" BO_ 2566054400 "VDMA_F2E2_High_Voltage_Energy_Storage_Pack";
BA_ "SystemMessageLongSymbol" BO_ 2566054656 "VDMA_F2E3_High_Voltage_Energy_Storage_Pack";
BA_ "SystemMessageLongSymbol" BO_ 2566054912 "VDMA_F2E4_High_Voltage_Energy_Storage_Pack";
BA_ "SystemMessageLongSymbol" BO_ 2566055168 "VDMA_F2E5_High_Voltage_Energy_Storage_Pack";
BA_ "SystemMessageLongSymbol" BO_ 2566055424 "VDMA_F2E6_High_Voltage_Energy_Storage_Pack";
BA_ "SystemMessageLongSymbol" BO_ 2566055680 "VDMA_F2E7_High_Voltage_Energy_Storage_Pack";
BA_ "SystemMessageLongSymbol" BO_ 2566055936 "VDMA_F2E8_High_Voltage_Energy_Storage_Pack";
BA_ "SystemMessageLongSymbol" BO_ 2566056192 "VDMA_F2E9_High_Voltage_Energy_Storage_Pack";
BA_ "SystemMessageLongSymbol" BO_ 2566056448 "VDMA_F2EA_High_Voltage_Energy_Storage_Pack";
BA_ "SystemMessageLongSymbol" BO_ 2566056704 "VDMA_F2EB_High_Voltage_Energy_Storage_Pack";
BA_ "SystemMessageLongSymbol" BO_ 2566056960 "VDMA_F2EC_High_Voltage_Energy_Storage_Pack";
BA_ "SystemMessageLongSymbol" BO_ 2566057216 "VDMA_F2ED_High_Voltage_Energy_Storage_Pack";
BA_ "SystemMessageLongSymbol" BO_ 2566057472 "VDMA_F2EE_High_Voltage_Energy_Storage_Pack";
BA_ "SystemMessageLongSymbol" BO_ 2566057728 "VDMA_F2EF_High_Voltage_Energy_Storage_Pack";
BA_ "SystemMessageLongSymbol" BO_ 2566057984 "VDMA_F2F0_High_Voltage_Energy_Storage_Pack";
BA_ "SystemMessageLongSymbol" BO_ 2566058240 "VDMA_F2F1_High_Voltage_Energy_Storage_Pack";
BA_ "SystemMessageLongSymbol" BO_ 2566058496 "VDMA_F2F2_High_Voltage_Energy_Storage_Pack";
BA_ "SystemMessageLongSymbol" BO_ 2566058752 "VDMA_F2F3_High_Voltage_Energy_Storage_Pack";
BA_ "SystemMessageLongSymbol" BO_ 2566059008 "VDMA_F2F4_High_Voltage_Energy_Storage_Pack";
BA_ "SystemMessageLongSymbol" BO_ 2566059264 "VDMA_F2F5_High_Voltage_Energy_Storage_Pack";
BA_ "SystemMessageLongSymbol" BO_ 2566059520 "VDMA_F2F6_High_Voltage_Energy_Storage_Pack";
BA_ "SystemMessageLongSymbol" BO_ 2566059776 "VDMA_F2F7_High_Voltage_Energy_Storage_Pack";
BA_ "SystemMessageLongSymbol" BO_ 2566060032 "VDMA_F2F8_High_Voltage_Energy_Storage_Pack";
BA_ "SystemMessageLongSymbol" BO_ 2566060288 "VDMA_F2F9_High_Voltage_Energy_Storage_Pack";
BA_ "SystemMessageLongSymbol" BO_ 2566060544 "VDMA_F2FA_High_Voltage_Energy_Storage_Pack";
BA_ "SystemMessageLongSymbol" BO_ 2566060800 "VDMA_F2FB_High_Voltage_Energy_Storage_Pack";
BA_ "SystemMessageLongSymbol" BO_ 2566061056 "VDMA_F2FC_High_Voltage_Energy_Storage_Pack";
BA_ "SystemMessageLongSymbol" BO_ 2566061312 "VDMA_F2FD_High_Voltage_Energy_Storage_Pack";
BA_ "SystemMessageLongSymbol" BO_ 2566061568 "VDMA_F2FE_High_Voltage_Energy_Storage_Pack";
BA_ "SystemMessageLongSymbol" BO_ 2566061824 "VDMA_F2FF_High_Voltage_Energy_Storage_Pack";
BA_ "SystemMessageLongSymbol" BO_ 2566062080 "VDMA_F300_High_Voltage_Energy_Storage_Pack";
BA_ "SystemMessageLongSymbol" BO_ 2566062336 "VDMA_F301_High_Voltage_Energy_Storage_Pack";
BA_ "SystemMessageLongSymbol" BO_ 2566062592 "VDMA_F302_High_Voltage_Energy_Storage_Pack";
BA_ "SystemMessageLongSymbol" BO_ 2566062848 "VDMA_F303_High_Voltage_Energy_Storage_Pack";
BA_ "SystemMessageLongSymbol" BO_ 2566063104 "VDMA_F304_High_Voltage_Energy_Storage_Pack";
BA_ "SystemMessageLongSymbol" BO_ 2566063360 "VDMA_F305_High_Voltage_Energy_Storage_Pack";
BA_ "SystemMessageLongSymbol" BO_ 2566063616 "VDMA_F306_High_Voltage_Energy_Storage_Pack";
BA_ "SystemMessageLongSymbol" BO_ 2566063872 "VDMA_F307_High_Voltage_Energy_Storage_Pack";
BA_ "SystemMessageLongSymbol" BO_ 2566064128 "VDMA_F308_High_Voltage_Energy_Storage_Pack";
BA_ "SystemMessageLongSymbol" BO_ 2566064384 "VDMA_F309_High_Voltage_Energy_Storage_Pack";
BA_ "SystemMessageLongSymbol" BO_ 2566064640 "VDMA_F30A_High_Voltage_Energy_Storage_Pack";
BA_ "SystemMessageLongSymbol" BO_ 2566064896 "VDMA_F30B_High_Voltage_Energy_Storage_Pack";
BA_ "SystemMessageLongSymbol" BO_ 2566065152 "VDMA_F30C_High_Voltage_Energy_Storage_Pack";
BA_ "SystemMessageLongSymbol" BO_ 2566065408 "VDMA_F30D_High_Voltage_Energy_Storage_Pack";
BA_ "SystemMessageLongSymbol" BO_ 2566065664 "VDMA_F30E_High_Voltage_Energy_Storage_Pack";
BA_ "SystemMessageLongSymbol" BO_ 2566065920 "VDMA_F30F_High_Voltage_Energy_Storage_Pack";
BA_ "SystemMessageLongSymbol" BO_ 2566066176 "VDMA_F310_High_Voltage_Energy_Storage_Pack";
BA_ "SystemMessageLongSymbol" BO_ 2566066432 "VDMA_F311_High_Voltage_Energy_Storage_Pack";
BA_ "SystemMessageLongSymbol" BO_ 2566066688 "VDMA_F312_High_Voltage_Energy_Storage_Pack";
BA_ "SystemMessageLongSymbol" BO_ 2566066944 "VDMA_F313_High_Voltage_Energy_Storage_Pack";
BA_ "SystemMessageLongSymbol" BO_ 2566067200 "VDMA_F314_High_Voltage_Energy_Storage_Pack";
BA_ "SystemMessageLongSymbol" BO_ 2566067456 "VDMA_F315_High_Voltage_Energy_Storage_Pack";
BA_ "SystemMessageLongSymbol" BO_ 2566067712 "VDMA_F316_High_Voltage_Energy_Storage_Pack";
BA_ "SystemMessageLongSymbol" BO_ 2566067968 "VDMA_F317_High_Voltage_Energy_Storage_Pack";
BA_ "SystemMessageLongSymbol" BO_ 2566068224 "VDMA_F318_High_Voltage_Energy_Storage_Pack";
BA_ "SystemMessageLongSymbol" BO_ 2566068480 "VDMA_F319_High_Voltage_Energy_Storage_Pack";
BA_ "SystemMessageLongSymbol" BO_ 2566068736 "VDMA_F31A_High_Voltage_Energy_Storage_Pack";
BA_ "SystemMessageLongSymbol" BO_ 2566068992 "VDMA_F31B_High_Voltage_Energy_Storage_Pack";
BA_ "SystemMessageLongSymbol" BO_ 2566069248 "VDMA_F31C_High_Voltage_Energy_Storage_Pack";
BA_ "SystemMessageLongSymbol" BO_ 2566069504 "VDMA_F31D_High_Voltage_Energy_Storage_Pack";
BA_ "SystemMessageLongSymbol" BO_ 2566069760 "VDMA_F31E_High_Voltage_Energy_Storage_Pack";
BA_ "SystemMessageLongSymbol" BO_ 2566070016 "VDMA_F31F_High_Voltage_Energy_Storage_Pack";
BA_ "SystemMessageLongSymbol" BO_ 2566070272 "VDMA_F320_High_Voltage_Energy_Storage_Pack";
BA_ "SystemMessageLongSymbol" BO_ 2566070528 "VDMA_F321_High_Voltage_Energy_Storage_Pack";
BA_ "SystemMessageLongSymbol" BO_ 2566070784 "VDMA_F322_High_Voltage_Energy_Storage_Pack";
BA_ "SystemMessageLongSymbol" BO_ 2566071040 "VDMA_F323_High_Voltage_Energy_Storage_Pack";
BA_ "SystemMessageLongSymbol" BO_ 2566071296 "VDMA_F324_High_Voltage_Energy_Storage_Pack";
BA_ "SystemMessageLongSymbol" BO_ 2566071552 "VDMA_F325_High_Voltage_Energy_Storage_Pack";
BA_ "SystemMessageLongSymbol" BO_ 2566071808 "VDMA_F326_High_Voltage_Energy_Storage_Pack";
BA_ "SystemMessageLongSymbol" BO_ 2566072064 "VDMA_F327_High_Voltage_Energy_Storage_Pack";
BA_ "SystemMessageLongSymbol" BO_ 2566072320 "VDMA_F328_High_Voltage_Energy_Storage_Pack";
BA_ "SystemMessageLongSymbol" BO_ 2566072576 "VDMA_F329_High_Voltage_Energy_Storage_Pack";
BA_ "SystemMessageLongSymbol" BO_ 2566072832 "VDMA_F32A_High_Voltage_Energy_Storage_Pack";
BA_ "SystemMessageLongSymbol" BO_ 2566073088 "VDMA_F32B_High_Voltage_Energy_Storage_Pack";
BA_ "SystemMessageLongSymbol" BO_ 2566073344 "VDMA_F32C_High_Voltage_Energy_Storage_Pack";
BA_ "SystemMessageLongSymbol" BO_ 2566073600 "VDMA_F32D_High_Voltage_Energy_Storage_Pack";
BA_ "SystemMessageLongSymbol" BO_ 2566073856 "VDMA_F32E_High_Voltage_Energy_Storage_Pack";
BA_ "SystemMessageLongSymbol" BO_ 2566074112 "VDMA_F32F_High_Voltage_Energy_Storage_Pack";
BA_ "SystemMessageLongSymbol" BO_ 2566074368 "VDMA_F330_High_Voltage_Energy_Storage_Pack";
BA_ "SystemMessageLongSymbol" BO_ 2566074624 "VDMA_F331_High_Voltage_Energy_Storage_Pack";
BA_ "SystemMessageLongSymbol" BO_ 2566074880 "VDMA_F332_High_Voltage_Energy_Storage_Pack";
BA_ "SystemMessageLongSymbol" BO_ 2566075136 "VDMA_F333_High_Voltage_Energy_Storage_Pack";
BA_ "SystemMessageLongSymbol" BO_ 2566075392 "VDMA_F334_High_Voltage_Energy_Storage_Pack";
BA_ "SystemMessageLongSymbol" BO_ 2566075648 "VDMA_F335_High_Voltage_Energy_Storage_Pack";
BA_ "SystemMessageLongSymbol" BO_ 2566075904 "VDMA_F336_High_Voltage_Energy_Storage_Pack";
BA_ "SystemMessageLongSymbol" BO_ 2566076160 "VDMA_F337_High_Voltage_Energy_Storage_Pack";
BA_ "SystemMessageLongSymbol" BO_ 2566076416 "VDMA_F338_High_Voltage_Energy_Storage_Pack";
BA_ "SystemMessageLongSymbol" BO_ 2566076672 "VDMA_F339_High_Voltage_Energy_Storage_Pack";
BA_ "SystemMessageLongSymbol" BO_ 2566076928 "VDMA_F33A_High_Voltage_Energy_Storage_Pack";
BA_ "SystemMessageLongSymbol" BO_ 2566077184 "VDMA_F33B_High_Voltage_Energy_Storage_Pack";
BA_ "SystemMessageLongSymbol" BO_ 2566077440 "VDMA_F33C_High_Voltage_Energy_Storage_Pack";
BA_ "SystemMessageLongSymbol" BO_ 2566077696 "VDMA_F33D_High_Voltage_Energy_Storage_Pack";
BA_ "SystemMessageLongSymbol" BO_ 2566077952 "VDMA_F33E_High_Voltage_Energy_Storage_Pack";
BA_ "SystemMessageLongSymbol" BO_ 2566078208 "VDMA_F33F_High_Voltage_Energy_Storage_Pack";
BA_ "SystemMessageLongSymbol" BO_ 2566078464 "VDMA_F340_High_Voltage_Energy_Storage_Pack";
BA_ "SystemMessageLongSymbol" BO_ 2566078720 "VDMA_F341_External_Steering_Request";
BA_ "SystemMessageLongSymbol" BO_ 2566078976 "VDMA_F342_Active_Steering_System_Controlle";
BA_ "SystemMessageLongSymbol" BO_ 2566079232 "VDMA_F343_Electronic_Park_Brake_Controller";
BA_ "SystemMessageLongSymbol" BO_ 2566079488 "VDMA_F344_Electronic_Park_Brake_Controller";
BA_ "SystemMessageLongSymbol" BO_ 2566079744 "VDMA_F345_Genset_Frequency_Limitation";
BA_ "SystemMessageLongSymbol" BO_ 2566080000 "VDMA_F346_Genset_Power_Limitation";
BA_ "SystemMessageLongSymbol" BO_ 2566080256 "VDMA_F347_Genset_Real_Power_Control";
BA_ "SystemMessageLongSymbol" BO_ 2566080768 "VDMA_F349_Fuel_Cell_Compartment_Informatio";
BA_ "SystemMessageLongSymbol" BO_ 2566081024 "VDMA_F34A_Genset_Real_Power_Setpoint_Deman";
BA_ "SystemMessageLongSymbol" BO_ 2566081280 "VDMA_F34B_Genset_Real_Power_Control_2";
BA_ "SystemMessageLongSymbol" BO_ 2566081536 "VDMA_F34C_High_Voltage_Energy_Storage_Pack";
BA_ "SystemMessageLongSymbol" BO_ 2566081792 "VDMA_F34D_High_Voltage_Energy_Storage_Pack";
BA_ "SystemMessageLongSymbol" BO_ 2566082048 "VDMA_F34E_High_Voltage_Energy_Storage_Pack";
BA_ "SystemMessageLongSymbol" BO_ 2566082304 "VDMA_F34F_High_Voltage_Energy_Storage_Pack";
BA_ "SystemMessageLongSymbol" BO_ 2566082560 "VDMA_F350_High_Voltage_Energy_Storage_Pack";
BA_ "SystemMessageLongSymbol" BO_ 2566082816 "VDMA_F351_High_Voltage_Energy_Storage_Pack";
BA_ "SystemMessageLongSymbol" BO_ 2566083072 "VDMA_F352_High_Voltage_Energy_Storage_Pack";
BA_ "SystemMessageLongSymbol" BO_ 2566083328 "VDMA_F353_High_Voltage_Energy_Storage_Pack";
BA_ "SystemMessageLongSymbol" BO_ 2566083584 "VDMA_F354_High_Voltage_Energy_Storage_Pack";
BA_ "SystemMessageLongSymbol" BO_ 2566083840 "VDMA_F355_High_Voltage_Energy_Storage_Pack";
BA_ "SystemMessageLongSymbol" BO_ 2566084096 "VDMA_F356_High_Voltage_Energy_Storage_Pack";
BA_ "SystemMessageLongSymbol" BO_ 2566084352 "VDMA_F357_High_Voltage_Energy_Storage_Pack";
BA_ "SystemMessageLongSymbol" BO_ 2566084608 "VDMA_F358_High_Voltage_Energy_Storage_Pack";
BA_ "SystemMessageLongSymbol" BO_ 2566084864 "VDMA_F359_High_Voltage_Energy_Storage_Pack";
BA_ "SystemMessageLongSymbol" BO_ 2566085120 "VDMA_F35A_High_Voltage_Energy_Storage_Pack";
BA_ "SystemMessageLongSymbol" BO_ 2566085376 "VDMA_F35B_High_Voltage_Energy_Storage_Pack";
BA_ "SystemMessageLongSymbol" BO_ 2566085632 "VDMA_F35C_High_Voltage_Energy_Storage_Pack";
BA_ "SystemMessageLongSymbol" BO_ 2566085888 "VDMA_F35D_High_Voltage_Energy_Storage_Pack";
BA_ "SystemMessageLongSymbol" BO_ 2566086144 "VDMA_F35E_High_Voltage_Energy_Storage_Pack";
BA_ "SystemMessageLongSymbol" BO_ 2566086400 "VDMA_F35F_High_Voltage_Energy_Storage_Pack";
BA_ "SystemMessageLongSymbol" BO_ 2566086656 "VDMA_F360_High_Voltage_Energy_Storage_Pack";
BA_ "SystemMessageLongSymbol" BO_ 2566086912 "VDMA_F361_High_Voltage_Energy_Storage_Pack";
BA_ "SystemMessageLongSymbol" BO_ 2566087168 "VDMA_F362_High_Voltage_Energy_Storage_Pack";
BA_ "SystemMessageLongSymbol" BO_ 2566087424 "VDMA_F363_High_Voltage_Energy_Storage_Pack";
BA_ "SystemMessageLongSymbol" BO_ 2566087936 "VDMA_F365_Electrified_Accessory_Propulsion";
BA_ "SystemMessageLongSymbol" BO_ 2566088192 "VDMA_F366_Electrified_Accessory_Propulsion";
BA_ "SystemMessageLongSymbol" BO_ 2566088448 "VDMA_F367_Electrified_Accessory_Propulsion";
BA_ "SystemMessageLongSymbol" BO_ 2566088704 "VDMA_F368_Electrified_Accessory_Power_Elec";
BA_ "SystemMessageLongSymbol" BO_ 2566088960 "VDMA_F369_Electrified_Accessory_Power_Elec";
BA_ "SystemMessageLongSymbol" BO_ 2566089216 "VDMA_F36A_Electrified_Accessory_Power_Elec";
BA_ "SystemMessageLongSymbol" BO_ 2566089472 "VDMA_F36B_Electrified_Accessory_Propulsion";
BA_ "SystemMessageLongSymbol" BO_ 2566089728 "VDMA_F36C_Electrified_Accessory_Propulsion";
BA_ "SystemMessageLongSymbol" BO_ 2566089984 "VDMA_F36D_Electrified_Accessory_Power_Elec";
BA_ "SystemMessageLongSymbol" BO_ 2566090240 "VDMA_F36E_Electrified_Accessory_Generator_";
BA_ "SystemMessageLongSymbol" BO_ 2566090496 "VDMA_F36F_Electrified_Accessory_Generator_";
BA_ "SystemMessageLongSymbol" BO_ 2566090752 "VDMA_F370_Electrified_Accessory_Motor_Stat";
BA_ "SystemMessageLongSymbol" BO_ 2566091008 "VDMA_F371_Fuel_Cell_System_Controller_Info";
BA_ "SystemMessageLongSymbol" BO_ 2566091264 "VDMA_F372_Fuel_Cell_System_Minimum_Power_I";
BA_ "SystemMessageLongSymbol" BO_ 2566091520 "VDMA_F373_Fuel_Cell_System_Maximum_Power_I";
BA_ "SystemMessageLongSymbol" BO_ 2566091776 "VDMA_F374_Fuel_Cell_System_Minimum_Current";
BA_ "SystemMessageLongSymbol" BO_ 2566092032 "VDMA_F375_Fuel_Cell_System_Maximum_Current";
BA_ "SystemMessageLongSymbol" BO_ 2566092288 "VDMA_F376_Hydrogen_Storage_System_Informat";
BA_ "SystemMessageLongSymbol" BO_ 2566092544 "VDMA_F377_Fuel_Cell_System_Operating_State";
BA_ "SystemMessageLongSymbol" BO_ 2566092800 "VDMA_F378_Fuel_Cell_System_Operations_Requ";
BA_ "SystemMessageLongSymbol" BO_ 2566093056 "VDMA_F379_Fuel_Cell_Stack_Information";
BA_ "SystemMessageLongSymbol" BO_ 2566093312 "VDMA_F37A_Fuel_Cell_System_Coolant_Fan_1_S";
BA_ "SystemMessageLongSymbol" BO_ 2566093568 "VDMA_F37B_Fuel_Cell_System_Coolant_Fan_2_S";
BA_ "SystemMessageLongSymbol" BO_ 2566093824 "VDMA_F37C_Fuel_Cell_System_Coolant_Fan_3_S";
BA_ "SystemMessageLongSymbol" BO_ 2566094080 "VDMA_F37D_Fuel_Cell_System_Coolant_Fan_4_S";
BA_ "SystemMessageLongSymbol" BO_ 2566094336 "VDMA_F37E_HVESS_Coolant_Pump_1_Status_2";
BA_ "SystemMessageLongSymbol" BO_ 2566094592 "VDMA_F37F_HVESS_Coolant_Pump_2_Status_2";
BA_ "SystemMessageLongSymbol" BO_ 2566094848 "VDMA_F380_High_Voltage_Energy_Storage_Syst";
BA_ "SystemMessageLongSymbol" BO_ 2566095360 "VDMA_F382_Fuel_Cell_System_Hydrogen_Pressu";
BA_ "SystemMessageLongSymbol" BO_ 2566095872 "VDMA_F384_Engine_Supercharger_Information";
BA_ "SystemMessageLongSymbol" BO_ 2566096128 "VDMA_F385_Engine_Disconnect_Clutch";
BA_ "SystemMessageLongSymbol" BO_ 2566478336 "VDMA_F95A_Engine_Crankcase_Ventilation_Hea";
BA_ "SystemMessageLongSymbol" BO_ 2566478592 "VDMA_F95B_Engine_Crankcase_Ventilation_Hea";
BA_ "SystemMessageLongSymbol" BO_ 2566478848 "VDMA_F95C_Engine_Crankcase_Ventilation_Hea";
BA_ "SystemMessageLongSymbol" BO_ 2566479360 "VDMA_F95E_OBFCM_Engine_Output_Energy_Stati";
BA_ "SystemMessageLongSymbol" BO_ 2566479616 "VDMA_F95F_OBFCM_Vehicle_Distance_Static_Da";
BA_ "SystemMessageLongSymbol" BO_ 2566479872 "VDMA_F960_OBFCM_Fuel_2_Static_Data";
BA_ "SystemMessageLongSymbol" BO_ 2566480128 "VDMA_F961_OBFCM_Fuel_1_Static_Data";
BA_ "SystemMessageLongSymbol" BO_ 2566481408 "VDMA_F966_Maintenance_Information_2";
BA_ "SystemMessageLongSymbol" BO_ 2566481920 "VDMA_F968_Engine_Catalyst_Diverter_Actuato";
BA_ "SystemMessageLongSymbol" BO_ 2566482176 "VDMA_F969_Electronic_Logging_Device_Hours_";
BA_ "SystemMessageLongSymbol" BO_ 2566482432 "VDMA_F96A_ER_DC_DC_Converter_4_References";
BA_ "SystemMessageLongSymbol" BO_ 2566482688 "VDMA_F96B_ER_DC_DC_Converter_4_Power_Limit";
BA_ "SystemMessageLongSymbol" BO_ 2566482944 "VDMA_F96C_ER_DC_DC_Converter_4_Current_Lim";
BA_ "SystemMessageLongSymbol" BO_ 2566483200 "VDMA_F96D_ER_DC_DC_Converter_4_Voltage_Lim";
BA_ "SystemMessageLongSymbol" BO_ 2566483456 "VDMA_F96E_ER_DC_DC_Converter_4_Temperature";
BA_ "SystemMessageLongSymbol" BO_ 2566483712 "VDMA_F96F_ER_DC_DC_Converter_4_Power_Limit";
BA_ "SystemMessageLongSymbol" BO_ 2566483968 "VDMA_F970_ER_DC_DC_Converter_4_Current_Lim";
BA_ "SystemMessageLongSymbol" BO_ 2566484224 "VDMA_F971_ER_DC_DC_Converter_4_Voltage_Lim";
BA_ "SystemMessageLongSymbol" BO_ 2566484480 "VDMA_F972_ER_DC_DC_Converter_4_Low_Voltage";
BA_ "SystemMessageLongSymbol" BO_ 2566484736 "VDMA_F973_ER_DC_DC_Converter_4_Power_and_C";
BA_ "SystemMessageLongSymbol" BO_ 2566484992 "VDMA_F974_ER_DC_DC_Converter_4_Voltage_and";
BA_ "SystemMessageLongSymbol" BO_ 2566485248 "VDMA_F975_ER_DC_DC_Converter_4_Operating_S";
BA_ "SystemMessageLongSymbol" BO_ 2566485504 "VDMA_F976_ER_DC_DC_Converter_4_Control";
BA_ "SystemMessageLongSymbol" BO_ 2566485760 "VDMA_F977_ER_DC_DC_Converter_3_References";
BA_ "SystemMessageLongSymbol" BO_ 2566486016 "VDMA_F978_ER_DC_DC_Converter_3_Power_Limit";
BA_ "SystemMessageLongSymbol" BO_ 2566486272 "VDMA_F979_ER_DC_DC_Converter_3_Current_Lim";
BA_ "SystemMessageLongSymbol" BO_ 2566486528 "VDMA_F97A_ER_DC_DC_Converter_3_Voltage_Lim";
BA_ "SystemMessageLongSymbol" BO_ 2566486784 "VDMA_F97B_ER_DC_DC_Converter_3_Temperature";
BA_ "SystemMessageLongSymbol" BO_ 2566487040 "VDMA_F97C_ER_DC_DC_Converter_3_Power_Limit";
BA_ "SystemMessageLongSymbol" BO_ 2566487296 "VDMA_F97D_ER_DC_DC_Converter_3_Current_Lim";
BA_ "SystemMessageLongSymbol" BO_ 2566487552 "VDMA_F97E_ER_DC_DC_Converter_3_Voltage_Lim";
BA_ "SystemMessageLongSymbol" BO_ 2566487808 "VDMA_F97F_ER_DC_DC_Converter_3_Low_Voltage";
BA_ "SystemMessageLongSymbol" BO_ 2566488064 "VDMA_F980_ER_DC_DC_Converter_3_Power_and_C";
BA_ "SystemMessageLongSymbol" BO_ 2566488320 "VDMA_F981_ER_DC_DC_Converter_3_Voltage_and";
BA_ "SystemMessageLongSymbol" BO_ 2566488576 "VDMA_F982_ER_DC_DC_Converter_3_Operating_S";
BA_ "SystemMessageLongSymbol" BO_ 2566488832 "VDMA_F983_ER_DC_DC_Converter_3_Control";
BA_ "SystemMessageLongSymbol" BO_ 2566489088 "VDMA_F984_ER_DC_DC_Converter_2_References";
BA_ "SystemMessageLongSymbol" BO_ 2566489344 "VDMA_F985_ER_DC_DC_Converter_2_Power_Limit";
BA_ "SystemMessageLongSymbol" BO_ 2566489600 "VDMA_F986_ER_DC_DC_Converter_2_Current_Lim";
BA_ "SystemMessageLongSymbol" BO_ 2566489856 "VDMA_F987_ER_DC_DC_Converter_2_Voltage_Lim";
BA_ "SystemMessageLongSymbol" BO_ 2566490112 "VDMA_F988_ER_DC_DC_Converter_2_Temperature";
BA_ "SystemMessageLongSymbol" BO_ 2566490368 "VDMA_F989_ER_DC_DC_Converter_2_Power_Limit";
BA_ "SystemMessageLongSymbol" BO_ 2566490624 "VDMA_F98A_ER_DC_DC_Converter_2_Current_Lim";
BA_ "SystemMessageLongSymbol" BO_ 2566490880 "VDMA_F98B_ER_DC_DC_Converter_2_Voltage_Lim";
BA_ "SystemMessageLongSymbol" BO_ 2566491136 "VDMA_F98C_ER_DC_DC_Converter_2_Low_Voltage";
BA_ "SystemMessageLongSymbol" BO_ 2566491392 "VDMA_F98D_ER_DC_DC_Converter_2_Power_and_C";
BA_ "SystemMessageLongSymbol" BO_ 2566491648 "VDMA_F98E_ER_DC_DC_Converter_2_Voltage_and";
BA_ "SystemMessageLongSymbol" BO_ 2566491904 "VDMA_F98F_ER_DC_DC_Converter_2_Operating_S";
BA_ "SystemMessageLongSymbol" BO_ 2566492160 "VDMA_F990_ER_DC_DC_Converter_2_Control";
BA_ "SystemMessageLongSymbol" BO_ 2566492416 "VDMA_F991_ER_DC_DC_Converter_1_References";
BA_ "SystemMessageLongSymbol" BO_ 2566492672 "VDMA_F992_ER_DC_DC_Converter_1_Power_Limit";
BA_ "SystemMessageLongSymbol" BO_ 2566492928 "VDMA_F993_ER_DC_DC_Converter_1_Current_Lim";
BA_ "SystemMessageLongSymbol" BO_ 2566493184 "VDMA_F994_ER_DC_DC_Converter_1_Voltage_Lim";
BA_ "SystemMessageLongSymbol" BO_ 2566493440 "VDMA_F995_ER_DC_DC_Converter_1_Temperature";
BA_ "SystemMessageLongSymbol" BO_ 2566493696 "VDMA_F996_ER_DC_DC_Converter_1_Power_Limit";
BA_ "SystemMessageLongSymbol" BO_ 2566493952 "VDMA_F997_ER_DC_DC_Converter_1_Current_Lim";
BA_ "SystemMessageLongSymbol" BO_ 2566494208 "VDMA_F998_ER_DC_DC_Converter_1_Voltage_Lim";
BA_ "SystemMessageLongSymbol" BO_ 2566494464 "VDMA_F999_ER_DC_DC_Converter_1_Low_Voltage";
BA_ "SystemMessageLongSymbol" BO_ 2566494720 "VDMA_F99A_ER_DC_DC_Converter_1_Power_and_C";
BA_ "SystemMessageLongSymbol" BO_ 2566494976 "VDMA_F99B_ER_DC_DC_Converter_1_Voltage_and";
BA_ "SystemMessageLongSymbol" BO_ 2566495232 "VDMA_F99C_ER_DC_DC_Converter_1_Operating_S";
BA_ "SystemMessageLongSymbol" BO_ 2566495488 "VDMA_F99D_ER_DC_DC_Converter_1_Control";
BA_ "SystemMessageLongSymbol" BO_ 2566495744 "VDMA_F99E_Cab_Air_Quality_System_Informati";
BA_ "SystemMessageLongSymbol" BO_ 2566496000 "VDMA_F99F_Cab_Air_Quality_System_Informati";
BA_ "SystemMessageLongSymbol" BO_ 2566496256 "VDMA_F9A0_Well_Stimulation_Pump_System_6";
BA_ "SystemMessageLongSymbol" BO_ 2566496512 "VDMA_F9A1_Engine_Fuel_Lube_Systems_4";
BA_ "SystemMessageLongSymbol" BO_ 2566497024 "VDMA_F9A3_Engine_Catalyst_Diverter_Actuato";
BA_ "SystemMessageLongSymbol" BO_ 2566497536 "VDMA_F9A5_Engine_Exhaust_Particulate_Contr";
BA_ "SystemMessageLongSymbol" BO_ 2566497792 "VDMA_F9A6_Engine_Exhaust_Particulate_Contr";
BA_ "SystemMessageLongSymbol" BO_ 2566498048 "VDMA_F9A7_Aftertreatment_System_Informatio";
BA_ "SystemMessageLongSymbol" BO_ 2566498304 "VDMA_F9A8_Aftertreatment_System_Informatio";
BA_ "SystemMessageLongSymbol" BO_ 2566498560 "VDMA_F9A9_Aftertreatment_System_Informatio";
BA_ "SystemMessageLongSymbol" BO_ 2566498816 "VDMA_F9AA_Aftertreatment_System_Informatio";
BA_ "SystemMessageLongSymbol" BO_ 2566499072 "VDMA_F9AB_Aftertreatment_System_Informatio";
BA_ "SystemMessageLongSymbol" BO_ 2566499328 "VDMA_F9AC_Aftertreatment_System_Informatio";
BA_ "SystemMessageLongSymbol" BO_ 2566499584 "VDMA_F9AD_Aftertreatment_System_Informatio";
BA_ "SystemMessageLongSymbol" BO_ 2566499840 "VDMA_F9AE_Aftertreatment_System_Informatio";
BA_ "SystemMessageLongSymbol" BO_ 2566500096 "VDMA_F9AF_Aftertreatment_System_Informatio";
BA_ "SystemMessageLongSymbol" BO_ 2566500352 "VDMA_F9B0_Aftertreatment_System_Informatio";
BA_ "SystemMessageLongSymbol" BO_ 2566500608 "VDMA_F9B1_Aftertreatment_System_Informatio";
BA_ "SystemMessageLongSymbol" BO_ 2566500864 "VDMA_F9B2_Aftertreatment_System_Informatio";
BA_ "SystemMessageLongSymbol" BO_ 2566501120 "VDMA_F9B3_Route_Attributes_Profile";
BA_ "SystemMessageLongSymbol" BO_ 2566501376 "VDMA_F9B4_Genset_Supporting_Functions_2";
BA_ "SystemMessageLongSymbol" BO_ 2566501632 "VDMA_F9B5_Alternator_Information_2";
BA_ "SystemMessageLongSymbol" BO_ 2566501888 "VDMA_F9B6_Well_Stimulation_Pump_System_5";
BA_ "SystemMessageLongSymbol" BO_ 2566502144 "VDMA_F9B7_Well_Stimulation_Pump_System_4";
BA_ "SystemMessageLongSymbol" BO_ 2566502912 "VDMA_F9BA_Route_Waypoint_GPS_Coordinates";
BA_ "SystemMessageLongSymbol" BO_ 2566503424 "VDMA_F9BC_Engine_Fluid_Level_Pressure_15";
BA_ "SystemMessageLongSymbol" BO_ 2566503680 "VDMA_F9BD_Fuel_Cell_System_Coolant_Informa";
BA_ "SystemMessageLongSymbol" BO_ 2566503936 "VDMA_F9BE_Transmission_Configuration_3";
BA_ "SystemMessageLongSymbol" BO_ 2566504448 "VDMA_F9C0_Fuel_Cell_System_Voltage_Limit_C";
BA_ "SystemMessageLongSymbol" BO_ 2566504960 "VDMA_F9C2_Hydrogen_System_Information";
BA_ "SystemMessageLongSymbol" BO_ 2566505216 "VDMA_F9C3_Auxiliary_Input_Output_Status_17";
BA_ "SystemMessageLongSymbol" BO_ 2566505472 "VDMA_F9C4_Auxiliary_Input_Output_Status_16";
BA_ "SystemMessageLongSymbol" BO_ 2566505728 "VDMA_F9C5_Auxiliary_Input_Output_Status_15";
BA_ "SystemMessageLongSymbol" BO_ 2566505984 "VDMA_F9C6_Auxiliary_Input_Output_Status_14";
BA_ "SystemMessageLongSymbol" BO_ 2566506240 "VDMA_F9C7_Auxiliary_Input_Output_Status_13";
BA_ "SystemMessageLongSymbol" BO_ 2566506496 "VDMA_F9C8_Auxiliary_Input_Output_Status_12";
BA_ "SystemMessageLongSymbol" BO_ 2566506752 "VDMA_F9C9_Auxiliary_Input_Output_Status_11";
BA_ "SystemMessageLongSymbol" BO_ 2566507008 "VDMA_F9CA_Auxiliary_Input_Output_Status_10";
BA_ "SystemMessageLongSymbol" BO_ 2566507264 "VDMA_F9CB_Auxiliary_Input_Output_Status_9";
BA_ "SystemMessageLongSymbol" BO_ 2566507520 "VDMA_F9CC_Auxiliary_Input_Output_Status_8";
BA_ "SystemMessageLongSymbol" BO_ 2566507776 "VDMA_F9CD_Aftertreatment_System_Informatio";
BA_ "SystemMessageLongSymbol" BO_ 2566509568 "VDMA_F9D4_Wheel_Brake_Lining_Remaining_Inf";
BA_ "SystemMessageLongSymbol" BO_ 2566509824 "VDMA_F9D5_Wheel_Brake_Lining_Remaining_Inf";
BA_ "SystemMessageLongSymbol" BO_ 2566510080 "VDMA_F9D6_High_Voltage_Bus_Contactor_Statu";
BA_ "SystemMessageLongSymbol" BO_ 2566510336 "VDMA_F9D7_High_Voltage_Bus_Contactor_Statu";
BA_ "SystemMessageLongSymbol" BO_ 2566510592 "VDMA_F9D8_High_Voltage_Bus_Connection_Comm";
BA_ "SystemMessageLongSymbol" BO_ 2566511104 "VDMA_F9DA_Service_Needed_DTC_Information";
BA_ "SystemMessageLongSymbol" BO_ 2566511616 "VDMA_F9DC_High_Voltage_Energy_Storage_Syst";
BA_ "SystemMessageLongSymbol" BO_ 2566511872 "VDMA_F9DD_High_Voltage_Energy_Storage_Syst";
BA_ "SystemMessageLongSymbol" BO_ 2566512128 "VDMA_F9DE_High_Voltage_Energy_Storage_Syst";
BA_ "SystemMessageLongSymbol" BO_ 2566512384 "VDMA_F9DF_HVESS_Coolant_Pump_1_Status_1";
BA_ "SystemMessageLongSymbol" BO_ 2566512640 "VDMA_F9E0_HVESS_Coolant_Pump_1_Command";
BA_ "SystemMessageLongSymbol" BO_ 2566512896 "VDMA_F9E1_HVESS_Coolant_Pump_2_Status_1";
BA_ "SystemMessageLongSymbol" BO_ 2566513152 "VDMA_F9E2_HVESS_Coolant_Pump_2_Command";
BA_ "SystemMessageLongSymbol" BO_ 2566513408 "VDMA_F9E3_Hydrogen_Sensor_Information";
BA_ "SystemMessageLongSymbol" BO_ 2566513664 "VDMA_F9E4_Operator_Inducement_Information_";
BA_ "SystemMessageLongSymbol" BO_ 2566513920 "VDMA_F9E5_Operator_Inducement_Vehicle_Spee";
BA_ "SystemMessageLongSymbol" BO_ 2566514176 "VDMA_F9E6_Operator_Inducement_Vehicle_Spee";
BA_ "SystemMessageLongSymbol" BO_ 2566514432 "VDMA_F9E7_Engine_Protection_Speed_Derate_I";
BA_ "SystemMessageLongSymbol" BO_ 2566514688 "VDMA_F9E8_Engine_Protection_Torque_Derate_";
BA_ "SystemMessageLongSymbol" BO_ 2566514944 "VDMA_F9E9_Aftertreatment_System_Informatio";
BA_ "SystemMessageLongSymbol" BO_ 2566515200 "VDMA_F9EA_SAE_J2012_3_Byte_DTC_Display";
BA_ "SystemMessageLongSymbol" BO_ 2566515456 "VDMA_F9EB_High_Voltage_Energy_Storage_Syst";
BA_ "SystemMessageLongSymbol" BO_ 2566515712 "VDMA_F9EC_High_Voltage_Energy_Storage_Syst";
BA_ "SystemMessageLongSymbol" BO_ 2566515968 "VDMA_F9ED_High_Voltage_Energy_Storage_Syst";
BA_ "SystemMessageLongSymbol" BO_ 2566516224 "VDMA_F9EE_Engine_Cylinder_Average_Ignition";
BA_ "SystemMessageLongSymbol" BO_ 2566516480 "VDMA_F9EF_Engine_Cylinder_Average_Ignition";
BA_ "SystemMessageLongSymbol" BO_ 2566516736 "VDMA_F9F0_Engine_Cylinder_Average_Ignition";
