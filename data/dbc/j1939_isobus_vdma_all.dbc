VERSION "created by canmatrix"

NS_ :

BS_:

BU_:

BA_DEF_ BO_ "SystemMessageLongSymbol" STRING;
BA_DEF_ SG_ "GenSigStartValue" FLOAT 0 100000000000;
BA_DEF_ SG_ "SystemSignalLongSymbol" STRING;

VERSION "created by canmatrix"

NS_ :

BS_:

BU_:

BA_DEF_ BO_ "SystemMessageLongSymbol" STRING;
BA_DEF_ SG_ "GenSigStartValue" FLOAT 0 100000000000;
BA_DEF_ SG_ "SystemSignalLongSymbol" STRING;

VERSION "created by canmatrix"

NS_ :

BS_:

BU_:

BO_ 2566683904 VDMA_FC7D_Heating_And_Refrigerat: 8 Vector__XXX
 SG_ Heating_And_Refrigerating_Unit_2 : 0|64@1+ (1,0) [0|18446744073709551615] "" Vector__XXX

BO_ 2566684160 VDMA_FC7E_Heating_And_Refrigerat: 8 Vector__XXX
 SG_ Heating_And_Refrigerating_Unit_3 : 0|64@1+ (1,0) [0|18446744073709551615] "" Vector__XXX

BO_ 2566684416 VDMA_FC7F_Heating_And_Refrigerat: 8 Vector__XXX
 SG_ Heating_And_Refrigerating_Unit_4 : 0|64@1+ (1,0) [0|18446744073709551615] "" Vector__XXX

BO_ 2566684672 VDMA_FC80_HRU_Temperature_Setpoi: 8 Vector__XXX
 SG_ HRU_Temperature_Setpoint_RawPayl : 0|64@1+ (1,0) [0|18446744073709551615] "" Vector__XXX

BO_ 2566684928 VDMA_FC81_Lifting_Unit_1: 8 Vector__XXX
 SG_ Lifting_Unit_1_RawPayload : 0|64@1+ (1,0) [0|18446744073709551615] "" Vector__XXX

BO_ 2566685184 VDMA_FC82_Tail_Lift_Unit_1: 8 Vector__XXX
 SG_ Tail_Lift_Unit_1_RawPayload : 0|64@1+ (1,0) [0|18446744073709551615] "" Vector__XXX

BO_ 2566685440 VDMA_FC83_Vehicle_Status: 8 Vector__XXX
 SG_ Vehicle_Status_RawPayload : 0|64@1+ (1,0) [0|18446744073709551615] "" Vector__XXX

BO_ 2566685696 VDMA_FC84_Windshield_Wiper_Reque: 8 Vector__XXX
 SG_ Windshield_Wiper_Request_RawPayl : 0|64@1+ (1,0) [0|18446744073709551615] "" Vector__XXX

BO_ 2566685952 VDMA_FC85_Fuel_Cell_Auxiliary_He: 8 Vector__XXX
 SG_ Fuel_Cell_Auxiliary_Heater_Contr : 0|64@1+ (1,0) [0|18446744073709551615] "" Vector__XXX

BO_ 2566686208 VDMA_FC86_Fuel_Cell_Auxiliary_He: 8 Vector__XXX
 SG_ Fuel_Cell_Auxiliary_Heater_Infor : 0|64@1+ (1,0) [0|18446744073709551615] "" Vector__XXX

BO_ 2566686464 VDMA_FC87_Fuel_Cell_Coolant_Pump: 8 Vector__XXX
 SG_ Fuel_Cell_Coolant_Pump_1_Command : 0|64@1+ (1,0) [0|18446744073709551615] "" Vector__XXX

BO_ 2566686720 VDMA_FC88_Fuel_Cell_Coolant_Pump: 8 Vector__XXX
 SG_ Fuel_Cell_Coolant_Pump_2_Command : 0|64@1+ (1,0) [0|18446744073709551615] "" Vector__XXX

BO_ 2566686976 VDMA_FC89_Fuel_Cell_Coolant_Pump: 8 Vector__XXX
 SG_ Fuel_Cell_Coolant_Pump_1_Status_ : 0|64@1+ (1,0) [0|18446744073709551615] "" Vector__XXX

BO_ 2566687232 VDMA_FC8A_Fuel_Cell_Coolant_Pump: 8 Vector__XXX
 SG_ Fuel_Cell_Coolant_Pump_2_Status_ : 0|64@1+ (1,0) [0|18446744073709551615] "" Vector__XXX

BO_ 2566687488 VDMA_FC8B_Aftertreatment_1_Parti: 8 Vector__XXX
 SG_ Aftertreatment_1_Particulate_Sen : 0|64@1+ (1,0) [0|18446744073709551615] "" Vector__XXX

BO_ 2566687744 VDMA_FC8C_Aftertreatment_1_Parti: 8 Vector__XXX
 SG_ Aftertreatment_1_Particulate_Sen : 0|64@1+ (1,0) [0|18446744073709551615] "" Vector__XXX

BO_ 2566688512 VDMA_FC8F_Alternate_Fuel_3: 8 Vector__XXX
 SG_ Alternate_Fuel_3_RawPayload : 0|64@1+ (1,0) [0|18446744073709551615] "" Vector__XXX

BO_ 2566688768 VDMA_FC90_Engine_Fuel_Injector_M: 8 Vector__XXX
 SG_ Engine_Fuel_Injector_Metering_Ra : 0|64@1+ (1,0) [0|18446744073709551615] "" Vector__XXX

BO_ 2566689024 VDMA_FC91_Engine_Exhaust_NOx: 8 Vector__XXX
 SG_ Engine_Exhaust_NOx_RawPayload : 0|64@1+ (1,0) [0|18446744073709551615] "" Vector__XXX

BO_ 2566689280 VDMA_FC92_Air_Fuel_Ratio_1: 8 Vector__XXX
 SG_ Air_Fuel_Ratio_1_RawPayload : 0|64@1+ (1,0) [0|18446744073709551615] "" Vector__XXX

BO_ 2566689536 VDMA_FC93_Gaseous_Fuel_Pressure_: 8 Vector__XXX
 SG_ Gaseous_Fuel_Pressure_2_RawPaylo : 0|64@1+ (1,0) [0|18446744073709551615] "" Vector__XXX

BO_ 2566689792 VDMA_FC94_Aftertreatment_System_: 8 Vector__XXX
 SG_ Aftertreatment_System_Abuse_Info : 0|64@1+ (1,0) [0|18446744073709551615] "" Vector__XXX

BO_ 2566690048 VDMA_FC95_Engine_Cylinder_Pressu: 8 Vector__XXX
 SG_ Engine_Cylinder_Pressure_Monitor : 0|64@1+ (1,0) [0|18446744073709551615] "" Vector__XXX

BO_ 2566690304 VDMA_FC96_Engine_Information_2: 8 Vector__XXX
 SG_ Engine_Information_2_RawPayload : 0|64@1+ (1,0) [0|18446744073709551615] "" Vector__XXX

BO_ 2566690560 VDMA_FC97_Electronic_Steering_Co: 8 Vector__XXX
 SG_ Electronic_Steering_Control_2_Ra : 0|64@1+ (1,0) [0|18446744073709551615] "" Vector__XXX

BO_ 2566690816 VDMA_FC98_Vehicle_Speed_Limiter: 8 Vector__XXX
 SG_ Vehicle_Speed_Limiter_RawPayload : 0|64@1+ (1,0) [0|18446744073709551615] "" Vector__XXX

BO_ 2566691072 VDMA_FC99_Assembly_Unit_Identifi: 8 Vector__XXX
 SG_ Assembly_Unit_Identification_Raw : 0|64@1+ (1,0) [0|18446744073709551615] "" Vector__XXX

BO_ 2566691328 VDMA_FC9A_Joystick_3_Lamp_Status: 8 Vector__XXX
 SG_ Joystick_3_Lamp_Status_RawPayloa : 0|64@1+ (1,0) [0|18446744073709551615] "" Vector__XXX

BO_ 2566691584 VDMA_FC9B_Joystick_2_Lamp_Status: 8 Vector__XXX
 SG_ Joystick_2_Lamp_Status_RawPayloa : 0|64@1+ (1,0) [0|18446744073709551615] "" Vector__XXX

BO_ 2566691840 VDMA_FC9C_Joystick_1_Lamp_Status: 8 Vector__XXX
 SG_ Joystick_1_Lamp_Status_RawPayloa : 0|64@1+ (1,0) [0|18446744073709551615] "" Vector__XXX

BO_ 2566692096 VDMA_FC9D_Engine_Timing_Actuator: 8 Vector__XXX
 SG_ Engine_Timing_Actuator_Position_ : 0|64@1+ (1,0) [0|18446744073709551615] "" Vector__XXX

BO_ 2566692352 VDMA_FC9E_Engine_Timing_Actuator: 8 Vector__XXX
 SG_ Engine_Timing_Actuator_Position_ : 0|64@1+ (1,0) [0|18446744073709551615] "" Vector__XXX

BO_ 2566692608 VDMA_FC9F_Dash_Display_2: 8 Vector__XXX
 SG_ Dash_Display_2_RawPayload : 0|64@1+ (1,0) [0|18446744073709551615] "" Vector__XXX

BO_ 2566692864 VDMA_FCA0_Multi_fuel_Engine_Hour: 8 Vector__XXX
 SG_ Multi_fuel_Engine_Hours_RawPaylo : 0|64@1+ (1,0) [0|18446744073709551615] "" Vector__XXX

BO_ 2566693120 VDMA_FCA1_Engine_Spark_Misfire_R: 8 Vector__XXX
 SG_ Engine_Spark_Misfire_Rate_3_RawP : 0|64@1+ (1,0) [0|18446744073709551615] "" Vector__XXX

BO_ 2566693376 VDMA_FCA2_Engine_Spark_Misfire_R: 8 Vector__XXX
 SG_ Engine_Spark_Misfire_Rate_2_RawP : 0|64@1+ (1,0) [0|18446744073709551615] "" Vector__XXX

BO_ 2566693632 VDMA_FCA3_Engine_Spark_Misfire_R: 8 Vector__XXX
 SG_ Engine_Spark_Misfire_Rate_1_RawP : 0|64@1+ (1,0) [0|18446744073709551615] "" Vector__XXX

BO_ 2566693888 VDMA_FCA4_Engine_Spark_Maximum_V: 8 Vector__XXX
 SG_ Engine_Spark_Maximum_Voltage_6_R : 0|64@1+ (1,0) [0|18446744073709551615] "" Vector__XXX

BO_ 2566694144 VDMA_FCA5_Engine_Spark_Maximum_V: 8 Vector__XXX
 SG_ Engine_Spark_Maximum_Voltage_5_R : 0|64@1+ (1,0) [0|18446744073709551615] "" Vector__XXX

BO_ 2566694400 VDMA_FCA6_Engine_Spark_Maximum_V: 8 Vector__XXX
 SG_ Engine_Spark_Maximum_Voltage_4_R : 0|64@1+ (1,0) [0|18446744073709551615] "" Vector__XXX

BO_ 2566694656 VDMA_FCA7_Engine_Spark_Maximum_V: 8 Vector__XXX
 SG_ Engine_Spark_Maximum_Voltage_3_R : 0|64@1+ (1,0) [0|18446744073709551615] "" Vector__XXX

BO_ 2566694912 VDMA_FCA8_Engine_Spark_Maximum_V: 8 Vector__XXX
 SG_ Engine_Spark_Maximum_Voltage_2_R : 0|64@1+ (1,0) [0|18446744073709551615] "" Vector__XXX

BO_ 2566695168 VDMA_FCA9_Engine_Spark_Maximum_V: 8 Vector__XXX
 SG_ Engine_Spark_Maximum_Voltage_1_R : 0|64@1+ (1,0) [0|18446744073709551615] "" Vector__XXX

BO_ 2566695424 VDMA_FCAA_Engine_Spark_Minimum_V: 8 Vector__XXX
 SG_ Engine_Spark_Minimum_Voltage_6_R : 0|64@1+ (1,0) [0|18446744073709551615] "" Vector__XXX

BO_ 2566695680 VDMA_FCAB_Engine_Spark_Minimum_V: 8 Vector__XXX
 SG_ Engine_Spark_Minimum_Voltage_5_R : 0|64@1+ (1,0) [0|18446744073709551615] "" Vector__XXX

BO_ 2566695936 VDMA_FCAC_Engine_Spark_Minimum_V: 8 Vector__XXX
 SG_ Engine_Spark_Minimum_Voltage_4_R : 0|64@1+ (1,0) [0|18446744073709551615] "" Vector__XXX

BO_ 2566696192 VDMA_FCAD_Engine_Spark_Minimum_V: 8 Vector__XXX
 SG_ Engine_Spark_Minimum_Voltage_3_R : 0|64@1+ (1,0) [0|18446744073709551615] "" Vector__XXX

BO_ 2566696448 VDMA_FCAE_Engine_Spark_Minimum_V: 8 Vector__XXX
 SG_ Engine_Spark_Minimum_Voltage_2_R : 0|64@1+ (1,0) [0|18446744073709551615] "" Vector__XXX

BO_ 2566696704 VDMA_FCAF_Engine_Spark_Minimum_V: 8 Vector__XXX
 SG_ Engine_Spark_Minimum_Voltage_1_R : 0|64@1+ (1,0) [0|18446744073709551615] "" Vector__XXX

BO_ 2566696960 VDMA_FCB0_Engine_Ignition_Contro: 8 Vector__XXX
 SG_ Engine_Ignition_Controller_Maint : 0|64@1+ (1,0) [0|18446744073709551615] "" Vector__XXX

BO_ 2566697216 VDMA_FCB1_Engine_Ignition_Contro: 8 Vector__XXX
 SG_ Engine_Ignition_Control_Module_S : 0|64@1+ (1,0) [0|18446744073709551615] "" Vector__XXX

BO_ 2566697728 VDMA_FCB3_Fused_Power_Output_Cur: 8 Vector__XXX
 SG_ Fused_Power_Output_Current_RawPa : 0|64@1+ (1,0) [0|18446744073709551615] "" Vector__XXX

BO_ 2566697984 VDMA_FCB4_Switched_Power_Output_: 8 Vector__XXX
 SG_ Switched_Power_Output_Status_Raw : 0|64@1+ (1,0) [0|18446744073709551615] "" Vector__XXX

BO_ 2566698240 VDMA_FCB5_Fused_Power_Output_Sta: 8 Vector__XXX
 SG_ Fused_Power_Output_Status_RawPay : 0|64@1+ (1,0) [0|18446744073709551615] "" Vector__XXX

BO_ 2566698496 VDMA_FCB6_Vehicle_Electrical_Pow: 8 Vector__XXX
 SG_ Vehicle_Electrical_Power_5_RawPa : 0|64@1+ (1,0) [0|18446744073709551615] "" Vector__XXX

BO_ 2566698752 VDMA_FCB7_Hybrid_or_EV_System_St: 8 Vector__XXX
 SG_ Hybrid_or_EV_System_Status_2_Raw : 0|64@1+ (1,0) [0|18446744073709551615] "" Vector__XXX

BO_ 2566699008 VDMA_FCB8_Aftertreatment_2_Servi: 8 Vector__XXX
 SG_ Aftertreatment_2_Service_2_RawPa : 0|64@1+ (1,0) [0|18446744073709551615] "" Vector__XXX

BO_ 2566699264 VDMA_FCB9_Aftertreatment_1_Servi: 8 Vector__XXX
 SG_ Aftertreatment_1_Service_2_RawPa : 0|64@1+ (1,0) [0|18446744073709551615] "" Vector__XXX

BO_ 2566699520 VDMA_FCBA_Aftertreatment_2_SCR_E: 8 Vector__XXX
 SG_ Aftertreatment_2_SCR_Electronic_ : 0|64@1+ (1,0) [0|18446744073709551615] "" Vector__XXX

BO_ 2566699776 VDMA_FCBB_Aftertreatment_1_SCR_E: 8 Vector__XXX
 SG_ Aftertreatment_1_SCR_Electronic_ : 0|64@1+ (1,0) [0|18446744073709551615] "" Vector__XXX

BO_ 2566700032 VDMA_FCBC_Aftertreatment_2_SCR_S: 8 Vector__XXX
 SG_ Aftertreatment_2_SCR_Service_Inf : 0|64@1+ (1,0) [0|18446744073709551615] "" Vector__XXX

BO_ 2566700288 VDMA_FCBD_Aftertreatment_1_SCR_S: 8 Vector__XXX
 SG_ Aftertreatment_1_SCR_Service_Inf : 0|64@1+ (1,0) [0|18446744073709551615] "" Vector__XXX

BO_ 2566700544 VDMA_FCBE_Electronic_Transmissio: 8 Vector__XXX
 SG_ Electronic_Transmission_Controll : 0|64@1+ (1,0) [0|18446744073709551615] "" Vector__XXX

BO_ 2566700800 VDMA_FCBF_Electronic_Transmissio: 8 Vector__XXX
 SG_ Electronic_Transmission_Controll : 0|64@1+ (1,0) [0|18446744073709551615] "" Vector__XXX

BO_ 2566701056 VDMA_FCC0_Electronic_Transmissio: 8 Vector__XXX
 SG_ Electronic_Transmission_Controll : 0|64@1+ (1,0) [0|18446744073709551615] "" Vector__XXX

BO_ 2566701312 VDMA_FCC1_Transmission_Fluids_3: 8 Vector__XXX
 SG_ Transmission_Fluids_3_RawPayload : 0|64@1+ (1,0) [0|18446744073709551615] "" Vector__XXX

BO_ 2566701568 VDMA_FCC2_Hybrid_or_EV_System_St: 8 Vector__XXX
 SG_ Hybrid_or_EV_System_Status_1_Raw : 0|64@1+ (1,0) [0|18446744073709551615] "" Vector__XXX

BO_ 2566701824 VDMA_FCC3_Fuel_Information_4_Gas: 8 Vector__XXX
 SG_ Fuel_Information_4_Gaseous_RawPa : 0|64@1+ (1,0) [0|18446744073709551615] "" Vector__XXX

BO_ 2566702080 VDMA_FCC4_Aftertreatment_2_SCR_E: 8 Vector__XXX
 SG_ Aftertreatment_2_SCR_Exhaust_Gas : 0|64@1+ (1,0) [0|18446744073709551615] "" Vector__XXX

BO_ 2566702336 VDMA_FCC5_Aftertreatment_1_SCR_E: 8 Vector__XXX
 SG_ Aftertreatment_1_SCR_Exhaust_Gas : 0|64@1+ (1,0) [0|18446744073709551615] "" Vector__XXX

BO_ 2566702592 VDMA_FCC6_OBD_Information: 8 Vector__XXX
 SG_ OBD_Information_RawPayload : 0|64@1+ (1,0) [0|18446744073709551615] "" Vector__XXX

BO_ 2566702848 VDMA_FCC7_Model_Year_and_Certifi: 8 Vector__XXX
 SG_ Model_Year_and_Certification_Eng : 0|64@1+ (1,0) [0|18446744073709551615] "" Vector__XXX

BO_ 2566703104 VDMA_FCC8_Electronic_Engine_Cont: 8 Vector__XXX
 SG_ Electronic_Engine_Controller_13_ : 0|64@1+ (1,0) [0|18446744073709551615] "" Vector__XXX

BO_ 2566703360 VDMA_FCC9_Engine_Fuel_Throttle_V: 8 Vector__XXX
 SG_ Engine_Fuel_Throttle_Valve_Infor : 0|64@1+ (1,0) [0|18446744073709551615] "" Vector__XXX

BO_ 2566703616 VDMA_FCCA_Engine_Exhaust_Gas_Rec: 8 Vector__XXX
 SG_ Engine_Exhaust_Gas_Recirculation : 0|64@1+ (1,0) [0|18446744073709551615] "" Vector__XXX

BO_ 2566703872 VDMA_FCCB_Engine_Exhaust_Gas_Rec: 8 Vector__XXX
 SG_ Engine_Exhaust_Gas_Recirculation : 0|64@1+ (1,0) [0|18446744073709551615] "" Vector__XXX

BO_ 2566704128 VDMA_FCCC_Electronic_Engine_Cont: 8 Vector__XXX
 SG_ Electronic_Engine_Controller_12_ : 0|64@1+ (1,0) [0|18446744073709551615] "" Vector__XXX

BO_ 2566704384 VDMA_FCCD_Drive_Strategy_Status: 8 Vector__XXX
 SG_ Drive_Strategy_Status_RawPayload : 0|64@1+ (1,0) [0|18446744073709551615] "" Vector__XXX

BO_ 2566704640 VDMA_FCCE_Drive_Strategy_command: 8 Vector__XXX
 SG_ Drive_Strategy_command_RawPayloa : 0|64@1+ (1,0) [0|18446744073709551615] "" Vector__XXX

BO_ 2566704896 VDMA_FCCF_NOx_Sensor_Self_Diagno: 8 Vector__XXX
 SG_ NOx_Sensor_Self_Diagnosis_Reques : 0|64@1+ (1,0) [0|18446744073709551615] "" Vector__XXX

BO_ 2566705152 VDMA_FCD0_Engine_Particulate_Sen: 8 Vector__XXX
 SG_ Engine_Particulate_Sensor_Inform : 0|64@1+ (1,0) [0|18446744073709551615] "" Vector__XXX

BO_ 2566705408 VDMA_FCD1_Active_Service_Only_DT: 8 Vector__XXX
 SG_ Active_Service_Only_DTCs_RawPayl : 0|64@1+ (1,0) [0|18446744073709551615] "" Vector__XXX

BO_ 2566705664 VDMA_FCD2_Previously_Active_Serv: 8 Vector__XXX
 SG_ Previously_Active_Service_Only_D : 0|64@1+ (1,0) [0|18446744073709551615] "" Vector__XXX

BO_ 2566705920 VDMA_FCD3_Diagnostic_Data_Clear_: 8 Vector__XXX
 SG_ Diagnostic_Data_Clear_Reset_for_ : 0|64@1+ (1,0) [0|18446744073709551615] "" Vector__XXX

BO_ 2566706176 VDMA_FCD4_XCP_Get_Slave_ID: 8 Vector__XXX
 SG_ XCP_Get_Slave_ID_RawPayload : 0|64@1+ (1,0) [0|18446744073709551615] "" Vector__XXX

BO_ 2566706432 VDMA_FCD5_Aftertreatment_1_Diese: 8 Vector__XXX
 SG_ Aftertreatment_1_Diesel_Exhaust_ : 0|64@1+ (1,0) [0|18446744073709551615] "" Vector__XXX

BO_ 2566706688 VDMA_FCD6_Aftertreatment_1_Diese: 8 Vector__XXX
 SG_ Aftertreatment_1_Diesel_Particul : 0|64@1+ (1,0) [0|18446744073709551615] "" Vector__XXX

BO_ 2566706944 VDMA_FCD7_Aftertreatment_1_Diese: 8 Vector__XXX
 SG_ Aftertreatment_1_Diesel_Particul : 0|64@1+ (1,0) [0|18446744073709551615] "" Vector__XXX

BO_ 2566707200 VDMA_FCD8_Aftertreatment_1_Diese: 8 Vector__XXX
 SG_ Aftertreatment_1_Diesel_Particul : 0|64@1+ (1,0) [0|18446744073709551615] "" Vector__XXX

BO_ 2566707456 VDMA_FCD9_Aftertreatment_1_Diese: 8 Vector__XXX
 SG_ Aftertreatment_1_Diesel_Particul : 0|64@1+ (1,0) [0|18446744073709551615] "" Vector__XXX

BO_ 2566707712 VDMA_FCDA_Aftertreatment_1_Diese: 8 Vector__XXX
 SG_ Aftertreatment_1_Diesel_Particul : 0|64@1+ (1,0) [0|18446744073709551615] "" Vector__XXX

BO_ 2566707968 VDMA_FCDB_Aftertreatment_1_Diese: 8 Vector__XXX
 SG_ Aftertreatment_1_Diesel_Particul : 0|64@1+ (1,0) [0|18446744073709551615] "" Vector__XXX

BO_ 2566708224 VDMA_FCDC_Cruise_Control_Vehicle: 8 Vector__XXX
 SG_ Cruise_Control_Vehicle_Speed_3_R : 0|64@1+ (1,0) [0|18446744073709551615] "" Vector__XXX

BO_ 2566708480 VDMA_FCDD_Aftertreatment_2_Air_C: 8 Vector__XXX
 SG_ Aftertreatment_2_Air_Control_3_R : 0|64@1+ (1,0) [0|18446744073709551615] "" Vector__XXX

BO_ 2566708736 VDMA_FCDE_Aftertreatment_1_Air_C: 8 Vector__XXX
 SG_ Aftertreatment_1_Air_Control_3_R : 0|64@1+ (1,0) [0|18446744073709551615] "" Vector__XXX

BO_ 2566708992 VDMA_FCDF_Engine_Fluid_Level_Pre: 8 Vector__XXX
 SG_ Engine_Fluid_Level_Pressure_12_R : 0|64@1+ (1,0) [0|18446744073709551615] "" Vector__XXX

BO_ 2566709248 VDMA_FCE0_Diesel_Particulate_Fil: 8 Vector__XXX
 SG_ Diesel_Particulate_Filter_Contro : 0|64@1+ (1,0) [0|18446744073709551615] "" Vector__XXX

BO_ 2566709504 VDMA_FCE1_Fuel_Economy_2_Liquid: 8 Vector__XXX
 SG_ Fuel_Economy_2_Liquid_RawPayload : 0|64@1+ (1,0) [0|18446744073709551615] "" Vector__XXX

BO_ 2566709760 VDMA_FCE2_Supplemental_Fan_Statu: 8 Vector__XXX
 SG_ Supplemental_Fan_Status_RawPaylo : 0|64@1+ (1,0) [0|18446744073709551615] "" Vector__XXX

BO_ 2566710016 VDMA_FCE3_Engine_Exhaust_Brake_C: 8 Vector__XXX
 SG_ Engine_Exhaust_Brake_Control_Raw : 0|64@1+ (1,0) [0|18446744073709551615] "" Vector__XXX

BO_ 2566710272 VDMA_FCE4_Engine_Fuel_Properties: 8 Vector__XXX
 SG_ Engine_Fuel_Properties_RawPayloa : 0|64@1+ (1,0) [0|18446744073709551615] "" Vector__XXX

BO_ 2566710528 VDMA_FCE5_Hydraulic_Oil_Properti: 8 Vector__XXX
 SG_ Hydraulic_Oil_Properties_RawPayl : 0|64@1+ (1,0) [0|18446744073709551615] "" Vector__XXX

BO_ 2566710784 VDMA_FCE6_Vehicle_Chassis_Lubric: 8 Vector__XXX
 SG_ Vehicle_Chassis_Lubrication_Syst : 0|64@1+ (1,0) [0|18446744073709551615] "" Vector__XXX

BO_ 2566711040 VDMA_FCE7_Engine_Configuration_3: 8 Vector__XXX
 SG_ Engine_Configuration_3_RawPayloa : 0|64@1+ (1,0) [0|18446744073709551615] "" Vector__XXX

BO_ 2566711296 VDMA_FCE8_Intake_Valve_Actuation: 8 Vector__XXX
 SG_ Intake_Valve_Actuation_Control_R : 0|64@1+ (1,0) [0|18446744073709551615] "" Vector__XXX

BO_ 2566711552 VDMA_FCE9_Armrest_Switch_Matrix_: 8 Vector__XXX
 SG_ Armrest_Switch_Matrix_Commands_R : 0|64@1+ (1,0) [0|18446744073709551615] "" Vector__XXX

BO_ 2566711808 VDMA_FCEA_Vehicle_Electrical_Pow: 8 Vector__XXX
 SG_ Vehicle_Electrical_Power_4_obsol : 0|64@1+ (1,0) [0|18446744073709551615] "" Vector__XXX

BO_ 2566712064 VDMA_FCEB_Aftertreatment_2_NOx_A: 8 Vector__XXX
 SG_ Aftertreatment_2_NOx_Adsorber_In : 0|64@1+ (1,0) [0|18446744073709551615] "" Vector__XXX

BO_ 2566712320 VDMA_FCEC_Aftertreatment_1_NOx_A: 8 Vector__XXX
 SG_ Aftertreatment_1_NOx_Adsorber_In : 0|64@1+ (1,0) [0|18446744073709551615] "" Vector__XXX

BO_ 2566712576 VDMA_FCED_Aftertreatment_2_Warm_: 8 Vector__XXX
 SG_ Aftertreatment_2_Warm_Up_Diesel_ : 0|64@1+ (1,0) [0|18446744073709551615] "" Vector__XXX

BO_ 2566712832 VDMA_FCEE_Land_Leveling_System_R: 8 Vector__XXX
 SG_ Land_Leveling_System_Reference_E : 0|64@1+ (1,0) [0|18446744073709551615] "" Vector__XXX

BO_ 2566713088 VDMA_FCEF_Engine_Fluid_Level_Pre: 8 Vector__XXX
 SG_ Engine_Fluid_Level_Pressure_11_R : 0|64@1+ (1,0) [0|18446744073709551615] "" Vector__XXX

BO_ 2566713344 VDMA_FCF0_Engine_Fuel_Lube_x000D: 8 Vector__XXX
 SG_ Engine_Fuel_Lube_x000D_Systems_2 : 0|64@1+ (1,0) [0|18446744073709551615] "" Vector__XXX

BO_ 2566713600 VDMA_FCF1_Engine_Turbocharger_Wa: 8 Vector__XXX
 SG_ Engine_Turbocharger_Wastegate_Ac : 0|64@1+ (1,0) [0|18446744073709551615] "" Vector__XXX

BO_ 2566713856 VDMA_FCF2_Engine_Fuel_Throttle_V: 8 Vector__XXX
 SG_ Engine_Fuel_Throttle_Valve_Infor : 0|64@1+ (1,0) [0|18446744073709551615] "" Vector__XXX

BO_ 2566714112 VDMA_FCF3_Engine_Turbocharger_Co: 8 Vector__XXX
 SG_ Engine_Turbocharger_Compressor_B : 0|64@1+ (1,0) [0|18446744073709551615] "" Vector__XXX

BO_ 2566714368 VDMA_FCF4_Charge_Air_Cooler_2: 8 Vector__XXX
 SG_ Charge_Air_Cooler_2_RawPayload : 0|64@1+ (1,0) [0|18446744073709551615] "" Vector__XXX

BO_ 2566714624 VDMA_FCF5_Charge_Air_Cooler_2_Pr: 8 Vector__XXX
 SG_ Charge_Air_Cooler_2_Precooler_Ra : 0|64@1+ (1,0) [0|18446744073709551615] "" Vector__XXX

BO_ 2566714880 VDMA_FCF6_Charge_Air_Cooler_1: 8 Vector__XXX
 SG_ Charge_Air_Cooler_1_RawPayload : 0|64@1+ (1,0) [0|18446744073709551615] "" Vector__XXX

BO_ 2566715136 VDMA_FCF7_Charge_Air_Cooler_1_Pr: 8 Vector__XXX
 SG_ Charge_Air_Cooler_1_Precooler_Ra : 0|64@1+ (1,0) [0|18446744073709551615] "" Vector__XXX

BO_ 2566715392 VDMA_FCF8_Diesel_Particulate_Fil: 8 Vector__XXX
 SG_ Diesel_Particulate_Filter_2_Soot : 0|64@1+ (1,0) [0|18446744073709551615] "" Vector__XXX

BO_ 2566715648 VDMA_FCF9_Diesel_Particulate_Fil: 8 Vector__XXX
 SG_ Diesel_Particulate_Filter_1_Soot : 0|64@1+ (1,0) [0|18446744073709551615] "" Vector__XXX

BO_ 2566715904 VDMA_FCFA_Electronic_Engine_Cont: 8 Vector__XXX
 SG_ Electronic_Engine_Controller_11_ : 0|64@1+ (1,0) [0|18446744073709551615] "" Vector__XXX

BO_ 2566716160 VDMA_FCFB_Engine_Manifold_Actuat: 8 Vector__XXX
 SG_ Engine_Manifold_Actuator_Positio : 0|64@1+ (1,0) [0|18446744073709551615] "" Vector__XXX

BO_ 2566716416 VDMA_FCFC_Engine_Manifold_Actuat: 8 Vector__XXX
 SG_ Engine_Manifold_Actuator_Control : 0|64@1+ (1,0) [0|18446744073709551615] "" Vector__XXX

BO_ 2566716672 VDMA_FCFD_Electronic_Engine_Cont: 8 Vector__XXX
 SG_ Electronic_Engine_Controller_9_R : 0|64@1+ (1,0) [0|18446744073709551615] "" Vector__XXX

BO_ 2566716928 VDMA_FCFE_Electronic_Engine_Cont: 8 Vector__XXX
 SG_ Electronic_Engine_Controller_10_ : 0|64@1+ (1,0) [0|18446744073709551615] "" Vector__XXX

BO_ 2566717184 VDMA_FCFF_Engine_Temperature_5: 8 Vector__XXX
 SG_ Engine_Temperature_5_RawPayload : 0|64@1+ (1,0) [0|18446744073709551615] "" Vector__XXX

BO_ 2566717440 VDMA_FD00_Engine_Fluid_Level_Pre: 8 Vector__XXX
 SG_ Engine_Fluid_Level_Pressure_10_R : 0|64@1+ (1,0) [0|18446744073709551615] "" Vector__XXX

BO_ 2566717696 VDMA_FD01_Low_Voltage_Disconnect: 8 Vector__XXX
 SG_ Low_Voltage_Disconnect_Status_Ra : 0|64@1+ (1,0) [0|18446744073709551615] "" Vector__XXX

BO_ 2566718208 VDMA_FD03_Implement_Operating_st: 8 Vector__XXX
 SG_ Implement_Operating_state_comman : 0|64@1+ (1,0) [0|18446744073709551615] "" Vector__XXX

BO_ 2566718464 VDMA_FD04_Direct_Lamp_Control_Da: 8 Vector__XXX
 SG_ Direct_Lamp_Control_Data_2_RawPa : 0|64@1+ (1,0) [0|18446744073709551615] "" Vector__XXX

BO_ 2566718720 VDMA_FD05_Direct_Lamp_Control_Da: 8 Vector__XXX
 SG_ Direct_Lamp_Control_Data_1_RawPa : 0|64@1+ (1,0) [0|18446744073709551615] "" Vector__XXX

BO_ 2566718976 VDMA_FD06_Direct_Lamp_Control_Co: 8 Vector__XXX
 SG_ Direct_Lamp_Control_Command_2_Ra : 0|64@1+ (1,0) [0|18446744073709551615] "" Vector__XXX

BO_ 2566719232 VDMA_FD07_Direct_Lamp_Control_Co: 8 Vector__XXX
 SG_ Direct_Lamp_Control_Command_1_Ra : 0|64@1+ (1,0) [0|18446744073709551615] "" Vector__XXX

BO_ 2566719488 VDMA_FD08_Engine_oil_message: 8 Vector__XXX
 SG_ Engine_oil_message_RawPayload : 0|64@1+ (1,0) [0|18446744073709551615] "" Vector__XXX

BO_ 2566720000 VDMA_FD0A_Aftertreatment_2_Outle: 8 Vector__XXX
 SG_ Aftertreatment_2_Outlet_Gas_NOx_ : 0|64@1+ (1,0) [0|18446744073709551615] "" Vector__XXX

BO_ 2566720256 VDMA_FD0B_Aftertreatment_2_Outle: 8 Vector__XXX
 SG_ Aftertreatment_2_Outlet_Gas_NOx_ : 0|64@1+ (1,0) [0|18446744073709551615] "" Vector__XXX

BO_ 2566720512 VDMA_FD0C_Aftertreatment_2_Intak: 8 Vector__XXX
 SG_ Aftertreatment_2_Intake_Gas_NOx_ : 0|64@1+ (1,0) [0|18446744073709551615] "" Vector__XXX

BO_ 2566720768 VDMA_FD0D_Aftertreatment_2_Intak: 8 Vector__XXX
 SG_ Aftertreatment_2_Intake_Gas_NOx_ : 0|64@1+ (1,0) [0|18446744073709551615] "" Vector__XXX

BO_ 2566721024 VDMA_FD0E_Aftertreatment_1_Outle: 8 Vector__XXX
 SG_ Aftertreatment_1_Outlet_Gas_NOx_ : 0|64@1+ (1,0) [0|18446744073709551615] "" Vector__XXX

BO_ 2566721280 VDMA_FD0F_Aftertreatment_1_Outle: 8 Vector__XXX
 SG_ Aftertreatment_1_Outlet_Gas_NOx_ : 0|64@1+ (1,0) [0|18446744073709551615] "" Vector__XXX

BO_ 2566721536 VDMA_FD10_Aftertreatment_1_Intak: 8 Vector__XXX
 SG_ Aftertreatment_1_Intake_Gas_NOx_ : 0|64@1+ (1,0) [0|18446744073709551615] "" Vector__XXX

BO_ 2566721792 VDMA_FD11_Aftertreatment_1_Intak: 8 Vector__XXX
 SG_ Aftertreatment_1_Intake_Gas_NOx_ : 0|64@1+ (1,0) [0|18446744073709551615] "" Vector__XXX

BO_ 2566722048 VDMA_FD12_Magnet_Status_Informat: 8 Vector__XXX
 SG_ Magnet_Status_Information_1_RawP : 0|64@1+ (1,0) [0|18446744073709551615] "" Vector__XXX

BO_ 2566722304 VDMA_FD13_Magnet_System_Configur: 8 Vector__XXX
 SG_ Magnet_System_Configuration_Info : 0|64@1+ (1,0) [0|18446744073709551615] "" Vector__XXX

BO_ 2566722560 VDMA_FD14_Battery_Charger_2: 8 Vector__XXX
 SG_ Battery_Charger_2_RawPayload : 0|64@1+ (1,0) [0|18446744073709551615] "" Vector__XXX

BO_ 2566722816 VDMA_FD15_Battery_Charger_1: 8 Vector__XXX
 SG_ Battery_Charger_1_RawPayload : 0|64@1+ (1,0) [0|18446744073709551615] "" Vector__XXX

BO_ 2566723072 VDMA_FD16_Occupant_Classificatio: 8 Vector__XXX
 SG_ Occupant_Classification_System_I : 0|64@1+ (1,0) [0|18446744073709551615] "" Vector__XXX

BO_ 2566723328 VDMA_FD17_Beltlock_and_Airbag_De: 8 Vector__XXX
 SG_ Beltlock_and_Airbag_Deactivation : 0|64@1+ (1,0) [0|18446744073709551615] "" Vector__XXX

BO_ 2566723584 VDMA_FD18_Collision_Sensor_Infor: 8 Vector__XXX
 SG_ Collision_Sensor_Information_Raw : 0|64@1+ (1,0) [0|18446744073709551615] "" Vector__XXX

BO_ 2566723840 VDMA_FD19_Ignitor_Loop_Informati: 8 Vector__XXX
 SG_ Ignitor_Loop_Information_RawPayl : 0|64@1+ (1,0) [0|18446744073709551615] "" Vector__XXX

BO_ 2566724096 VDMA_FD1A_Aftertreatment_1_Warm_: 8 Vector__XXX
 SG_ Aftertreatment_1_Warm_Up_Diesel_ : 0|64@1+ (1,0) [0|18446744073709551615] "" Vector__XXX

BO_ 2566724352 VDMA_FD1B_Diesel_Particulate_Fil: 8 Vector__XXX
 SG_ Diesel_Particulate_Filter_2_Soot : 0|64@1+ (1,0) [0|18446744073709551615] "" Vector__XXX

BO_ 2566724608 VDMA_FD1C_Diesel_Particulate_Fil: 8 Vector__XXX
 SG_ Diesel_Particulate_Filter_1_Soot : 0|64@1+ (1,0) [0|18446744073709551615] "" Vector__XXX

BO_ 2566724864 VDMA_FD1D_Aftertreatment_Differe: 8 Vector__XXX
 SG_ Aftertreatment_Differential_Temp : 0|64@1+ (1,0) [0|18446744073709551615] "" Vector__XXX

BO_ 2566725120 VDMA_FD1E_Aftertreatment_Differe: 8 Vector__XXX
 SG_ Aftertreatment_Differential_Temp : 0|64@1+ (1,0) [0|18446744073709551615] "" Vector__XXX

BO_ 2566725376 VDMA_FD1F_Aftertreatment_2_Diese: 8 Vector__XXX
 SG_ Aftertreatment_2_Diesel_Oxidatio : 0|64@1+ (1,0) [0|18446744073709551615] "" Vector__XXX

BO_ 2566725632 VDMA_FD20_Aftertreatment_1_Diese: 8 Vector__XXX
 SG_ Aftertreatment_1_Diesel_Oxidatio : 0|64@1+ (1,0) [0|18446744073709551615] "" Vector__XXX

BO_ 2566725888 VDMA_FD21_Aftertreatment_2_Gas_O: 8 Vector__XXX
 SG_ Aftertreatment_2_Gas_Oxidation_C : 0|64@1+ (1,0) [0|18446744073709551615] "" Vector__XXX

BO_ 2566726144 VDMA_FD22_Aftertreatment_1_Gas_O: 8 Vector__XXX
 SG_ Aftertreatment_1_Gas_Oxidation_C : 0|64@1+ (1,0) [0|18446744073709551615] "" Vector__XXX

BO_ 2566726400 VDMA_FD23_Extended_Joystick_Mess: 8 Vector__XXX
 SG_ Extended_Joystick_Message_10_Raw : 0|64@1+ (1,0) [0|18446744073709551615] "" Vector__XXX

BO_ 2566726656 VDMA_FD24_Basic_Joystick_Message: 8 Vector__XXX
 SG_ Basic_Joystick_Message_10_RawPay : 0|64@1+ (1,0) [0|18446744073709551615] "" Vector__XXX

BO_ 2566726912 VDMA_FD25_Extended_Joystick_Mess: 8 Vector__XXX
 SG_ Extended_Joystick_Message_9_RawP : 0|64@1+ (1,0) [0|18446744073709551615] "" Vector__XXX

BO_ 2566727168 VDMA_FD26_Basic_Joystick_Message: 8 Vector__XXX
 SG_ Basic_Joystick_Message_9_RawPayl : 0|64@1+ (1,0) [0|18446744073709551615] "" Vector__XXX

BO_ 2566727424 VDMA_FD27_Extended_Joystick_Mess: 8 Vector__XXX
 SG_ Extended_Joystick_Message_8_RawP : 0|64@1+ (1,0) [0|18446744073709551615] "" Vector__XXX

BO_ 2566727680 VDMA_FD28_Basic_Joystick_Message: 8 Vector__XXX
 SG_ Basic_Joystick_Message_8_RawPayl : 0|64@1+ (1,0) [0|18446744073709551615] "" Vector__XXX

BO_ 2566727936 VDMA_FD29_Extended_Joystick_Mess: 8 Vector__XXX
 SG_ Extended_Joystick_Message_7_RawP : 0|64@1+ (1,0) [0|18446744073709551615] "" Vector__XXX

BO_ 2566728192 VDMA_FD2A_Basic_Joystick_Message: 8 Vector__XXX
 SG_ Basic_Joystick_Message_7_RawPayl : 0|64@1+ (1,0) [0|18446744073709551615] "" Vector__XXX

BO_ 2566728448 VDMA_FD2B_Extended_Joystick_Mess: 8 Vector__XXX
 SG_ Extended_Joystick_Message_6_RawP : 0|64@1+ (1,0) [0|18446744073709551615] "" Vector__XXX

BO_ 2566728704 VDMA_FD2C_Basic_Joystick_Message: 8 Vector__XXX
 SG_ Basic_Joystick_Message_6_RawPayl : 0|64@1+ (1,0) [0|18446744073709551615] "" Vector__XXX

BO_ 2566728960 VDMA_FD2D_Extended_Joystick_Mess: 8 Vector__XXX
 SG_ Extended_Joystick_Message_5_RawP : 0|64@1+ (1,0) [0|18446744073709551615] "" Vector__XXX

BO_ 2566729216 VDMA_FD2E_Basic_Joystick_Message: 8 Vector__XXX
 SG_ Basic_Joystick_Message_5_RawPayl : 0|64@1+ (1,0) [0|18446744073709551615] "" Vector__XXX

BO_ 2566729472 VDMA_FD2F_Extended_Joystick_Mess: 8 Vector__XXX
 SG_ Extended_Joystick_Message_4_RawP : 0|64@1+ (1,0) [0|18446744073709551615] "" Vector__XXX

BO_ 2566729728 VDMA_FD30_Basic_Joystick_Message: 8 Vector__XXX
 SG_ Basic_Joystick_Message_4_RawPayl : 0|64@1+ (1,0) [0|18446744073709551615] "" Vector__XXX

BO_ 2566729984 VDMA_FD31_Fan_Drive_2: 8 Vector__XXX
 SG_ Fan_Drive_2_RawPayload : 0|64@1+ (1,0) [0|18446744073709551615] "" Vector__XXX

BO_ 2566730496 VDMA_FD33_Aftertreatment_2_Diese: 8 Vector__XXX
 SG_ Aftertreatment_2_Diesel_Exhaust_ : 0|64@1+ (1,0) [0|18446744073709551615] "" Vector__XXX

BO_ 2566730752 VDMA_FD34_Aftertreatment_2_SCR_R: 8 Vector__XXX
 SG_ Aftertreatment_2_SCR_Reagant_Tan : 0|64@1+ (1,0) [0|18446744073709551615] "" Vector__XXX

BO_ 2566731008 VDMA_FD35_Aftertreatment_2_Diese: 8 Vector__XXX
 SG_ Aftertreatment_2_Diesel_Exhaust_ : 0|64@1+ (1,0) [0|18446744073709551615] "" Vector__XXX

BO_ 2566731264 VDMA_FD36_Aftertreatment_2_Diese: 8 Vector__XXX
 SG_ Aftertreatment_2_Diesel_Exhaust_ : 0|64@1+ (1,0) [0|18446744073709551615] "" Vector__XXX

BO_ 2566731520 VDMA_FD37_Aftertreatment_2_SCR_S: 8 Vector__XXX
 SG_ Aftertreatment_2_SCR_Service_Inf : 0|64@1+ (1,0) [0|18446744073709551615] "" Vector__XXX

BO_ 2566731776 VDMA_FD38_Aftertreatment_2_SCR_E: 8 Vector__XXX
 SG_ Aftertreatment_2_SCR_Exhaust_Gas : 0|64@1+ (1,0) [0|18446744073709551615] "" Vector__XXX

BO_ 2566732032 VDMA_FD39_Aftertreatment_2_SCR_E: 8 Vector__XXX
 SG_ Aftertreatment_2_SCR_Exhaust_Gas : 0|64@1+ (1,0) [0|18446744073709551615] "" Vector__XXX

BO_ 2566732288 VDMA_FD3A_Aftertreatment_2_SCR_D: 8 Vector__XXX
 SG_ Aftertreatment_2_SCR_Dosing_Syst : 0|64@1+ (1,0) [0|18446744073709551615] "" Vector__XXX

BO_ 2566732544 VDMA_FD3B_Aftertreatment_2_SCR_D: 8 Vector__XXX
 SG_ Aftertreatment_2_SCR_Dosing_Syst : 0|64@1+ (1,0) [0|18446744073709551615] "" Vector__XXX

BO_ 2566732800 VDMA_FD3C_Aftertreatment_1_Diese: 8 Vector__XXX
 SG_ Aftertreatment_1_Diesel_Exhaust_ : 0|64@1+ (1,0) [0|18446744073709551615] "" Vector__XXX

BO_ 2566733056 VDMA_FD3D_Aftertreatment_1_SCR_R: 8 Vector__XXX
 SG_ Aftertreatment_1_SCR_Reagant_Tan : 0|64@1+ (1,0) [0|18446744073709551615] "" Vector__XXX

BO_ 2566733312 VDMA_FD3E_Aftertreatment_1_SCR_E: 8 Vector__XXX
 SG_ Aftertreatment_1_SCR_Exhaust_Gas : 0|64@1+ (1,0) [0|18446744073709551615] "" Vector__XXX

BO_ 2566733568 VDMA_FD3F_Aftertreatment_1_SCR_E: 8 Vector__XXX
 SG_ Aftertreatment_1_SCR_Exhaust_Gas : 0|64@1+ (1,0) [0|18446744073709551615] "" Vector__XXX

BO_ 2566733824 VDMA_FD40_Aftertreatment_1_SCR_D: 8 Vector__XXX
 SG_ Aftertreatment_1_SCR_Dosing_Syst : 0|64@1+ (1,0) [0|18446744073709551615] "" Vector__XXX

BO_ 2566734080 VDMA_FD41_Aftertreatment_1_SCR_D: 8 Vector__XXX
 SG_ Aftertreatment_1_SCR_Dosing_Syst : 0|64@1+ (1,0) [0|18446744073709551615] "" Vector__XXX

BO_ 2566734336 VDMA_FD42_ISOBUS_compliance_cert: 8 Vector__XXX
 SG_ ISOBUS_compliance_certification_ : 0|64@1+ (1,0) [0|18446744073709551615] "" Vector__XXX

BO_ 2566734848 VDMA_FD44_Aftertreatment_2_Fuel_: 8 Vector__XXX
 SG_ Aftertreatment_2_Fuel_Control_2_ : 0|64@1+ (1,0) [0|18446744073709551615] "" Vector__XXX

BO_ 2566735104 VDMA_FD45_Aftertreatment_2_Three: 8 Vector__XXX
 SG_ Aftertreatment_2_Three_Way_Catal : 0|64@1+ (1,0) [0|18446744073709551615] "" Vector__XXX

BO_ 2566735360 VDMA_FD46_Aftertreatment_1_Three: 8 Vector__XXX
 SG_ Aftertreatment_1_Three_Way_Catal : 0|64@1+ (1,0) [0|18446744073709551615] "" Vector__XXX

BO_ 2566735616 VDMA_FD47_Transmission_Mode_Labe: 8 Vector__XXX
 SG_ Transmission_Mode_Labels_RawPayl : 0|64@1+ (1,0) [0|18446744073709551615] "" Vector__XXX

BO_ 2566735872 VDMA_FD48_Engine_Exhaust_Bank_2_: 8 Vector__XXX
 SG_ Engine_Exhaust_Bank_2_O2_Fuel_Tr : 0|64@1+ (1,0) [0|18446744073709551615] "" Vector__XXX

BO_ 2566736128 VDMA_FD49_Engine_Exhaust_Bank_1_: 8 Vector__XXX
 SG_ Engine_Exhaust_Bank_1_O2_Fuel_Tr : 0|64@1+ (1,0) [0|18446744073709551615] "" Vector__XXX

BO_ 2566736384 VDMA_FD4A_General_Purpose_Messag: 8 Vector__XXX
 SG_ General_Purpose_Message_2_11_Raw : 0|64@1+ (1,0) [0|18446744073709551615] "" Vector__XXX

BO_ 2566736640 VDMA_FD4B_General_Purpose_Messag: 8 Vector__XXX
 SG_ General_Purpose_Message_2_10_Raw : 0|64@1+ (1,0) [0|18446744073709551615] "" Vector__XXX

BO_ 2566736896 VDMA_FD4C_General_Purpose_Messag: 8 Vector__XXX
 SG_ General_Purpose_Message_2_9_RawP : 0|64@1+ (1,0) [0|18446744073709551615] "" Vector__XXX

BO_ 2566737152 VDMA_FD4D_General_Purpose_Messag: 8 Vector__XXX
 SG_ General_Purpose_Message_2_8_RawP : 0|64@1+ (1,0) [0|18446744073709551615] "" Vector__XXX

BO_ 2566737408 VDMA_FD4E_General_Purpose_Messag: 8 Vector__XXX
 SG_ General_Purpose_Message_2_7_RawP : 0|64@1+ (1,0) [0|18446744073709551615] "" Vector__XXX

BO_ 2566737664 VDMA_FD4F_General_Purpose_Messag: 8 Vector__XXX
 SG_ General_Purpose_Message_2_6_RawP : 0|64@1+ (1,0) [0|18446744073709551615] "" Vector__XXX

BO_ 2566737920 VDMA_FD50_General_Purpose_Messag: 8 Vector__XXX
 SG_ General_Purpose_Message_1_9_RawP : 0|64@1+ (1,0) [0|18446744073709551615] "" Vector__XXX

BO_ 2566738176 VDMA_FD51_Aftercooler_Coolant_Co: 8 Vector__XXX
 SG_ Aftercooler_Coolant_Control_Valv : 0|64@1+ (1,0) [0|18446744073709551615] "" Vector__XXX

BO_ 2566738432 VDMA_FD52_Engine_Coolant_Control: 8 Vector__XXX
 SG_ Engine_Coolant_Control_Valve_Com : 0|64@1+ (1,0) [0|18446744073709551615] "" Vector__XXX

BO_ 2566738688 VDMA_FD53_Engine_Average_Informa: 8 Vector__XXX
 SG_ Engine_Average_Information_RawPa : 0|64@1+ (1,0) [0|18446744073709551615] "" Vector__XXX

BO_ 2566738944 VDMA_FD54_DTCs_C_Previously_Acti: 8 Vector__XXX
 SG_ DTCs_C_Previously_Active_RawPayl : 0|64@1+ (1,0) [0|18446744073709551615] "" Vector__XXX

BO_ 2566739200 VDMA_FD55_DTCs_C_Confirmed_and_A: 8 Vector__XXX
 SG_ DTCs_C_Confirmed_and_Active_RawP : 0|64@1+ (1,0) [0|18446744073709551615] "" Vector__XXX

BO_ 2566739456 VDMA_FD56_DTCs_C_Pending: 8 Vector__XXX
 SG_ DTCs_C_Pending_RawPayload : 0|64@1+ (1,0) [0|18446744073709551615] "" Vector__XXX

BO_ 2566739712 VDMA_FD57_DTCs_B2_Previously_Act: 8 Vector__XXX
 SG_ DTCs_B2_Previously_Active_RawPay : 0|64@1+ (1,0) [0|18446744073709551615] "" Vector__XXX

BO_ 2566739968 VDMA_FD58_DTCs_B2_Confirmed_and_: 8 Vector__XXX
 SG_ DTCs_B2_Confirmed_and_Active_Raw : 0|64@1+ (1,0) [0|18446744073709551615] "" Vector__XXX

BO_ 2566740224 VDMA_FD59_DTCs_B2_Pending: 8 Vector__XXX
 SG_ DTCs_B2_Pending_RawPayload : 0|64@1+ (1,0) [0|18446744073709551615] "" Vector__XXX

BO_ 2566740480 VDMA_FD5A_DTCs_B1_Previously_Act: 8 Vector__XXX
 SG_ DTCs_B1_Previously_Active_RawPay : 0|64@1+ (1,0) [0|18446744073709551615] "" Vector__XXX

BO_ 2566740736 VDMA_FD5B_DTCs_B1_Confirmed_and_: 8 Vector__XXX
 SG_ DTCs_B1_Confirmed_and_Active_Raw : 0|64@1+ (1,0) [0|18446744073709551615] "" Vector__XXX

BO_ 2566740992 VDMA_FD5C_DTCs_B1_Pending: 8 Vector__XXX
 SG_ DTCs_B1_Pending_RawPayload : 0|64@1+ (1,0) [0|18446744073709551615] "" Vector__XXX

BO_ 2566741248 VDMA_FD5D_DTCs_A_Previously_Acti: 8 Vector__XXX
 SG_ DTCs_A_Previously_Active_RawPayl : 0|64@1+ (1,0) [0|18446744073709551615] "" Vector__XXX

BO_ 2566741504 VDMA_FD5E_DTCs_A_Confirmed_and_A: 8 Vector__XXX
 SG_ DTCs_A_Confirmed_and_Active_RawP : 0|64@1+ (1,0) [0|18446744073709551615] "" Vector__XXX

BO_ 2566741760 VDMA_FD5F_DTCs_A_Pending: 8 Vector__XXX
 SG_ DTCs_A_Pending_RawPayload : 0|64@1+ (1,0) [0|18446744073709551615] "" Vector__XXX

BO_ 2566742016 VDMA_FD60_Harmonized_B1_Failure_: 8 Vector__XXX
 SG_ Harmonized_B1_Failure_Counts_Raw : 0|64@1+ (1,0) [0|18446744073709551615] "" Vector__XXX

BO_ 2566742272 VDMA_FD61_Harmonized_Cumulative_: 8 Vector__XXX
 SG_ Harmonized_Cumulative_Continuous : 0|64@1+ (1,0) [0|18446744073709551615] "" Vector__XXX

BO_ 2566742528 VDMA_FD62_Harmonized_Global_Regu: 8 Vector__XXX
 SG_ Harmonized_Global_Regulation_Des : 0|64@1+ (1,0) [0|18446744073709551615] "" Vector__XXX

BO_ 2566742784 VDMA_FD63_Harmonized_Roadworthin: 8 Vector__XXX
 SG_ Harmonized_Roadworthiness_System : 0|64@1+ (1,0) [0|18446744073709551615] "" Vector__XXX

BO_ 2566743040 VDMA_FD64_Harmonized_Roadworthin: 8 Vector__XXX
 SG_ Harmonized_Roadworthiness_Vehicl : 0|64@1+ (1,0) [0|18446744073709551615] "" Vector__XXX

BO_ 2566743296 VDMA_FD65_Aftertreatment_1_Fuel_: 8 Vector__XXX
 SG_ Aftertreatment_1_Fuel_Control_2_ : 0|64@1+ (1,0) [0|18446744073709551615] "" Vector__XXX

BO_ 2566743552 VDMA_FD66_Engine_Temperature_4: 8 Vector__XXX
 SG_ Engine_Temperature_4_RawPayload : 0|64@1+ (1,0) [0|18446744073709551615] "" Vector__XXX

BO_ 2566743808 VDMA_FD67_Zero_Net_Vehicle_Weigh: 8 Vector__XXX
 SG_ Zero_Net_Vehicle_Weight_Change_R : 0|64@1+ (1,0) [0|18446744073709551615] "" Vector__XXX

BO_ 2566744064 VDMA_FD68_Gross_Combination_Vehi: 8 Vector__XXX
 SG_ Gross_Combination_Vehicle_Weight : 0|64@1+ (1,0) [0|18446744073709551615] "" Vector__XXX

BO_ 2566744320 VDMA_FD69_Axle_Group_Calibration: 8 Vector__XXX
 SG_ Axle_Group_Calibration_Weights_R : 0|64@1+ (1,0) [0|18446744073709551615] "" Vector__XXX

BO_ 2566744576 VDMA_FD6A_Axle_Group_Weight: 8 Vector__XXX
 SG_ Axle_Group_Weight_RawPayload : 0|64@1+ (1,0) [0|18446744073709551615] "" Vector__XXX

BO_ 2566744832 VDMA_FD6B_Available_Axle_Group_W: 8 Vector__XXX
 SG_ Available_Axle_Group_Weights_Raw : 0|64@1+ (1,0) [0|18446744073709551615] "" Vector__XXX

BO_ 2566745088 VDMA_FD6C_Aftertreatment_2_Air_C: 8 Vector__XXX
 SG_ Aftertreatment_2_Air_Control_2_R : 0|64@1+ (1,0) [0|18446744073709551615] "" Vector__XXX

BO_ 2566745344 VDMA_FD6D_Aftertreatment_1_Air_C: 8 Vector__XXX
 SG_ Aftertreatment_1_Air_Control_2_R : 0|64@1+ (1,0) [0|18446744073709551615] "" Vector__XXX

BO_ 2566745600 VDMA_FD6E_Aftertreatment_1_SCR_S: 8 Vector__XXX
 SG_ Aftertreatment_1_SCR_Service_Inf : 0|64@1+ (1,0) [0|18446744073709551615] "" Vector__XXX

BO_ 2566745856 VDMA_FD6F_Electronic_Engine_Cont: 8 Vector__XXX
 SG_ Electronic_Engine_Controller_8_R : 0|64@1+ (1,0) [0|18446744073709551615] "" Vector__XXX

BO_ 2566746112 VDMA_FD70_Door_ramp_control: 8 Vector__XXX
 SG_ Door_ramp_control_RawPayload : 0|64@1+ (1,0) [0|18446744073709551615] "" Vector__XXX

BO_ 2566746368 VDMA_FD71_Brake_actuator_stroke_: 8 Vector__XXX
 SG_ Brake_actuator_stroke_status_Raw : 0|64@1+ (1,0) [0|18446744073709551615] "" Vector__XXX

BO_ 2566746624 VDMA_FD72_Engine_Spark_Voltage_6: 8 Vector__XXX
 SG_ Engine_Spark_Voltage_6_RawPayloa : 0|64@1+ (1,0) [0|18446744073709551615] "" Vector__XXX

BO_ 2566746880 VDMA_FD73_Engine_Spark_Voltage_5: 8 Vector__XXX
 SG_ Engine_Spark_Voltage_5_RawPayloa : 0|64@1+ (1,0) [0|18446744073709551615] "" Vector__XXX

BO_ 2566747136 VDMA_FD74_Engine_Spark_Voltage_4: 8 Vector__XXX
 SG_ Engine_Spark_Voltage_4_RawPayloa : 0|64@1+ (1,0) [0|18446744073709551615] "" Vector__XXX

BO_ 2566747392 VDMA_FD75_Engine_Spark_Voltage_3: 8 Vector__XXX
 SG_ Engine_Spark_Voltage_3_RawPayloa : 0|64@1+ (1,0) [0|18446744073709551615] "" Vector__XXX

BO_ 2566747648 VDMA_FD76_Engine_Spark_Voltage_2: 8 Vector__XXX
 SG_ Engine_Spark_Voltage_2_RawPayloa : 0|64@1+ (1,0) [0|18446744073709551615] "" Vector__XXX

BO_ 2566747904 VDMA_FD77_Engine_Spark_Voltage_1: 8 Vector__XXX
 SG_ Engine_Spark_Voltage_1_RawPayloa : 0|64@1+ (1,0) [0|18446744073709551615] "" Vector__XXX

BO_ 2566748160 VDMA_FD78_Aftertreatment_2_Trip_: 8 Vector__XXX
 SG_ Aftertreatment_2_Trip_Informatio : 0|64@1+ (1,0) [0|18446744073709551615] "" Vector__XXX

BO_ 2566748416 VDMA_FD79_Aftertreatment_1_Trip_: 8 Vector__XXX
 SG_ Aftertreatment_1_Trip_Informatio : 0|64@1+ (1,0) [0|18446744073709551615] "" Vector__XXX

BO_ 2566748672 VDMA_FD7A_Aftertreatment_2_Servi: 8 Vector__XXX
 SG_ Aftertreatment_2_Service_1_RawPa : 0|64@1+ (1,0) [0|18446744073709551615] "" Vector__XXX

BO_ 2566748928 VDMA_FD7B_Aftertreatment_1_Servi: 8 Vector__XXX
 SG_ Aftertreatment_1_Service_1_RawPa : 0|64@1+ (1,0) [0|18446744073709551615] "" Vector__XXX

BO_ 2566749696 VDMA_FD7E_Adaptive_Front_Lightin: 8 Vector__XXX
 SG_ Adaptive_Front_Lighting_System_S : 0|64@1+ (1,0) [0|18446744073709551615] "" Vector__XXX

BO_ 2566749952 VDMA_FD7F_Engine_Configuration_2: 8 Vector__XXX
 SG_ Engine_Configuration_2_RawPayloa : 0|64@1+ (1,0) [0|18446744073709551615] "" Vector__XXX

BO_ 2566750208 VDMA_FD80_Emission_Related_Perma: 8 Vector__XXX
 SG_ Emission_Related_Permanent_Diagn : 0|64@1+ (1,0) [0|18446744073709551615] "" Vector__XXX

BO_ 2566750464 VDMA_FD81_EGR_Cooler_Bypass: 8 Vector__XXX
 SG_ EGR_Cooler_Bypass_RawPayload : 0|64@1+ (1,0) [0|18446744073709551615] "" Vector__XXX

BO_ 2566750720 VDMA_FD82_All_Pending_DTCs: 8 Vector__XXX
 SG_ All_Pending_DTCs_RawPayload : 0|64@1+ (1,0) [0|18446744073709551615] "" Vector__XXX

BO_ 2566750976 VDMA_FD83_Transfer_Case_Informat: 8 Vector__XXX
 SG_ Transfer_Case_Information_RawPay : 0|64@1+ (1,0) [0|18446744073709551615] "" Vector__XXX

BO_ 2566751232 VDMA_FD84_Engine_Fluid_Level_Pre: 8 Vector__XXX
 SG_ Engine_Fluid_Level_Pressure_9_Ra : 0|64@1+ (1,0) [0|18446744073709551615] "" Vector__XXX

BO_ 2566751488 VDMA_FD85_Engine_Fluid_Level_Pre: 8 Vector__XXX
 SG_ Engine_Fluid_Level_Pressure_8_Ra : 0|64@1+ (1,0) [0|18446744073709551615] "" Vector__XXX

BO_ 2566751744 VDMA_FD86_Engine_Fluid_Level_Pre: 8 Vector__XXX
 SG_ Engine_Fluid_Level_Pressure_7_Ra : 0|64@1+ (1,0) [0|18446744073709551615] "" Vector__XXX

BO_ 2566752000 VDMA_FD87_Engine_Fluid_Level_Pre: 8 Vector__XXX
 SG_ Engine_Fluid_Level_Pressure_6_Ra : 0|64@1+ (1,0) [0|18446744073709551615] "" Vector__XXX

BO_ 2566752256 VDMA_FD88_Engine_Fluid_Level_Pre: 8 Vector__XXX
 SG_ Engine_Fluid_Level_Pressure_5_Ra : 0|64@1+ (1,0) [0|18446744073709551615] "" Vector__XXX

BO_ 2566752512 VDMA_FD89_Vehicle_Direction_Spee: 8 Vector__XXX
 SG_ Vehicle_Direction_Speed_2_RawPay : 0|64@1+ (1,0) [0|18446744073709551615] "" Vector__XXX

BO_ 2566752768 VDMA_FD8A_SAE_J2012_2_Byte_DTC_D: 8 Vector__XXX
 SG_ SAE_J2012_2_Byte_DTC_Display_Raw : 0|64@1+ (1,0) [0|18446744073709551615] "" Vector__XXX

BO_ 2566753024 VDMA_FD8B_Aftertreatment_2_Gas_P: 8 Vector__XXX
 SG_ Aftertreatment_2_Gas_Parameters_ : 0|64@1+ (1,0) [0|18446744073709551615] "" Vector__XXX

BO_ 2566753280 VDMA_FD8C_Aftertreatment_1_Gas_P: 8 Vector__XXX
 SG_ Aftertreatment_1_Gas_Parameters_ : 0|64@1+ (1,0) [0|18446744073709551615] "" Vector__XXX

BO_ 2566753536 VDMA_FD8D_Utility_Total_AC_React: 8 Vector__XXX
 SG_ Utility_Total_AC_Reactive_Energy : 0|64@1+ (1,0) [0|18446744073709551615] "" Vector__XXX

BO_ 2566753792 VDMA_FD8E_Generator_Total_AC_Rea: 8 Vector__XXX
 SG_ Generator_Total_AC_Reactive_Ener : 0|64@1+ (1,0) [0|18446744073709551615] "" Vector__XXX

BO_ 2566754048 VDMA_FD8F_Generator_Total_AC_Per: 8 Vector__XXX
 SG_ Generator_Total_AC_Percent_Power : 0|64@1+ (1,0) [0|18446744073709551615] "" Vector__XXX

BO_ 2566754304 VDMA_FD90_Advertised_Engine_Torq: 8 Vector__XXX
 SG_ Advertised_Engine_Torque_Curve_R : 0|64@1+ (1,0) [0|18446744073709551615] "" Vector__XXX

BO_ 2566754560 VDMA_FD91_AC_Switching_Device_St: 8 Vector__XXX
 SG_ AC_Switching_Device_Status_RawPa : 0|64@1+ (1,0) [0|18446744073709551615] "" Vector__XXX

BO_ 2566754816 VDMA_FD92_Engine_Operating_Infor: 8 Vector__XXX
 SG_ Engine_Operating_Information_Raw : 0|64@1+ (1,0) [0|18446744073709551615] "" Vector__XXX

BO_ 2566755072 VDMA_FD93_Generator_Control_1: 8 Vector__XXX
 SG_ Generator_Control_1_RawPayload : 0|64@1+ (1,0) [0|18446744073709551615] "" Vector__XXX

BO_ 2566755328 VDMA_FD94_Electronic_Engine_Cont: 8 Vector__XXX
 SG_ Electronic_Engine_Controller_7_R : 0|64@1+ (1,0) [0|18446744073709551615] "" Vector__XXX

BO_ 2566755584 VDMA_FD95_Transmission_Fluids_2: 8 Vector__XXX
 SG_ Transmission_Fluids_2_RawPayload : 0|64@1+ (1,0) [0|18446744073709551615] "" Vector__XXX

BO_ 2566755840 VDMA_FD96_Fuel_Information_2_Liq: 8 Vector__XXX
 SG_ Fuel_Information_2_Liquid_RawPay : 0|64@1+ (1,0) [0|18446744073709551615] "" Vector__XXX

BO_ 2566756096 VDMA_FD97_Fuel_Information_3_Liq: 8 Vector__XXX
 SG_ Fuel_Information_3_Liquid_RawPay : 0|64@1+ (1,0) [0|18446744073709551615] "" Vector__XXX

BO_ 2566756352 VDMA_FD98_Aftertreatment_1_Histo: 8 Vector__XXX
 SG_ Aftertreatment_1_Historical_Info : 0|64@1+ (1,0) [0|18446744073709551615] "" Vector__XXX

BO_ 2566756608 VDMA_FD99_Aftertreatment_2_Histo: 8 Vector__XXX
 SG_ Aftertreatment_2_Historical_info : 0|64@1+ (1,0) [0|18446744073709551615] "" Vector__XXX

BO_ 2566756864 VDMA_FD9A_Electronic_Brake_Syste: 8 Vector__XXX
 SG_ Electronic_Brake_System_2_4_RawP : 0|64@1+ (1,0) [0|18446744073709551615] "" Vector__XXX

BO_ 2566757120 VDMA_FD9B_Aftertreatment_1_Diese: 8 Vector__XXX
 SG_ Aftertreatment_1_Diesel_Exhaust_ : 0|64@1+ (1,0) [0|18446744073709551615] "" Vector__XXX

BO_ 2566757376 VDMA_FD9C_Sensor_Electrical_Powe: 8 Vector__XXX
 SG_ Sensor_Electrical_Power_2_RawPay : 0|64@1+ (1,0) [0|18446744073709551615] "" Vector__XXX

BO_ 2566757632 VDMA_FD9D_Sensor_Electrical_Powe: 8 Vector__XXX
 SG_ Sensor_Electrical_Power_1_RawPay : 0|64@1+ (1,0) [0|18446744073709551615] "" Vector__XXX

BO_ 2566757888 VDMA_FD9E_Aftertreatment_2_Air_C: 8 Vector__XXX
 SG_ Aftertreatment_2_Air_Control_1_R : 0|64@1+ (1,0) [0|18446744073709551615] "" Vector__XXX

BO_ 2566758144 VDMA_FD9F_Aftertreatment_1_Air_C: 8 Vector__XXX
 SG_ Aftertreatment_1_Air_Control_1_R : 0|64@1+ (1,0) [0|18446744073709551615] "" Vector__XXX

BO_ 2566758400 VDMA_FDA0_Aftertreatment_2_Fuel_: 8 Vector__XXX
 SG_ Aftertreatment_2_Fuel_Control_1_ : 0|64@1+ (1,0) [0|18446744073709551615] "" Vector__XXX

BO_ 2566758656 VDMA_FDA1_Aftertreatment_1_Fuel_: 8 Vector__XXX
 SG_ Aftertreatment_1_Fuel_Control_1_ : 0|64@1+ (1,0) [0|18446744073709551615] "" Vector__XXX

BO_ 2566758912 VDMA_FDA2_Fuel_Information_3_Gas: 8 Vector__XXX
 SG_ Fuel_Information_3_Gaseous_RawPa : 0|64@1+ (1,0) [0|18446744073709551615] "" Vector__XXX

BO_ 2566759168 VDMA_FDA3_Electronic_Engine_Cont: 8 Vector__XXX
 SG_ Electronic_Engine_Controller_6_R : 0|64@1+ (1,0) [0|18446744073709551615] "" Vector__XXX

BO_ 2566759424 VDMA_FDA4_PTO_Drive_Engagement_1: 8 Vector__XXX
 SG_ PTO_Drive_Engagement_1_RawPayloa : 0|64@1+ (1,0) [0|18446744073709551615] "" Vector__XXX

BO_ 2566759680 VDMA_FDA5_Door_Control_2: 8 Vector__XXX
 SG_ Door_Control_2_RawPayload : 0|64@1+ (1,0) [0|18446744073709551615] "" Vector__XXX

BO_ 2566759936 VDMA_FDA6_Voltage_Regulator_Exci: 8 Vector__XXX
 SG_ Voltage_Regulator_Excitation_Sta : 0|64@1+ (1,0) [0|18446744073709551615] "" Vector__XXX

BO_ 2566760192 VDMA_FDA7_Voltage_Regulator_Oper: 8 Vector__XXX
 SG_ Voltage_Regulator_Operating_Mode : 0|64@1+ (1,0) [0|18446744073709551615] "" Vector__XXX

BO_ 2566760448 VDMA_FDA8_Wireless_Communication: 8 Vector__XXX
 SG_ Wireless_Communications_Message_ : 0|64@1+ (1,0) [0|18446744073709551615] "" Vector__XXX

BO_ 2566760704 VDMA_FDA9_Wireless_Communication: 8 Vector__XXX
 SG_ Wireless_Communications_Message_ : 0|64@1+ (1,0) [0|18446744073709551615] "" Vector__XXX

BO_ 2566760960 VDMA_FDAA_Engine_Fluid_Level_Pre: 8 Vector__XXX
 SG_ Engine_Fluid_Level_Pressure_4_Ra : 0|64@1+ (1,0) [0|18446744073709551615] "" Vector__XXX

BO_ 2566761216 VDMA_FDAB_Request_For_Complete_C: 8 Vector__XXX
 SG_ Request_For_Complete_Configurabl : 0|64@1+ (1,0) [0|18446744073709551615] "" Vector__XXX

BO_ 2566761472 VDMA_FDAC_Engine_Fuel_Informatio: 8 Vector__XXX
 SG_ Engine_Fuel_Information_RawPaylo : 0|64@1+ (1,0) [0|18446744073709551615] "" Vector__XXX

BO_ 2566761728 VDMA_FDAD_Request_For_Complete_C: 8 Vector__XXX
 SG_ Request_For_Complete_Configurabl : 0|64@1+ (1,0) [0|18446744073709551615] "" Vector__XXX

BO_ 2566761984 VDMA_FDAE_Fifth_Wheel_Smart_Syst: 8 Vector__XXX
 SG_ Fifth_Wheel_Smart_Systems_2_RawP : 0|64@1+ (1,0) [0|18446744073709551615] "" Vector__XXX

BO_ 2566762240 VDMA_FDAF_Aftertreatment_2_Inter: 8 Vector__XXX
 SG_ Aftertreatment_2_Intermediate_Ga : 0|64@1+ (1,0) [0|18446744073709551615] "" Vector__XXX

BO_ 2566762496 VDMA_FDB0_Aftertreatment_2_Outle: 8 Vector__XXX
 SG_ Aftertreatment_2_Outlet_Gas_2_Ra : 0|64@1+ (1,0) [0|18446744073709551615] "" Vector__XXX

BO_ 2566762752 VDMA_FDB1_Aftertreatment_2_Intak: 8 Vector__XXX
 SG_ Aftertreatment_2_Intake_Gas_2_Ra : 0|64@1+ (1,0) [0|18446744073709551615] "" Vector__XXX

BO_ 2566763008 VDMA_FDB2_Aftertreatment_1_Inter: 8 Vector__XXX
 SG_ Aftertreatment_1_Intermediate_Ga : 0|64@1+ (1,0) [0|18446744073709551615] "" Vector__XXX

BO_ 2566763264 VDMA_FDB3_Aftertreatment_1_Outle: 8 Vector__XXX
 SG_ Aftertreatment_1_Outlet_Gas_2_Ra : 0|64@1+ (1,0) [0|18446744073709551615] "" Vector__XXX

BO_ 2566763520 VDMA_FDB4_Aftertreatment_1_Intak: 8 Vector__XXX
 SG_ Aftertreatment_1_Intake_Gas_2_Ra : 0|64@1+ (1,0) [0|18446744073709551615] "" Vector__XXX

BO_ 2566763776 VDMA_FDB5_Emission_Related_Previ: 8 Vector__XXX
 SG_ Emission_Related_Previously_MIL_ : 0|64@1+ (1,0) [0|18446744073709551615] "" Vector__XXX

BO_ 2566764032 VDMA_FDB6_SPN_Support: 8 Vector__XXX
 SG_ SPN_Support_RawPayload : 0|64@1+ (1,0) [0|18446744073709551615] "" Vector__XXX

BO_ 2566764288 VDMA_FDB7_Expanded_Freeze_Frame: 8 Vector__XXX
 SG_ Expanded_Freeze_Frame_RawPayload : 0|64@1+ (1,0) [0|18446744073709551615] "" Vector__XXX

BO_ 2566764544 VDMA_FDB8_Diagnostic_Readiness_3: 8 Vector__XXX
 SG_ Diagnostic_Readiness_3_RawPayloa : 0|64@1+ (1,0) [0|18446744073709551615] "" Vector__XXX

BO_ 2566764800 VDMA_FDB9_Tire_Pressure_Referenc: 8 Vector__XXX
 SG_ Tire_Pressure_Reference_Informat : 0|64@1+ (1,0) [0|18446744073709551615] "" Vector__XXX

BO_ 2566765056 VDMA_FDBA_Farebox_Status: 8 Vector__XXX
 SG_ Farebox_Status_RawPayload : 0|64@1+ (1,0) [0|18446744073709551615] "" Vector__XXX

BO_ 2566765312 VDMA_FDBB_Farebox_Point_of_Sale: 8 Vector__XXX
 SG_ Farebox_Point_of_Sale_RawPayload : 0|64@1+ (1,0) [0|18446744073709551615] "" Vector__XXX

BO_ 2566765568 VDMA_FDBC_Farebox_Service_Detail: 8 Vector__XXX
 SG_ Farebox_Service_Detail_RawPayloa : 0|64@1+ (1,0) [0|18446744073709551615] "" Vector__XXX

BO_ 2566765824 VDMA_FDBD_Signal_Preemption: 8 Vector__XXX
 SG_ Signal_Preemption_RawPayload : 0|64@1+ (1,0) [0|18446744073709551615] "" Vector__XXX

BO_ 2566766080 VDMA_FDBE_Transit_Route: 8 Vector__XXX
 SG_ Transit_Route_RawPayload : 0|64@1+ (1,0) [0|18446744073709551615] "" Vector__XXX

BO_ 2566766336 VDMA_FDBF_Transit_Milepost: 8 Vector__XXX
 SG_ Transit_Milepost_RawPayload : 0|64@1+ (1,0) [0|18446744073709551615] "" Vector__XXX

BO_ 2566766592 VDMA_FDC0_Passenger_Counter: 8 Vector__XXX
 SG_ Passenger_Counter_RawPayload : 0|64@1+ (1,0) [0|18446744073709551615] "" Vector__XXX

BO_ 2566766848 VDMA_FDC1_Engine_Fluid_Level_Pre: 8 Vector__XXX
 SG_ Engine_Fluid_Level_Pressure_3_Ra : 0|64@1+ (1,0) [0|18446744073709551615] "" Vector__XXX

BO_ 2566767104 VDMA_FDC2_Electronic_Engine_Cont: 8 Vector__XXX
 SG_ Electronic_Engine_Controller_14_ : 0|64@1+ (1,0) [0|18446744073709551615] "" Vector__XXX

BO_ 2566767360 VDMA_FDC3_Electronic_Engine_Cont: 8 Vector__XXX
 SG_ Electronic_Engine_Controller_15_ : 0|64@1+ (1,0) [0|18446744073709551615] "" Vector__XXX

BO_ 2566767616 VDMA_FDC4_Electronic_Brake_Contr: 8 Vector__XXX
 SG_ Electronic_Brake_Controller_5_Ra : 0|64@1+ (1,0) [0|18446744073709551615] "" Vector__XXX

BO_ 2566768128 VDMA_FDC6_Cold_Start_Aids: 8 Vector__XXX
 SG_ Cold_Start_Aids_RawPayload : 0|64@1+ (1,0) [0|18446744073709551615] "" Vector__XXX

BO_ 2566768384 VDMA_FDC7_Off_Highway_Engine_Con: 8 Vector__XXX
 SG_ Off_Highway_Engine_Control_Selec : 0|64@1+ (1,0) [0|18446744073709551615] "" Vector__XXX

BO_ 2566768640 VDMA_FDC8_Operator_Primary_Inter: 8 Vector__XXX
 SG_ Operator_Primary_Intermediate_Sp : 0|64@1+ (1,0) [0|18446744073709551615] "" Vector__XXX

BO_ 2566768896 VDMA_FDC9_Electronic_Control_Mod: 8 Vector__XXX
 SG_ Electronic_Control_Module_Inform : 0|64@1+ (1,0) [0|18446744073709551615] "" Vector__XXX

BO_ 2566769152 VDMA_FDCA_Intermediate_Speed_Con: 8 Vector__XXX
 SG_ Intermediate_Speed_Control_RawPa : 0|64@1+ (1,0) [0|18446744073709551615] "" Vector__XXX

BO_ 2566769408 VDMA_FDCB_Off_Highway_Engine_Con: 8 Vector__XXX
 SG_ Off_Highway_Engine_Control_Selec : 0|64@1+ (1,0) [0|18446744073709551615] "" Vector__XXX

CM_ BO_ 2566683904  "Source: isobus.net VDMA Data Dictionary (https://www.isobus.net/isobus/pGNAndSPN/13013?type=PGN)";
CM_ BO_ 2566684160  "Source: isobus.net VDMA Data Dictionary (https://www.isobus.net/isobus/pGNAndSPN/13014?type=PGN)";
CM_ BO_ 2566684416  "Source: isobus.net VDMA Data Dictionary (https://www.isobus.net/isobus/pGNAndSPN/13015?type=PGN)";
CM_ BO_ 2566684672  "Source: isobus.net VDMA Data Dictionary (https://www.isobus.net/isobus/pGNAndSPN/13016?type=PGN)";
CM_ BO_ 2566684928  "Source: isobus.net VDMA Data Dictionary (https://www.isobus.net/isobus/pGNAndSPN/13017?type=PGN)";
CM_ BO_ 2566685184  "Source: isobus.net VDMA Data Dictionary (https://www.isobus.net/isobus/pGNAndSPN/13018?type=PGN)";
CM_ BO_ 2566685440  "Source: isobus.net VDMA Data Dictionary (https://www.isobus.net/isobus/pGNAndSPN/13019?type=PGN)";
CM_ BO_ 2566685696  "Source: isobus.net VDMA Data Dictionary (https://www.isobus.net/isobus/pGNAndSPN/13020?type=PGN)";
CM_ BO_ 2566685952  "Source: isobus.net VDMA Data Dictionary (https://www.isobus.net/isobus/pGNAndSPN/13023?type=PGN)";
CM_ BO_ 2566686208  "Source: isobus.net VDMA Data Dictionary (https://www.isobus.net/isobus/pGNAndSPN/13028?type=PGN)";
CM_ BO_ 2566686464  "Source: isobus.net VDMA Data Dictionary (https://www.isobus.net/isobus/pGNAndSPN/13031?type=PGN)";
CM_ BO_ 2566686720  "Source: isobus.net VDMA Data Dictionary (https://www.isobus.net/isobus/pGNAndSPN/13034?type=PGN)";
CM_ BO_ 2566686976  "Source: isobus.net VDMA Data Dictionary (https://www.isobus.net/isobus/pGNAndSPN/13038?type=PGN)";
CM_ BO_ 2566687232  "Source: isobus.net VDMA Data Dictionary (https://www.isobus.net/isobus/pGNAndSPN/13042?type=PGN)";
CM_ BO_ 2566687488  "Source: isobus.net VDMA Data Dictionary (https://www.isobus.net/isobus/pGNAndSPN/13048?type=PGN)";
CM_ BO_ 2566687744  "Source: isobus.net VDMA Data Dictionary (https://www.isobus.net/isobus/pGNAndSPN/13054?type=PGN)";
CM_ BO_ 2566688512  "Source: isobus.net VDMA Data Dictionary (https://www.isobus.net/isobus/pGNAndSPN/13067?type=PGN)";
CM_ BO_ 2566688768  "Source: isobus.net VDMA Data Dictionary (https://www.isobus.net/isobus/pGNAndSPN/13071?type=PGN)";
CM_ BO_ 2566689024  "Source: isobus.net VDMA Data Dictionary (https://www.isobus.net/isobus/pGNAndSPN/13074?type=PGN)";
CM_ BO_ 2566689280  "Source: isobus.net VDMA Data Dictionary (https://www.isobus.net/isobus/pGNAndSPN/13078?type=PGN)";
CM_ BO_ 2566689536  "Source: isobus.net VDMA Data Dictionary (https://www.isobus.net/isobus/pGNAndSPN/13082?type=PGN)";
CM_ BO_ 2566689792  "Source: isobus.net VDMA Data Dictionary (https://www.isobus.net/isobus/pGNAndSPN/13089?type=PGN)";
CM_ BO_ 2566690048  "Source: isobus.net VDMA Data Dictionary (https://www.isobus.net/isobus/pGNAndSPN/13091?type=PGN)";
CM_ BO_ 2566690304  "Source: isobus.net VDMA Data Dictionary (https://www.isobus.net/isobus/pGNAndSPN/13096?type=PGN)";
CM_ BO_ 2566690560  "Source: isobus.net VDMA Data Dictionary (https://www.isobus.net/isobus/pGNAndSPN/13108?type=PGN)";
CM_ BO_ 2566690816  "Source: isobus.net VDMA Data Dictionary (https://www.isobus.net/isobus/pGNAndSPN/13113?type=PGN)";
CM_ BO_ 2566691072  "Source: isobus.net VDMA Data Dictionary (https://www.isobus.net/isobus/pGNAndSPN/13115?type=PGN)";
CM_ BO_ 2566691328  "Source: isobus.net VDMA Data Dictionary (https://www.isobus.net/isobus/pGNAndSPN/13125?type=PGN)";
CM_ BO_ 2566691584  "Source: isobus.net VDMA Data Dictionary (https://www.isobus.net/isobus/pGNAndSPN/13135?type=PGN)";
CM_ BO_ 2566691840  "Source: isobus.net VDMA Data Dictionary (https://www.isobus.net/isobus/pGNAndSPN/13145?type=PGN)";
CM_ BO_ 2566692096  "Source: isobus.net VDMA Data Dictionary (https://www.isobus.net/isobus/pGNAndSPN/13147?type=PGN)";
CM_ BO_ 2566692352  "Source: isobus.net VDMA Data Dictionary (https://www.isobus.net/isobus/pGNAndSPN/13151?type=PGN)";
CM_ BO_ 2566692608  "Source: isobus.net VDMA Data Dictionary (https://www.isobus.net/isobus/pGNAndSPN/13158?type=PGN)";
CM_ BO_ 2566692864  "Source: isobus.net VDMA Data Dictionary (https://www.isobus.net/isobus/pGNAndSPN/13160?type=PGN)";
CM_ BO_ 2566693120  "Source: isobus.net VDMA Data Dictionary (https://www.isobus.net/isobus/pGNAndSPN/13168?type=PGN)";
CM_ BO_ 2566693376  "Source: isobus.net VDMA Data Dictionary (https://www.isobus.net/isobus/pGNAndSPN/13176?type=PGN)";
CM_ BO_ 2566693632  "Source: isobus.net VDMA Data Dictionary (https://www.isobus.net/isobus/pGNAndSPN/13184?type=PGN)";
CM_ BO_ 2566693888  "Source: isobus.net VDMA Data Dictionary (https://www.isobus.net/isobus/pGNAndSPN/13188?type=PGN)";
CM_ BO_ 2566694144  "Source: isobus.net VDMA Data Dictionary (https://www.isobus.net/isobus/pGNAndSPN/13192?type=PGN)";
CM_ BO_ 2566694400  "Source: isobus.net VDMA Data Dictionary (https://www.isobus.net/isobus/pGNAndSPN/13196?type=PGN)";
CM_ BO_ 2566694656  "Source: isobus.net VDMA Data Dictionary (https://www.isobus.net/isobus/pGNAndSPN/13200?type=PGN)";
CM_ BO_ 2566694912  "Source: isobus.net VDMA Data Dictionary (https://www.isobus.net/isobus/pGNAndSPN/13204?type=PGN)";
CM_ BO_ 2566695168  "Source: isobus.net VDMA Data Dictionary (https://www.isobus.net/isobus/pGNAndSPN/13208?type=PGN)";
CM_ BO_ 2566695424  "Source: isobus.net VDMA Data Dictionary (https://www.isobus.net/isobus/pGNAndSPN/13212?type=PGN)";
CM_ BO_ 2566695680  "Source: isobus.net VDMA Data Dictionary (https://www.isobus.net/isobus/pGNAndSPN/13216?type=PGN)";
CM_ BO_ 2566695936  "Source: isobus.net VDMA Data Dictionary (https://www.isobus.net/isobus/pGNAndSPN/13220?type=PGN)";
CM_ BO_ 2566696192  "Source: isobus.net VDMA Data Dictionary (https://www.isobus.net/isobus/pGNAndSPN/13224?type=PGN)";
CM_ BO_ 2566696448  "Source: isobus.net VDMA Data Dictionary (https://www.isobus.net/isobus/pGNAndSPN/13228?type=PGN)";
CM_ BO_ 2566696704  "Source: isobus.net VDMA Data Dictionary (https://www.isobus.net/isobus/pGNAndSPN/13232?type=PGN)";
CM_ BO_ 2566696960  "Source: isobus.net VDMA Data Dictionary (https://www.isobus.net/isobus/pGNAndSPN/13234?type=PGN)";
CM_ BO_ 2566697216  "Source: isobus.net VDMA Data Dictionary (https://www.isobus.net/isobus/pGNAndSPN/13238?type=PGN)";
CM_ BO_ 2566697728  "Source: isobus.net VDMA Data Dictionary (https://www.isobus.net/isobus/pGNAndSPN/13302?type=PGN)";
CM_ BO_ 2566697984  "Source: isobus.net VDMA Data Dictionary (https://www.isobus.net/isobus/pGNAndSPN/13334?type=PGN)";
CM_ BO_ 2566698240  "Source: isobus.net VDMA Data Dictionary (https://www.isobus.net/isobus/pGNAndSPN/13366?type=PGN)";
CM_ BO_ 2566698496  "Source: isobus.net VDMA Data Dictionary (https://www.isobus.net/isobus/pGNAndSPN/13370?type=PGN)";
CM_ BO_ 2566698752  "Source: isobus.net VDMA Data Dictionary (https://www.isobus.net/isobus/pGNAndSPN/13376?type=PGN)";
CM_ BO_ 2566699008  "Source: isobus.net VDMA Data Dictionary (https://www.isobus.net/isobus/pGNAndSPN/13378?type=PGN)";
CM_ BO_ 2566699264  "Source: isobus.net VDMA Data Dictionary (https://www.isobus.net/isobus/pGNAndSPN/13380?type=PGN)";
CM_ BO_ 2566699520  "Source: isobus.net VDMA Data Dictionary (https://www.isobus.net/isobus/pGNAndSPN/13387?type=PGN)";
CM_ BO_ 2566699776  "Source: isobus.net VDMA Data Dictionary (https://www.isobus.net/isobus/pGNAndSPN/13394?type=PGN)";
CM_ BO_ 2566700032  "Source: isobus.net VDMA Data Dictionary (https://www.isobus.net/isobus/pGNAndSPN/13395?type=PGN)";
CM_ BO_ 2566700288  "Source: isobus.net VDMA Data Dictionary (https://www.isobus.net/isobus/pGNAndSPN/13397?type=PGN)";
CM_ BO_ 2566700544  "Source: isobus.net VDMA Data Dictionary (https://www.isobus.net/isobus/pGNAndSPN/13401?type=PGN)";
CM_ BO_ 2566700800  "Source: isobus.net VDMA Data Dictionary (https://www.isobus.net/isobus/pGNAndSPN/13415?type=PGN)";
CM_ BO_ 2566701056  "Source: isobus.net VDMA Data Dictionary (https://www.isobus.net/isobus/pGNAndSPN/13421?type=PGN)";
CM_ BO_ 2566701312  "Source: isobus.net VDMA Data Dictionary (https://www.isobus.net/isobus/pGNAndSPN/13425?type=PGN)";
CM_ BO_ 2566701568  "Source: isobus.net VDMA Data Dictionary (https://www.isobus.net/isobus/pGNAndSPN/13446?type=PGN)";
CM_ BO_ 2566701824  "Source: isobus.net VDMA Data Dictionary (https://www.isobus.net/isobus/pGNAndSPN/13448?type=PGN)";
CM_ BO_ 2566702080  "Source: isobus.net VDMA Data Dictionary (https://www.isobus.net/isobus/pGNAndSPN/13450?type=PGN)";
CM_ BO_ 2566702336  "Source: isobus.net VDMA Data Dictionary (https://www.isobus.net/isobus/pGNAndSPN/13452?type=PGN)";
CM_ BO_ 2566702592  "Source: isobus.net VDMA Data Dictionary (https://www.isobus.net/isobus/pGNAndSPN/13453?type=PGN)";
CM_ BO_ 2566702848  "Source: isobus.net VDMA Data Dictionary (https://www.isobus.net/isobus/pGNAndSPN/13455?type=PGN)";
CM_ BO_ 2566703104  "Source: isobus.net VDMA Data Dictionary (https://www.isobus.net/isobus/pGNAndSPN/13468?type=PGN)";
CM_ BO_ 2566703360  "Source: isobus.net VDMA Data Dictionary (https://www.isobus.net/isobus/pGNAndSPN/13475?type=PGN)";
CM_ BO_ 2566703616  "Source: isobus.net VDMA Data Dictionary (https://www.isobus.net/isobus/pGNAndSPN/13485?type=PGN)";
CM_ BO_ 2566703872  "Source: isobus.net VDMA Data Dictionary (https://www.isobus.net/isobus/pGNAndSPN/13495?type=PGN)";
CM_ BO_ 2566704128  "Source: isobus.net VDMA Data Dictionary (https://www.isobus.net/isobus/pGNAndSPN/13501?type=PGN)";
CM_ BO_ 2566704384  "Source: isobus.net VDMA Data Dictionary (https://www.isobus.net/isobus/pGNAndSPN/13507?type=PGN)";
CM_ BO_ 2566704640  "Source: isobus.net VDMA Data Dictionary (https://www.isobus.net/isobus/pGNAndSPN/13512?type=PGN)";
CM_ BO_ 2566704896  "Source: isobus.net VDMA Data Dictionary (https://www.isobus.net/isobus/pGNAndSPN/13516?type=PGN)";
CM_ BO_ 2566705152  "Source: isobus.net VDMA Data Dictionary (https://www.isobus.net/isobus/pGNAndSPN/13519?type=PGN)";
CM_ BO_ 2566705408  "Source: isobus.net VDMA Data Dictionary (https://www.isobus.net/isobus/pGNAndSPN/13531?type=PGN)";
CM_ BO_ 2566705664  "Source: isobus.net VDMA Data Dictionary (https://www.isobus.net/isobus/pGNAndSPN/13543?type=PGN)";
CM_ BO_ 2566705920  "Source: isobus.net VDMA Data Dictionary (https://www.isobus.net/isobus/pGNAndSPN/13544?type=PGN)";
CM_ BO_ 2566706176  "Source: isobus.net VDMA Data Dictionary (https://www.isobus.net/isobus/pGNAndSPN/13545?type=PGN)";
CM_ BO_ 2566706432  "Source: isobus.net VDMA Data Dictionary (https://www.isobus.net/isobus/pGNAndSPN/13552?type=PGN)";
CM_ BO_ 2566706688  "Source: isobus.net VDMA Data Dictionary (https://www.isobus.net/isobus/pGNAndSPN/13556?type=PGN)";
CM_ BO_ 2566706944  "Source: isobus.net VDMA Data Dictionary (https://www.isobus.net/isobus/pGNAndSPN/13560?type=PGN)";
CM_ BO_ 2566707200  "Source: isobus.net VDMA Data Dictionary (https://www.isobus.net/isobus/pGNAndSPN/13564?type=PGN)";
CM_ BO_ 2566707456  "Source: isobus.net VDMA Data Dictionary (https://www.isobus.net/isobus/pGNAndSPN/13568?type=PGN)";
CM_ BO_ 2566707712  "Source: isobus.net VDMA Data Dictionary (https://www.isobus.net/isobus/pGNAndSPN/13572?type=PGN)";
CM_ BO_ 2566707968  "Source: isobus.net VDMA Data Dictionary (https://www.isobus.net/isobus/pGNAndSPN/13576?type=PGN)";
CM_ BO_ 2566708224  "Source: isobus.net VDMA Data Dictionary (https://www.isobus.net/isobus/pGNAndSPN/13587?type=PGN)";
CM_ BO_ 2566708480  "Source: isobus.net VDMA Data Dictionary (https://www.isobus.net/isobus/pGNAndSPN/13588?type=PGN)";
CM_ BO_ 2566708736  "Source: isobus.net VDMA Data Dictionary (https://www.isobus.net/isobus/pGNAndSPN/13590?type=PGN)";
CM_ BO_ 2566708992  "Source: isobus.net VDMA Data Dictionary (https://www.isobus.net/isobus/pGNAndSPN/13597?type=PGN)";
CM_ BO_ 2566709248  "Source: isobus.net VDMA Data Dictionary (https://www.isobus.net/isobus/pGNAndSPN/13601?type=PGN)";
CM_ BO_ 2566709504  "Source: isobus.net VDMA Data Dictionary (https://www.isobus.net/isobus/pGNAndSPN/13603?type=PGN)";
CM_ BO_ 2566709760  "Source: isobus.net VDMA Data Dictionary (https://www.isobus.net/isobus/pGNAndSPN/13612?type=PGN)";
CM_ BO_ 2566710016  "Source: isobus.net VDMA Data Dictionary (https://www.isobus.net/isobus/pGNAndSPN/13617?type=PGN)";
CM_ BO_ 2566710272  "Source: isobus.net VDMA Data Dictionary (https://www.isobus.net/isobus/pGNAndSPN/13621?type=PGN)";
CM_ BO_ 2566710528  "Source: isobus.net VDMA Data Dictionary (https://www.isobus.net/isobus/pGNAndSPN/13625?type=PGN)";
CM_ BO_ 2566710784  "Source: isobus.net VDMA Data Dictionary (https://www.isobus.net/isobus/pGNAndSPN/13631?type=PGN)";
CM_ BO_ 2566711040  "Source: isobus.net VDMA Data Dictionary (https://www.isobus.net/isobus/pGNAndSPN/13638?type=PGN)";
CM_ BO_ 2566711296  "Source: isobus.net VDMA Data Dictionary (https://www.isobus.net/isobus/pGNAndSPN/13640?type=PGN)";
CM_ BO_ 2566711552  "Source: isobus.net VDMA Data Dictionary (https://www.isobus.net/isobus/pGNAndSPN/13644?type=PGN)";
CM_ BO_ 2566711808  "Source: isobus.net VDMA Data Dictionary (https://www.isobus.net/isobus/pGNAndSPN/13645?type=PGN)";
CM_ BO_ 2566712064  "Source: isobus.net VDMA Data Dictionary (https://www.isobus.net/isobus/pGNAndSPN/13647?type=PGN)";
CM_ BO_ 2566712320  "Source: isobus.net VDMA Data Dictionary (https://www.isobus.net/isobus/pGNAndSPN/13649?type=PGN)";
CM_ BO_ 2566712576  "Source: isobus.net VDMA Data Dictionary (https://www.isobus.net/isobus/pGNAndSPN/13651?type=PGN)";
CM_ BO_ 2566712832  "Source: isobus.net VDMA Data Dictionary (https://www.isobus.net/isobus/pGNAndSPN/13655?type=PGN)";
CM_ BO_ 2566713088  "Source: isobus.net VDMA Data Dictionary (https://www.isobus.net/isobus/pGNAndSPN/13659?type=PGN)";
CM_ BO_ 2566713344  "Source: isobus.net VDMA Data Dictionary (https://www.isobus.net/isobus/pGNAndSPN/13664?type=PGN)";
CM_ BO_ 2566713600  "Source: isobus.net VDMA Data Dictionary (https://www.isobus.net/isobus/pGNAndSPN/13676?type=PGN)";
CM_ BO_ 2566713856  "Source: isobus.net VDMA Data Dictionary (https://www.isobus.net/isobus/pGNAndSPN/13690?type=PGN)";
CM_ BO_ 2566714112  "Source: isobus.net VDMA Data Dictionary (https://www.isobus.net/isobus/pGNAndSPN/13698?type=PGN)";
CM_ BO_ 2566714368  "Source: isobus.net VDMA Data Dictionary (https://www.isobus.net/isobus/pGNAndSPN/13702?type=PGN)";
CM_ BO_ 2566714624  "Source: isobus.net VDMA Data Dictionary (https://www.isobus.net/isobus/pGNAndSPN/13705?type=PGN)";
CM_ BO_ 2566714880  "Source: isobus.net VDMA Data Dictionary (https://www.isobus.net/isobus/pGNAndSPN/13709?type=PGN)";
CM_ BO_ 2566715136  "Source: isobus.net VDMA Data Dictionary (https://www.isobus.net/isobus/pGNAndSPN/13712?type=PGN)";
CM_ BO_ 2566715392  "Source: isobus.net VDMA Data Dictionary (https://www.isobus.net/isobus/pGNAndSPN/13715?type=PGN)";
CM_ BO_ 2566715648  "Source: isobus.net VDMA Data Dictionary (https://www.isobus.net/isobus/pGNAndSPN/13718?type=PGN)";
CM_ BO_ 2566715904  "Source: isobus.net VDMA Data Dictionary (https://www.isobus.net/isobus/pGNAndSPN/13722?type=PGN)";
CM_ BO_ 2566716160  "Source: isobus.net VDMA Data Dictionary (https://www.isobus.net/isobus/pGNAndSPN/13724?type=PGN)";
CM_ BO_ 2566716416  "Source: isobus.net VDMA Data Dictionary (https://www.isobus.net/isobus/pGNAndSPN/13726?type=PGN)";
CM_ BO_ 2566716672  "Source: isobus.net VDMA Data Dictionary (https://www.isobus.net/isobus/pGNAndSPN/13730?type=PGN)";
CM_ BO_ 2566716928  "Source: isobus.net VDMA Data Dictionary (https://www.isobus.net/isobus/pGNAndSPN/13735?type=PGN)";
CM_ BO_ 2566717184  "Source: isobus.net VDMA Data Dictionary (https://www.isobus.net/isobus/pGNAndSPN/13738?type=PGN)";
CM_ BO_ 2566717440  "Source: isobus.net VDMA Data Dictionary (https://www.isobus.net/isobus/pGNAndSPN/13743?type=PGN)";
CM_ BO_ 2566717696  "Source: isobus.net VDMA Data Dictionary (https://www.isobus.net/isobus/pGNAndSPN/13751?type=PGN)";
CM_ BO_ 2566718208  "Source: isobus.net VDMA Data Dictionary (https://www.isobus.net/isobus/pGNAndSPN/13754?type=PGN)";
CM_ BO_ 2566718464  "Source: isobus.net VDMA Data Dictionary (https://www.isobus.net/isobus/pGNAndSPN/13769?type=PGN)";
CM_ BO_ 2566718720  "Source: isobus.net VDMA Data Dictionary (https://www.isobus.net/isobus/pGNAndSPN/13796?type=PGN)";
CM_ BO_ 2566718976  "Source: isobus.net VDMA Data Dictionary (https://www.isobus.net/isobus/pGNAndSPN/13811?type=PGN)";
CM_ BO_ 2566719232  "Source: isobus.net VDMA Data Dictionary (https://www.isobus.net/isobus/pGNAndSPN/13838?type=PGN)";
CM_ BO_ 2566719488  "Source: isobus.net VDMA Data Dictionary (https://www.isobus.net/isobus/pGNAndSPN/13842?type=PGN)";
CM_ BO_ 2566720000  "Source: isobus.net VDMA Data Dictionary (https://www.isobus.net/isobus/pGNAndSPN/13850?type=PGN)";
CM_ BO_ 2566720256  "Source: isobus.net VDMA Data Dictionary (https://www.isobus.net/isobus/pGNAndSPN/13854?type=PGN)";
CM_ BO_ 2566720512  "Source: isobus.net VDMA Data Dictionary (https://www.isobus.net/isobus/pGNAndSPN/13860?type=PGN)";
CM_ BO_ 2566720768  "Source: isobus.net VDMA Data Dictionary (https://www.isobus.net/isobus/pGNAndSPN/13864?type=PGN)";
CM_ BO_ 2566721024  "Source: isobus.net VDMA Data Dictionary (https://www.isobus.net/isobus/pGNAndSPN/13870?type=PGN)";
CM_ BO_ 2566721280  "Source: isobus.net VDMA Data Dictionary (https://www.isobus.net/isobus/pGNAndSPN/13874?type=PGN)";
CM_ BO_ 2566721536  "Source: isobus.net VDMA Data Dictionary (https://www.isobus.net/isobus/pGNAndSPN/13880?type=PGN)";
CM_ BO_ 2566721792  "Source: isobus.net VDMA Data Dictionary (https://www.isobus.net/isobus/pGNAndSPN/13884?type=PGN)";
CM_ BO_ 2566722048  "Source: isobus.net VDMA Data Dictionary (https://www.isobus.net/isobus/pGNAndSPN/13892?type=PGN)";
CM_ BO_ 2566722304  "Source: isobus.net VDMA Data Dictionary (https://www.isobus.net/isobus/pGNAndSPN/13894?type=PGN)";
CM_ BO_ 2566722560  "Source: isobus.net VDMA Data Dictionary (https://www.isobus.net/isobus/pGNAndSPN/13901?type=PGN)";
CM_ BO_ 2566722816  "Source: isobus.net VDMA Data Dictionary (https://www.isobus.net/isobus/pGNAndSPN/13908?type=PGN)";
CM_ BO_ 2566723072  "Source: isobus.net VDMA Data Dictionary (https://www.isobus.net/isobus/pGNAndSPN/13918?type=PGN)";
CM_ BO_ 2566723328  "Source: isobus.net VDMA Data Dictionary (https://www.isobus.net/isobus/pGNAndSPN/13930?type=PGN)";
CM_ BO_ 2566723584  "Source: isobus.net VDMA Data Dictionary (https://www.isobus.net/isobus/pGNAndSPN/13964?type=PGN)";
CM_ BO_ 2566723840  "Source: isobus.net VDMA Data Dictionary (https://www.isobus.net/isobus/pGNAndSPN/14064?type=PGN)";
CM_ BO_ 2566724096  "Source: isobus.net VDMA Data Dictionary (https://www.isobus.net/isobus/pGNAndSPN/14066?type=PGN)";
CM_ BO_ 2566724352  "Source: isobus.net VDMA Data Dictionary (https://www.isobus.net/isobus/pGNAndSPN/14072?type=PGN)";
CM_ BO_ 2566724608  "Source: isobus.net VDMA Data Dictionary (https://www.isobus.net/isobus/pGNAndSPN/14078?type=PGN)";
CM_ BO_ 2566724864  "Source: isobus.net VDMA Data Dictionary (https://www.isobus.net/isobus/pGNAndSPN/14080?type=PGN)";
CM_ BO_ 2566725120  "Source: isobus.net VDMA Data Dictionary (https://www.isobus.net/isobus/pGNAndSPN/14082?type=PGN)";
CM_ BO_ 2566725376  "Source: isobus.net VDMA Data Dictionary (https://www.isobus.net/isobus/pGNAndSPN/14088?type=PGN)";
CM_ BO_ 2566725632  "Source: isobus.net VDMA Data Dictionary (https://www.isobus.net/isobus/pGNAndSPN/14094?type=PGN)";
CM_ BO_ 2566725888  "Source: isobus.net VDMA Data Dictionary (https://www.isobus.net/isobus/pGNAndSPN/14100?type=PGN)";
CM_ BO_ 2566726144  "Source: isobus.net VDMA Data Dictionary (https://www.isobus.net/isobus/pGNAndSPN/14106?type=PGN)";
CM_ BO_ 2566726400  "Source: isobus.net VDMA Data Dictionary (https://www.isobus.net/isobus/pGNAndSPN/14125?type=PGN)";
CM_ BO_ 2566726656  "Source: isobus.net VDMA Data Dictionary (https://www.isobus.net/isobus/pGNAndSPN/14147?type=PGN)";
CM_ BO_ 2566726912  "Source: isobus.net VDMA Data Dictionary (https://www.isobus.net/isobus/pGNAndSPN/14166?type=PGN)";
CM_ BO_ 2566727168  "Source: isobus.net VDMA Data Dictionary (https://www.isobus.net/isobus/pGNAndSPN/14188?type=PGN)";
CM_ BO_ 2566727424  "Source: isobus.net VDMA Data Dictionary (https://www.isobus.net/isobus/pGNAndSPN/14207?type=PGN)";
CM_ BO_ 2566727680  "Source: isobus.net VDMA Data Dictionary (https://www.isobus.net/isobus/pGNAndSPN/14229?type=PGN)";
CM_ BO_ 2566727936  "Source: isobus.net VDMA Data Dictionary (https://www.isobus.net/isobus/pGNAndSPN/14248?type=PGN)";
CM_ BO_ 2566728192  "Source: isobus.net VDMA Data Dictionary (https://www.isobus.net/isobus/pGNAndSPN/14270?type=PGN)";
CM_ BO_ 2566728448  "Source: isobus.net VDMA Data Dictionary (https://www.isobus.net/isobus/pGNAndSPN/14289?type=PGN)";
CM_ BO_ 2566728704  "Source: isobus.net VDMA Data Dictionary (https://www.isobus.net/isobus/pGNAndSPN/14311?type=PGN)";
CM_ BO_ 2566728960  "Source: isobus.net VDMA Data Dictionary (https://www.isobus.net/isobus/pGNAndSPN/14330?type=PGN)";
CM_ BO_ 2566729216  "Source: isobus.net VDMA Data Dictionary (https://www.isobus.net/isobus/pGNAndSPN/14352?type=PGN)";
CM_ BO_ 2566729472  "Source: isobus.net VDMA Data Dictionary (https://www.isobus.net/isobus/pGNAndSPN/14371?type=PGN)";
CM_ BO_ 2566729728  "Source: isobus.net VDMA Data Dictionary (https://www.isobus.net/isobus/pGNAndSPN/14393?type=PGN)";
CM_ BO_ 2566729984  "Source: isobus.net VDMA Data Dictionary (https://www.isobus.net/isobus/pGNAndSPN/14398?type=PGN)";
CM_ BO_ 2566730496  "Source: isobus.net VDMA Data Dictionary (https://www.isobus.net/isobus/pGNAndSPN/14408?type=PGN)";
CM_ BO_ 2566730752  "Source: isobus.net VDMA Data Dictionary (https://www.isobus.net/isobus/pGNAndSPN/14415?type=PGN)";
CM_ BO_ 2566731008  "Source: isobus.net VDMA Data Dictionary (https://www.isobus.net/isobus/pGNAndSPN/14422?type=PGN)";
CM_ BO_ 2566731264  "Source: isobus.net VDMA Data Dictionary (https://www.isobus.net/isobus/pGNAndSPN/14428?type=PGN)";
CM_ BO_ 2566731520  "Source: isobus.net VDMA Data Dictionary (https://www.isobus.net/isobus/pGNAndSPN/14433?type=PGN)";
CM_ BO_ 2566731776  "Source: isobus.net VDMA Data Dictionary (https://www.isobus.net/isobus/pGNAndSPN/14437?type=PGN)";
CM_ BO_ 2566732032  "Source: isobus.net VDMA Data Dictionary (https://www.isobus.net/isobus/pGNAndSPN/14441?type=PGN)";
CM_ BO_ 2566732288  "Source: isobus.net VDMA Data Dictionary (https://www.isobus.net/isobus/pGNAndSPN/14458?type=PGN)";
CM_ BO_ 2566732544  "Source: isobus.net VDMA Data Dictionary (https://www.isobus.net/isobus/pGNAndSPN/14471?type=PGN)";
CM_ BO_ 2566732800  "Source: isobus.net VDMA Data Dictionary (https://www.isobus.net/isobus/pGNAndSPN/14480?type=PGN)";
CM_ BO_ 2566733056  "Source: isobus.net VDMA Data Dictionary (https://www.isobus.net/isobus/pGNAndSPN/14487?type=PGN)";
CM_ BO_ 2566733312  "Source: isobus.net VDMA Data Dictionary (https://www.isobus.net/isobus/pGNAndSPN/14491?type=PGN)";
CM_ BO_ 2566733568  "Source: isobus.net VDMA Data Dictionary (https://www.isobus.net/isobus/pGNAndSPN/14495?type=PGN)";
CM_ BO_ 2566733824  "Source: isobus.net VDMA Data Dictionary (https://www.isobus.net/isobus/pGNAndSPN/14513?type=PGN)";
CM_ BO_ 2566734080  "Source: isobus.net VDMA Data Dictionary (https://www.isobus.net/isobus/pGNAndSPN/14526?type=PGN)";
CM_ BO_ 2566734336  "Source: isobus.net VDMA Data Dictionary (https://www.isobus.net/isobus/pGNAndSPN/14545?type=PGN)";
CM_ BO_ 2566734848  "Source: isobus.net VDMA Data Dictionary (https://www.isobus.net/isobus/pGNAndSPN/14552?type=PGN)";
CM_ BO_ 2566735104  "Source: isobus.net VDMA Data Dictionary (https://www.isobus.net/isobus/pGNAndSPN/14558?type=PGN)";
CM_ BO_ 2566735360  "Source: isobus.net VDMA Data Dictionary (https://www.isobus.net/isobus/pGNAndSPN/14564?type=PGN)";
CM_ BO_ 2566735616  "Source: isobus.net VDMA Data Dictionary (https://www.isobus.net/isobus/pGNAndSPN/14565?type=PGN)";
CM_ BO_ 2566735872  "Source: isobus.net VDMA Data Dictionary (https://www.isobus.net/isobus/pGNAndSPN/14568?type=PGN)";
CM_ BO_ 2566736128  "Source: isobus.net VDMA Data Dictionary (https://www.isobus.net/isobus/pGNAndSPN/14571?type=PGN)";
CM_ BO_ 2566736384  "Source: isobus.net VDMA Data Dictionary (https://www.isobus.net/isobus/pGNAndSPN/14572?type=PGN)";
CM_ BO_ 2566736640  "Source: isobus.net VDMA Data Dictionary (https://www.isobus.net/isobus/pGNAndSPN/14573?type=PGN)";
CM_ BO_ 2566736896  "Source: isobus.net VDMA Data Dictionary (https://www.isobus.net/isobus/pGNAndSPN/14574?type=PGN)";
CM_ BO_ 2566737152  "Source: isobus.net VDMA Data Dictionary (https://www.isobus.net/isobus/pGNAndSPN/14575?type=PGN)";
CM_ BO_ 2566737408  "Source: isobus.net VDMA Data Dictionary (https://www.isobus.net/isobus/pGNAndSPN/14576?type=PGN)";
CM_ BO_ 2566737664  "Source: isobus.net VDMA Data Dictionary (https://www.isobus.net/isobus/pGNAndSPN/14577?type=PGN)";
CM_ BO_ 2566737920  "Source: isobus.net VDMA Data Dictionary (https://www.isobus.net/isobus/pGNAndSPN/14578?type=PGN)";
CM_ BO_ 2566738176  "Source: isobus.net VDMA Data Dictionary (https://www.isobus.net/isobus/pGNAndSPN/14584?type=PGN)";
CM_ BO_ 2566738432  "Source: isobus.net VDMA Data Dictionary (https://www.isobus.net/isobus/pGNAndSPN/14592?type=PGN)";
CM_ BO_ 2566738688  "Source: isobus.net VDMA Data Dictionary (https://www.isobus.net/isobus/pGNAndSPN/14595?type=PGN)";
CM_ BO_ 2566738944  "Source: isobus.net VDMA Data Dictionary (https://www.isobus.net/isobus/pGNAndSPN/14607?type=PGN)";
CM_ BO_ 2566739200  "Source: isobus.net VDMA Data Dictionary (https://www.isobus.net/isobus/pGNAndSPN/14619?type=PGN)";
CM_ BO_ 2566739456  "Source: isobus.net VDMA Data Dictionary (https://www.isobus.net/isobus/pGNAndSPN/14631?type=PGN)";
CM_ BO_ 2566739712  "Source: isobus.net VDMA Data Dictionary (https://www.isobus.net/isobus/pGNAndSPN/14643?type=PGN)";
CM_ BO_ 2566739968  "Source: isobus.net VDMA Data Dictionary (https://www.isobus.net/isobus/pGNAndSPN/14655?type=PGN)";
CM_ BO_ 2566740224  "Source: isobus.net VDMA Data Dictionary (https://www.isobus.net/isobus/pGNAndSPN/14667?type=PGN)";
CM_ BO_ 2566740480  "Source: isobus.net VDMA Data Dictionary (https://www.isobus.net/isobus/pGNAndSPN/14679?type=PGN)";
CM_ BO_ 2566740736  "Source: isobus.net VDMA Data Dictionary (https://www.isobus.net/isobus/pGNAndSPN/14691?type=PGN)";
CM_ BO_ 2566740992  "Source: isobus.net VDMA Data Dictionary (https://www.isobus.net/isobus/pGNAndSPN/14703?type=PGN)";
CM_ BO_ 2566741248  "Source: isobus.net VDMA Data Dictionary (https://www.isobus.net/isobus/pGNAndSPN/14715?type=PGN)";
CM_ BO_ 2566741504  "Source: isobus.net VDMA Data Dictionary (https://www.isobus.net/isobus/pGNAndSPN/14727?type=PGN)";
CM_ BO_ 2566741760  "Source: isobus.net VDMA Data Dictionary (https://www.isobus.net/isobus/pGNAndSPN/14739?type=PGN)";
CM_ BO_ 2566742016  "Source: isobus.net VDMA Data Dictionary (https://www.isobus.net/isobus/pGNAndSPN/14742?type=PGN)";
CM_ BO_ 2566742272  "Source: isobus.net VDMA Data Dictionary (https://www.isobus.net/isobus/pGNAndSPN/14744?type=PGN)";
CM_ BO_ 2566742528  "Source: isobus.net VDMA Data Dictionary (https://www.isobus.net/isobus/pGNAndSPN/14745?type=PGN)";
CM_ BO_ 2566742784  "Source: isobus.net VDMA Data Dictionary (https://www.isobus.net/isobus/pGNAndSPN/14750?type=PGN)";
CM_ BO_ 2566743040  "Source: isobus.net VDMA Data Dictionary (https://www.isobus.net/isobus/pGNAndSPN/14751?type=PGN)";
CM_ BO_ 2566743296  "Source: isobus.net VDMA Data Dictionary (https://www.isobus.net/isobus/pGNAndSPN/14756?type=PGN)";
CM_ BO_ 2566743552  "Source: isobus.net VDMA Data Dictionary (https://www.isobus.net/isobus/pGNAndSPN/14762?type=PGN)";
CM_ BO_ 2566743808  "Source: isobus.net VDMA Data Dictionary (https://www.isobus.net/isobus/pGNAndSPN/14763?type=PGN)";
CM_ BO_ 2566744064  "Source: isobus.net VDMA Data Dictionary (https://www.isobus.net/isobus/pGNAndSPN/14765?type=PGN)";
CM_ BO_ 2566744320  "Source: isobus.net VDMA Data Dictionary (https://www.isobus.net/isobus/pGNAndSPN/14769?type=PGN)";
CM_ BO_ 2566744576  "Source: isobus.net VDMA Data Dictionary (https://www.isobus.net/isobus/pGNAndSPN/14772?type=PGN)";
CM_ BO_ 2566744832  "Source: isobus.net VDMA Data Dictionary (https://www.isobus.net/isobus/pGNAndSPN/14788?type=PGN)";
CM_ BO_ 2566745088  "Source: isobus.net VDMA Data Dictionary (https://www.isobus.net/isobus/pGNAndSPN/14792?type=PGN)";
CM_ BO_ 2566745344  "Source: isobus.net VDMA Data Dictionary (https://www.isobus.net/isobus/pGNAndSPN/14796?type=PGN)";
CM_ BO_ 2566745600  "Source: isobus.net VDMA Data Dictionary (https://www.isobus.net/isobus/pGNAndSPN/14801?type=PGN)";
CM_ BO_ 2566745856  "Source: isobus.net VDMA Data Dictionary (https://www.isobus.net/isobus/pGNAndSPN/14806?type=PGN)";
CM_ BO_ 2566746112  "Source: isobus.net VDMA Data Dictionary (https://www.isobus.net/isobus/pGNAndSPN/14821?type=PGN)";
CM_ BO_ 2566746368  "Source: isobus.net VDMA Data Dictionary (https://www.isobus.net/isobus/pGNAndSPN/14841?type=PGN)";
CM_ BO_ 2566746624  "Source: isobus.net VDMA Data Dictionary (https://www.isobus.net/isobus/pGNAndSPN/14845?type=PGN)";
CM_ BO_ 2566746880  "Source: isobus.net VDMA Data Dictionary (https://www.isobus.net/isobus/pGNAndSPN/14849?type=PGN)";
CM_ BO_ 2566747136  "Source: isobus.net VDMA Data Dictionary (https://www.isobus.net/isobus/pGNAndSPN/14853?type=PGN)";
CM_ BO_ 2566747392  "Source: isobus.net VDMA Data Dictionary (https://www.isobus.net/isobus/pGNAndSPN/14857?type=PGN)";
CM_ BO_ 2566747648  "Source: isobus.net VDMA Data Dictionary (https://www.isobus.net/isobus/pGNAndSPN/14861?type=PGN)";
CM_ BO_ 2566747904  "Source: isobus.net VDMA Data Dictionary (https://www.isobus.net/isobus/pGNAndSPN/14865?type=PGN)";
CM_ BO_ 2566748160  "Source: isobus.net VDMA Data Dictionary (https://www.isobus.net/isobus/pGNAndSPN/14873?type=PGN)";
CM_ BO_ 2566748416  "Source: isobus.net VDMA Data Dictionary (https://www.isobus.net/isobus/pGNAndSPN/14881?type=PGN)";
CM_ BO_ 2566748672  "Source: isobus.net VDMA Data Dictionary (https://www.isobus.net/isobus/pGNAndSPN/14885?type=PGN)";
CM_ BO_ 2566748928  "Source: isobus.net VDMA Data Dictionary (https://www.isobus.net/isobus/pGNAndSPN/14889?type=PGN)";
CM_ BO_ 2566749696  "Source: isobus.net VDMA Data Dictionary (https://www.isobus.net/isobus/pGNAndSPN/14922?type=PGN)";
CM_ BO_ 2566749952  "Source: isobus.net VDMA Data Dictionary (https://www.isobus.net/isobus/pGNAndSPN/14926?type=PGN)";
CM_ BO_ 2566750208  "Source: isobus.net VDMA Data Dictionary (https://www.isobus.net/isobus/pGNAndSPN/14938?type=PGN)";
CM_ BO_ 2566750464  "Source: isobus.net VDMA Data Dictionary (https://www.isobus.net/isobus/pGNAndSPN/14939?type=PGN)";
CM_ BO_ 2566750720  "Source: isobus.net VDMA Data Dictionary (https://www.isobus.net/isobus/pGNAndSPN/14951?type=PGN)";
CM_ BO_ 2566750976  "Source: isobus.net VDMA Data Dictionary (https://www.isobus.net/isobus/pGNAndSPN/14956?type=PGN)";
CM_ BO_ 2566751232  "Source: isobus.net VDMA Data Dictionary (https://www.isobus.net/isobus/pGNAndSPN/14960?type=PGN)";
CM_ BO_ 2566751488  "Source: isobus.net VDMA Data Dictionary (https://www.isobus.net/isobus/pGNAndSPN/14964?type=PGN)";
CM_ BO_ 2566751744  "Source: isobus.net VDMA Data Dictionary (https://www.isobus.net/isobus/pGNAndSPN/14968?type=PGN)";
CM_ BO_ 2566752000  "Source: isobus.net VDMA Data Dictionary (https://www.isobus.net/isobus/pGNAndSPN/14972?type=PGN)";
CM_ BO_ 2566752256  "Source: isobus.net VDMA Data Dictionary (https://www.isobus.net/isobus/pGNAndSPN/14976?type=PGN)";
CM_ BO_ 2566752512  "Source: isobus.net VDMA Data Dictionary (https://www.isobus.net/isobus/pGNAndSPN/14977?type=PGN)";
CM_ BO_ 2566752768  "Source: isobus.net VDMA Data Dictionary (https://www.isobus.net/isobus/pGNAndSPN/14981?type=PGN)";
CM_ BO_ 2566753024  "Source: isobus.net VDMA Data Dictionary (https://www.isobus.net/isobus/pGNAndSPN/14983?type=PGN)";
CM_ BO_ 2566753280  "Source: isobus.net VDMA Data Dictionary (https://www.isobus.net/isobus/pGNAndSPN/14985?type=PGN)";
CM_ BO_ 2566753536  "Source: isobus.net VDMA Data Dictionary (https://www.isobus.net/isobus/pGNAndSPN/14987?type=PGN)";
CM_ BO_ 2566753792  "Source: isobus.net VDMA Data Dictionary (https://www.isobus.net/isobus/pGNAndSPN/14989?type=PGN)";
CM_ BO_ 2566754048  "Source: isobus.net VDMA Data Dictionary (https://www.isobus.net/isobus/pGNAndSPN/14992?type=PGN)";
CM_ BO_ 2566754304  "Source: isobus.net VDMA Data Dictionary (https://www.isobus.net/isobus/pGNAndSPN/14996?type=PGN)";
CM_ BO_ 2566754560  "Source: isobus.net VDMA Data Dictionary (https://www.isobus.net/isobus/pGNAndSPN/15007?type=PGN)";
CM_ BO_ 2566754816  "Source: isobus.net VDMA Data Dictionary (https://www.isobus.net/isobus/pGNAndSPN/15025?type=PGN)";
CM_ BO_ 2566755072  "Source: isobus.net VDMA Data Dictionary (https://www.isobus.net/isobus/pGNAndSPN/15033?type=PGN)";
CM_ BO_ 2566755328  "Source: isobus.net VDMA Data Dictionary (https://www.isobus.net/isobus/pGNAndSPN/15037?type=PGN)";
CM_ BO_ 2566755584  "Source: isobus.net VDMA Data Dictionary (https://www.isobus.net/isobus/pGNAndSPN/15047?type=PGN)";
CM_ BO_ 2566755840  "Source: isobus.net VDMA Data Dictionary (https://www.isobus.net/isobus/pGNAndSPN/15049?type=PGN)";
CM_ BO_ 2566756096  "Source: isobus.net VDMA Data Dictionary (https://www.isobus.net/isobus/pGNAndSPN/15051?type=PGN)";
CM_ BO_ 2566756352  "Source: isobus.net VDMA Data Dictionary (https://www.isobus.net/isobus/pGNAndSPN/15062?type=PGN)";
CM_ BO_ 2566756608  "Source: isobus.net VDMA Data Dictionary (https://www.isobus.net/isobus/pGNAndSPN/15073?type=PGN)";
CM_ BO_ 2566756864  "Source: isobus.net VDMA Data Dictionary (https://www.isobus.net/isobus/pGNAndSPN/15074?type=PGN)";
CM_ BO_ 2566757120  "Source: isobus.net VDMA Data Dictionary (https://www.isobus.net/isobus/pGNAndSPN/15081?type=PGN)";
CM_ BO_ 2566757376  "Source: isobus.net VDMA Data Dictionary (https://www.isobus.net/isobus/pGNAndSPN/15085?type=PGN)";
CM_ BO_ 2566757632  "Source: isobus.net VDMA Data Dictionary (https://www.isobus.net/isobus/pGNAndSPN/15089?type=PGN)";
CM_ BO_ 2566757888  "Source: isobus.net VDMA Data Dictionary (https://www.isobus.net/isobus/pGNAndSPN/15097?type=PGN)";
CM_ BO_ 2566758144  "Source: isobus.net VDMA Data Dictionary (https://www.isobus.net/isobus/pGNAndSPN/15105?type=PGN)";
CM_ BO_ 2566758400  "Source: isobus.net VDMA Data Dictionary (https://www.isobus.net/isobus/pGNAndSPN/15113?type=PGN)";
CM_ BO_ 2566758656  "Source: isobus.net VDMA Data Dictionary (https://www.isobus.net/isobus/pGNAndSPN/15121?type=PGN)";
CM_ BO_ 2566758912  "Source: isobus.net VDMA Data Dictionary (https://www.isobus.net/isobus/pGNAndSPN/15125?type=PGN)";
CM_ BO_ 2566759168  "Source: isobus.net VDMA Data Dictionary (https://www.isobus.net/isobus/pGNAndSPN/15132?type=PGN)";
CM_ BO_ 2566759424  "Source: isobus.net VDMA Data Dictionary (https://www.isobus.net/isobus/pGNAndSPN/15160?type=PGN)";
CM_ BO_ 2566759680  "Source: isobus.net VDMA Data Dictionary (https://www.isobus.net/isobus/pGNAndSPN/15190?type=PGN)";
CM_ BO_ 2566759936  "Source: isobus.net VDMA Data Dictionary (https://www.isobus.net/isobus/pGNAndSPN/15193?type=PGN)";
CM_ BO_ 2566760192  "Source: isobus.net VDMA Data Dictionary (https://www.isobus.net/isobus/pGNAndSPN/15198?type=PGN)";
CM_ BO_ 2566760448  "Source: isobus.net VDMA Data Dictionary (https://www.isobus.net/isobus/pGNAndSPN/15203?type=PGN)";
CM_ BO_ 2566760704  "Source: isobus.net VDMA Data Dictionary (https://www.isobus.net/isobus/pGNAndSPN/15208?type=PGN)";
CM_ BO_ 2566760960  "Source: isobus.net VDMA Data Dictionary (https://www.isobus.net/isobus/pGNAndSPN/15215?type=PGN)";
CM_ BO_ 2566761216  "Source: isobus.net VDMA Data Dictionary (https://www.isobus.net/isobus/pGNAndSPN/15216?type=PGN)";
CM_ BO_ 2566761472  "Source: isobus.net VDMA Data Dictionary (https://www.isobus.net/isobus/pGNAndSPN/15218?type=PGN)";
CM_ BO_ 2566761728  "Source: isobus.net VDMA Data Dictionary (https://www.isobus.net/isobus/pGNAndSPN/15220?type=PGN)";
CM_ BO_ 2566761984  "Source: isobus.net VDMA Data Dictionary (https://www.isobus.net/isobus/pGNAndSPN/15225?type=PGN)";
CM_ BO_ 2566762240  "Source: isobus.net VDMA Data Dictionary (https://www.isobus.net/isobus/pGNAndSPN/15231?type=PGN)";
CM_ BO_ 2566762496  "Source: isobus.net VDMA Data Dictionary (https://www.isobus.net/isobus/pGNAndSPN/15236?type=PGN)";
CM_ BO_ 2566762752  "Source: isobus.net VDMA Data Dictionary (https://www.isobus.net/isobus/pGNAndSPN/15241?type=PGN)";
CM_ BO_ 2566763008  "Source: isobus.net VDMA Data Dictionary (https://www.isobus.net/isobus/pGNAndSPN/15247?type=PGN)";
CM_ BO_ 2566763264  "Source: isobus.net VDMA Data Dictionary (https://www.isobus.net/isobus/pGNAndSPN/15252?type=PGN)";
CM_ BO_ 2566763520  "Source: isobus.net VDMA Data Dictionary (https://www.isobus.net/isobus/pGNAndSPN/15257?type=PGN)";
CM_ BO_ 2566763776  "Source: isobus.net VDMA Data Dictionary (https://www.isobus.net/isobus/pGNAndSPN/15269?type=PGN)";
CM_ BO_ 2566764032  "Source: isobus.net VDMA Data Dictionary (https://www.isobus.net/isobus/pGNAndSPN/15275?type=PGN)";
CM_ BO_ 2566764288  "Source: isobus.net VDMA Data Dictionary (https://www.isobus.net/isobus/pGNAndSPN/15281?type=PGN)";
CM_ BO_ 2566764544  "Source: isobus.net VDMA Data Dictionary (https://www.isobus.net/isobus/pGNAndSPN/15286?type=PGN)";
CM_ BO_ 2566764800  "Source: isobus.net VDMA Data Dictionary (https://www.isobus.net/isobus/pGNAndSPN/15288?type=PGN)";
CM_ BO_ 2566765056  "Source: isobus.net VDMA Data Dictionary (https://www.isobus.net/isobus/pGNAndSPN/15290?type=PGN)";
CM_ BO_ 2566765312  "Source: isobus.net VDMA Data Dictionary (https://www.isobus.net/isobus/pGNAndSPN/15301?type=PGN)";
CM_ BO_ 2566765568  "Source: isobus.net VDMA Data Dictionary (https://www.isobus.net/isobus/pGNAndSPN/15311?type=PGN)";
CM_ BO_ 2566765824  "Source: isobus.net VDMA Data Dictionary (https://www.isobus.net/isobus/pGNAndSPN/15318?type=PGN)";
CM_ BO_ 2566766080  "Source: isobus.net VDMA Data Dictionary (https://www.isobus.net/isobus/pGNAndSPN/15325?type=PGN)";
CM_ BO_ 2566766336  "Source: isobus.net VDMA Data Dictionary (https://www.isobus.net/isobus/pGNAndSPN/15327?type=PGN)";
CM_ BO_ 2566766592  "Source: isobus.net VDMA Data Dictionary (https://www.isobus.net/isobus/pGNAndSPN/15332?type=PGN)";
CM_ BO_ 2566766848  "Source: isobus.net VDMA Data Dictionary (https://www.isobus.net/isobus/pGNAndSPN/15337?type=PGN)";
CM_ BO_ 2566767104  "Source: isobus.net VDMA Data Dictionary (https://www.isobus.net/isobus/pGNAndSPN/15342?type=PGN)";
CM_ BO_ 2566767360  "Source: isobus.net VDMA Data Dictionary (https://www.isobus.net/isobus/pGNAndSPN/15347?type=PGN)";
CM_ BO_ 2566767616  "Source: isobus.net VDMA Data Dictionary (https://www.isobus.net/isobus/pGNAndSPN/15360?type=PGN)";
CM_ BO_ 2566768128  "Source: isobus.net VDMA Data Dictionary (https://www.isobus.net/isobus/pGNAndSPN/15373?type=PGN)";
CM_ BO_ 2566768384  "Source: isobus.net VDMA Data Dictionary (https://www.isobus.net/isobus/pGNAndSPN/15383?type=PGN)";
CM_ BO_ 2566768640  "Source: isobus.net VDMA Data Dictionary (https://www.isobus.net/isobus/pGNAndSPN/15384?type=PGN)";
CM_ BO_ 2566768896  "Source: isobus.net VDMA Data Dictionary (https://www.isobus.net/isobus/pGNAndSPN/15385?type=PGN)";
CM_ BO_ 2566769152  "Source: isobus.net VDMA Data Dictionary (https://www.isobus.net/isobus/pGNAndSPN/15386?type=PGN)";
CM_ BO_ 2566769408  "Source: isobus.net VDMA Data Dictionary (https://www.isobus.net/isobus/pGNAndSPN/15396?type=PGN)";
CM_ SG_ 2566683904 Heating_And_Refrigerating_Unit_2 "Generic 8-byte raw payload. Detail page: https://www.isobus.net/isobus/pGNAndSPN/13013?type=PGN. Signal-level enrichment via PR welcome  see CONTRIBUTING.md.";
CM_ SG_ 2566684160 Heating_And_Refrigerating_Unit_3 "Generic 8-byte raw payload. Detail page: https://www.isobus.net/isobus/pGNAndSPN/13014?type=PGN. Signal-level enrichment via PR welcome  see CONTRIBUTING.md.";
CM_ SG_ 2566684416 Heating_And_Refrigerating_Unit_4 "Generic 8-byte raw payload. Detail page: https://www.isobus.net/isobus/pGNAndSPN/13015?type=PGN. Signal-level enrichment via PR welcome  see CONTRIBUTING.md.";
CM_ SG_ 2566684672 HRU_Temperature_Setpoint_RawPayl "Generic 8-byte raw payload. Detail page: https://www.isobus.net/isobus/pGNAndSPN/13016?type=PGN. Signal-level enrichment via PR welcome  see CONTRIBUTING.md.";
CM_ SG_ 2566684928 Lifting_Unit_1_RawPayload "Generic 8-byte raw payload. Detail page: https://www.isobus.net/isobus/pGNAndSPN/13017?type=PGN. Signal-level enrichment via PR welcome  see CONTRIBUTING.md.";
CM_ SG_ 2566685184 Tail_Lift_Unit_1_RawPayload "Generic 8-byte raw payload. Detail page: https://www.isobus.net/isobus/pGNAndSPN/13018?type=PGN. Signal-level enrichment via PR welcome  see CONTRIBUTING.md.";
CM_ SG_ 2566685440 Vehicle_Status_RawPayload "Generic 8-byte raw payload. Detail page: https://www.isobus.net/isobus/pGNAndSPN/13019?type=PGN. Signal-level enrichment via PR welcome  see CONTRIBUTING.md.";
CM_ SG_ 2566685696 Windshield_Wiper_Request_RawPayl "Generic 8-byte raw payload. Detail page: https://www.isobus.net/isobus/pGNAndSPN/13020?type=PGN. Signal-level enrichment via PR welcome  see CONTRIBUTING.md.";
CM_ SG_ 2566685952 Fuel_Cell_Auxiliary_Heater_Contr "Generic 8-byte raw payload. Detail page: https://www.isobus.net/isobus/pGNAndSPN/13023?type=PGN. Signal-level enrichment via PR welcome  see CONTRIBUTING.md.";
CM_ SG_ 2566686208 Fuel_Cell_Auxiliary_Heater_Infor "Generic 8-byte raw payload. Detail page: https://www.isobus.net/isobus/pGNAndSPN/13028?type=PGN. Signal-level enrichment via PR welcome  see CONTRIBUTING.md.";
CM_ SG_ 2566686464 Fuel_Cell_Coolant_Pump_1_Command "Generic 8-byte raw payload. Detail page: https://www.isobus.net/isobus/pGNAndSPN/13031?type=PGN. Signal-level enrichment via PR welcome  see CONTRIBUTING.md.";
CM_ SG_ 2566686720 Fuel_Cell_Coolant_Pump_2_Command "Generic 8-byte raw payload. Detail page: https://www.isobus.net/isobus/pGNAndSPN/13034?type=PGN. Signal-level enrichment via PR welcome  see CONTRIBUTING.md.";
CM_ SG_ 2566686976 Fuel_Cell_Coolant_Pump_1_Status_ "Generic 8-byte raw payload. Detail page: https://www.isobus.net/isobus/pGNAndSPN/13038?type=PGN. Signal-level enrichment via PR welcome  see CONTRIBUTING.md.";
CM_ SG_ 2566687232 Fuel_Cell_Coolant_Pump_2_Status_ "Generic 8-byte raw payload. Detail page: https://www.isobus.net/isobus/pGNAndSPN/13042?type=PGN. Signal-level enrichment via PR welcome  see CONTRIBUTING.md.";
CM_ SG_ 2566687488 Aftertreatment_1_Particulate_Sen "Generic 8-byte raw payload. Detail page: https://www.isobus.net/isobus/pGNAndSPN/13048?type=PGN. Signal-level enrichment via PR welcome  see CONTRIBUTING.md.";
CM_ SG_ 2566687744 Aftertreatment_1_Particulate_Sen "Generic 8-byte raw payload. Detail page: https://www.isobus.net/isobus/pGNAndSPN/13054?type=PGN. Signal-level enrichment via PR welcome  see CONTRIBUTING.md.";
CM_ SG_ 2566688512 Alternate_Fuel_3_RawPayload "Generic 8-byte raw payload. Detail page: https://www.isobus.net/isobus/pGNAndSPN/13067?type=PGN. Signal-level enrichment via PR welcome  see CONTRIBUTING.md.";
CM_ SG_ 2566688768 Engine_Fuel_Injector_Metering_Ra "Generic 8-byte raw payload. Detail page: https://www.isobus.net/isobus/pGNAndSPN/13071?type=PGN. Signal-level enrichment via PR welcome  see CONTRIBUTING.md.";
CM_ SG_ 2566689024 Engine_Exhaust_NOx_RawPayload "Generic 8-byte raw payload. Detail page: https://www.isobus.net/isobus/pGNAndSPN/13074?type=PGN. Signal-level enrichment via PR welcome  see CONTRIBUTING.md.";
CM_ SG_ 2566689280 Air_Fuel_Ratio_1_RawPayload "Generic 8-byte raw payload. Detail page: https://www.isobus.net/isobus/pGNAndSPN/13078?type=PGN. Signal-level enrichment via PR welcome  see CONTRIBUTING.md.";
CM_ SG_ 2566689536 Gaseous_Fuel_Pressure_2_RawPaylo "Generic 8-byte raw payload. Detail page: https://www.isobus.net/isobus/pGNAndSPN/13082?type=PGN. Signal-level enrichment via PR welcome  see CONTRIBUTING.md.";
CM_ SG_ 2566689792 Aftertreatment_System_Abuse_Info "Generic 8-byte raw payload. Detail page: https://www.isobus.net/isobus/pGNAndSPN/13089?type=PGN. Signal-level enrichment via PR welcome  see CONTRIBUTING.md.";
CM_ SG_ 2566690048 Engine_Cylinder_Pressure_Monitor "Generic 8-byte raw payload. Detail page: https://www.isobus.net/isobus/pGNAndSPN/13091?type=PGN. Signal-level enrichment via PR welcome  see CONTRIBUTING.md.";
CM_ SG_ 2566690304 Engine_Information_2_RawPayload "Generic 8-byte raw payload. Detail page: https://www.isobus.net/isobus/pGNAndSPN/13096?type=PGN. Signal-level enrichment via PR welcome  see CONTRIBUTING.md.";
CM_ SG_ 2566690560 Electronic_Steering_Control_2_Ra "Generic 8-byte raw payload. Detail page: https://www.isobus.net/isobus/pGNAndSPN/13108?type=PGN. Signal-level enrichment via PR welcome  see CONTRIBUTING.md.";
CM_ SG_ 2566690816 Vehicle_Speed_Limiter_RawPayload "Generic 8-byte raw payload. Detail page: https://www.isobus.net/isobus/pGNAndSPN/13113?type=PGN. Signal-level enrichment via PR welcome  see CONTRIBUTING.md.";
CM_ SG_ 2566691072 Assembly_Unit_Identification_Raw "Generic 8-byte raw payload. Detail page: https://www.isobus.net/isobus/pGNAndSPN/13115?type=PGN. Signal-level enrichment via PR welcome  see CONTRIBUTING.md.";
CM_ SG_ 2566691328 Joystick_3_Lamp_Status_RawPayloa "Generic 8-byte raw payload. Detail page: https://www.isobus.net/isobus/pGNAndSPN/13125?type=PGN. Signal-level enrichment via PR welcome  see CONTRIBUTING.md.";
CM_ SG_ 2566691584 Joystick_2_Lamp_Status_RawPayloa "Generic 8-byte raw payload. Detail page: https://www.isobus.net/isobus/pGNAndSPN/13135?type=PGN. Signal-level enrichment via PR welcome  see CONTRIBUTING.md.";
CM_ SG_ 2566691840 Joystick_1_Lamp_Status_RawPayloa "Generic 8-byte raw payload. Detail page: https://www.isobus.net/isobus/pGNAndSPN/13145?type=PGN. Signal-level enrichment via PR welcome  see CONTRIBUTING.md.";
CM_ SG_ 2566692096 Engine_Timing_Actuator_Position_ "Generic 8-byte raw payload. Detail page: https://www.isobus.net/isobus/pGNAndSPN/13147?type=PGN. Signal-level enrichment via PR welcome  see CONTRIBUTING.md.";
CM_ SG_ 2566692352 Engine_Timing_Actuator_Position_ "Generic 8-byte raw payload. Detail page: https://www.isobus.net/isobus/pGNAndSPN/13151?type=PGN. Signal-level enrichment via PR welcome  see CONTRIBUTING.md.";
CM_ SG_ 2566692608 Dash_Display_2_RawPayload "Generic 8-byte raw payload. Detail page: https://www.isobus.net/isobus/pGNAndSPN/13158?type=PGN. Signal-level enrichment via PR welcome  see CONTRIBUTING.md.";
CM_ SG_ 2566692864 Multi_fuel_Engine_Hours_RawPaylo "Generic 8-byte raw payload. Detail page: https://www.isobus.net/isobus/pGNAndSPN/13160?type=PGN. Signal-level enrichment via PR welcome  see CONTRIBUTING.md.";
CM_ SG_ 2566693120 Engine_Spark_Misfire_Rate_3_RawP "Generic 8-byte raw payload. Detail page: https://www.isobus.net/isobus/pGNAndSPN/13168?type=PGN. Signal-level enrichment via PR welcome  see CONTRIBUTING.md.";
CM_ SG_ 2566693376 Engine_Spark_Misfire_Rate_2_RawP "Generic 8-byte raw payload. Detail page: https://www.isobus.net/isobus/pGNAndSPN/13176?type=PGN. Signal-level enrichment via PR welcome  see CONTRIBUTING.md.";
CM_ SG_ 2566693632 Engine_Spark_Misfire_Rate_1_RawP "Generic 8-byte raw payload. Detail page: https://www.isobus.net/isobus/pGNAndSPN/13184?type=PGN. Signal-level enrichment via PR welcome  see CONTRIBUTING.md.";
CM_ SG_ 2566693888 Engine_Spark_Maximum_Voltage_6_R "Generic 8-byte raw payload. Detail page: https://www.isobus.net/isobus/pGNAndSPN/13188?type=PGN. Signal-level enrichment via PR welcome  see CONTRIBUTING.md.";
CM_ SG_ 2566694144 Engine_Spark_Maximum_Voltage_5_R "Generic 8-byte raw payload. Detail page: https://www.isobus.net/isobus/pGNAndSPN/13192?type=PGN. Signal-level enrichment via PR welcome  see CONTRIBUTING.md.";
CM_ SG_ 2566694400 Engine_Spark_Maximum_Voltage_4_R "Generic 8-byte raw payload. Detail page: https://www.isobus.net/isobus/pGNAndSPN/13196?type=PGN. Signal-level enrichment via PR welcome  see CONTRIBUTING.md.";
CM_ SG_ 2566694656 Engine_Spark_Maximum_Voltage_3_R "Generic 8-byte raw payload. Detail page: https://www.isobus.net/isobus/pGNAndSPN/13200?type=PGN. Signal-level enrichment via PR welcome  see CONTRIBUTING.md.";
CM_ SG_ 2566694912 Engine_Spark_Maximum_Voltage_2_R "Generic 8-byte raw payload. Detail page: https://www.isobus.net/isobus/pGNAndSPN/13204?type=PGN. Signal-level enrichment via PR welcome  see CONTRIBUTING.md.";
CM_ SG_ 2566695168 Engine_Spark_Maximum_Voltage_1_R "Generic 8-byte raw payload. Detail page: https://www.isobus.net/isobus/pGNAndSPN/13208?type=PGN. Signal-level enrichment via PR welcome  see CONTRIBUTING.md.";
CM_ SG_ 2566695424 Engine_Spark_Minimum_Voltage_6_R "Generic 8-byte raw payload. Detail page: https://www.isobus.net/isobus/pGNAndSPN/13212?type=PGN. Signal-level enrichment via PR welcome  see CONTRIBUTING.md.";
CM_ SG_ 2566695680 Engine_Spark_Minimum_Voltage_5_R "Generic 8-byte raw payload. Detail page: https://www.isobus.net/isobus/pGNAndSPN/13216?type=PGN. Signal-level enrichment via PR welcome  see CONTRIBUTING.md.";
CM_ SG_ 2566695936 Engine_Spark_Minimum_Voltage_4_R "Generic 8-byte raw payload. Detail page: https://www.isobus.net/isobus/pGNAndSPN/13220?type=PGN. Signal-level enrichment via PR welcome  see CONTRIBUTING.md.";
CM_ SG_ 2566696192 Engine_Spark_Minimum_Voltage_3_R "Generic 8-byte raw payload. Detail page: https://www.isobus.net/isobus/pGNAndSPN/13224?type=PGN. Signal-level enrichment via PR welcome  see CONTRIBUTING.md.";
CM_ SG_ 2566696448 Engine_Spark_Minimum_Voltage_2_R "Generic 8-byte raw payload. Detail page: https://www.isobus.net/isobus/pGNAndSPN/13228?type=PGN. Signal-level enrichment via PR welcome  see CONTRIBUTING.md.";
CM_ SG_ 2566696704 Engine_Spark_Minimum_Voltage_1_R "Generic 8-byte raw payload. Detail page: https://www.isobus.net/isobus/pGNAndSPN/13232?type=PGN. Signal-level enrichment via PR welcome  see CONTRIBUTING.md.";
CM_ SG_ 2566696960 Engine_Ignition_Controller_Maint "Generic 8-byte raw payload. Detail page: https://www.isobus.net/isobus/pGNAndSPN/13234?type=PGN. Signal-level enrichment via PR welcome  see CONTRIBUTING.md.";
CM_ SG_ 2566697216 Engine_Ignition_Control_Module_S "Generic 8-byte raw payload. Detail page: https://www.isobus.net/isobus/pGNAndSPN/13238?type=PGN. Signal-level enrichment via PR welcome  see CONTRIBUTING.md.";
CM_ SG_ 2566697728 Fused_Power_Output_Current_RawPa "Generic 8-byte raw payload. Detail page: https://www.isobus.net/isobus/pGNAndSPN/13302?type=PGN. Signal-level enrichment via PR welcome  see CONTRIBUTING.md.";
CM_ SG_ 2566697984 Switched_Power_Output_Status_Raw "Generic 8-byte raw payload. Detail page: https://www.isobus.net/isobus/pGNAndSPN/13334?type=PGN. Signal-level enrichment via PR welcome  see CONTRIBUTING.md.";
CM_ SG_ 2566698240 Fused_Power_Output_Status_RawPay "Generic 8-byte raw payload. Detail page: https://www.isobus.net/isobus/pGNAndSPN/13366?type=PGN. Signal-level enrichment via PR welcome  see CONTRIBUTING.md.";
CM_ SG_ 2566698496 Vehicle_Electrical_Power_5_RawPa "Generic 8-byte raw payload. Detail page: https://www.isobus.net/isobus/pGNAndSPN/13370?type=PGN. Signal-level enrichment via PR welcome  see CONTRIBUTING.md.";
CM_ SG_ 2566698752 Hybrid_or_EV_System_Status_2_Raw "Generic 8-byte raw payload. Detail page: https://www.isobus.net/isobus/pGNAndSPN/13376?type=PGN. Signal-level enrichment via PR welcome  see CONTRIBUTING.md.";
CM_ SG_ 2566699008 Aftertreatment_2_Service_2_RawPa "Generic 8-byte raw payload. Detail page: https://www.isobus.net/isobus/pGNAndSPN/13378?type=PGN. Signal-level enrichment via PR welcome  see CONTRIBUTING.md.";
CM_ SG_ 2566699264 Aftertreatment_1_Service_2_RawPa "Generic 8-byte raw payload. Detail page: https://www.isobus.net/isobus/pGNAndSPN/13380?type=PGN. Signal-level enrichment via PR welcome  see CONTRIBUTING.md.";
CM_ SG_ 2566699520 Aftertreatment_2_SCR_Electronic_ "Generic 8-byte raw payload. Detail page: https://www.isobus.net/isobus/pGNAndSPN/13387?type=PGN. Signal-level enrichment via PR welcome  see CONTRIBUTING.md.";
CM_ SG_ 2566699776 Aftertreatment_1_SCR_Electronic_ "Generic 8-byte raw payload. Detail page: https://www.isobus.net/isobus/pGNAndSPN/13394?type=PGN. Signal-level enrichment via PR welcome  see CONTRIBUTING.md.";
CM_ SG_ 2566700032 Aftertreatment_2_SCR_Service_Inf "Generic 8-byte raw payload. Detail page: https://www.isobus.net/isobus/pGNAndSPN/13395?type=PGN. Signal-level enrichment via PR welcome  see CONTRIBUTING.md.";
CM_ SG_ 2566700288 Aftertreatment_1_SCR_Service_Inf "Generic 8-byte raw payload. Detail page: https://www.isobus.net/isobus/pGNAndSPN/13397?type=PGN. Signal-level enrichment via PR welcome  see CONTRIBUTING.md.";
CM_ SG_ 2566700544 Electronic_Transmission_Controll "Generic 8-byte raw payload. Detail page: https://www.isobus.net/isobus/pGNAndSPN/13401?type=PGN. Signal-level enrichment via PR welcome  see CONTRIBUTING.md.";
CM_ SG_ 2566700800 Electronic_Transmission_Controll "Generic 8-byte raw payload. Detail page: https://www.isobus.net/isobus/pGNAndSPN/13415?type=PGN. Signal-level enrichment via PR welcome  see CONTRIBUTING.md.";
CM_ SG_ 2566701056 Electronic_Transmission_Controll "Generic 8-byte raw payload. Detail page: https://www.isobus.net/isobus/pGNAndSPN/13421?type=PGN. Signal-level enrichment via PR welcome  see CONTRIBUTING.md.";
CM_ SG_ 2566701312 Transmission_Fluids_3_RawPayload "Generic 8-byte raw payload. Detail page: https://www.isobus.net/isobus/pGNAndSPN/13425?type=PGN. Signal-level enrichment via PR welcome  see CONTRIBUTING.md.";
CM_ SG_ 2566701568 Hybrid_or_EV_System_Status_1_Raw "Generic 8-byte raw payload. Detail page: https://www.isobus.net/isobus/pGNAndSPN/13446?type=PGN. Signal-level enrichment via PR welcome  see CONTRIBUTING.md.";
CM_ SG_ 2566701824 Fuel_Information_4_Gaseous_RawPa "Generic 8-byte raw payload. Detail page: https://www.isobus.net/isobus/pGNAndSPN/13448?type=PGN. Signal-level enrichment via PR welcome  see CONTRIBUTING.md.";
CM_ SG_ 2566702080 Aftertreatment_2_SCR_Exhaust_Gas "Generic 8-byte raw payload. Detail page: https://www.isobus.net/isobus/pGNAndSPN/13450?type=PGN. Signal-level enrichment via PR welcome  see CONTRIBUTING.md.";
CM_ SG_ 2566702336 Aftertreatment_1_SCR_Exhaust_Gas "Generic 8-byte raw payload. Detail page: https://www.isobus.net/isobus/pGNAndSPN/13452?type=PGN. Signal-level enrichment via PR welcome  see CONTRIBUTING.md.";
CM_ SG_ 2566702592 OBD_Information_RawPayload "Generic 8-byte raw payload. Detail page: https://www.isobus.net/isobus/pGNAndSPN/13453?type=PGN. Signal-level enrichment via PR welcome  see CONTRIBUTING.md.";
CM_ SG_ 2566702848 Model_Year_and_Certification_Eng "Generic 8-byte raw payload. Detail page: https://www.isobus.net/isobus/pGNAndSPN/13455?type=PGN. Signal-level enrichment via PR welcome  see CONTRIBUTING.md.";
CM_ SG_ 2566703104 Electronic_Engine_Controller_13_ "Generic 8-byte raw payload. Detail page: https://www.isobus.net/isobus/pGNAndSPN/13468?type=PGN. Signal-level enrichment via PR welcome  see CONTRIBUTING.md.";
CM_ SG_ 2566703360 Engine_Fuel_Throttle_Valve_Infor "Generic 8-byte raw payload. Detail page: https://www.isobus.net/isobus/pGNAndSPN/13475?type=PGN. Signal-level enrichment via PR welcome  see CONTRIBUTING.md.";
CM_ SG_ 2566703616 Engine_Exhaust_Gas_Recirculation "Generic 8-byte raw payload. Detail page: https://www.isobus.net/isobus/pGNAndSPN/13485?type=PGN. Signal-level enrichment via PR welcome  see CONTRIBUTING.md.";
CM_ SG_ 2566703872 Engine_Exhaust_Gas_Recirculation "Generic 8-byte raw payload. Detail page: https://www.isobus.net/isobus/pGNAndSPN/13495?type=PGN. Signal-level enrichment via PR welcome  see CONTRIBUTING.md.";
CM_ SG_ 2566704128 Electronic_Engine_Controller_12_ "Generic 8-byte raw payload. Detail page: https://www.isobus.net/isobus/pGNAndSPN/13501?type=PGN. Signal-level enrichment via PR welcome  see CONTRIBUTING.md.";
CM_ SG_ 2566704384 Drive_Strategy_Status_RawPayload "Generic 8-byte raw payload. Detail page: https://www.isobus.net/isobus/pGNAndSPN/13507?type=PGN. Signal-level enrichment via PR welcome  see CONTRIBUTING.md.";
CM_ SG_ 2566704640 Drive_Strategy_command_RawPayloa "Generic 8-byte raw payload. Detail page: https://www.isobus.net/isobus/pGNAndSPN/13512?type=PGN. Signal-level enrichment via PR welcome  see CONTRIBUTING.md.";
CM_ SG_ 2566704896 NOx_Sensor_Self_Diagnosis_Reques "Generic 8-byte raw payload. Detail page: https://www.isobus.net/isobus/pGNAndSPN/13516?type=PGN. Signal-level enrichment via PR welcome  see CONTRIBUTING.md.";
CM_ SG_ 2566705152 Engine_Particulate_Sensor_Inform "Generic 8-byte raw payload. Detail page: https://www.isobus.net/isobus/pGNAndSPN/13519?type=PGN. Signal-level enrichment via PR welcome  see CONTRIBUTING.md.";
CM_ SG_ 2566705408 Active_Service_Only_DTCs_RawPayl "Generic 8-byte raw payload. Detail page: https://www.isobus.net/isobus/pGNAndSPN/13531?type=PGN. Signal-level enrichment via PR welcome  see CONTRIBUTING.md.";
CM_ SG_ 2566705664 Previously_Active_Service_Only_D "Generic 8-byte raw payload. Detail page: https://www.isobus.net/isobus/pGNAndSPN/13543?type=PGN. Signal-level enrichment via PR welcome  see CONTRIBUTING.md.";
CM_ SG_ 2566705920 Diagnostic_Data_Clear_Reset_for_ "Generic 8-byte raw payload. Detail page: https://www.isobus.net/isobus/pGNAndSPN/13544?type=PGN. Signal-level enrichment via PR welcome  see CONTRIBUTING.md.";
CM_ SG_ 2566706176 XCP_Get_Slave_ID_RawPayload "Generic 8-byte raw payload. Detail page: https://www.isobus.net/isobus/pGNAndSPN/13545?type=PGN. Signal-level enrichment via PR welcome  see CONTRIBUTING.md.";
CM_ SG_ 2566706432 Aftertreatment_1_Diesel_Exhaust_ "Generic 8-byte raw payload. Detail page: https://www.isobus.net/isobus/pGNAndSPN/13552?type=PGN. Signal-level enrichment via PR welcome  see CONTRIBUTING.md.";
CM_ SG_ 2566706688 Aftertreatment_1_Diesel_Particul "Generic 8-byte raw payload. Detail page: https://www.isobus.net/isobus/pGNAndSPN/13556?type=PGN. Signal-level enrichment via PR welcome  see CONTRIBUTING.md.";
CM_ SG_ 2566706944 Aftertreatment_1_Diesel_Particul "Generic 8-byte raw payload. Detail page: https://www.isobus.net/isobus/pGNAndSPN/13560?type=PGN. Signal-level enrichment via PR welcome  see CONTRIBUTING.md.";
CM_ SG_ 2566707200 Aftertreatment_1_Diesel_Particul "Generic 8-byte raw payload. Detail page: https://www.isobus.net/isobus/pGNAndSPN/13564?type=PGN. Signal-level enrichment via PR welcome  see CONTRIBUTING.md.";
CM_ SG_ 2566707456 Aftertreatment_1_Diesel_Particul "Generic 8-byte raw payload. Detail page: https://www.isobus.net/isobus/pGNAndSPN/13568?type=PGN. Signal-level enrichment via PR welcome  see CONTRIBUTING.md.";
CM_ SG_ 2566707712 Aftertreatment_1_Diesel_Particul "Generic 8-byte raw payload. Detail page: https://www.isobus.net/isobus/pGNAndSPN/13572?type=PGN. Signal-level enrichment via PR welcome  see CONTRIBUTING.md.";
CM_ SG_ 2566707968 Aftertreatment_1_Diesel_Particul "Generic 8-byte raw payload. Detail page: https://www.isobus.net/isobus/pGNAndSPN/13576?type=PGN. Signal-level enrichment via PR welcome  see CONTRIBUTING.md.";
CM_ SG_ 2566708224 Cruise_Control_Vehicle_Speed_3_R "Generic 8-byte raw payload. Detail page: https://www.isobus.net/isobus/pGNAndSPN/13587?type=PGN. Signal-level enrichment via PR welcome  see CONTRIBUTING.md.";
CM_ SG_ 2566708480 Aftertreatment_2_Air_Control_3_R "Generic 8-byte raw payload. Detail page: https://www.isobus.net/isobus/pGNAndSPN/13588?type=PGN. Signal-level enrichment via PR welcome  see CONTRIBUTING.md.";
CM_ SG_ 2566708736 Aftertreatment_1_Air_Control_3_R "Generic 8-byte raw payload. Detail page: https://www.isobus.net/isobus/pGNAndSPN/13590?type=PGN. Signal-level enrichment via PR welcome  see CONTRIBUTING.md.";
CM_ SG_ 2566708992 Engine_Fluid_Level_Pressure_12_R "Generic 8-byte raw payload. Detail page: https://www.isobus.net/isobus/pGNAndSPN/13597?type=PGN. Signal-level enrichment via PR welcome  see CONTRIBUTING.md.";
CM_ SG_ 2566709248 Diesel_Particulate_Filter_Contro "Generic 8-byte raw payload. Detail page: https://www.isobus.net/isobus/pGNAndSPN/13601?type=PGN. Signal-level enrichment via PR welcome  see CONTRIBUTING.md.";
CM_ SG_ 2566709504 Fuel_Economy_2_Liquid_RawPayload "Generic 8-byte raw payload. Detail page: https://www.isobus.net/isobus/pGNAndSPN/13603?type=PGN. Signal-level enrichment via PR welcome  see CONTRIBUTING.md.";
CM_ SG_ 2566709760 Supplemental_Fan_Status_RawPaylo "Generic 8-byte raw payload. Detail page: https://www.isobus.net/isobus/pGNAndSPN/13612?type=PGN. Signal-level enrichment via PR welcome  see CONTRIBUTING.md.";
CM_ SG_ 2566710016 Engine_Exhaust_Brake_Control_Raw "Generic 8-byte raw payload. Detail page: https://www.isobus.net/isobus/pGNAndSPN/13617?type=PGN. Signal-level enrichment via PR welcome  see CONTRIBUTING.md.";
CM_ SG_ 2566710272 Engine_Fuel_Properties_RawPayloa "Generic 8-byte raw payload. Detail page: https://www.isobus.net/isobus/pGNAndSPN/13621?type=PGN. Signal-level enrichment via PR welcome  see CONTRIBUTING.md.";
CM_ SG_ 2566710528 Hydraulic_Oil_Properties_RawPayl "Generic 8-byte raw payload. Detail page: https://www.isobus.net/isobus/pGNAndSPN/13625?type=PGN. Signal-level enrichment via PR welcome  see CONTRIBUTING.md.";
CM_ SG_ 2566710784 Vehicle_Chassis_Lubrication_Syst "Generic 8-byte raw payload. Detail page: https://www.isobus.net/isobus/pGNAndSPN/13631?type=PGN. Signal-level enrichment via PR welcome  see CONTRIBUTING.md.";
CM_ SG_ 2566711040 Engine_Configuration_3_RawPayloa "Generic 8-byte raw payload. Detail page: https://www.isobus.net/isobus/pGNAndSPN/13638?type=PGN. Signal-level enrichment via PR welcome  see CONTRIBUTING.md.";
CM_ SG_ 2566711296 Intake_Valve_Actuation_Control_R "Generic 8-byte raw payload. Detail page: https://www.isobus.net/isobus/pGNAndSPN/13640?type=PGN. Signal-level enrichment via PR welcome  see CONTRIBUTING.md.";
CM_ SG_ 2566711552 Armrest_Switch_Matrix_Commands_R "Generic 8-byte raw payload. Detail page: https://www.isobus.net/isobus/pGNAndSPN/13644?type=PGN. Signal-level enrichment via PR welcome  see CONTRIBUTING.md.";
CM_ SG_ 2566711808 Vehicle_Electrical_Power_4_obsol "Generic 8-byte raw payload. Detail page: https://www.isobus.net/isobus/pGNAndSPN/13645?type=PGN. Signal-level enrichment via PR welcome  see CONTRIBUTING.md.";
CM_ SG_ 2566712064 Aftertreatment_2_NOx_Adsorber_In "Generic 8-byte raw payload. Detail page: https://www.isobus.net/isobus/pGNAndSPN/13647?type=PGN. Signal-level enrichment via PR welcome  see CONTRIBUTING.md.";
CM_ SG_ 2566712320 Aftertreatment_1_NOx_Adsorber_In "Generic 8-byte raw payload. Detail page: https://www.isobus.net/isobus/pGNAndSPN/13649?type=PGN. Signal-level enrichment via PR welcome  see CONTRIBUTING.md.";
CM_ SG_ 2566712576 Aftertreatment_2_Warm_Up_Diesel_ "Generic 8-byte raw payload. Detail page: https://www.isobus.net/isobus/pGNAndSPN/13651?type=PGN. Signal-level enrichment via PR welcome  see CONTRIBUTING.md.";
CM_ SG_ 2566712832 Land_Leveling_System_Reference_E "Generic 8-byte raw payload. Detail page: https://www.isobus.net/isobus/pGNAndSPN/13655?type=PGN. Signal-level enrichment via PR welcome  see CONTRIBUTING.md.";
CM_ SG_ 2566713088 Engine_Fluid_Level_Pressure_11_R "Generic 8-byte raw payload. Detail page: https://www.isobus.net/isobus/pGNAndSPN/13659?type=PGN. Signal-level enrichment via PR welcome  see CONTRIBUTING.md.";
CM_ SG_ 2566713344 Engine_Fuel_Lube_x000D_Systems_2 "Generic 8-byte raw payload. Detail page: https://www.isobus.net/isobus/pGNAndSPN/13664?type=PGN. Signal-level enrichment via PR welcome  see CONTRIBUTING.md.";
CM_ SG_ 2566713600 Engine_Turbocharger_Wastegate_Ac "Generic 8-byte raw payload. Detail page: https://www.isobus.net/isobus/pGNAndSPN/13676?type=PGN. Signal-level enrichment via PR welcome  see CONTRIBUTING.md.";
CM_ SG_ 2566713856 Engine_Fuel_Throttle_Valve_Infor "Generic 8-byte raw payload. Detail page: https://www.isobus.net/isobus/pGNAndSPN/13690?type=PGN. Signal-level enrichment via PR welcome  see CONTRIBUTING.md.";
CM_ SG_ 2566714112 Engine_Turbocharger_Compressor_B "Generic 8-byte raw payload. Detail page: https://www.isobus.net/isobus/pGNAndSPN/13698?type=PGN. Signal-level enrichment via PR welcome  see CONTRIBUTING.md.";
CM_ SG_ 2566714368 Charge_Air_Cooler_2_RawPayload "Generic 8-byte raw payload. Detail page: https://www.isobus.net/isobus/pGNAndSPN/13702?type=PGN. Signal-level enrichment via PR welcome  see CONTRIBUTING.md.";
CM_ SG_ 2566714624 Charge_Air_Cooler_2_Precooler_Ra "Generic 8-byte raw payload. Detail page: https://www.isobus.net/isobus/pGNAndSPN/13705?type=PGN. Signal-level enrichment via PR welcome  see CONTRIBUTING.md.";
CM_ SG_ 2566714880 Charge_Air_Cooler_1_RawPayload "Generic 8-byte raw payload. Detail page: https://www.isobus.net/isobus/pGNAndSPN/13709?type=PGN. Signal-level enrichment via PR welcome  see CONTRIBUTING.md.";
CM_ SG_ 2566715136 Charge_Air_Cooler_1_Precooler_Ra "Generic 8-byte raw payload. Detail page: https://www.isobus.net/isobus/pGNAndSPN/13712?type=PGN. Signal-level enrichment via PR welcome  see CONTRIBUTING.md.";
CM_ SG_ 2566715392 Diesel_Particulate_Filter_2_Soot "Generic 8-byte raw payload. Detail page: https://www.isobus.net/isobus/pGNAndSPN/13715?type=PGN. Signal-level enrichment via PR welcome  see CONTRIBUTING.md.";
CM_ SG_ 2566715648 Diesel_Particulate_Filter_1_Soot "Generic 8-byte raw payload. Detail page: https://www.isobus.net/isobus/pGNAndSPN/13718?type=PGN. Signal-level enrichment via PR welcome  see CONTRIBUTING.md.";
CM_ SG_ 2566715904 Electronic_Engine_Controller_11_ "Generic 8-byte raw payload. Detail page: https://www.isobus.net/isobus/pGNAndSPN/13722?type=PGN. Signal-level enrichment via PR welcome  see CONTRIBUTING.md.";
CM_ SG_ 2566716160 Engine_Manifold_Actuator_Positio "Generic 8-byte raw payload. Detail page: https://www.isobus.net/isobus/pGNAndSPN/13724?type=PGN. Signal-level enrichment via PR welcome  see CONTRIBUTING.md.";
CM_ SG_ 2566716416 Engine_Manifold_Actuator_Control "Generic 8-byte raw payload. Detail page: https://www.isobus.net/isobus/pGNAndSPN/13726?type=PGN. Signal-level enrichment via PR welcome  see CONTRIBUTING.md.";
CM_ SG_ 2566716672 Electronic_Engine_Controller_9_R "Generic 8-byte raw payload. Detail page: https://www.isobus.net/isobus/pGNAndSPN/13730?type=PGN. Signal-level enrichment via PR welcome  see CONTRIBUTING.md.";
CM_ SG_ 2566716928 Electronic_Engine_Controller_10_ "Generic 8-byte raw payload. Detail page: https://www.isobus.net/isobus/pGNAndSPN/13735?type=PGN. Signal-level enrichment via PR welcome  see CONTRIBUTING.md.";
CM_ SG_ 2566717184 Engine_Temperature_5_RawPayload "Generic 8-byte raw payload. Detail page: https://www.isobus.net/isobus/pGNAndSPN/13738?type=PGN. Signal-level enrichment via PR welcome  see CONTRIBUTING.md.";
CM_ SG_ 2566717440 Engine_Fluid_Level_Pressure_10_R "Generic 8-byte raw payload. Detail page: https://www.isobus.net/isobus/pGNAndSPN/13743?type=PGN. Signal-level enrichment via PR welcome  see CONTRIBUTING.md.";
CM_ SG_ 2566717696 Low_Voltage_Disconnect_Status_Ra "Generic 8-byte raw payload. Detail page: https://www.isobus.net/isobus/pGNAndSPN/13751?type=PGN. Signal-level enrichment via PR welcome  see CONTRIBUTING.md.";
CM_ SG_ 2566718208 Implement_Operating_state_comman "Generic 8-byte raw payload. Detail page: https://www.isobus.net/isobus/pGNAndSPN/13754?type=PGN. Signal-level enrichment via PR welcome  see CONTRIBUTING.md.";
CM_ SG_ 2566718464 Direct_Lamp_Control_Data_2_RawPa "Generic 8-byte raw payload. Detail page: https://www.isobus.net/isobus/pGNAndSPN/13769?type=PGN. Signal-level enrichment via PR welcome  see CONTRIBUTING.md.";
CM_ SG_ 2566718720 Direct_Lamp_Control_Data_1_RawPa "Generic 8-byte raw payload. Detail page: https://www.isobus.net/isobus/pGNAndSPN/13796?type=PGN. Signal-level enrichment via PR welcome  see CONTRIBUTING.md.";
CM_ SG_ 2566718976 Direct_Lamp_Control_Command_2_Ra "Generic 8-byte raw payload. Detail page: https://www.isobus.net/isobus/pGNAndSPN/13811?type=PGN. Signal-level enrichment via PR welcome  see CONTRIBUTING.md.";
CM_ SG_ 2566719232 Direct_Lamp_Control_Command_1_Ra "Generic 8-byte raw payload. Detail page: https://www.isobus.net/isobus/pGNAndSPN/13838?type=PGN. Signal-level enrichment via PR welcome  see CONTRIBUTING.md.";
CM_ SG_ 2566719488 Engine_oil_message_RawPayload "Generic 8-byte raw payload. Detail page: https://www.isobus.net/isobus/pGNAndSPN/13842?type=PGN. Signal-level enrichment via PR welcome  see CONTRIBUTING.md.";
CM_ SG_ 2566720000 Aftertreatment_2_Outlet_Gas_NOx_ "Generic 8-byte raw payload. Detail page: https://www.isobus.net/isobus/pGNAndSPN/13850?type=PGN. Signal-level enrichment via PR welcome  see CONTRIBUTING.md.";
CM_ SG_ 2566720256 Aftertreatment_2_Outlet_Gas_NOx_ "Generic 8-byte raw payload. Detail page: https://www.isobus.net/isobus/pGNAndSPN/13854?type=PGN. Signal-level enrichment via PR welcome  see CONTRIBUTING.md.";
CM_ SG_ 2566720512 Aftertreatment_2_Intake_Gas_NOx_ "Generic 8-byte raw payload. Detail page: https://www.isobus.net/isobus/pGNAndSPN/13860?type=PGN. Signal-level enrichment via PR welcome  see CONTRIBUTING.md.";
CM_ SG_ 2566720768 Aftertreatment_2_Intake_Gas_NOx_ "Generic 8-byte raw payload. Detail page: https://www.isobus.net/isobus/pGNAndSPN/13864?type=PGN. Signal-level enrichment via PR welcome  see CONTRIBUTING.md.";
CM_ SG_ 2566721024 Aftertreatment_1_Outlet_Gas_NOx_ "Generic 8-byte raw payload. Detail page: https://www.isobus.net/isobus/pGNAndSPN/13870?type=PGN. Signal-level enrichment via PR welcome  see CONTRIBUTING.md.";
CM_ SG_ 2566721280 Aftertreatment_1_Outlet_Gas_NOx_ "Generic 8-byte raw payload. Detail page: https://www.isobus.net/isobus/pGNAndSPN/13874?type=PGN. Signal-level enrichment via PR welcome  see CONTRIBUTING.md.";
CM_ SG_ 2566721536 Aftertreatment_1_Intake_Gas_NOx_ "Generic 8-byte raw payload. Detail page: https://www.isobus.net/isobus/pGNAndSPN/13880?type=PGN. Signal-level enrichment via PR welcome  see CONTRIBUTING.md.";
CM_ SG_ 2566721792 Aftertreatment_1_Intake_Gas_NOx_ "Generic 8-byte raw payload. Detail page: https://www.isobus.net/isobus/pGNAndSPN/13884?type=PGN. Signal-level enrichment via PR welcome  see CONTRIBUTING.md.";
CM_ SG_ 2566722048 Magnet_Status_Information_1_RawP "Generic 8-byte raw payload. Detail page: https://www.isobus.net/isobus/pGNAndSPN/13892?type=PGN. Signal-level enrichment via PR welcome  see CONTRIBUTING.md.";
CM_ SG_ 2566722304 Magnet_System_Configuration_Info "Generic 8-byte raw payload. Detail page: https://www.isobus.net/isobus/pGNAndSPN/13894?type=PGN. Signal-level enrichment via PR welcome  see CONTRIBUTING.md.";
CM_ SG_ 2566722560 Battery_Charger_2_RawPayload "Generic 8-byte raw payload. Detail page: https://www.isobus.net/isobus/pGNAndSPN/13901?type=PGN. Signal-level enrichment via PR welcome  see CONTRIBUTING.md.";
CM_ SG_ 2566722816 Battery_Charger_1_RawPayload "Generic 8-byte raw payload. Detail page: https://www.isobus.net/isobus/pGNAndSPN/13908?type=PGN. Signal-level enrichment via PR welcome  see CONTRIBUTING.md.";
CM_ SG_ 2566723072 Occupant_Classification_System_I "Generic 8-byte raw payload. Detail page: https://www.isobus.net/isobus/pGNAndSPN/13918?type=PGN. Signal-level enrichment via PR welcome  see CONTRIBUTING.md.";
CM_ SG_ 2566723328 Beltlock_and_Airbag_Deactivation "Generic 8-byte raw payload. Detail page: https://www.isobus.net/isobus/pGNAndSPN/13930?type=PGN. Signal-level enrichment via PR welcome  see CONTRIBUTING.md.";
CM_ SG_ 2566723584 Collision_Sensor_Information_Raw "Generic 8-byte raw payload. Detail page: https://www.isobus.net/isobus/pGNAndSPN/13964?type=PGN. Signal-level enrichment via PR welcome  see CONTRIBUTING.md.";
CM_ SG_ 2566723840 Ignitor_Loop_Information_RawPayl "Generic 8-byte raw payload. Detail page: https://www.isobus.net/isobus/pGNAndSPN/14064?type=PGN. Signal-level enrichment via PR welcome  see CONTRIBUTING.md.";
CM_ SG_ 2566724096 Aftertreatment_1_Warm_Up_Diesel_ "Generic 8-byte raw payload. Detail page: https://www.isobus.net/isobus/pGNAndSPN/14066?type=PGN. Signal-level enrichment via PR welcome  see CONTRIBUTING.md.";
CM_ SG_ 2566724352 Diesel_Particulate_Filter_2_Soot "Generic 8-byte raw payload. Detail page: https://www.isobus.net/isobus/pGNAndSPN/14072?type=PGN. Signal-level enrichment via PR welcome  see CONTRIBUTING.md.";
CM_ SG_ 2566724608 Diesel_Particulate_Filter_1_Soot "Generic 8-byte raw payload. Detail page: https://www.isobus.net/isobus/pGNAndSPN/14078?type=PGN. Signal-level enrichment via PR welcome  see CONTRIBUTING.md.";
CM_ SG_ 2566724864 Aftertreatment_Differential_Temp "Generic 8-byte raw payload. Detail page: https://www.isobus.net/isobus/pGNAndSPN/14080?type=PGN. Signal-level enrichment via PR welcome  see CONTRIBUTING.md.";
CM_ SG_ 2566725120 Aftertreatment_Differential_Temp "Generic 8-byte raw payload. Detail page: https://www.isobus.net/isobus/pGNAndSPN/14082?type=PGN. Signal-level enrichment via PR welcome  see CONTRIBUTING.md.";
CM_ SG_ 2566725376 Aftertreatment_2_Diesel_Oxidatio "Generic 8-byte raw payload. Detail page: https://www.isobus.net/isobus/pGNAndSPN/14088?type=PGN. Signal-level enrichment via PR welcome  see CONTRIBUTING.md.";
CM_ SG_ 2566725632 Aftertreatment_1_Diesel_Oxidatio "Generic 8-byte raw payload. Detail page: https://www.isobus.net/isobus/pGNAndSPN/14094?type=PGN. Signal-level enrichment via PR welcome  see CONTRIBUTING.md.";
CM_ SG_ 2566725888 Aftertreatment_2_Gas_Oxidation_C "Generic 8-byte raw payload. Detail page: https://www.isobus.net/isobus/pGNAndSPN/14100?type=PGN. Signal-level enrichment via PR welcome  see CONTRIBUTING.md.";
CM_ SG_ 2566726144 Aftertreatment_1_Gas_Oxidation_C "Generic 8-byte raw payload. Detail page: https://www.isobus.net/isobus/pGNAndSPN/14106?type=PGN. Signal-level enrichment via PR welcome  see CONTRIBUTING.md.";
CM_ SG_ 2566726400 Extended_Joystick_Message_10_Raw "Generic 8-byte raw payload. Detail page: https://www.isobus.net/isobus/pGNAndSPN/14125?type=PGN. Signal-level enrichment via PR welcome  see CONTRIBUTING.md.";
CM_ SG_ 2566726656 Basic_Joystick_Message_10_RawPay "Generic 8-byte raw payload. Detail page: https://www.isobus.net/isobus/pGNAndSPN/14147?type=PGN. Signal-level enrichment via PR welcome  see CONTRIBUTING.md.";
CM_ SG_ 2566726912 Extended_Joystick_Message_9_RawP "Generic 8-byte raw payload. Detail page: https://www.isobus.net/isobus/pGNAndSPN/14166?type=PGN. Signal-level enrichment via PR welcome  see CONTRIBUTING.md.";
CM_ SG_ 2566727168 Basic_Joystick_Message_9_RawPayl "Generic 8-byte raw payload. Detail page: https://www.isobus.net/isobus/pGNAndSPN/14188?type=PGN. Signal-level enrichment via PR welcome  see CONTRIBUTING.md.";
CM_ SG_ 2566727424 Extended_Joystick_Message_8_RawP "Generic 8-byte raw payload. Detail page: https://www.isobus.net/isobus/pGNAndSPN/14207?type=PGN. Signal-level enrichment via PR welcome  see CONTRIBUTING.md.";
CM_ SG_ 2566727680 Basic_Joystick_Message_8_RawPayl "Generic 8-byte raw payload. Detail page: https://www.isobus.net/isobus/pGNAndSPN/14229?type=PGN. Signal-level enrichment via PR welcome  see CONTRIBUTING.md.";
CM_ SG_ 2566727936 Extended_Joystick_Message_7_RawP "Generic 8-byte raw payload. Detail page: https://www.isobus.net/isobus/pGNAndSPN/14248?type=PGN. Signal-level enrichment via PR welcome  see CONTRIBUTING.md.";
CM_ SG_ 2566728192 Basic_Joystick_Message_7_RawPayl "Generic 8-byte raw payload. Detail page: https://www.isobus.net/isobus/pGNAndSPN/14270?type=PGN. Signal-level enrichment via PR welcome  see CONTRIBUTING.md.";
CM_ SG_ 2566728448 Extended_Joystick_Message_6_RawP "Generic 8-byte raw payload. Detail page: https://www.isobus.net/isobus/pGNAndSPN/14289?type=PGN. Signal-level enrichment via PR welcome  see CONTRIBUTING.md.";
CM_ SG_ 2566728704 Basic_Joystick_Message_6_RawPayl "Generic 8-byte raw payload. Detail page: https://www.isobus.net/isobus/pGNAndSPN/14311?type=PGN. Signal-level enrichment via PR welcome  see CONTRIBUTING.md.";
CM_ SG_ 2566728960 Extended_Joystick_Message_5_RawP "Generic 8-byte raw payload. Detail page: https://www.isobus.net/isobus/pGNAndSPN/14330?type=PGN. Signal-level enrichment via PR welcome  see CONTRIBUTING.md.";
CM_ SG_ 2566729216 Basic_Joystick_Message_5_RawPayl "Generic 8-byte raw payload. Detail page: https://www.isobus.net/isobus/pGNAndSPN/14352?type=PGN. Signal-level enrichment via PR welcome  see CONTRIBUTING.md.";
CM_ SG_ 2566729472 Extended_Joystick_Message_4_RawP "Generic 8-byte raw payload. Detail page: https://www.isobus.net/isobus/pGNAndSPN/14371?type=PGN. Signal-level enrichment via PR welcome  see CONTRIBUTING.md.";
CM_ SG_ 2566729728 Basic_Joystick_Message_4_RawPayl "Generic 8-byte raw payload. Detail page: https://www.isobus.net/isobus/pGNAndSPN/14393?type=PGN. Signal-level enrichment via PR welcome  see CONTRIBUTING.md.";
CM_ SG_ 2566729984 Fan_Drive_2_RawPayload "Generic 8-byte raw payload. Detail page: https://www.isobus.net/isobus/pGNAndSPN/14398?type=PGN. Signal-level enrichment via PR welcome  see CONTRIBUTING.md.";
CM_ SG_ 2566730496 Aftertreatment_2_Diesel_Exhaust_ "Generic 8-byte raw payload. Detail page: https://www.isobus.net/isobus/pGNAndSPN/14408?type=PGN. Signal-level enrichment via PR welcome  see CONTRIBUTING.md.";
CM_ SG_ 2566730752 Aftertreatment_2_SCR_Reagant_Tan "Generic 8-byte raw payload. Detail page: https://www.isobus.net/isobus/pGNAndSPN/14415?type=PGN. Signal-level enrichment via PR welcome  see CONTRIBUTING.md.";
CM_ SG_ 2566731008 Aftertreatment_2_Diesel_Exhaust_ "Generic 8-byte raw payload. Detail page: https://www.isobus.net/isobus/pGNAndSPN/14422?type=PGN. Signal-level enrichment via PR welcome  see CONTRIBUTING.md.";
CM_ SG_ 2566731264 Aftertreatment_2_Diesel_Exhaust_ "Generic 8-byte raw payload. Detail page: https://www.isobus.net/isobus/pGNAndSPN/14428?type=PGN. Signal-level enrichment via PR welcome  see CONTRIBUTING.md.";
CM_ SG_ 2566731520 Aftertreatment_2_SCR_Service_Inf "Generic 8-byte raw payload. Detail page: https://www.isobus.net/isobus/pGNAndSPN/14433?type=PGN. Signal-level enrichment via PR welcome  see CONTRIBUTING.md.";
CM_ SG_ 2566731776 Aftertreatment_2_SCR_Exhaust_Gas "Generic 8-byte raw payload. Detail page: https://www.isobus.net/isobus/pGNAndSPN/14437?type=PGN. Signal-level enrichment via PR welcome  see CONTRIBUTING.md.";
CM_ SG_ 2566732032 Aftertreatment_2_SCR_Exhaust_Gas "Generic 8-byte raw payload. Detail page: https://www.isobus.net/isobus/pGNAndSPN/14441?type=PGN. Signal-level enrichment via PR welcome  see CONTRIBUTING.md.";
CM_ SG_ 2566732288 Aftertreatment_2_SCR_Dosing_Syst "Generic 8-byte raw payload. Detail page: https://www.isobus.net/isobus/pGNAndSPN/14458?type=PGN. Signal-level enrichment via PR welcome  see CONTRIBUTING.md.";
CM_ SG_ 2566732544 Aftertreatment_2_SCR_Dosing_Syst "Generic 8-byte raw payload. Detail page: https://www.isobus.net/isobus/pGNAndSPN/14471?type=PGN. Signal-level enrichment via PR welcome  see CONTRIBUTING.md.";
CM_ SG_ 2566732800 Aftertreatment_1_Diesel_Exhaust_ "Generic 8-byte raw payload. Detail page: https://www.isobus.net/isobus/pGNAndSPN/14480?type=PGN. Signal-level enrichment via PR welcome  see CONTRIBUTING.md.";
CM_ SG_ 2566733056 Aftertreatment_1_SCR_Reagant_Tan "Generic 8-byte raw payload. Detail page: https://www.isobus.net/isobus/pGNAndSPN/14487?type=PGN. Signal-level enrichment via PR welcome  see CONTRIBUTING.md.";
CM_ SG_ 2566733312 Aftertreatment_1_SCR_Exhaust_Gas "Generic 8-byte raw payload. Detail page: https://www.isobus.net/isobus/pGNAndSPN/14491?type=PGN. Signal-level enrichment via PR welcome  see CONTRIBUTING.md.";
CM_ SG_ 2566733568 Aftertreatment_1_SCR_Exhaust_Gas "Generic 8-byte raw payload. Detail page: https://www.isobus.net/isobus/pGNAndSPN/14495?type=PGN. Signal-level enrichment via PR welcome  see CONTRIBUTING.md.";
CM_ SG_ 2566733824 Aftertreatment_1_SCR_Dosing_Syst "Generic 8-byte raw payload. Detail page: https://www.isobus.net/isobus/pGNAndSPN/14513?type=PGN. Signal-level enrichment via PR welcome  see CONTRIBUTING.md.";
CM_ SG_ 2566734080 Aftertreatment_1_SCR_Dosing_Syst "Generic 8-byte raw payload. Detail page: https://www.isobus.net/isobus/pGNAndSPN/14526?type=PGN. Signal-level enrichment via PR welcome  see CONTRIBUTING.md.";
CM_ SG_ 2566734336 ISOBUS_compliance_certification_ "Generic 8-byte raw payload. Detail page: https://www.isobus.net/isobus/pGNAndSPN/14545?type=PGN. Signal-level enrichment via PR welcome  see CONTRIBUTING.md.";
CM_ SG_ 2566734848 Aftertreatment_2_Fuel_Control_2_ "Generic 8-byte raw payload. Detail page: https://www.isobus.net/isobus/pGNAndSPN/14552?type=PGN. Signal-level enrichment via PR welcome  see CONTRIBUTING.md.";
CM_ SG_ 2566735104 Aftertreatment_2_Three_Way_Catal "Generic 8-byte raw payload. Detail page: https://www.isobus.net/isobus/pGNAndSPN/14558?type=PGN. Signal-level enrichment via PR welcome  see CONTRIBUTING.md.";
CM_ SG_ 2566735360 Aftertreatment_1_Three_Way_Catal "Generic 8-byte raw payload. Detail page: https://www.isobus.net/isobus/pGNAndSPN/14564?type=PGN. Signal-level enrichment via PR welcome  see CONTRIBUTING.md.";
CM_ SG_ 2566735616 Transmission_Mode_Labels_RawPayl "Generic 8-byte raw payload. Detail page: https://www.isobus.net/isobus/pGNAndSPN/14565?type=PGN. Signal-level enrichment via PR welcome  see CONTRIBUTING.md.";
CM_ SG_ 2566735872 Engine_Exhaust_Bank_2_O2_Fuel_Tr "Generic 8-byte raw payload. Detail page: https://www.isobus.net/isobus/pGNAndSPN/14568?type=PGN. Signal-level enrichment via PR welcome  see CONTRIBUTING.md.";
CM_ SG_ 2566736128 Engine_Exhaust_Bank_1_O2_Fuel_Tr "Generic 8-byte raw payload. Detail page: https://www.isobus.net/isobus/pGNAndSPN/14571?type=PGN. Signal-level enrichment via PR welcome  see CONTRIBUTING.md.";
CM_ SG_ 2566736384 General_Purpose_Message_2_11_Raw "Generic 8-byte raw payload. Detail page: https://www.isobus.net/isobus/pGNAndSPN/14572?type=PGN. Signal-level enrichment via PR welcome  see CONTRIBUTING.md.";
CM_ SG_ 2566736640 General_Purpose_Message_2_10_Raw "Generic 8-byte raw payload. Detail page: https://www.isobus.net/isobus/pGNAndSPN/14573?type=PGN. Signal-level enrichment via PR welcome  see CONTRIBUTING.md.";
CM_ SG_ 2566736896 General_Purpose_Message_2_9_RawP "Generic 8-byte raw payload. Detail page: https://www.isobus.net/isobus/pGNAndSPN/14574?type=PGN. Signal-level enrichment via PR welcome  see CONTRIBUTING.md.";
CM_ SG_ 2566737152 General_Purpose_Message_2_8_RawP "Generic 8-byte raw payload. Detail page: https://www.isobus.net/isobus/pGNAndSPN/14575?type=PGN. Signal-level enrichment via PR welcome  see CONTRIBUTING.md.";
CM_ SG_ 2566737408 General_Purpose_Message_2_7_RawP "Generic 8-byte raw payload. Detail page: https://www.isobus.net/isobus/pGNAndSPN/14576?type=PGN. Signal-level enrichment via PR welcome  see CONTRIBUTING.md.";
CM_ SG_ 2566737664 General_Purpose_Message_2_6_RawP "Generic 8-byte raw payload. Detail page: https://www.isobus.net/isobus/pGNAndSPN/14577?type=PGN. Signal-level enrichment via PR welcome  see CONTRIBUTING.md.";
CM_ SG_ 2566737920 General_Purpose_Message_1_9_RawP "Generic 8-byte raw payload. Detail page: https://www.isobus.net/isobus/pGNAndSPN/14578?type=PGN. Signal-level enrichment via PR welcome  see CONTRIBUTING.md.";
CM_ SG_ 2566738176 Aftercooler_Coolant_Control_Valv "Generic 8-byte raw payload. Detail page: https://www.isobus.net/isobus/pGNAndSPN/14584?type=PGN. Signal-level enrichment via PR welcome  see CONTRIBUTING.md.";
CM_ SG_ 2566738432 Engine_Coolant_Control_Valve_Com "Generic 8-byte raw payload. Detail page: https://www.isobus.net/isobus/pGNAndSPN/14592?type=PGN. Signal-level enrichment via PR welcome  see CONTRIBUTING.md.";
CM_ SG_ 2566738688 Engine_Average_Information_RawPa "Generic 8-byte raw payload. Detail page: https://www.isobus.net/isobus/pGNAndSPN/14595?type=PGN. Signal-level enrichment via PR welcome  see CONTRIBUTING.md.";
CM_ SG_ 2566738944 DTCs_C_Previously_Active_RawPayl "Generic 8-byte raw payload. Detail page: https://www.isobus.net/isobus/pGNAndSPN/14607?type=PGN. Signal-level enrichment via PR welcome  see CONTRIBUTING.md.";
CM_ SG_ 2566739200 DTCs_C_Confirmed_and_Active_RawP "Generic 8-byte raw payload. Detail page: https://www.isobus.net/isobus/pGNAndSPN/14619?type=PGN. Signal-level enrichment via PR welcome  see CONTRIBUTING.md.";
CM_ SG_ 2566739456 DTCs_C_Pending_RawPayload "Generic 8-byte raw payload. Detail page: https://www.isobus.net/isobus/pGNAndSPN/14631?type=PGN. Signal-level enrichment via PR welcome  see CONTRIBUTING.md.";
CM_ SG_ 2566739712 DTCs_B2_Previously_Active_RawPay "Generic 8-byte raw payload. Detail page: https://www.isobus.net/isobus/pGNAndSPN/14643?type=PGN. Signal-level enrichment via PR welcome  see CONTRIBUTING.md.";
CM_ SG_ 2566739968 DTCs_B2_Confirmed_and_Active_Raw "Generic 8-byte raw payload. Detail page: https://www.isobus.net/isobus/pGNAndSPN/14655?type=PGN. Signal-level enrichment via PR welcome  see CONTRIBUTING.md.";
CM_ SG_ 2566740224 DTCs_B2_Pending_RawPayload "Generic 8-byte raw payload. Detail page: https://www.isobus.net/isobus/pGNAndSPN/14667?type=PGN. Signal-level enrichment via PR welcome  see CONTRIBUTING.md.";
CM_ SG_ 2566740480 DTCs_B1_Previously_Active_RawPay "Generic 8-byte raw payload. Detail page: https://www.isobus.net/isobus/pGNAndSPN/14679?type=PGN. Signal-level enrichment via PR welcome  see CONTRIBUTING.md.";
CM_ SG_ 2566740736 DTCs_B1_Confirmed_and_Active_Raw "Generic 8-byte raw payload. Detail page: https://www.isobus.net/isobus/pGNAndSPN/14691?type=PGN. Signal-level enrichment via PR welcome  see CONTRIBUTING.md.";
CM_ SG_ 2566740992 DTCs_B1_Pending_RawPayload "Generic 8-byte raw payload. Detail page: https://www.isobus.net/isobus/pGNAndSPN/14703?type=PGN. Signal-level enrichment via PR welcome  see CONTRIBUTING.md.";
CM_ SG_ 2566741248 DTCs_A_Previously_Active_RawPayl "Generic 8-byte raw payload. Detail page: https://www.isobus.net/isobus/pGNAndSPN/14715?type=PGN. Signal-level enrichment via PR welcome  see CONTRIBUTING.md.";
CM_ SG_ 2566741504 DTCs_A_Confirmed_and_Active_RawP "Generic 8-byte raw payload. Detail page: https://www.isobus.net/isobus/pGNAndSPN/14727?type=PGN. Signal-level enrichment via PR welcome  see CONTRIBUTING.md.";
CM_ SG_ 2566741760 DTCs_A_Pending_RawPayload "Generic 8-byte raw payload. Detail page: https://www.isobus.net/isobus/pGNAndSPN/14739?type=PGN. Signal-level enrichment via PR welcome  see CONTRIBUTING.md.";
CM_ SG_ 2566742016 Harmonized_B1_Failure_Counts_Raw "Generic 8-byte raw payload. Detail page: https://www.isobus.net/isobus/pGNAndSPN/14742?type=PGN. Signal-level enrichment via PR welcome  see CONTRIBUTING.md.";
CM_ SG_ 2566742272 Harmonized_Cumulative_Continuous "Generic 8-byte raw payload. Detail page: https://www.isobus.net/isobus/pGNAndSPN/14744?type=PGN. Signal-level enrichment via PR welcome  see CONTRIBUTING.md.";
CM_ SG_ 2566742528 Harmonized_Global_Regulation_Des "Generic 8-byte raw payload. Detail page: https://www.isobus.net/isobus/pGNAndSPN/14745?type=PGN. Signal-level enrichment via PR welcome  see CONTRIBUTING.md.";
CM_ SG_ 2566742784 Harmonized_Roadworthiness_System "Generic 8-byte raw payload. Detail page: https://www.isobus.net/isobus/pGNAndSPN/14750?type=PGN. Signal-level enrichment via PR welcome  see CONTRIBUTING.md.";
CM_ SG_ 2566743040 Harmonized_Roadworthiness_Vehicl "Generic 8-byte raw payload. Detail page: https://www.isobus.net/isobus/pGNAndSPN/14751?type=PGN. Signal-level enrichment via PR welcome  see CONTRIBUTING.md.";
CM_ SG_ 2566743296 Aftertreatment_1_Fuel_Control_2_ "Generic 8-byte raw payload. Detail page: https://www.isobus.net/isobus/pGNAndSPN/14756?type=PGN. Signal-level enrichment via PR welcome  see CONTRIBUTING.md.";
CM_ SG_ 2566743552 Engine_Temperature_4_RawPayload "Generic 8-byte raw payload. Detail page: https://www.isobus.net/isobus/pGNAndSPN/14762?type=PGN. Signal-level enrichment via PR welcome  see CONTRIBUTING.md.";
CM_ SG_ 2566743808 Zero_Net_Vehicle_Weight_Change_R "Generic 8-byte raw payload. Detail page: https://www.isobus.net/isobus/pGNAndSPN/14763?type=PGN. Signal-level enrichment via PR welcome  see CONTRIBUTING.md.";
CM_ SG_ 2566744064 Gross_Combination_Vehicle_Weight "Generic 8-byte raw payload. Detail page: https://www.isobus.net/isobus/pGNAndSPN/14765?type=PGN. Signal-level enrichment via PR welcome  see CONTRIBUTING.md.";
CM_ SG_ 2566744320 Axle_Group_Calibration_Weights_R "Generic 8-byte raw payload. Detail page: https://www.isobus.net/isobus/pGNAndSPN/14769?type=PGN. Signal-level enrichment via PR welcome  see CONTRIBUTING.md.";
CM_ SG_ 2566744576 Axle_Group_Weight_RawPayload "Generic 8-byte raw payload. Detail page: https://www.isobus.net/isobus/pGNAndSPN/14772?type=PGN. Signal-level enrichment via PR welcome  see CONTRIBUTING.md.";
CM_ SG_ 2566744832 Available_Axle_Group_Weights_Raw "Generic 8-byte raw payload. Detail page: https://www.isobus.net/isobus/pGNAndSPN/14788?type=PGN. Signal-level enrichment via PR welcome  see CONTRIBUTING.md.";
CM_ SG_ 2566745088 Aftertreatment_2_Air_Control_2_R "Generic 8-byte raw payload. Detail page: https://www.isobus.net/isobus/pGNAndSPN/14792?type=PGN. Signal-level enrichment via PR welcome  see CONTRIBUTING.md.";
CM_ SG_ 2566745344 Aftertreatment_1_Air_Control_2_R "Generic 8-byte raw payload. Detail page: https://www.isobus.net/isobus/pGNAndSPN/14796?type=PGN. Signal-level enrichment via PR welcome  see CONTRIBUTING.md.";
CM_ SG_ 2566745600 Aftertreatment_1_SCR_Service_Inf "Generic 8-byte raw payload. Detail page: https://www.isobus.net/isobus/pGNAndSPN/14801?type=PGN. Signal-level enrichment via PR welcome  see CONTRIBUTING.md.";
CM_ SG_ 2566745856 Electronic_Engine_Controller_8_R "Generic 8-byte raw payload. Detail page: https://www.isobus.net/isobus/pGNAndSPN/14806?type=PGN. Signal-level enrichment via PR welcome  see CONTRIBUTING.md.";
CM_ SG_ 2566746112 Door_ramp_control_RawPayload "Generic 8-byte raw payload. Detail page: https://www.isobus.net/isobus/pGNAndSPN/14821?type=PGN. Signal-level enrichment via PR welcome  see CONTRIBUTING.md.";
CM_ SG_ 2566746368 Brake_actuator_stroke_status_Raw "Generic 8-byte raw payload. Detail page: https://www.isobus.net/isobus/pGNAndSPN/14841?type=PGN. Signal-level enrichment via PR welcome  see CONTRIBUTING.md.";
CM_ SG_ 2566746624 Engine_Spark_Voltage_6_RawPayloa "Generic 8-byte raw payload. Detail page: https://www.isobus.net/isobus/pGNAndSPN/14845?type=PGN. Signal-level enrichment via PR welcome  see CONTRIBUTING.md.";
CM_ SG_ 2566746880 Engine_Spark_Voltage_5_RawPayloa "Generic 8-byte raw payload. Detail page: https://www.isobus.net/isobus/pGNAndSPN/14849?type=PGN. Signal-level enrichment via PR welcome  see CONTRIBUTING.md.";
CM_ SG_ 2566747136 Engine_Spark_Voltage_4_RawPayloa "Generic 8-byte raw payload. Detail page: https://www.isobus.net/isobus/pGNAndSPN/14853?type=PGN. Signal-level enrichment via PR welcome  see CONTRIBUTING.md.";
CM_ SG_ 2566747392 Engine_Spark_Voltage_3_RawPayloa "Generic 8-byte raw payload. Detail page: https://www.isobus.net/isobus/pGNAndSPN/14857?type=PGN. Signal-level enrichment via PR welcome  see CONTRIBUTING.md.";
CM_ SG_ 2566747648 Engine_Spark_Voltage_2_RawPayloa "Generic 8-byte raw payload. Detail page: https://www.isobus.net/isobus/pGNAndSPN/14861?type=PGN. Signal-level enrichment via PR welcome  see CONTRIBUTING.md.";
CM_ SG_ 2566747904 Engine_Spark_Voltage_1_RawPayloa "Generic 8-byte raw payload. Detail page: https://www.isobus.net/isobus/pGNAndSPN/14865?type=PGN. Signal-level enrichment via PR welcome  see CONTRIBUTING.md.";
CM_ SG_ 2566748160 Aftertreatment_2_Trip_Informatio "Generic 8-byte raw payload. Detail page: https://www.isobus.net/isobus/pGNAndSPN/14873?type=PGN. Signal-level enrichment via PR welcome  see CONTRIBUTING.md.";
CM_ SG_ 2566748416 Aftertreatment_1_Trip_Informatio "Generic 8-byte raw payload. Detail page: https://www.isobus.net/isobus/pGNAndSPN/14881?type=PGN. Signal-level enrichment via PR welcome  see CONTRIBUTING.md.";
CM_ SG_ 2566748672 Aftertreatment_2_Service_1_RawPa "Generic 8-byte raw payload. Detail page: https://www.isobus.net/isobus/pGNAndSPN/14885?type=PGN. Signal-level enrichment via PR welcome  see CONTRIBUTING.md.";
CM_ SG_ 2566748928 Aftertreatment_1_Service_1_RawPa "Generic 8-byte raw payload. Detail page: https://www.isobus.net/isobus/pGNAndSPN/14889?type=PGN. Signal-level enrichment via PR welcome  see CONTRIBUTING.md.";
CM_ SG_ 2566749696 Adaptive_Front_Lighting_System_S "Generic 8-byte raw payload. Detail page: https://www.isobus.net/isobus/pGNAndSPN/14922?type=PGN. Signal-level enrichment via PR welcome  see CONTRIBUTING.md.";
CM_ SG_ 2566749952 Engine_Configuration_2_RawPayloa "Generic 8-byte raw payload. Detail page: https://www.isobus.net/isobus/pGNAndSPN/14926?type=PGN. Signal-level enrichment via PR welcome  see CONTRIBUTING.md.";
CM_ SG_ 2566750208 Emission_Related_Permanent_Diagn "Generic 8-byte raw payload. Detail page: https://www.isobus.net/isobus/pGNAndSPN/14938?type=PGN. Signal-level enrichment via PR welcome  see CONTRIBUTING.md.";
CM_ SG_ 2566750464 EGR_Cooler_Bypass_RawPayload "Generic 8-byte raw payload. Detail page: https://www.isobus.net/isobus/pGNAndSPN/14939?type=PGN. Signal-level enrichment via PR welcome  see CONTRIBUTING.md.";
CM_ SG_ 2566750720 All_Pending_DTCs_RawPayload "Generic 8-byte raw payload. Detail page: https://www.isobus.net/isobus/pGNAndSPN/14951?type=PGN. Signal-level enrichment via PR welcome  see CONTRIBUTING.md.";
CM_ SG_ 2566750976 Transfer_Case_Information_RawPay "Generic 8-byte raw payload. Detail page: https://www.isobus.net/isobus/pGNAndSPN/14956?type=PGN. Signal-level enrichment via PR welcome  see CONTRIBUTING.md.";
CM_ SG_ 2566751232 Engine_Fluid_Level_Pressure_9_Ra "Generic 8-byte raw payload. Detail page: https://www.isobus.net/isobus/pGNAndSPN/14960?type=PGN. Signal-level enrichment via PR welcome  see CONTRIBUTING.md.";
CM_ SG_ 2566751488 Engine_Fluid_Level_Pressure_8_Ra "Generic 8-byte raw payload. Detail page: https://www.isobus.net/isobus/pGNAndSPN/14964?type=PGN. Signal-level enrichment via PR welcome  see CONTRIBUTING.md.";
CM_ SG_ 2566751744 Engine_Fluid_Level_Pressure_7_Ra "Generic 8-byte raw payload. Detail page: https://www.isobus.net/isobus/pGNAndSPN/14968?type=PGN. Signal-level enrichment via PR welcome  see CONTRIBUTING.md.";
CM_ SG_ 2566752000 Engine_Fluid_Level_Pressure_6_Ra "Generic 8-byte raw payload. Detail page: https://www.isobus.net/isobus/pGNAndSPN/14972?type=PGN. Signal-level enrichment via PR welcome  see CONTRIBUTING.md.";
CM_ SG_ 2566752256 Engine_Fluid_Level_Pressure_5_Ra "Generic 8-byte raw payload. Detail page: https://www.isobus.net/isobus/pGNAndSPN/14976?type=PGN. Signal-level enrichment via PR welcome  see CONTRIBUTING.md.";
CM_ SG_ 2566752512 Vehicle_Direction_Speed_2_RawPay "Generic 8-byte raw payload. Detail page: https://www.isobus.net/isobus/pGNAndSPN/14977?type=PGN. Signal-level enrichment via PR welcome  see CONTRIBUTING.md.";
CM_ SG_ 2566752768 SAE_J2012_2_Byte_DTC_Display_Raw "Generic 8-byte raw payload. Detail page: https://www.isobus.net/isobus/pGNAndSPN/14981?type=PGN. Signal-level enrichment via PR welcome  see CONTRIBUTING.md.";
CM_ SG_ 2566753024 Aftertreatment_2_Gas_Parameters_ "Generic 8-byte raw payload. Detail page: https://www.isobus.net/isobus/pGNAndSPN/14983?type=PGN. Signal-level enrichment via PR welcome  see CONTRIBUTING.md.";
CM_ SG_ 2566753280 Aftertreatment_1_Gas_Parameters_ "Generic 8-byte raw payload. Detail page: https://www.isobus.net/isobus/pGNAndSPN/14985?type=PGN. Signal-level enrichment via PR welcome  see CONTRIBUTING.md.";
CM_ SG_ 2566753536 Utility_Total_AC_Reactive_Energy "Generic 8-byte raw payload. Detail page: https://www.isobus.net/isobus/pGNAndSPN/14987?type=PGN. Signal-level enrichment via PR welcome  see CONTRIBUTING.md.";
CM_ SG_ 2566753792 Generator_Total_AC_Reactive_Ener "Generic 8-byte raw payload. Detail page: https://www.isobus.net/isobus/pGNAndSPN/14989?type=PGN. Signal-level enrichment via PR welcome  see CONTRIBUTING.md.";
CM_ SG_ 2566754048 Generator_Total_AC_Percent_Power "Generic 8-byte raw payload. Detail page: https://www.isobus.net/isobus/pGNAndSPN/14992?type=PGN. Signal-level enrichment via PR welcome  see CONTRIBUTING.md.";
CM_ SG_ 2566754304 Advertised_Engine_Torque_Curve_R "Generic 8-byte raw payload. Detail page: https://www.isobus.net/isobus/pGNAndSPN/14996?type=PGN. Signal-level enrichment via PR welcome  see CONTRIBUTING.md.";
CM_ SG_ 2566754560 AC_Switching_Device_Status_RawPa "Generic 8-byte raw payload. Detail page: https://www.isobus.net/isobus/pGNAndSPN/15007?type=PGN. Signal-level enrichment via PR welcome  see CONTRIBUTING.md.";
CM_ SG_ 2566754816 Engine_Operating_Information_Raw "Generic 8-byte raw payload. Detail page: https://www.isobus.net/isobus/pGNAndSPN/15025?type=PGN. Signal-level enrichment via PR welcome  see CONTRIBUTING.md.";
CM_ SG_ 2566755072 Generator_Control_1_RawPayload "Generic 8-byte raw payload. Detail page: https://www.isobus.net/isobus/pGNAndSPN/15033?type=PGN. Signal-level enrichment via PR welcome  see CONTRIBUTING.md.";
CM_ SG_ 2566755328 Electronic_Engine_Controller_7_R "Generic 8-byte raw payload. Detail page: https://www.isobus.net/isobus/pGNAndSPN/15037?type=PGN. Signal-level enrichment via PR welcome  see CONTRIBUTING.md.";
CM_ SG_ 2566755584 Transmission_Fluids_2_RawPayload "Generic 8-byte raw payload. Detail page: https://www.isobus.net/isobus/pGNAndSPN/15047?type=PGN. Signal-level enrichment via PR welcome  see CONTRIBUTING.md.";
CM_ SG_ 2566755840 Fuel_Information_2_Liquid_RawPay "Generic 8-byte raw payload. Detail page: https://www.isobus.net/isobus/pGNAndSPN/15049?type=PGN. Signal-level enrichment via PR welcome  see CONTRIBUTING.md.";
CM_ SG_ 2566756096 Fuel_Information_3_Liquid_RawPay "Generic 8-byte raw payload. Detail page: https://www.isobus.net/isobus/pGNAndSPN/15051?type=PGN. Signal-level enrichment via PR welcome  see CONTRIBUTING.md.";
CM_ SG_ 2566756352 Aftertreatment_1_Historical_Info "Generic 8-byte raw payload. Detail page: https://www.isobus.net/isobus/pGNAndSPN/15062?type=PGN. Signal-level enrichment via PR welcome  see CONTRIBUTING.md.";
CM_ SG_ 2566756608 Aftertreatment_2_Historical_info "Generic 8-byte raw payload. Detail page: https://www.isobus.net/isobus/pGNAndSPN/15073?type=PGN. Signal-level enrichment via PR welcome  see CONTRIBUTING.md.";
CM_ SG_ 2566756864 Electronic_Brake_System_2_4_RawP "Generic 8-byte raw payload. Detail page: https://www.isobus.net/isobus/pGNAndSPN/15074?type=PGN. Signal-level enrichment via PR welcome  see CONTRIBUTING.md.";
CM_ SG_ 2566757120 Aftertreatment_1_Diesel_Exhaust_ "Generic 8-byte raw payload. Detail page: https://www.isobus.net/isobus/pGNAndSPN/15081?type=PGN. Signal-level enrichment via PR welcome  see CONTRIBUTING.md.";
CM_ SG_ 2566757376 Sensor_Electrical_Power_2_RawPay "Generic 8-byte raw payload. Detail page: https://www.isobus.net/isobus/pGNAndSPN/15085?type=PGN. Signal-level enrichment via PR welcome  see CONTRIBUTING.md.";
CM_ SG_ 2566757632 Sensor_Electrical_Power_1_RawPay "Generic 8-byte raw payload. Detail page: https://www.isobus.net/isobus/pGNAndSPN/15089?type=PGN. Signal-level enrichment via PR welcome  see CONTRIBUTING.md.";
CM_ SG_ 2566757888 Aftertreatment_2_Air_Control_1_R "Generic 8-byte raw payload. Detail page: https://www.isobus.net/isobus/pGNAndSPN/15097?type=PGN. Signal-level enrichment via PR welcome  see CONTRIBUTING.md.";
CM_ SG_ 2566758144 Aftertreatment_1_Air_Control_1_R "Generic 8-byte raw payload. Detail page: https://www.isobus.net/isobus/pGNAndSPN/15105?type=PGN. Signal-level enrichment via PR welcome  see CONTRIBUTING.md.";
CM_ SG_ 2566758400 Aftertreatment_2_Fuel_Control_1_ "Generic 8-byte raw payload. Detail page: https://www.isobus.net/isobus/pGNAndSPN/15113?type=PGN. Signal-level enrichment via PR welcome  see CONTRIBUTING.md.";
CM_ SG_ 2566758656 Aftertreatment_1_Fuel_Control_1_ "Generic 8-byte raw payload. Detail page: https://www.isobus.net/isobus/pGNAndSPN/15121?type=PGN. Signal-level enrichment via PR welcome  see CONTRIBUTING.md.";
CM_ SG_ 2566758912 Fuel_Information_3_Gaseous_RawPa "Generic 8-byte raw payload. Detail page: https://www.isobus.net/isobus/pGNAndSPN/15125?type=PGN. Signal-level enrichment via PR welcome  see CONTRIBUTING.md.";
CM_ SG_ 2566759168 Electronic_Engine_Controller_6_R "Generic 8-byte raw payload. Detail page: https://www.isobus.net/isobus/pGNAndSPN/15132?type=PGN. Signal-level enrichment via PR welcome  see CONTRIBUTING.md.";
CM_ SG_ 2566759424 PTO_Drive_Engagement_1_RawPayloa "Generic 8-byte raw payload. Detail page: https://www.isobus.net/isobus/pGNAndSPN/15160?type=PGN. Signal-level enrichment via PR welcome  see CONTRIBUTING.md.";
CM_ SG_ 2566759680 Door_Control_2_RawPayload "Generic 8-byte raw payload. Detail page: https://www.isobus.net/isobus/pGNAndSPN/15190?type=PGN. Signal-level enrichment via PR welcome  see CONTRIBUTING.md.";
CM_ SG_ 2566759936 Voltage_Regulator_Excitation_Sta "Generic 8-byte raw payload. Detail page: https://www.isobus.net/isobus/pGNAndSPN/15193?type=PGN. Signal-level enrichment via PR welcome  see CONTRIBUTING.md.";
CM_ SG_ 2566760192 Voltage_Regulator_Operating_Mode "Generic 8-byte raw payload. Detail page: https://www.isobus.net/isobus/pGNAndSPN/15198?type=PGN. Signal-level enrichment via PR welcome  see CONTRIBUTING.md.";
CM_ SG_ 2566760448 Wireless_Communications_Message_ "Generic 8-byte raw payload. Detail page: https://www.isobus.net/isobus/pGNAndSPN/15203?type=PGN. Signal-level enrichment via PR welcome  see CONTRIBUTING.md.";
CM_ SG_ 2566760704 Wireless_Communications_Message_ "Generic 8-byte raw payload. Detail page: https://www.isobus.net/isobus/pGNAndSPN/15208?type=PGN. Signal-level enrichment via PR welcome  see CONTRIBUTING.md.";
CM_ SG_ 2566760960 Engine_Fluid_Level_Pressure_4_Ra "Generic 8-byte raw payload. Detail page: https://www.isobus.net/isobus/pGNAndSPN/15215?type=PGN. Signal-level enrichment via PR welcome  see CONTRIBUTING.md.";
CM_ SG_ 2566761216 Request_For_Complete_Configurabl "Generic 8-byte raw payload. Detail page: https://www.isobus.net/isobus/pGNAndSPN/15216?type=PGN. Signal-level enrichment via PR welcome  see CONTRIBUTING.md.";
CM_ SG_ 2566761472 Engine_Fuel_Information_RawPaylo "Generic 8-byte raw payload. Detail page: https://www.isobus.net/isobus/pGNAndSPN/15218?type=PGN. Signal-level enrichment via PR welcome  see CONTRIBUTING.md.";
CM_ SG_ 2566761728 Request_For_Complete_Configurabl "Generic 8-byte raw payload. Detail page: https://www.isobus.net/isobus/pGNAndSPN/15220?type=PGN. Signal-level enrichment via PR welcome  see CONTRIBUTING.md.";
CM_ SG_ 2566761984 Fifth_Wheel_Smart_Systems_2_RawP "Generic 8-byte raw payload. Detail page: https://www.isobus.net/isobus/pGNAndSPN/15225?type=PGN. Signal-level enrichment via PR welcome  see CONTRIBUTING.md.";
CM_ SG_ 2566762240 Aftertreatment_2_Intermediate_Ga "Generic 8-byte raw payload. Detail page: https://www.isobus.net/isobus/pGNAndSPN/15231?type=PGN. Signal-level enrichment via PR welcome  see CONTRIBUTING.md.";
CM_ SG_ 2566762496 Aftertreatment_2_Outlet_Gas_2_Ra "Generic 8-byte raw payload. Detail page: https://www.isobus.net/isobus/pGNAndSPN/15236?type=PGN. Signal-level enrichment via PR welcome  see CONTRIBUTING.md.";
CM_ SG_ 2566762752 Aftertreatment_2_Intake_Gas_2_Ra "Generic 8-byte raw payload. Detail page: https://www.isobus.net/isobus/pGNAndSPN/15241?type=PGN. Signal-level enrichment via PR welcome  see CONTRIBUTING.md.";
CM_ SG_ 2566763008 Aftertreatment_1_Intermediate_Ga "Generic 8-byte raw payload. Detail page: https://www.isobus.net/isobus/pGNAndSPN/15247?type=PGN. Signal-level enrichment via PR welcome  see CONTRIBUTING.md.";
CM_ SG_ 2566763264 Aftertreatment_1_Outlet_Gas_2_Ra "Generic 8-byte raw payload. Detail page: https://www.isobus.net/isobus/pGNAndSPN/15252?type=PGN. Signal-level enrichment via PR welcome  see CONTRIBUTING.md.";
CM_ SG_ 2566763520 Aftertreatment_1_Intake_Gas_2_Ra "Generic 8-byte raw payload. Detail page: https://www.isobus.net/isobus/pGNAndSPN/15257?type=PGN. Signal-level enrichment via PR welcome  see CONTRIBUTING.md.";
CM_ SG_ 2566763776 Emission_Related_Previously_MIL_ "Generic 8-byte raw payload. Detail page: https://www.isobus.net/isobus/pGNAndSPN/15269?type=PGN. Signal-level enrichment via PR welcome  see CONTRIBUTING.md.";
CM_ SG_ 2566764032 SPN_Support_RawPayload "Generic 8-byte raw payload. Detail page: https://www.isobus.net/isobus/pGNAndSPN/15275?type=PGN. Signal-level enrichment via PR welcome  see CONTRIBUTING.md.";
CM_ SG_ 2566764288 Expanded_Freeze_Frame_RawPayload "Generic 8-byte raw payload. Detail page: https://www.isobus.net/isobus/pGNAndSPN/15281?type=PGN. Signal-level enrichment via PR welcome  see CONTRIBUTING.md.";
CM_ SG_ 2566764544 Diagnostic_Readiness_3_RawPayloa "Generic 8-byte raw payload. Detail page: https://www.isobus.net/isobus/pGNAndSPN/15286?type=PGN. Signal-level enrichment via PR welcome  see CONTRIBUTING.md.";
CM_ SG_ 2566764800 Tire_Pressure_Reference_Informat "Generic 8-byte raw payload. Detail page: https://www.isobus.net/isobus/pGNAndSPN/15288?type=PGN. Signal-level enrichment via PR welcome  see CONTRIBUTING.md.";
CM_ SG_ 2566765056 Farebox_Status_RawPayload "Generic 8-byte raw payload. Detail page: https://www.isobus.net/isobus/pGNAndSPN/15290?type=PGN. Signal-level enrichment via PR welcome  see CONTRIBUTING.md.";
CM_ SG_ 2566765312 Farebox_Point_of_Sale_RawPayload "Generic 8-byte raw payload. Detail page: https://www.isobus.net/isobus/pGNAndSPN/15301?type=PGN. Signal-level enrichment via PR welcome  see CONTRIBUTING.md.";
CM_ SG_ 2566765568 Farebox_Service_Detail_RawPayloa "Generic 8-byte raw payload. Detail page: https://www.isobus.net/isobus/pGNAndSPN/15311?type=PGN. Signal-level enrichment via PR welcome  see CONTRIBUTING.md.";
CM_ SG_ 2566765824 Signal_Preemption_RawPayload "Generic 8-byte raw payload. Detail page: https://www.isobus.net/isobus/pGNAndSPN/15318?type=PGN. Signal-level enrichment via PR welcome  see CONTRIBUTING.md.";
CM_ SG_ 2566766080 Transit_Route_RawPayload "Generic 8-byte raw payload. Detail page: https://www.isobus.net/isobus/pGNAndSPN/15325?type=PGN. Signal-level enrichment via PR welcome  see CONTRIBUTING.md.";
CM_ SG_ 2566766336 Transit_Milepost_RawPayload "Generic 8-byte raw payload. Detail page: https://www.isobus.net/isobus/pGNAndSPN/15327?type=PGN. Signal-level enrichment via PR welcome  see CONTRIBUTING.md.";
CM_ SG_ 2566766592 Passenger_Counter_RawPayload "Generic 8-byte raw payload. Detail page: https://www.isobus.net/isobus/pGNAndSPN/15332?type=PGN. Signal-level enrichment via PR welcome  see CONTRIBUTING.md.";
CM_ SG_ 2566766848 Engine_Fluid_Level_Pressure_3_Ra "Generic 8-byte raw payload. Detail page: https://www.isobus.net/isobus/pGNAndSPN/15337?type=PGN. Signal-level enrichment via PR welcome  see CONTRIBUTING.md.";
CM_ SG_ 2566767104 Electronic_Engine_Controller_14_ "Generic 8-byte raw payload. Detail page: https://www.isobus.net/isobus/pGNAndSPN/15342?type=PGN. Signal-level enrichment via PR welcome  see CONTRIBUTING.md.";
CM_ SG_ 2566767360 Electronic_Engine_Controller_15_ "Generic 8-byte raw payload. Detail page: https://www.isobus.net/isobus/pGNAndSPN/15347?type=PGN. Signal-level enrichment via PR welcome  see CONTRIBUTING.md.";
CM_ SG_ 2566767616 Electronic_Brake_Controller_5_Ra "Generic 8-byte raw payload. Detail page: https://www.isobus.net/isobus/pGNAndSPN/15360?type=PGN. Signal-level enrichment via PR welcome  see CONTRIBUTING.md.";
CM_ SG_ 2566768128 Cold_Start_Aids_RawPayload "Generic 8-byte raw payload. Detail page: https://www.isobus.net/isobus/pGNAndSPN/15373?type=PGN. Signal-level enrichment via PR welcome  see CONTRIBUTING.md.";
CM_ SG_ 2566768384 Off_Highway_Engine_Control_Selec "Generic 8-byte raw payload. Detail page: https://www.isobus.net/isobus/pGNAndSPN/15383?type=PGN. Signal-level enrichment via PR welcome  see CONTRIBUTING.md.";
CM_ SG_ 2566768640 Operator_Primary_Intermediate_Sp "Generic 8-byte raw payload. Detail page: https://www.isobus.net/isobus/pGNAndSPN/15384?type=PGN. Signal-level enrichment via PR welcome  see CONTRIBUTING.md.";
CM_ SG_ 2566768896 Electronic_Control_Module_Inform "Generic 8-byte raw payload. Detail page: https://www.isobus.net/isobus/pGNAndSPN/15385?type=PGN. Signal-level enrichment via PR welcome  see CONTRIBUTING.md.";
CM_ SG_ 2566769152 Intermediate_Speed_Control_RawPa "Generic 8-byte raw payload. Detail page: https://www.isobus.net/isobus/pGNAndSPN/15386?type=PGN. Signal-level enrichment via PR welcome  see CONTRIBUTING.md.";
CM_ SG_ 2566769408 Off_Highway_Engine_Control_Selec "Generic 8-byte raw payload. Detail page: https://www.isobus.net/isobus/pGNAndSPN/15396?type=PGN. Signal-level enrichment via PR welcome  see CONTRIBUTING.md.";

BA_DEF_ BO_ "SystemMessageLongSymbol" STRING;
BA_DEF_ SG_ "SystemSignalLongSymbol" STRING;
BA_ "SystemMessageLongSymbol" BO_ 2566683904 "VDMA_FC7D_Heating_And_Refrigerating_Unit_2";
BA_ "SystemMessageLongSymbol" BO_ 2566684160 "VDMA_FC7E_Heating_And_Refrigerating_Unit_3";
BA_ "SystemMessageLongSymbol" BO_ 2566684416 "VDMA_FC7F_Heating_And_Refrigerating_Unit_4";
BA_ "SystemMessageLongSymbol" BO_ 2566684672 "VDMA_FC80_HRU_Temperature_Setpoint";
BA_ "SystemMessageLongSymbol" BO_ 2566685696 "VDMA_FC84_Windshield_Wiper_Request";
BA_ "SystemMessageLongSymbol" BO_ 2566685952 "VDMA_FC85_Fuel_Cell_Auxiliary_Heater_Contr";
BA_ "SystemMessageLongSymbol" BO_ 2566686208 "VDMA_FC86_Fuel_Cell_Auxiliary_Heater_Infor";
BA_ "SystemMessageLongSymbol" BO_ 2566686464 "VDMA_FC87_Fuel_Cell_Coolant_Pump_1_Command";
BA_ "SystemMessageLongSymbol" BO_ 2566686720 "VDMA_FC88_Fuel_Cell_Coolant_Pump_2_Command";
BA_ "SystemMessageLongSymbol" BO_ 2566686976 "VDMA_FC89_Fuel_Cell_Coolant_Pump_1_Status";
BA_ "SystemMessageLongSymbol" BO_ 2566687232 "VDMA_FC8A_Fuel_Cell_Coolant_Pump_2_Status";
BA_ "SystemMessageLongSymbol" BO_ 2566687488 "VDMA_FC8B_Aftertreatment_1_Particulate_Sen";
BA_ "SystemMessageLongSymbol" BO_ 2566687744 "VDMA_FC8C_Aftertreatment_1_Particulate_Sen";
BA_ "SystemMessageLongSymbol" BO_ 2566688768 "VDMA_FC90_Engine_Fuel_Injector_Metering_Ra";
BA_ "SystemMessageLongSymbol" BO_ 2566689536 "VDMA_FC93_Gaseous_Fuel_Pressure_2";
BA_ "SystemMessageLongSymbol" BO_ 2566689792 "VDMA_FC94_Aftertreatment_System_Abuse_Info";
BA_ "SystemMessageLongSymbol" BO_ 2566690048 "VDMA_FC95_Engine_Cylinder_Pressure_Monitor";
BA_ "SystemMessageLongSymbol" BO_ 2566690560 "VDMA_FC97_Electronic_Steering_Control_2";
BA_ "SystemMessageLongSymbol" BO_ 2566691072 "VDMA_FC99_Assembly_Unit_Identification";
BA_ "SystemMessageLongSymbol" BO_ 2566692096 "VDMA_FC9D_Engine_Timing_Actuator_Position_";
BA_ "SystemMessageLongSymbol" BO_ 2566692352 "VDMA_FC9E_Engine_Timing_Actuator_Position";
BA_ "SystemMessageLongSymbol" BO_ 2566692864 "VDMA_FCA0_Multi_fuel_Engine_Hours";
BA_ "SystemMessageLongSymbol" BO_ 2566693120 "VDMA_FCA1_Engine_Spark_Misfire_Rate_3";
BA_ "SystemMessageLongSymbol" BO_ 2566693376 "VDMA_FCA2_Engine_Spark_Misfire_Rate_2";
BA_ "SystemMessageLongSymbol" BO_ 2566693632 "VDMA_FCA3_Engine_Spark_Misfire_Rate_1";
BA_ "SystemMessageLongSymbol" BO_ 2566693888 "VDMA_FCA4_Engine_Spark_Maximum_Voltage_6";
BA_ "SystemMessageLongSymbol" BO_ 2566694144 "VDMA_FCA5_Engine_Spark_Maximum_Voltage_5";
BA_ "SystemMessageLongSymbol" BO_ 2566694400 "VDMA_FCA6_Engine_Spark_Maximum_Voltage_4";
BA_ "SystemMessageLongSymbol" BO_ 2566694656 "VDMA_FCA7_Engine_Spark_Maximum_Voltage_3";
BA_ "SystemMessageLongSymbol" BO_ 2566694912 "VDMA_FCA8_Engine_Spark_Maximum_Voltage_2";
BA_ "SystemMessageLongSymbol" BO_ 2566695168 "VDMA_FCA9_Engine_Spark_Maximum_Voltage_1";
BA_ "SystemMessageLongSymbol" BO_ 2566695424 "VDMA_FCAA_Engine_Spark_Minimum_Voltage_6";
BA_ "SystemMessageLongSymbol" BO_ 2566695680 "VDMA_FCAB_Engine_Spark_Minimum_Voltage_5";
BA_ "SystemMessageLongSymbol" BO_ 2566695936 "VDMA_FCAC_Engine_Spark_Minimum_Voltage_4";
BA_ "SystemMessageLongSymbol" BO_ 2566696192 "VDMA_FCAD_Engine_Spark_Minimum_Voltage_3";
BA_ "SystemMessageLongSymbol" BO_ 2566696448 "VDMA_FCAE_Engine_Spark_Minimum_Voltage_2";
BA_ "SystemMessageLongSymbol" BO_ 2566696704 "VDMA_FCAF_Engine_Spark_Minimum_Voltage_1";
BA_ "SystemMessageLongSymbol" BO_ 2566696960 "VDMA_FCB0_Engine_Ignition_Controller_Maint";
BA_ "SystemMessageLongSymbol" BO_ 2566697216 "VDMA_FCB1_Engine_Ignition_Control_Module_S";
BA_ "SystemMessageLongSymbol" BO_ 2566697728 "VDMA_FCB3_Fused_Power_Output_Current";
BA_ "SystemMessageLongSymbol" BO_ 2566697984 "VDMA_FCB4_Switched_Power_Output_Status";
BA_ "SystemMessageLongSymbol" BO_ 2566698240 "VDMA_FCB5_Fused_Power_Output_Status";
BA_ "SystemMessageLongSymbol" BO_ 2566698496 "VDMA_FCB6_Vehicle_Electrical_Power_5";
BA_ "SystemMessageLongSymbol" BO_ 2566698752 "VDMA_FCB7_Hybrid_or_EV_System_Status_2";
BA_ "SystemMessageLongSymbol" BO_ 2566699008 "VDMA_FCB8_Aftertreatment_2_Service_2";
BA_ "SystemMessageLongSymbol" BO_ 2566699264 "VDMA_FCB9_Aftertreatment_1_Service_2";
BA_ "SystemMessageLongSymbol" BO_ 2566699520 "VDMA_FCBA_Aftertreatment_2_SCR_Electronic_";
BA_ "SystemMessageLongSymbol" BO_ 2566699776 "VDMA_FCBB_Aftertreatment_1_SCR_Electronic_";
BA_ "SystemMessageLongSymbol" BO_ 2566700032 "VDMA_FCBC_Aftertreatment_2_SCR_Service_Inf";
BA_ "SystemMessageLongSymbol" BO_ 2566700288 "VDMA_FCBD_Aftertreatment_1_SCR_Service_Inf";
BA_ "SystemMessageLongSymbol" BO_ 2566700544 "VDMA_FCBE_Electronic_Transmission_Controll";
BA_ "SystemMessageLongSymbol" BO_ 2566700800 "VDMA_FCBF_Electronic_Transmission_Controll";
BA_ "SystemMessageLongSymbol" BO_ 2566701056 "VDMA_FCC0_Electronic_Transmission_Controll";
BA_ "SystemMessageLongSymbol" BO_ 2566701568 "VDMA_FCC2_Hybrid_or_EV_System_Status_1";
BA_ "SystemMessageLongSymbol" BO_ 2566701824 "VDMA_FCC3_Fuel_Information_4_Gaseous";
BA_ "SystemMessageLongSymbol" BO_ 2566702080 "VDMA_FCC4_Aftertreatment_2_SCR_Exhaust_Gas";
BA_ "SystemMessageLongSymbol" BO_ 2566702336 "VDMA_FCC5_Aftertreatment_1_SCR_Exhaust_Gas";
BA_ "SystemMessageLongSymbol" BO_ 2566702848 "VDMA_FCC7_Model_Year_and_Certification_Eng";
BA_ "SystemMessageLongSymbol" BO_ 2566703104 "VDMA_FCC8_Electronic_Engine_Controller_13";
BA_ "SystemMessageLongSymbol" BO_ 2566703360 "VDMA_FCC9_Engine_Fuel_Throttle_Valve_Infor";
BA_ "SystemMessageLongSymbol" BO_ 2566703616 "VDMA_FCCA_Engine_Exhaust_Gas_Recirculation";
BA_ "SystemMessageLongSymbol" BO_ 2566703872 "VDMA_FCCB_Engine_Exhaust_Gas_Recirculation";
BA_ "SystemMessageLongSymbol" BO_ 2566704128 "VDMA_FCCC_Electronic_Engine_Controller_12";
BA_ "SystemMessageLongSymbol" BO_ 2566704896 "VDMA_FCCF_NOx_Sensor_Self_Diagnosis_Reques";
BA_ "SystemMessageLongSymbol" BO_ 2566705152 "VDMA_FCD0_Engine_Particulate_Sensor_Inform";
BA_ "SystemMessageLongSymbol" BO_ 2566705408 "VDMA_FCD1_Active_Service_Only_DTCs";
BA_ "SystemMessageLongSymbol" BO_ 2566705664 "VDMA_FCD2_Previously_Active_Service_Only_D";
BA_ "SystemMessageLongSymbol" BO_ 2566705920 "VDMA_FCD3_Diagnostic_Data_Clear_Reset_for_";
BA_ "SystemMessageLongSymbol" BO_ 2566706432 "VDMA_FCD5_Aftertreatment_1_Diesel_Exhaust_";
BA_ "SystemMessageLongSymbol" BO_ 2566706688 "VDMA_FCD6_Aftertreatment_1_Diesel_Particul";
BA_ "SystemMessageLongSymbol" BO_ 2566706944 "VDMA_FCD7_Aftertreatment_1_Diesel_Particul";
BA_ "SystemMessageLongSymbol" BO_ 2566707200 "VDMA_FCD8_Aftertreatment_1_Diesel_Particul";
BA_ "SystemMessageLongSymbol" BO_ 2566707456 "VDMA_FCD9_Aftertreatment_1_Diesel_Particul";
BA_ "SystemMessageLongSymbol" BO_ 2566707712 "VDMA_FCDA_Aftertreatment_1_Diesel_Particul";
BA_ "SystemMessageLongSymbol" BO_ 2566707968 "VDMA_FCDB_Aftertreatment_1_Diesel_Particul";
BA_ "SystemMessageLongSymbol" BO_ 2566708224 "VDMA_FCDC_Cruise_Control_Vehicle_Speed_3";
BA_ "SystemMessageLongSymbol" BO_ 2566708480 "VDMA_FCDD_Aftertreatment_2_Air_Control_3";
BA_ "SystemMessageLongSymbol" BO_ 2566708736 "VDMA_FCDE_Aftertreatment_1_Air_Control_3";
BA_ "SystemMessageLongSymbol" BO_ 2566708992 "VDMA_FCDF_Engine_Fluid_Level_Pressure_12";
BA_ "SystemMessageLongSymbol" BO_ 2566709248 "VDMA_FCE0_Diesel_Particulate_Filter_Contro";
BA_ "SystemMessageLongSymbol" BO_ 2566709760 "VDMA_FCE2_Supplemental_Fan_Status";
BA_ "SystemMessageLongSymbol" BO_ 2566710016 "VDMA_FCE3_Engine_Exhaust_Brake_Control";
BA_ "SystemMessageLongSymbol" BO_ 2566710528 "VDMA_FCE5_Hydraulic_Oil_Properties";
BA_ "SystemMessageLongSymbol" BO_ 2566710784 "VDMA_FCE6_Vehicle_Chassis_Lubrication_Syst";
BA_ "SystemMessageLongSymbol" BO_ 2566711296 "VDMA_FCE8_Intake_Valve_Actuation_Control";
BA_ "SystemMessageLongSymbol" BO_ 2566711552 "VDMA_FCE9_Armrest_Switch_Matrix_Commands";
BA_ "SystemMessageLongSymbol" BO_ 2566711808 "VDMA_FCEA_Vehicle_Electrical_Power_4_obsol";
BA_ "SystemMessageLongSymbol" BO_ 2566712064 "VDMA_FCEB_Aftertreatment_2_NOx_Adsorber_In";
BA_ "SystemMessageLongSymbol" BO_ 2566712320 "VDMA_FCEC_Aftertreatment_1_NOx_Adsorber_In";
BA_ "SystemMessageLongSymbol" BO_ 2566712576 "VDMA_FCED_Aftertreatment_2_Warm_Up_Diesel_";
BA_ "SystemMessageLongSymbol" BO_ 2566712832 "VDMA_FCEE_Land_Leveling_System_Reference_E";
BA_ "SystemMessageLongSymbol" BO_ 2566713088 "VDMA_FCEF_Engine_Fluid_Level_Pressure_11";
BA_ "SystemMessageLongSymbol" BO_ 2566713344 "VDMA_FCF0_Engine_Fuel_Lube_x000D_Systems_2";
BA_ "SystemMessageLongSymbol" BO_ 2566713600 "VDMA_FCF1_Engine_Turbocharger_Wastegate_Ac";
BA_ "SystemMessageLongSymbol" BO_ 2566713856 "VDMA_FCF2_Engine_Fuel_Throttle_Valve_Infor";
BA_ "SystemMessageLongSymbol" BO_ 2566714112 "VDMA_FCF3_Engine_Turbocharger_Compressor_B";
BA_ "SystemMessageLongSymbol" BO_ 2566714624 "VDMA_FCF5_Charge_Air_Cooler_2_Precooler";
BA_ "SystemMessageLongSymbol" BO_ 2566715136 "VDMA_FCF7_Charge_Air_Cooler_1_Precooler";
BA_ "SystemMessageLongSymbol" BO_ 2566715392 "VDMA_FCF8_Diesel_Particulate_Filter_2_Soot";
BA_ "SystemMessageLongSymbol" BO_ 2566715648 "VDMA_FCF9_Diesel_Particulate_Filter_1_Soot";
BA_ "SystemMessageLongSymbol" BO_ 2566715904 "VDMA_FCFA_Electronic_Engine_Controller_11";
BA_ "SystemMessageLongSymbol" BO_ 2566716160 "VDMA_FCFB_Engine_Manifold_Actuator_Positio";
BA_ "SystemMessageLongSymbol" BO_ 2566716416 "VDMA_FCFC_Engine_Manifold_Actuator_Control";
BA_ "SystemMessageLongSymbol" BO_ 2566716672 "VDMA_FCFD_Electronic_Engine_Controller_9";
BA_ "SystemMessageLongSymbol" BO_ 2566716928 "VDMA_FCFE_Electronic_Engine_Controller_10";
BA_ "SystemMessageLongSymbol" BO_ 2566717440 "VDMA_FD00_Engine_Fluid_Level_Pressure_10";
BA_ "SystemMessageLongSymbol" BO_ 2566717696 "VDMA_FD01_Low_Voltage_Disconnect_Status";
BA_ "SystemMessageLongSymbol" BO_ 2566718208 "VDMA_FD03_Implement_Operating_state_comman";
BA_ "SystemMessageLongSymbol" BO_ 2566718464 "VDMA_FD04_Direct_Lamp_Control_Data_2";
BA_ "SystemMessageLongSymbol" BO_ 2566718720 "VDMA_FD05_Direct_Lamp_Control_Data_1";
BA_ "SystemMessageLongSymbol" BO_ 2566718976 "VDMA_FD06_Direct_Lamp_Control_Command_2";
BA_ "SystemMessageLongSymbol" BO_ 2566719232 "VDMA_FD07_Direct_Lamp_Control_Command_1";
BA_ "SystemMessageLongSymbol" BO_ 2566720000 "VDMA_FD0A_Aftertreatment_2_Outlet_Gas_NOx_";
BA_ "SystemMessageLongSymbol" BO_ 2566720256 "VDMA_FD0B_Aftertreatment_2_Outlet_Gas_NOx_";
BA_ "SystemMessageLongSymbol" BO_ 2566720512 "VDMA_FD0C_Aftertreatment_2_Intake_Gas_NOx_";
BA_ "SystemMessageLongSymbol" BO_ 2566720768 "VDMA_FD0D_Aftertreatment_2_Intake_Gas_NOx_";
BA_ "SystemMessageLongSymbol" BO_ 2566721024 "VDMA_FD0E_Aftertreatment_1_Outlet_Gas_NOx_";
BA_ "SystemMessageLongSymbol" BO_ 2566721280 "VDMA_FD0F_Aftertreatment_1_Outlet_Gas_NOx_";
BA_ "SystemMessageLongSymbol" BO_ 2566721536 "VDMA_FD10_Aftertreatment_1_Intake_Gas_NOx_";
BA_ "SystemMessageLongSymbol" BO_ 2566721792 "VDMA_FD11_Aftertreatment_1_Intake_Gas_NOx_";
BA_ "SystemMessageLongSymbol" BO_ 2566722048 "VDMA_FD12_Magnet_Status_Information_1";
BA_ "SystemMessageLongSymbol" BO_ 2566722304 "VDMA_FD13_Magnet_System_Configuration_Info";
BA_ "SystemMessageLongSymbol" BO_ 2566723072 "VDMA_FD16_Occupant_Classification_System_I";
BA_ "SystemMessageLongSymbol" BO_ 2566723328 "VDMA_FD17_Beltlock_and_Airbag_Deactivation";
BA_ "SystemMessageLongSymbol" BO_ 2566723584 "VDMA_FD18_Collision_Sensor_Information";
BA_ "SystemMessageLongSymbol" BO_ 2566723840 "VDMA_FD19_Ignitor_Loop_Information";
BA_ "SystemMessageLongSymbol" BO_ 2566724096 "VDMA_FD1A_Aftertreatment_1_Warm_Up_Diesel_";
BA_ "SystemMessageLongSymbol" BO_ 2566724352 "VDMA_FD1B_Diesel_Particulate_Filter_2_Soot";
BA_ "SystemMessageLongSymbol" BO_ 2566724608 "VDMA_FD1C_Diesel_Particulate_Filter_1_Soot";
BA_ "SystemMessageLongSymbol" BO_ 2566724864 "VDMA_FD1D_Aftertreatment_Differential_Temp";
BA_ "SystemMessageLongSymbol" BO_ 2566725120 "VDMA_FD1E_Aftertreatment_Differential_Temp";
BA_ "SystemMessageLongSymbol" BO_ 2566725376 "VDMA_FD1F_Aftertreatment_2_Diesel_Oxidatio";
BA_ "SystemMessageLongSymbol" BO_ 2566725632 "VDMA_FD20_Aftertreatment_1_Diesel_Oxidatio";
BA_ "SystemMessageLongSymbol" BO_ 2566725888 "VDMA_FD21_Aftertreatment_2_Gas_Oxidation_C";
BA_ "SystemMessageLongSymbol" BO_ 2566726144 "VDMA_FD22_Aftertreatment_1_Gas_Oxidation_C";
BA_ "SystemMessageLongSymbol" BO_ 2566726400 "VDMA_FD23_Extended_Joystick_Message_10";
BA_ "SystemMessageLongSymbol" BO_ 2566726656 "VDMA_FD24_Basic_Joystick_Message_10";
BA_ "SystemMessageLongSymbol" BO_ 2566726912 "VDMA_FD25_Extended_Joystick_Message_9";
BA_ "SystemMessageLongSymbol" BO_ 2566727168 "VDMA_FD26_Basic_Joystick_Message_9";
BA_ "SystemMessageLongSymbol" BO_ 2566727424 "VDMA_FD27_Extended_Joystick_Message_8";
BA_ "SystemMessageLongSymbol" BO_ 2566727680 "VDMA_FD28_Basic_Joystick_Message_8";
BA_ "SystemMessageLongSymbol" BO_ 2566727936 "VDMA_FD29_Extended_Joystick_Message_7";
BA_ "SystemMessageLongSymbol" BO_ 2566728192 "VDMA_FD2A_Basic_Joystick_Message_7";
BA_ "SystemMessageLongSymbol" BO_ 2566728448 "VDMA_FD2B_Extended_Joystick_Message_6";
BA_ "SystemMessageLongSymbol" BO_ 2566728704 "VDMA_FD2C_Basic_Joystick_Message_6";
BA_ "SystemMessageLongSymbol" BO_ 2566728960 "VDMA_FD2D_Extended_Joystick_Message_5";
BA_ "SystemMessageLongSymbol" BO_ 2566729216 "VDMA_FD2E_Basic_Joystick_Message_5";
BA_ "SystemMessageLongSymbol" BO_ 2566729472 "VDMA_FD2F_Extended_Joystick_Message_4";
BA_ "SystemMessageLongSymbol" BO_ 2566729728 "VDMA_FD30_Basic_Joystick_Message_4";
BA_ "SystemMessageLongSymbol" BO_ 2566730496 "VDMA_FD33_Aftertreatment_2_Diesel_Exhaust_";
BA_ "SystemMessageLongSymbol" BO_ 2566730752 "VDMA_FD34_Aftertreatment_2_SCR_Reagant_Tan";
BA_ "SystemMessageLongSymbol" BO_ 2566731008 "VDMA_FD35_Aftertreatment_2_Diesel_Exhaust_";
BA_ "SystemMessageLongSymbol" BO_ 2566731264 "VDMA_FD36_Aftertreatment_2_Diesel_Exhaust_";
BA_ "SystemMessageLongSymbol" BO_ 2566731520 "VDMA_FD37_Aftertreatment_2_SCR_Service_Inf";
BA_ "SystemMessageLongSymbol" BO_ 2566731776 "VDMA_FD38_Aftertreatment_2_SCR_Exhaust_Gas";
BA_ "SystemMessageLongSymbol" BO_ 2566732032 "VDMA_FD39_Aftertreatment_2_SCR_Exhaust_Gas";
BA_ "SystemMessageLongSymbol" BO_ 2566732288 "VDMA_FD3A_Aftertreatment_2_SCR_Dosing_Syst";
BA_ "SystemMessageLongSymbol" BO_ 2566732544 "VDMA_FD3B_Aftertreatment_2_SCR_Dosing_Syst";
BA_ "SystemMessageLongSymbol" BO_ 2566732800 "VDMA_FD3C_Aftertreatment_1_Diesel_Exhaust_";
BA_ "SystemMessageLongSymbol" BO_ 2566733056 "VDMA_FD3D_Aftertreatment_1_SCR_Reagant_Tan";
BA_ "SystemMessageLongSymbol" BO_ 2566733312 "VDMA_FD3E_Aftertreatment_1_SCR_Exhaust_Gas";
BA_ "SystemMessageLongSymbol" BO_ 2566733568 "VDMA_FD3F_Aftertreatment_1_SCR_Exhaust_Gas";
BA_ "SystemMessageLongSymbol" BO_ 2566733824 "VDMA_FD40_Aftertreatment_1_SCR_Dosing_Syst";
BA_ "SystemMessageLongSymbol" BO_ 2566734080 "VDMA_FD41_Aftertreatment_1_SCR_Dosing_Syst";
BA_ "SystemMessageLongSymbol" BO_ 2566734336 "VDMA_FD42_ISOBUS_compliance_certification";
BA_ "SystemMessageLongSymbol" BO_ 2566734848 "VDMA_FD44_Aftertreatment_2_Fuel_Control_2";
BA_ "SystemMessageLongSymbol" BO_ 2566735104 "VDMA_FD45_Aftertreatment_2_Three_Way_Catal";
BA_ "SystemMessageLongSymbol" BO_ 2566735360 "VDMA_FD46_Aftertreatment_1_Three_Way_Catal";
BA_ "SystemMessageLongSymbol" BO_ 2566735616 "VDMA_FD47_Transmission_Mode_Labels";
BA_ "SystemMessageLongSymbol" BO_ 2566735872 "VDMA_FD48_Engine_Exhaust_Bank_2_O2_Fuel_Tr";
BA_ "SystemMessageLongSymbol" BO_ 2566736128 "VDMA_FD49_Engine_Exhaust_Bank_1_O2_Fuel_Tr";
BA_ "SystemMessageLongSymbol" BO_ 2566736384 "VDMA_FD4A_General_Purpose_Message_2_11";
BA_ "SystemMessageLongSymbol" BO_ 2566736640 "VDMA_FD4B_General_Purpose_Message_2_10";
BA_ "SystemMessageLongSymbol" BO_ 2566736896 "VDMA_FD4C_General_Purpose_Message_2_9";
BA_ "SystemMessageLongSymbol" BO_ 2566737152 "VDMA_FD4D_General_Purpose_Message_2_8";
BA_ "SystemMessageLongSymbol" BO_ 2566737408 "VDMA_FD4E_General_Purpose_Message_2_7";
BA_ "SystemMessageLongSymbol" BO_ 2566737664 "VDMA_FD4F_General_Purpose_Message_2_6";
BA_ "SystemMessageLongSymbol" BO_ 2566737920 "VDMA_FD50_General_Purpose_Message_1_9";
BA_ "SystemMessageLongSymbol" BO_ 2566738176 "VDMA_FD51_Aftercooler_Coolant_Control_Valv";
BA_ "SystemMessageLongSymbol" BO_ 2566738432 "VDMA_FD52_Engine_Coolant_Control_Valve_Com";
BA_ "SystemMessageLongSymbol" BO_ 2566738688 "VDMA_FD53_Engine_Average_Information";
BA_ "SystemMessageLongSymbol" BO_ 2566738944 "VDMA_FD54_DTCs_C_Previously_Active";
BA_ "SystemMessageLongSymbol" BO_ 2566739200 "VDMA_FD55_DTCs_C_Confirmed_and_Active";
BA_ "SystemMessageLongSymbol" BO_ 2566739712 "VDMA_FD57_DTCs_B2_Previously_Active";
BA_ "SystemMessageLongSymbol" BO_ 2566739968 "VDMA_FD58_DTCs_B2_Confirmed_and_Active";
BA_ "SystemMessageLongSymbol" BO_ 2566740480 "VDMA_FD5A_DTCs_B1_Previously_Active";
BA_ "SystemMessageLongSymbol" BO_ 2566740736 "VDMA_FD5B_DTCs_B1_Confirmed_and_Active";
BA_ "SystemMessageLongSymbol" BO_ 2566741248 "VDMA_FD5D_DTCs_A_Previously_Active";
BA_ "SystemMessageLongSymbol" BO_ 2566741504 "VDMA_FD5E_DTCs_A_Confirmed_and_Active";
BA_ "SystemMessageLongSymbol" BO_ 2566742016 "VDMA_FD60_Harmonized_B1_Failure_Counts";
BA_ "SystemMessageLongSymbol" BO_ 2566742272 "VDMA_FD61_Harmonized_Cumulative_Continuous";
BA_ "SystemMessageLongSymbol" BO_ 2566742528 "VDMA_FD62_Harmonized_Global_Regulation_Des";
BA_ "SystemMessageLongSymbol" BO_ 2566742784 "VDMA_FD63_Harmonized_Roadworthiness_System";
BA_ "SystemMessageLongSymbol" BO_ 2566743040 "VDMA_FD64_Harmonized_Roadworthiness_Vehicl";
BA_ "SystemMessageLongSymbol" BO_ 2566743296 "VDMA_FD65_Aftertreatment_1_Fuel_Control_2";
BA_ "SystemMessageLongSymbol" BO_ 2566743808 "VDMA_FD67_Zero_Net_Vehicle_Weight_Change";
BA_ "SystemMessageLongSymbol" BO_ 2566744064 "VDMA_FD68_Gross_Combination_Vehicle_Weight";
BA_ "SystemMessageLongSymbol" BO_ 2566744320 "VDMA_FD69_Axle_Group_Calibration_Weights";
BA_ "SystemMessageLongSymbol" BO_ 2566744832 "VDMA_FD6B_Available_Axle_Group_Weights";
BA_ "SystemMessageLongSymbol" BO_ 2566745088 "VDMA_FD6C_Aftertreatment_2_Air_Control_2";
BA_ "SystemMessageLongSymbol" BO_ 2566745344 "VDMA_FD6D_Aftertreatment_1_Air_Control_2";
BA_ "SystemMessageLongSymbol" BO_ 2566745600 "VDMA_FD6E_Aftertreatment_1_SCR_Service_Inf";
BA_ "SystemMessageLongSymbol" BO_ 2566745856 "VDMA_FD6F_Electronic_Engine_Controller_8";
BA_ "SystemMessageLongSymbol" BO_ 2566746368 "VDMA_FD71_Brake_actuator_stroke_status";
BA_ "SystemMessageLongSymbol" BO_ 2566748160 "VDMA_FD78_Aftertreatment_2_Trip_Informatio";
BA_ "SystemMessageLongSymbol" BO_ 2566748416 "VDMA_FD79_Aftertreatment_1_Trip_Informatio";
BA_ "SystemMessageLongSymbol" BO_ 2566748672 "VDMA_FD7A_Aftertreatment_2_Service_1";
BA_ "SystemMessageLongSymbol" BO_ 2566748928 "VDMA_FD7B_Aftertreatment_1_Service_1";
BA_ "SystemMessageLongSymbol" BO_ 2566749696 "VDMA_FD7E_Adaptive_Front_Lighting_System_S";
BA_ "SystemMessageLongSymbol" BO_ 2566750208 "VDMA_FD80_Emission_Related_Permanent_Diagn";
BA_ "SystemMessageLongSymbol" BO_ 2566750976 "VDMA_FD83_Transfer_Case_Information";
BA_ "SystemMessageLongSymbol" BO_ 2566751232 "VDMA_FD84_Engine_Fluid_Level_Pressure_9";
BA_ "SystemMessageLongSymbol" BO_ 2566751488 "VDMA_FD85_Engine_Fluid_Level_Pressure_8";
BA_ "SystemMessageLongSymbol" BO_ 2566751744 "VDMA_FD86_Engine_Fluid_Level_Pressure_7";
BA_ "SystemMessageLongSymbol" BO_ 2566752000 "VDMA_FD87_Engine_Fluid_Level_Pressure_6";
BA_ "SystemMessageLongSymbol" BO_ 2566752256 "VDMA_FD88_Engine_Fluid_Level_Pressure_5";
BA_ "SystemMessageLongSymbol" BO_ 2566752512 "VDMA_FD89_Vehicle_Direction_Speed_2";
BA_ "SystemMessageLongSymbol" BO_ 2566752768 "VDMA_FD8A_SAE_J2012_2_Byte_DTC_Display";
BA_ "SystemMessageLongSymbol" BO_ 2566753024 "VDMA_FD8B_Aftertreatment_2_Gas_Parameters";
BA_ "SystemMessageLongSymbol" BO_ 2566753280 "VDMA_FD8C_Aftertreatment_1_Gas_Parameters";
BA_ "SystemMessageLongSymbol" BO_ 2566753536 "VDMA_FD8D_Utility_Total_AC_Reactive_Energy";
BA_ "SystemMessageLongSymbol" BO_ 2566753792 "VDMA_FD8E_Generator_Total_AC_Reactive_Ener";
BA_ "SystemMessageLongSymbol" BO_ 2566754048 "VDMA_FD8F_Generator_Total_AC_Percent_Power";
BA_ "SystemMessageLongSymbol" BO_ 2566754304 "VDMA_FD90_Advertised_Engine_Torque_Curve";
BA_ "SystemMessageLongSymbol" BO_ 2566754560 "VDMA_FD91_AC_Switching_Device_Status";
BA_ "SystemMessageLongSymbol" BO_ 2566754816 "VDMA_FD92_Engine_Operating_Information";
BA_ "SystemMessageLongSymbol" BO_ 2566755328 "VDMA_FD94_Electronic_Engine_Controller_7";
BA_ "SystemMessageLongSymbol" BO_ 2566755840 "VDMA_FD96_Fuel_Information_2_Liquid";
BA_ "SystemMessageLongSymbol" BO_ 2566756096 "VDMA_FD97_Fuel_Information_3_Liquid";
BA_ "SystemMessageLongSymbol" BO_ 2566756352 "VDMA_FD98_Aftertreatment_1_Historical_Info";
BA_ "SystemMessageLongSymbol" BO_ 2566756608 "VDMA_FD99_Aftertreatment_2_Historical_info";
BA_ "SystemMessageLongSymbol" BO_ 2566756864 "VDMA_FD9A_Electronic_Brake_System_2_4";
BA_ "SystemMessageLongSymbol" BO_ 2566757120 "VDMA_FD9B_Aftertreatment_1_Diesel_Exhaust_";
BA_ "SystemMessageLongSymbol" BO_ 2566757376 "VDMA_FD9C_Sensor_Electrical_Power_2";
BA_ "SystemMessageLongSymbol" BO_ 2566757632 "VDMA_FD9D_Sensor_Electrical_Power_1";
BA_ "SystemMessageLongSymbol" BO_ 2566757888 "VDMA_FD9E_Aftertreatment_2_Air_Control_1";
BA_ "SystemMessageLongSymbol" BO_ 2566758144 "VDMA_FD9F_Aftertreatment_1_Air_Control_1";
BA_ "SystemMessageLongSymbol" BO_ 2566758400 "VDMA_FDA0_Aftertreatment_2_Fuel_Control_1";
BA_ "SystemMessageLongSymbol" BO_ 2566758656 "VDMA_FDA1_Aftertreatment_1_Fuel_Control_1";
BA_ "SystemMessageLongSymbol" BO_ 2566758912 "VDMA_FDA2_Fuel_Information_3_Gaseous";
BA_ "SystemMessageLongSymbol" BO_ 2566759168 "VDMA_FDA3_Electronic_Engine_Controller_6";
BA_ "SystemMessageLongSymbol" BO_ 2566759936 "VDMA_FDA6_Voltage_Regulator_Excitation_Sta";
BA_ "SystemMessageLongSymbol" BO_ 2566760192 "VDMA_FDA7_Voltage_Regulator_Operating_Mode";
BA_ "SystemMessageLongSymbol" BO_ 2566760448 "VDMA_FDA8_Wireless_Communications_Message_";
BA_ "SystemMessageLongSymbol" BO_ 2566760704 "VDMA_FDA9_Wireless_Communications_Message_";
BA_ "SystemMessageLongSymbol" BO_ 2566760960 "VDMA_FDAA_Engine_Fluid_Level_Pressure_4";
BA_ "SystemMessageLongSymbol" BO_ 2566761216 "VDMA_FDAB_Request_For_Complete_Configurabl";
BA_ "SystemMessageLongSymbol" BO_ 2566761472 "VDMA_FDAC_Engine_Fuel_Information";
BA_ "SystemMessageLongSymbol" BO_ 2566761728 "VDMA_FDAD_Request_For_Complete_Configurabl";
BA_ "SystemMessageLongSymbol" BO_ 2566761984 "VDMA_FDAE_Fifth_Wheel_Smart_Systems_2";
BA_ "SystemMessageLongSymbol" BO_ 2566762240 "VDMA_FDAF_Aftertreatment_2_Intermediate_Ga";
BA_ "SystemMessageLongSymbol" BO_ 2566762496 "VDMA_FDB0_Aftertreatment_2_Outlet_Gas_2";
BA_ "SystemMessageLongSymbol" BO_ 2566762752 "VDMA_FDB1_Aftertreatment_2_Intake_Gas_2";
BA_ "SystemMessageLongSymbol" BO_ 2566763008 "VDMA_FDB2_Aftertreatment_1_Intermediate_Ga";
BA_ "SystemMessageLongSymbol" BO_ 2566763264 "VDMA_FDB3_Aftertreatment_1_Outlet_Gas_2";
BA_ "SystemMessageLongSymbol" BO_ 2566763520 "VDMA_FDB4_Aftertreatment_1_Intake_Gas_2";
BA_ "SystemMessageLongSymbol" BO_ 2566763776 "VDMA_FDB5_Emission_Related_Previously_MIL_";
BA_ "SystemMessageLongSymbol" BO_ 2566764800 "VDMA_FDB9_Tire_Pressure_Reference_Informat";
BA_ "SystemMessageLongSymbol" BO_ 2566766848 "VDMA_FDC1_Engine_Fluid_Level_Pressure_3";
BA_ "SystemMessageLongSymbol" BO_ 2566767104 "VDMA_FDC2_Electronic_Engine_Controller_14";
BA_ "SystemMessageLongSymbol" BO_ 2566767360 "VDMA_FDC3_Electronic_Engine_Controller_15";
BA_ "SystemMessageLongSymbol" BO_ 2566767616 "VDMA_FDC4_Electronic_Brake_Controller_5";
BA_ "SystemMessageLongSymbol" BO_ 2566768384 "VDMA_FDC7_Off_Highway_Engine_Control_Selec";
BA_ "SystemMessageLongSymbol" BO_ 2566768640 "VDMA_FDC8_Operator_Primary_Intermediate_Sp";
BA_ "SystemMessageLongSymbol" BO_ 2566768896 "VDMA_FDC9_Electronic_Control_Module_Inform";
BA_ "SystemMessageLongSymbol" BO_ 2566769152 "VDMA_FDCA_Intermediate_Speed_Control";
BA_ "SystemMessageLongSymbol" BO_ 2566769408 "VDMA_FDCB_Off_Highway_Engine_Control_Selec";
