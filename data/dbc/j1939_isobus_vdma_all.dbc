VERSION "created by canmatrix"

NS_ :

BS_:

BU_:

BA_DEF_ BO_ "SystemMessageLongSymbol" STRING;
BA_DEF_ SG_ "GenSigStartValue" FLOAT 0 100000000000;
BA_DEF_ SG_ "SystemSignalLongSymbol" STRING;

VERSION "created by canmatrix"

NS_ :

BS_:

BU_:

BA_DEF_ BO_ "SystemMessageLongSymbol" STRING;
BA_DEF_ SG_ "GenSigStartValue" FLOAT 0 100000000000;
BA_DEF_ SG_ "SystemSignalLongSymbol" STRING;

VERSION "created by canmatrix"

NS_ :

BS_:

BU_:

BO_ 2565875712 VDMA_F028_Aftertreatment_2_SCR_A: 8 Vector__XXX
 SG_ Aftertreatment_2_SCR_Ammonia_Inf : 0|64@1+ (1,0) [0|18446744073709551615] "" Vector__XXX

BO_ 2565875968 VDMA_F029_Slope_Sensor_Informati: 8 Vector__XXX
 SG_ Slope_Sensor_Information_2_RawPa : 0|64@1+ (1,0) [0|18446744073709551615] "" Vector__XXX

BO_ 2565876224 VDMA_F02A_Angular_Rate_Informati: 8 Vector__XXX
 SG_ Angular_Rate_Information_RawPayl : 0|64@1+ (1,0) [0|18446744073709551615] "" Vector__XXX

BO_ 2565876480 VDMA_F02B_Crash_Notification: 8 Vector__XXX
 SG_ Crash_Notification_RawPayload : 0|64@1+ (1,0) [0|18446744073709551615] "" Vector__XXX

BO_ 2565876736 VDMA_F02C_Magnet_Status_Informat: 8 Vector__XXX
 SG_ Magnet_Status_Information_2_RawP : 0|64@1+ (1,0) [0|18446744073709551615] "" Vector__XXX

BO_ 2565876992 VDMA_F02D_Acceleration_Sensor: 8 Vector__XXX
 SG_ Acceleration_Sensor_RawPayload : 0|64@1+ (1,0) [0|18446744073709551615] "" Vector__XXX

BO_ 2565877248 VDMA_F02E_Engine_Turbocharger_Co: 8 Vector__XXX
 SG_ Engine_Turbocharger_Control_1_Ra : 0|64@1+ (1,0) [0|18446744073709551615] "" Vector__XXX

BO_ 2565877504 VDMA_F02F_Advanced_Emergency_Bra: 8 Vector__XXX
 SG_ Advanced_Emergency_Braking_Syste : 0|64@1+ (1,0) [0|18446744073709551615] "" Vector__XXX

BO_ 2565877760 VDMA_F030_Wireless_Status: 8 Vector__XXX
 SG_ Wireless_Status_RawPayload : 0|64@1+ (1,0) [0|18446744073709551615] "" Vector__XXX

BO_ 2565878016 VDMA_F031_Wand_Sensor: 8 Vector__XXX
 SG_ Wand_Sensor_RawPayload : 0|64@1+ (1,0) [0|18446744073709551615] "" Vector__XXX

BO_ 2565878272 VDMA_F032_Linear_Displacement_Se: 8 Vector__XXX
 SG_ Linear_Displacement_Sensor_RawPa : 0|64@1+ (1,0) [0|18446744073709551615] "" Vector__XXX

BO_ 2565878528 VDMA_F033_Aftertreatment_1_SCR_A: 8 Vector__XXX
 SG_ Aftertreatment_1_SCR_Ammonia_Inf : 0|64@1+ (1,0) [0|18446744073709551615] "" Vector__XXX

BO_ 2565878784 VDMA_F034_Aftertreatment_2_SCR_A: 8 Vector__XXX
 SG_ Aftertreatment_2_SCR_Ammonia_Inf : 0|64@1+ (1,0) [0|18446744073709551615] "" Vector__XXX

BO_ 2565879296 VDMA_F036_High_Voltage_Energy_St: 8 Vector__XXX
 SG_ High_Voltage_Energy_Storage_Syst : 0|64@1+ (1,0) [0|18446744073709551615] "" Vector__XXX

BO_ 2565879552 VDMA_F037_Engine_Turbocharger_Bl: 8 Vector__XXX
 SG_ Engine_Turbocharger_Blowoff_Actu : 0|64@1+ (1,0) [0|18446744073709551615] "" Vector__XXX

BO_ 2565879808 VDMA_F038_Engine_Torque_Fuel_Req: 8 Vector__XXX
 SG_ Engine_Torque_Fuel_Request_RawPa : 0|64@1+ (1,0) [0|18446744073709551615] "" Vector__XXX

BO_ 2565880064 VDMA_F039_Engine_Air_System_Info: 8 Vector__XXX
 SG_ Engine_Air_System_Information_Ra : 0|64@1+ (1,0) [0|18446744073709551615] "" Vector__XXX

BO_ 2565880320 VDMA_F03A_Engine_Cylinder_1_Comb: 8 Vector__XXX
 SG_ Engine_Cylinder_1_Combustion_Inf : 0|64@1+ (1,0) [0|18446744073709551615] "" Vector__XXX

BO_ 2565880576 VDMA_F03B_Engine_Cylinder_2_Comb: 8 Vector__XXX
 SG_ Engine_Cylinder_2_Combustion_Inf : 0|64@1+ (1,0) [0|18446744073709551615] "" Vector__XXX

BO_ 2565880832 VDMA_F03C_Engine_Cylinder_3_Comb: 8 Vector__XXX
 SG_ Engine_Cylinder_3_Combustion_Inf : 0|64@1+ (1,0) [0|18446744073709551615] "" Vector__XXX

BO_ 2565881088 VDMA_F03D_Engine_Cylinder_4_Comb: 8 Vector__XXX
 SG_ Engine_Cylinder_4_Combustion_Inf : 0|64@1+ (1,0) [0|18446744073709551615] "" Vector__XXX

BO_ 2565881344 VDMA_F03E_Engine_Cylinder_5_Comb: 8 Vector__XXX
 SG_ Engine_Cylinder_5_Combustion_Inf : 0|64@1+ (1,0) [0|18446744073709551615] "" Vector__XXX

BO_ 2565881600 VDMA_F03F_Engine_Cylinder_6_Comb: 8 Vector__XXX
 SG_ Engine_Cylinder_6_Combustion_Inf : 0|64@1+ (1,0) [0|18446744073709551615] "" Vector__XXX

BO_ 2565881856 VDMA_F040_Engine_Cylinder_7_Comb: 8 Vector__XXX
 SG_ Engine_Cylinder_7_Combustion_Inf : 0|64@1+ (1,0) [0|18446744073709551615] "" Vector__XXX

BO_ 2565882112 VDMA_F041_Engine_Cylinder_8_Comb: 8 Vector__XXX
 SG_ Engine_Cylinder_8_Combustion_Inf : 0|64@1+ (1,0) [0|18446744073709551615] "" Vector__XXX

BO_ 2565882368 VDMA_F042_Engine_Cylinder_9_Comb: 8 Vector__XXX
 SG_ Engine_Cylinder_9_Combustion_Inf : 0|64@1+ (1,0) [0|18446744073709551615] "" Vector__XXX

BO_ 2565882624 VDMA_F043_Engine_Cylinder_10_Com: 8 Vector__XXX
 SG_ Engine_Cylinder_10_Combustion_In : 0|64@1+ (1,0) [0|18446744073709551615] "" Vector__XXX

BO_ 2565882880 VDMA_F044_Engine_Cylinder_11_Com: 8 Vector__XXX
 SG_ Engine_Cylinder_11_Combustion_In : 0|64@1+ (1,0) [0|18446744073709551615] "" Vector__XXX

BO_ 2565883136 VDMA_F045_Engine_Cylinder_12_Com: 8 Vector__XXX
 SG_ Engine_Cylinder_12_Combustion_In : 0|64@1+ (1,0) [0|18446744073709551615] "" Vector__XXX

BO_ 2565883392 VDMA_F046_Engine_Cylinder_13_Com: 8 Vector__XXX
 SG_ Engine_Cylinder_13_Combustion_In : 0|64@1+ (1,0) [0|18446744073709551615] "" Vector__XXX

BO_ 2565883648 VDMA_F047_Engine_Cylinder_14_Com: 8 Vector__XXX
 SG_ Engine_Cylinder_14_Combustion_In : 0|64@1+ (1,0) [0|18446744073709551615] "" Vector__XXX

BO_ 2565883904 VDMA_F048_Engine_Cylinder_15_Com: 8 Vector__XXX
 SG_ Engine_Cylinder_15_Combustion_In : 0|64@1+ (1,0) [0|18446744073709551615] "" Vector__XXX

BO_ 2565884160 VDMA_F049_Engine_Cylinder_16_Com: 8 Vector__XXX
 SG_ Engine_Cylinder_16_Combustion_In : 0|64@1+ (1,0) [0|18446744073709551615] "" Vector__XXX

BO_ 2565884416 VDMA_F04A_Engine_Cylinder_17_Com: 8 Vector__XXX
 SG_ Engine_Cylinder_17_Combustion_In : 0|64@1+ (1,0) [0|18446744073709551615] "" Vector__XXX

BO_ 2565884672 VDMA_F04B_Engine_Cylinder_18_Com: 8 Vector__XXX
 SG_ Engine_Cylinder_18_Combustion_In : 0|64@1+ (1,0) [0|18446744073709551615] "" Vector__XXX

BO_ 2565884928 VDMA_F04C_Engine_Cylinder_19_Com: 8 Vector__XXX
 SG_ Engine_Cylinder_19_Combustion_In : 0|64@1+ (1,0) [0|18446744073709551615] "" Vector__XXX

BO_ 2565885184 VDMA_F04D_Engine_Cylinder_20_Com: 8 Vector__XXX
 SG_ Engine_Cylinder_20_Combustion_In : 0|64@1+ (1,0) [0|18446744073709551615] "" Vector__XXX

BO_ 2565885440 VDMA_F04E_Engine_Cylinder_1_Comb: 8 Vector__XXX
 SG_ Engine_Cylinder_1_Combustion_Ave : 0|64@1+ (1,0) [0|18446744073709551615] "" Vector__XXX

BO_ 2565885696 VDMA_F04F_Engine_Cylinder_2_Comb: 8 Vector__XXX
 SG_ Engine_Cylinder_2_Combustion_Ave : 0|64@1+ (1,0) [0|18446744073709551615] "" Vector__XXX

BO_ 2565885952 VDMA_F050_Engine_Cylinder_3_Comb: 8 Vector__XXX
 SG_ Engine_Cylinder_3_Combustion_Ave : 0|64@1+ (1,0) [0|18446744073709551615] "" Vector__XXX

BO_ 2565886208 VDMA_F051_Engine_Cylinder_4_Comb: 8 Vector__XXX
 SG_ Engine_Cylinder_4_Combustion_Ave : 0|64@1+ (1,0) [0|18446744073709551615] "" Vector__XXX

BO_ 2565886464 VDMA_F052_Engine_Cylinder_5_Comb: 8 Vector__XXX
 SG_ Engine_Cylinder_5_Combustion_Ave : 0|64@1+ (1,0) [0|18446744073709551615] "" Vector__XXX

BO_ 2565886720 VDMA_F053_Engine_Cylinder_6_Comb: 8 Vector__XXX
 SG_ Engine_Cylinder_6_Combustion_Ave : 0|64@1+ (1,0) [0|18446744073709551615] "" Vector__XXX

BO_ 2565886976 VDMA_F054_Engine_Cylinder_7_Comb: 8 Vector__XXX
 SG_ Engine_Cylinder_7_Combustion_Ave : 0|64@1+ (1,0) [0|18446744073709551615] "" Vector__XXX

BO_ 2565887232 VDMA_F055_Engine_Cylinder_8_Comb: 8 Vector__XXX
 SG_ Engine_Cylinder_8_Combustion_Ave : 0|64@1+ (1,0) [0|18446744073709551615] "" Vector__XXX

BO_ 2565887488 VDMA_F056_Engine_Cylinder_9_Comb: 8 Vector__XXX
 SG_ Engine_Cylinder_9_Combustion_Ave : 0|64@1+ (1,0) [0|18446744073709551615] "" Vector__XXX

BO_ 2565887744 VDMA_F057_Engine_Cylinder_10_Com: 8 Vector__XXX
 SG_ Engine_Cylinder_10_Combustion_Av : 0|64@1+ (1,0) [0|18446744073709551615] "" Vector__XXX

BO_ 2565888000 VDMA_F058_Engine_Cylinder_11_Com: 8 Vector__XXX
 SG_ Engine_Cylinder_11_Combustion_Av : 0|64@1+ (1,0) [0|18446744073709551615] "" Vector__XXX

BO_ 2565888256 VDMA_F059_Engine_Cylinder_12_Com: 8 Vector__XXX
 SG_ Engine_Cylinder_12_Combustion_Av : 0|64@1+ (1,0) [0|18446744073709551615] "" Vector__XXX

BO_ 2565888512 VDMA_F05A_Engine_Cylinder_13_Com: 8 Vector__XXX
 SG_ Engine_Cylinder_13_Combustion_Av : 0|64@1+ (1,0) [0|18446744073709551615] "" Vector__XXX

BO_ 2565888768 VDMA_F05B_Engine_Cylinder_14_Com: 8 Vector__XXX
 SG_ Engine_Cylinder_14_Combustion_Av : 0|64@1+ (1,0) [0|18446744073709551615] "" Vector__XXX

BO_ 2565889024 VDMA_F05C_Engine_Cylinder_15_Com: 8 Vector__XXX
 SG_ Engine_Cylinder_15_Combustion_Av : 0|64@1+ (1,0) [0|18446744073709551615] "" Vector__XXX

BO_ 2565889280 VDMA_F05D_Engine_Cylinder_16_Com: 8 Vector__XXX
 SG_ Engine_Cylinder_16_Combustion_Av : 0|64@1+ (1,0) [0|18446744073709551615] "" Vector__XXX

BO_ 2565889536 VDMA_F05E_Engine_Cylinder_17_Com: 8 Vector__XXX
 SG_ Engine_Cylinder_17_Combustion_Av : 0|64@1+ (1,0) [0|18446744073709551615] "" Vector__XXX

BO_ 2565889792 VDMA_F05F_Engine_Cylinder_18_Com: 8 Vector__XXX
 SG_ Engine_Cylinder_18_Combustion_Av : 0|64@1+ (1,0) [0|18446744073709551615] "" Vector__XXX

BO_ 2565890048 VDMA_F060_Engine_Cylinder_19_Com: 8 Vector__XXX
 SG_ Engine_Cylinder_19_Combustion_Av : 0|64@1+ (1,0) [0|18446744073709551615] "" Vector__XXX

BO_ 2565890304 VDMA_F061_Engine_Cylinder_20_Com: 8 Vector__XXX
 SG_ Engine_Cylinder_20_Combustion_Av : 0|64@1+ (1,0) [0|18446744073709551615] "" Vector__XXX

BO_ 2565890560 VDMA_F062_Electronic_Transmissio: 8 Vector__XXX
 SG_ Electronic_Transmission_Controll : 0|64@1+ (1,0) [0|18446744073709551615] "" Vector__XXX

BO_ 2565890816 VDMA_F063_Fuel_Information_5_Gas: 8 Vector__XXX
 SG_ Fuel_Information_5_Gaseous_RawPa : 0|64@1+ (1,0) [0|18446744073709551615] "" Vector__XXX

BO_ 2565891072 VDMA_F064_Engine_Gaseous_Fuel_Va: 8 Vector__XXX
 SG_ Engine_Gaseous_Fuel_Valve_Durati : 0|64@1+ (1,0) [0|18446744073709551615] "" Vector__XXX

BO_ 2565891328 VDMA_F065_Engine_Gaseous_Fuel_Va: 8 Vector__XXX
 SG_ Engine_Gaseous_Fuel_Valve_Durati : 0|64@1+ (1,0) [0|18446744073709551615] "" Vector__XXX

BO_ 2565891584 VDMA_F066_Engine_Gaseous_Fuel_Va: 8 Vector__XXX
 SG_ Engine_Gaseous_Fuel_Valve_Durati : 0|64@1+ (1,0) [0|18446744073709551615] "" Vector__XXX

BO_ 2565891840 VDMA_F067_Engine_Gaseous_Fuel_Va: 8 Vector__XXX
 SG_ Engine_Gaseous_Fuel_Valve_Durati : 0|64@1+ (1,0) [0|18446744073709551615] "" Vector__XXX

BO_ 2565892096 VDMA_F068_Engine_Gaseous_Fuel_Va: 8 Vector__XXX
 SG_ Engine_Gaseous_Fuel_Valve_Durati : 0|64@1+ (1,0) [0|18446744073709551615] "" Vector__XXX

BO_ 2565892352 VDMA_F069_Engine_Gaseous_Fuel_Va: 8 Vector__XXX
 SG_ Engine_Gaseous_Fuel_Valve_Start_ : 0|64@1+ (1,0) [0|18446744073709551615] "" Vector__XXX

BO_ 2565892608 VDMA_F06A_Engine_Gaseous_Fuel_Va: 8 Vector__XXX
 SG_ Engine_Gaseous_Fuel_Valve_Start_ : 0|64@1+ (1,0) [0|18446744073709551615] "" Vector__XXX

BO_ 2565892864 VDMA_F06B_Engine_Gaseous_Fuel_Va: 8 Vector__XXX
 SG_ Engine_Gaseous_Fuel_Valve_Start_ : 0|64@1+ (1,0) [0|18446744073709551615] "" Vector__XXX

BO_ 2565893120 VDMA_F06C_Engine_Gaseous_Fuel_Va: 8 Vector__XXX
 SG_ Engine_Gaseous_Fuel_Valve_Start_ : 0|64@1+ (1,0) [0|18446744073709551615] "" Vector__XXX

BO_ 2565893376 VDMA_F06D_Engine_Gaseous_Fuel_Va: 8 Vector__XXX
 SG_ Engine_Gaseous_Fuel_Valve_Start_ : 0|64@1+ (1,0) [0|18446744073709551615] "" Vector__XXX

BO_ 2565893632 VDMA_F06E_Fuel_Pump_Actuator_Con: 8 Vector__XXX
 SG_ Fuel_Pump_Actuator_Control_Comma : 0|64@1+ (1,0) [0|18446744073709551615] "" Vector__XXX

BO_ 2565893888 VDMA_F06F_Power_Converter_1_Cont: 8 Vector__XXX
 SG_ Power_Converter_1_Control_1_RawP : 0|64@1+ (1,0) [0|18446744073709551615] "" Vector__XXX

BO_ 2565894144 VDMA_F070_Power_Converter_2_Cont: 8 Vector__XXX
 SG_ Power_Converter_2_Control_1_RawP : 0|64@1+ (1,0) [0|18446744073709551615] "" Vector__XXX

BO_ 2565894400 VDMA_F071_Power_Converter_1_Rate: 8 Vector__XXX
 SG_ Power_Converter_1_Rate_Limits_Re : 0|64@1+ (1,0) [0|18446744073709551615] "" Vector__XXX

BO_ 2565894656 VDMA_F072_Power_Converter_2_Rate: 8 Vector__XXX
 SG_ Power_Converter_2_Rate_Limits_Re : 0|64@1+ (1,0) [0|18446744073709551615] "" Vector__XXX

BO_ 2565894912 VDMA_F073_Power_Converter_2_Cont: 8 Vector__XXX
 SG_ Power_Converter_2_Control_2_RawP : 0|64@1+ (1,0) [0|18446744073709551615] "" Vector__XXX

BO_ 2565895168 VDMA_F074_Power_Converter_1_Cont: 8 Vector__XXX
 SG_ Power_Converter_1_Control_2_RawP : 0|64@1+ (1,0) [0|18446744073709551615] "" Vector__XXX

BO_ 2565895424 VDMA_F075_Power_Converter_1_Mode: 8 Vector__XXX
 SG_ Power_Converter_1_Mode_Feedback_ : 0|64@1+ (1,0) [0|18446744073709551615] "" Vector__XXX

BO_ 2565895680 VDMA_F076_Power_Converter_1_Limi: 8 Vector__XXX
 SG_ Power_Converter_1_Limits_Active_ : 0|64@1+ (1,0) [0|18446744073709551615] "" Vector__XXX

BO_ 2565895936 VDMA_F077_Power_Converter_1_Limi: 8 Vector__XXX
 SG_ Power_Converter_1_Limits_Active_ : 0|64@1+ (1,0) [0|18446744073709551615] "" Vector__XXX

BO_ 2565896192 VDMA_F078_Power_Converter_1_Limi: 8 Vector__XXX
 SG_ Power_Converter_1_Limits_Active_ : 0|64@1+ (1,0) [0|18446744073709551615] "" Vector__XXX

BO_ 2565896448 VDMA_F079_Power_Converter_1_Low_: 8 Vector__XXX
 SG_ Power_Converter_1_Low_Voltage_Ra : 0|64@1+ (1,0) [0|18446744073709551615] "" Vector__XXX

BO_ 2565896704 VDMA_F07A_Power_Converter_2_Mode: 8 Vector__XXX
 SG_ Power_Converter_2_Mode_Feedback_ : 0|64@1+ (1,0) [0|18446744073709551615] "" Vector__XXX

BO_ 2565896960 VDMA_F07B_Power_Converter_2_Limi: 8 Vector__XXX
 SG_ Power_Converter_2_Limits_Active_ : 0|64@1+ (1,0) [0|18446744073709551615] "" Vector__XXX

BO_ 2565897216 VDMA_F07C_Power_Converter_2_Limi: 8 Vector__XXX
 SG_ Power_Converter_2_Limits_Active_ : 0|64@1+ (1,0) [0|18446744073709551615] "" Vector__XXX

BO_ 2565897472 VDMA_F07D_Power_Converter_2_Limi: 8 Vector__XXX
 SG_ Power_Converter_2_Limits_Active_ : 0|64@1+ (1,0) [0|18446744073709551615] "" Vector__XXX

BO_ 2565897728 VDMA_F07E_Power_Converter_2_Low_: 8 Vector__XXX
 SG_ Power_Converter_2_Low_Voltage_Ra : 0|64@1+ (1,0) [0|18446744073709551615] "" Vector__XXX

BO_ 2565897984 VDMA_F07F_Power_Converter_1_Stat: 8 Vector__XXX
 SG_ Power_Converter_1_Status_2_RawPa : 0|64@1+ (1,0) [0|18446744073709551615] "" Vector__XXX

BO_ 2565898240 VDMA_F080_Power_Converter_1_Rate: 8 Vector__XXX
 SG_ Power_Converter_1_Rate_Limits_Ac : 0|64@1+ (1,0) [0|18446744073709551615] "" Vector__XXX

BO_ 2565898496 VDMA_F081_Power_Converter_2_Stat: 8 Vector__XXX
 SG_ Power_Converter_2_Status_2_RawPa : 0|64@1+ (1,0) [0|18446744073709551615] "" Vector__XXX

BO_ 2565898752 VDMA_F082_Power_Converter_2_Rate: 8 Vector__XXX
 SG_ Power_Converter_2_Rate_Limits_Ac : 0|64@1+ (1,0) [0|18446744073709551615] "" Vector__XXX

BO_ 2565899008 VDMA_F083_Power_Converter_2_Isol: 8 Vector__XXX
 SG_ Power_Converter_2_Isolation_Inte : 0|64@1+ (1,0) [0|18446744073709551615] "" Vector__XXX

BO_ 2565899264 VDMA_F084_Power_Converter_1_Isol: 8 Vector__XXX
 SG_ Power_Converter_1_Isolation_Inte : 0|64@1+ (1,0) [0|18446744073709551615] "" Vector__XXX

BO_ 2565899520 VDMA_F085_Power_Converter_2_Stat: 8 Vector__XXX
 SG_ Power_Converter_2_Status_1_RawPa : 0|64@1+ (1,0) [0|18446744073709551615] "" Vector__XXX

BO_ 2565899776 VDMA_F086_Power_Converter_1_Stat: 8 Vector__XXX
 SG_ Power_Converter_1_Status_1_RawPa : 0|64@1+ (1,0) [0|18446744073709551615] "" Vector__XXX

BO_ 2565900032 VDMA_F087_Wireless_Charger_Syste: 8 Vector__XXX
 SG_ Wireless_Charger_System_Status_1 : 0|64@1+ (1,0) [0|18446744073709551615] "" Vector__XXX

BO_ 2565900288 VDMA_F088_Wireless_Charger_Align: 8 Vector__XXX
 SG_ Wireless_Charger_Alignment_Quali : 0|64@1+ (1,0) [0|18446744073709551615] "" Vector__XXX

BO_ 2565900544 VDMA_F089_Motor_Generator_1_Inve: 8 Vector__XXX
 SG_ Motor_Generator_1_Inverter_Contr : 0|64@1+ (1,0) [0|18446744073709551615] "" Vector__XXX

BO_ 2565900800 VDMA_F08A_Motor_Generator_2_Inve: 8 Vector__XXX
 SG_ Motor_Generator_2_Inverter_Contr : 0|64@1+ (1,0) [0|18446744073709551615] "" Vector__XXX

BO_ 2565901056 VDMA_F08B_Motor_Generator_3_Inve: 8 Vector__XXX
 SG_ Motor_Generator_3_Inverter_Contr : 0|64@1+ (1,0) [0|18446744073709551615] "" Vector__XXX

BO_ 2565901312 VDMA_F08C_Motor_Generator_4_Inve: 8 Vector__XXX
 SG_ Motor_Generator_4_Inverter_Contr : 0|64@1+ (1,0) [0|18446744073709551615] "" Vector__XXX

BO_ 2565901568 VDMA_F08D_Motor_Generator_5_Inve: 8 Vector__XXX
 SG_ Motor_Generator_5_Inverter_Contr : 0|64@1+ (1,0) [0|18446744073709551615] "" Vector__XXX

BO_ 2565901824 VDMA_F08E_Motor_Generator_6_Inve: 8 Vector__XXX
 SG_ Motor_Generator_6_Inverter_Contr : 0|64@1+ (1,0) [0|18446744073709551615] "" Vector__XXX

BO_ 2565902336 VDMA_F090_High_Voltage_Energy_St: 8 Vector__XXX
 SG_ High_Voltage_Energy_Storage_Syst : 0|64@1+ (1,0) [0|18446744073709551615] "" Vector__XXX

BO_ 2565902592 VDMA_F091_High_Voltage_Energy_St: 8 Vector__XXX
 SG_ High_Voltage_Energy_Storage_Syst : 0|64@1+ (1,0) [0|18446744073709551615] "" Vector__XXX

BO_ 2565902848 VDMA_F092_High_Voltage_Energy_St: 8 Vector__XXX
 SG_ High_Voltage_Energy_Storage_Syst : 0|64@1+ (1,0) [0|18446744073709551615] "" Vector__XXX

BO_ 2565903104 VDMA_F093_High_Voltage_Energy_St: 8 Vector__XXX
 SG_ High_Voltage_Energy_Storage_Syst : 0|64@1+ (1,0) [0|18446744073709551615] "" Vector__XXX

BO_ 2565903360 VDMA_F094_High_Voltage_Energy_St: 8 Vector__XXX
 SG_ High_Voltage_Energy_Storage_Syst : 0|64@1+ (1,0) [0|18446744073709551615] "" Vector__XXX

BO_ 2565903616 VDMA_F095_High_Voltage_Energy_St: 8 Vector__XXX
 SG_ High_Voltage_Energy_Storage_Syst : 0|64@1+ (1,0) [0|18446744073709551615] "" Vector__XXX

BO_ 2565903872 VDMA_F096_High_Voltage_Energy_St: 8 Vector__XXX
 SG_ High_Voltage_Energy_Storage_Syst : 0|64@1+ (1,0) [0|18446744073709551615] "" Vector__XXX

BO_ 2565904128 VDMA_F097_Motor_Generator_1_Inve: 8 Vector__XXX
 SG_ Motor_Generator_1_Inverter_Therm : 0|64@1+ (1,0) [0|18446744073709551615] "" Vector__XXX

BO_ 2565904384 VDMA_F098_Motor_Generator_2_Inve: 8 Vector__XXX
 SG_ Motor_Generator_2_Inverter_Therm : 0|64@1+ (1,0) [0|18446744073709551615] "" Vector__XXX

BO_ 2565904640 VDMA_F099_Motor_Generator_3_Inve: 8 Vector__XXX
 SG_ Motor_Generator_3_Inverter_Therm : 0|64@1+ (1,0) [0|18446744073709551615] "" Vector__XXX

BO_ 2565904896 VDMA_F09A_Motor_Generator_4_Inve: 8 Vector__XXX
 SG_ Motor_Generator_4_Inverter_Therm : 0|64@1+ (1,0) [0|18446744073709551615] "" Vector__XXX

BO_ 2565905152 VDMA_F09B_Motor_Generator_5_Inve: 8 Vector__XXX
 SG_ Motor_Generator_5_Inverter_Therm : 0|64@1+ (1,0) [0|18446744073709551615] "" Vector__XXX

BO_ 2565905408 VDMA_F09C_Motor_Generator_6_Inve: 8 Vector__XXX
 SG_ Motor_Generator_6_Inverter_Therm : 0|64@1+ (1,0) [0|18446744073709551615] "" Vector__XXX

BO_ 2565906432 VDMA_F0A0_High_Voltage_Energy_St: 8 Vector__XXX
 SG_ High_Voltage_Energy_Storage_Syst : 0|64@1+ (1,0) [0|18446744073709551615] "" Vector__XXX

BO_ 2565916672 VDMA_F0C8_DC_AC_Accessory_Invert: 8 Vector__XXX
 SG_ DC_AC_Accessory_Inverter_1_Statu : 0|64@1+ (1,0) [0|18446744073709551615] "" Vector__XXX

BO_ 2565916928 VDMA_F0C9_DC_AC_Accessory_Invert: 8 Vector__XXX
 SG_ DC_AC_Accessory_Inverter_1_Volta : 0|64@1+ (1,0) [0|18446744073709551615] "" Vector__XXX

BO_ 2565917184 VDMA_F0CA_DC_AC_Accessory_Invert: 8 Vector__XXX
 SG_ DC_AC_Accessory_Inverter_1_Feedb : 0|64@1+ (1,0) [0|18446744073709551615] "" Vector__XXX

BO_ 2565917440 VDMA_F0CB_DC_AC_Accessory_Invert: 8 Vector__XXX
 SG_ DC_AC_Accessory_Inverter_2_Statu : 0|64@1+ (1,0) [0|18446744073709551615] "" Vector__XXX

BO_ 2565917696 VDMA_F0CC_DC_AC_Accessory_Invert: 8 Vector__XXX
 SG_ DC_AC_Accessory_Inverter_2_Volta : 0|64@1+ (1,0) [0|18446744073709551615] "" Vector__XXX

BO_ 2565917952 VDMA_F0CD_DC_AC_Accessory_Invert: 8 Vector__XXX
 SG_ DC_AC_Accessory_Inverter_2_Feedb : 0|64@1+ (1,0) [0|18446744073709551615] "" Vector__XXX

BO_ 2565918208 VDMA_F0CE_Engine_Turbocharger_Co: 8 Vector__XXX
 SG_ Engine_Turbocharger_Control_4_Ra : 0|64@1+ (1,0) [0|18446744073709551615] "" Vector__XXX

BO_ 2565918464 VDMA_F0CF_Engine_Turbocharger_Wa: 8 Vector__XXX
 SG_ Engine_Turbocharger_Wastegate_Ac : 0|64@1+ (1,0) [0|18446744073709551615] "" Vector__XXX

BO_ 2565918720 VDMA_F0D0_Engine_Cylinder_Combus: 8 Vector__XXX
 SG_ Engine_Cylinder_Combustion_Reque : 0|64@1+ (1,0) [0|18446744073709551615] "" Vector__XXX

BO_ 2565918976 VDMA_F0D1_Engine_Cylinder_Head_B: 8 Vector__XXX
 SG_ Engine_Cylinder_Head_Bypass_Actu : 0|64@1+ (1,0) [0|18446744073709551615] "" Vector__XXX

BO_ 2565919232 VDMA_F0D2_Engine_Electronic_Cont: 8 Vector__XXX
 SG_ Engine_Electronic_Controller_18_ : 0|64@1+ (1,0) [0|18446744073709551615] "" Vector__XXX

BO_ 2565919488 VDMA_F0D3_Predictive_Cruise_Cont: 8 Vector__XXX
 SG_ Predictive_Cruise_Control_1_RawP : 0|64@1+ (1,0) [0|18446744073709551615] "" Vector__XXX

BO_ 2565920256 VDMA_F0D6_DC_AC_Accessory_Invert: 8 Vector__XXX
 SG_ DC_AC_Accessory_Inverter_1_Comma : 0|64@1+ (1,0) [0|18446744073709551615] "" Vector__XXX

BO_ 2565920512 VDMA_F0D7_DC_AC_Accessory_Invert: 8 Vector__XXX
 SG_ DC_AC_Accessory_Inverter_1_Feedb : 0|64@1+ (1,0) [0|18446744073709551615] "" Vector__XXX

BO_ 2565921280 VDMA_F0DA_DC_AC_Accessory_Invert: 8 Vector__XXX
 SG_ DC_AC_Accessory_Inverter_2_Comma : 0|64@1+ (1,0) [0|18446744073709551615] "" Vector__XXX

BO_ 2565921536 VDMA_F0DB_DC_AC_Accessory_Invert: 8 Vector__XXX
 SG_ DC_AC_Accessory_Inverter_2_Feedb : 0|64@1+ (1,0) [0|18446744073709551615] "" Vector__XXX

BO_ 2565922304 VDMA_F0DE_DC_AC_Accessory_Invert: 8 Vector__XXX
 SG_ DC_AC_Accessory_Inverter_3_Comma : 0|64@1+ (1,0) [0|18446744073709551615] "" Vector__XXX

BO_ 2565922560 VDMA_F0DF_DC_AC_Accessory_Invert: 8 Vector__XXX
 SG_ DC_AC_Accessory_Inverter_3_Feedb : 0|64@1+ (1,0) [0|18446744073709551615] "" Vector__XXX

BO_ 2565923328 VDMA_F0E2_DC_AC_Accessory_Invert: 8 Vector__XXX
 SG_ DC_AC_Accessory_Inverter_4_Comma : 0|64@1+ (1,0) [0|18446744073709551615] "" Vector__XXX

BO_ 2565923584 VDMA_F0E3_DC_AC_Accessory_Invert: 8 Vector__XXX
 SG_ DC_AC_Accessory_Inverter_4_Feedb : 0|64@1+ (1,0) [0|18446744073709551615] "" Vector__XXX

BO_ 2565924096 VDMA_F0E5_Engine_Ignition_Timing: 8 Vector__XXX
 SG_ Engine_Ignition_Timing_Offset_1_ : 0|64@1+ (1,0) [0|18446744073709551615] "" Vector__XXX

BO_ 2565924352 VDMA_F0E6_Engine_Ignition_Timing: 8 Vector__XXX
 SG_ Engine_Ignition_Timing_Offset_2_ : 0|64@1+ (1,0) [0|18446744073709551615] "" Vector__XXX

BO_ 2565924608 VDMA_F0E7_Engine_Ignition_Timing: 8 Vector__XXX
 SG_ Engine_Ignition_Timing_Offset_3_ : 0|64@1+ (1,0) [0|18446744073709551615] "" Vector__XXX

BO_ 2565924864 VDMA_F0E8_Engine_Throttle_Fuel_A: 8 Vector__XXX
 SG_ Engine_Throttle_Fuel_Actuator_Co : 0|64@1+ (1,0) [0|18446744073709551615] "" Vector__XXX

BO_ 2565925120 VDMA_F0E9_Aftertreatment_1_Intak: 8 Vector__XXX
 SG_ Aftertreatment_1_Intake_Gas_3_Ra : 0|64@1+ (1,0) [0|18446744073709551615] "" Vector__XXX

BO_ 2565925376 VDMA_F0EA_Aftertreatment_1_Outle: 8 Vector__XXX
 SG_ Aftertreatment_1_Outlet_Gas_3_Ra : 0|64@1+ (1,0) [0|18446744073709551615] "" Vector__XXX

BO_ 2565925632 VDMA_F0EB_Aftertreatment_2_Intak: 8 Vector__XXX
 SG_ Aftertreatment_2_Intake_Gas_3_Ra : 0|64@1+ (1,0) [0|18446744073709551615] "" Vector__XXX

BO_ 2565925888 VDMA_F0EC_Aftertreatment_2_Outle: 8 Vector__XXX
 SG_ Aftertreatment_2_Outlet_Gas_3_Ra : 0|64@1+ (1,0) [0|18446744073709551615] "" Vector__XXX

BO_ 2565926144 VDMA_F0ED_Engine_Start_Control: 8 Vector__XXX
 SG_ Engine_Start_Control_RawPayload : 0|64@1+ (1,0) [0|18446744073709551615] "" Vector__XXX

BO_ 2565927936 VDMA_F0F4_Genset_Reactive_Power_: 8 Vector__XXX
 SG_ Genset_Reactive_Power_and_Suppor : 0|64@1+ (1,0) [0|18446744073709551615] "" Vector__XXX

BO_ 2565928192 VDMA_F0F5_Engine_Start_Arbitrato: 8 Vector__XXX
 SG_ Engine_Start_Arbitrator_RawPaylo : 0|64@1+ (1,0) [0|18446744073709551615] "" Vector__XXX

BO_ 2565928448 VDMA_F0F6_Advanced_Driver_Assist: 8 Vector__XXX
 SG_ Advanced_Driver_Assistance_Syste : 0|64@1+ (1,0) [0|18446744073709551615] "" Vector__XXX

BO_ 2565928704 VDMA_F0F7_Advanced_Driver_Assist: 8 Vector__XXX
 SG_ Advanced_Driver_Assistance_Syste : 0|64@1+ (1,0) [0|18446744073709551615] "" Vector__XXX

BO_ 2565928960 VDMA_F0F8_Advanced_Driver_Assist: 8 Vector__XXX
 SG_ Advanced_Driver_Assistance_Syste : 0|64@1+ (1,0) [0|18446744073709551615] "" Vector__XXX

BO_ 2565929216 VDMA_F0F9_Engine_Valve_Controlle: 8 Vector__XXX
 SG_ Engine_Valve_Controller_RawPaylo : 0|64@1+ (1,0) [0|18446744073709551615] "" Vector__XXX

BO_ 2565929472 VDMA_F0FA_Electronic_Transmissio: 8 Vector__XXX
 SG_ Electronic_Transmission_Controll : 0|64@1+ (1,0) [0|18446744073709551615] "" Vector__XXX

BO_ 2565929728 VDMA_F0FB_Aftertreatment_1_SCR_D: 8 Vector__XXX
 SG_ Aftertreatment_1_SCR_Dosing_Syst : 0|64@1+ (1,0) [0|18446744073709551615] "" Vector__XXX

BO_ 2565929984 VDMA_F0FC_Aftertreatment_2_SCR_D: 8 Vector__XXX
 SG_ Aftertreatment_2_SCR_Dosing_Syst : 0|64@1+ (1,0) [0|18446744073709551615] "" Vector__XXX

BO_ 2565930240 VDMA_F0FD_Aftertreatment_1_SCR_D: 8 Vector__XXX
 SG_ Aftertreatment_1_SCR_Dosing_Syst : 0|64@1+ (1,0) [0|18446744073709551615] "" Vector__XXX

BO_ 2565930496 VDMA_F0FE_Aftertreatment_2_SCR_D: 8 Vector__XXX
 SG_ Aftertreatment_2_SCR_Dosing_Syst : 0|64@1+ (1,0) [0|18446744073709551615] "" Vector__XXX

BO_ 2565930752 VDMA_F0FF_Secondary_or_Front_Hit: 8 Vector__XXX
 SG_ Secondary_or_Front_Hitch_Roll_an : 0|64@1+ (1,0) [0|18446744073709551615] "" Vector__XXX

BO_ 2565931008 VDMA_F100_Secondary_or_Front_Hit: 8 Vector__XXX
 SG_ Secondary_or_Front_Hitch_Roll_an : 0|64@1+ (1,0) [0|18446744073709551615] "" Vector__XXX

BO_ 2565931264 VDMA_F101_Primary_or_Rear_Hitch_: 8 Vector__XXX
 SG_ Primary_or_Rear_Hitch_Roll_and_P : 0|64@1+ (1,0) [0|18446744073709551615] "" Vector__XXX

BO_ 2565931520 VDMA_F102_Primary_or_Rear_Hitch_: 8 Vector__XXX
 SG_ Primary_or_Rear_Hitch_Roll_and_P : 0|64@1+ (1,0) [0|18446744073709551615] "" Vector__XXX

BO_ 2565931776 VDMA_F103_Generator_Trip_Energy: 8 Vector__XXX
 SG_ Generator_Trip_Energy_RawPayload : 0|64@1+ (1,0) [0|18446744073709551615] "" Vector__XXX

BO_ 2565932032 VDMA_F104_Engine_Speed_Sensor_In: 8 Vector__XXX
 SG_ Engine_Speed_Sensor_Information_ : 0|64@1+ (1,0) [0|18446744073709551615] "" Vector__XXX

BO_ 2565932288 VDMA_F105_Hydraulic_Pressure_Dis: 8 Vector__XXX
 SG_ Hydraulic_Pressure_Displacement_ : 0|64@1+ (1,0) [0|18446744073709551615] "" Vector__XXX

BO_ 2565932544 VDMA_F106_Well_Stimulation_Pump_: 8 Vector__XXX
 SG_ Well_Stimulation_Pump_System_1_R : 0|64@1+ (1,0) [0|18446744073709551615] "" Vector__XXX

BO_ 2565932800 VDMA_F107_Well_Stimulation_Pump_: 8 Vector__XXX
 SG_ Well_Stimulation_Pump_System_2_R : 0|64@1+ (1,0) [0|18446744073709551615] "" Vector__XXX

BO_ 2565933056 VDMA_F108_High_Voltage_Energy_St: 8 Vector__XXX
 SG_ High_Voltage_Energy_Storage_Syst : 0|64@1+ (1,0) [0|18446744073709551615] "" Vector__XXX

BO_ 2565933312 VDMA_F109_High_Voltage_Energy_St: 8 Vector__XXX
 SG_ High_Voltage_Energy_Storage_Syst : 0|64@1+ (1,0) [0|18446744073709551615] "" Vector__XXX

BO_ 2565933568 VDMA_F10A_High_Voltage_Energy_St: 8 Vector__XXX
 SG_ High_Voltage_Energy_Storage_Syst : 0|64@1+ (1,0) [0|18446744073709551615] "" Vector__XXX

BO_ 2565933824 VDMA_F10B_High_Voltage_Energy_St: 8 Vector__XXX
 SG_ High_Voltage_Energy_Storage_Syst : 0|64@1+ (1,0) [0|18446744073709551615] "" Vector__XXX

BO_ 2565934080 VDMA_F10C_High_Voltage_Energy_St: 8 Vector__XXX
 SG_ High_Voltage_Energy_Storage_Syst : 0|64@1+ (1,0) [0|18446744073709551615] "" Vector__XXX

BO_ 2565934336 VDMA_F10D_Fuel_Information_6_Gas: 8 Vector__XXX
 SG_ Fuel_Information_6_Gaseous_RawPa : 0|64@1+ (1,0) [0|18446744073709551615] "" Vector__XXX

BO_ 2565934592 VDMA_F10E_Dump_Truck_Body_Inform: 8 Vector__XXX
 SG_ Dump_Truck_Body_Information_RawP : 0|64@1+ (1,0) [0|18446744073709551615] "" Vector__XXX

BO_ 2565934848 VDMA_F10F_Engine_Operating_Infor: 8 Vector__XXX
 SG_ Engine_Operating_Information_2_R : 0|64@1+ (1,0) [0|18446744073709551615] "" Vector__XXX

BO_ 2565935104 VDMA_F110_Brakes_2: 8 Vector__XXX
 SG_ Brakes_2_RawPayload : 0|64@1+ (1,0) [0|18446744073709551615] "" Vector__XXX

BO_ 2565935360 VDMA_F111_Gaseous_Fuel_Pressure_: 8 Vector__XXX
 SG_ Gaseous_Fuel_Pressure_3_RawPaylo : 0|64@1+ (1,0) [0|18446744073709551615] "" Vector__XXX

BO_ 2565935616 VDMA_F112_DC_DC_Converter_1_Cont: 8 Vector__XXX
 SG_ DC_DC_Converter_1_Control_RawPay : 0|64@1+ (1,0) [0|18446744073709551615] "" Vector__XXX

BO_ 2565935872 VDMA_F113_DC_DC_Converter_1_Oper: 8 Vector__XXX
 SG_ DC_DC_Converter_1_Operating_Stat : 0|64@1+ (1,0) [0|18446744073709551615] "" Vector__XXX

BO_ 2565936128 VDMA_F114_DC_DC_Converter_1_Volt: 8 Vector__XXX
 SG_ DC_DC_Converter_1_Voltage_and_Cu : 0|64@1+ (1,0) [0|18446744073709551615] "" Vector__XXX

BO_ 2565936384 VDMA_F115_DC_DC_Converter_1_SLI_: 8 Vector__XXX
 SG_ DC_DC_Converter_1_SLI_Battery_St : 0|64@1+ (1,0) [0|18446744073709551615] "" Vector__XXX

BO_ 2565936640 VDMA_F116_Well_Stimulation_Pump_: 8 Vector__XXX
 SG_ Well_Stimulation_Pump_System_3_R : 0|64@1+ (1,0) [0|18446744073709551615] "" Vector__XXX

BO_ 2565936896 VDMA_F117_DC_DC_Converter_1_Stat: 8 Vector__XXX
 SG_ DC_DC_Converter_1_Status_2_RawPa : 0|64@1+ (1,0) [0|18446744073709551615] "" Vector__XXX

BO_ 2565937152 VDMA_F118_DC_DC_Converter_2_Cont: 8 Vector__XXX
 SG_ DC_DC_Converter_2_Control_RawPay : 0|64@1+ (1,0) [0|18446744073709551615] "" Vector__XXX

BO_ 2565937408 VDMA_F119_DC_DC_Converter_2_Oper: 8 Vector__XXX
 SG_ DC_DC_Converter_2_Operating_Stat : 0|64@1+ (1,0) [0|18446744073709551615] "" Vector__XXX

BO_ 2565937664 VDMA_F11A_DC_DC_Converter_2_Volt: 8 Vector__XXX
 SG_ DC_DC_Converter_2_Voltage_and_Cu : 0|64@1+ (1,0) [0|18446744073709551615] "" Vector__XXX

BO_ 2565937920 VDMA_F11B_DC_DC_Converter_2_SLI_: 8 Vector__XXX
 SG_ DC_DC_Converter_2_SLI_Battery_St : 0|64@1+ (1,0) [0|18446744073709551615] "" Vector__XXX

BO_ 2565938176 VDMA_F11C_DC_DC_Converter_2_Stat: 8 Vector__XXX
 SG_ DC_DC_Converter_2_Status_2_RawPa : 0|64@1+ (1,0) [0|18446744073709551615] "" Vector__XXX

BO_ 2565938432 VDMA_F11D_DC_DC_Converter_3_Cont: 8 Vector__XXX
 SG_ DC_DC_Converter_3_Control_RawPay : 0|64@1+ (1,0) [0|18446744073709551615] "" Vector__XXX

BO_ 2565938688 VDMA_F11E_DC_DC_Converter_3_Oper: 8 Vector__XXX
 SG_ DC_DC_Converter_3_Operating_Stat : 0|64@1+ (1,0) [0|18446744073709551615] "" Vector__XXX

BO_ 2565938944 VDMA_F11F_DC_DC_Converter_3_Volt: 8 Vector__XXX
 SG_ DC_DC_Converter_3_Voltage_and_Cu : 0|64@1+ (1,0) [0|18446744073709551615] "" Vector__XXX

BO_ 2565939200 VDMA_F120_DC_DC_Converter_3_SLI_: 8 Vector__XXX
 SG_ DC_DC_Converter_3_SLI_Battery_St : 0|64@1+ (1,0) [0|18446744073709551615] "" Vector__XXX

BO_ 2565939456 VDMA_F121_DC_DC_Converter_3_Stat: 8 Vector__XXX
 SG_ DC_DC_Converter_3_Status_2_RawPa : 0|64@1+ (1,0) [0|18446744073709551615] "" Vector__XXX

BO_ 2565939712 VDMA_F122_DC_DC_Converter_4_Cont: 8 Vector__XXX
 SG_ DC_DC_Converter_4_Control_RawPay : 0|64@1+ (1,0) [0|18446744073709551615] "" Vector__XXX

BO_ 2565939968 VDMA_F123_DC_DC_Converter_4_Oper: 8 Vector__XXX
 SG_ DC_DC_Converter_4_Operating_Stat : 0|64@1+ (1,0) [0|18446744073709551615] "" Vector__XXX

BO_ 2565940224 VDMA_F124_DC_DC_Converter_4_Volt: 8 Vector__XXX
 SG_ DC_DC_Converter_4_Voltage_and_Cu : 0|64@1+ (1,0) [0|18446744073709551615] "" Vector__XXX

BO_ 2565940480 VDMA_F125_DC_DC_Converter_4_SLI_: 8 Vector__XXX
 SG_ DC_DC_Converter_4_SLI_Battery_St : 0|64@1+ (1,0) [0|18446744073709551615] "" Vector__XXX

BO_ 2565940736 VDMA_F126_DC_DC_Converter_4_Stat: 8 Vector__XXX
 SG_ DC_DC_Converter_4_Status_2_RawPa : 0|64@1+ (1,0) [0|18446744073709551615] "" Vector__XXX

BO_ 2565940992 VDMA_F127_Slope_Sensor_Informati: 8 Vector__XXX
 SG_ Slope_Sensor_Information_3_RawPa : 0|64@1+ (1,0) [0|18446744073709551615] "" Vector__XXX

BO_ 2565941248 VDMA_F128_DC_AC_Accessory_Invert: 8 Vector__XXX
 SG_ DC_AC_Accessory_Inverter_3_Statu : 0|64@1+ (1,0) [0|18446744073709551615] "" Vector__XXX

BO_ 2565941504 VDMA_F129_DC_AC_Accessory_Invert: 8 Vector__XXX
 SG_ DC_AC_Accessory_Inverter_3_Volta : 0|64@1+ (1,0) [0|18446744073709551615] "" Vector__XXX

BO_ 2565941760 VDMA_F12A_DC_AC_Accessory_Invert: 8 Vector__XXX
 SG_ DC_AC_Accessory_Inverter_3_Feedb : 0|64@1+ (1,0) [0|18446744073709551615] "" Vector__XXX

BO_ 2565942016 VDMA_F12B_DC_AC_Accessory_Invert: 8 Vector__XXX
 SG_ DC_AC_Accessory_Inverter_4_Statu : 0|64@1+ (1,0) [0|18446744073709551615] "" Vector__XXX

BO_ 2565942272 VDMA_F12C_DC_AC_Accessory_Invert: 8 Vector__XXX
 SG_ DC_AC_Accessory_Inverter_4_Volta : 0|64@1+ (1,0) [0|18446744073709551615] "" Vector__XXX

BO_ 2565942528 VDMA_F12D_DC_AC_Accessory_Invert: 8 Vector__XXX
 SG_ DC_AC_Accessory_Inverter_4_Feedb : 0|64@1+ (1,0) [0|18446744073709551615] "" Vector__XXX

BO_ 2565942784 VDMA_F12E_DC_AC_Accessory_Invert: 8 Vector__XXX
 SG_ DC_AC_Accessory_Inverter_5_Comma : 0|64@1+ (1,0) [0|18446744073709551615] "" Vector__XXX

BO_ 2565943040 VDMA_F12F_DC_AC_Accessory_Invert: 8 Vector__XXX
 SG_ DC_AC_Accessory_Inverter_5_Feedb : 0|64@1+ (1,0) [0|18446744073709551615] "" Vector__XXX

BO_ 2565943296 VDMA_F130_DC_AC_Accessory_Invert: 8 Vector__XXX
 SG_ DC_AC_Accessory_Inverter_5_Statu : 0|64@1+ (1,0) [0|18446744073709551615] "" Vector__XXX

BO_ 2565943552 VDMA_F131_DC_AC_Accessory_Invert: 8 Vector__XXX
 SG_ DC_AC_Accessory_Inverter_5_Volta : 0|64@1+ (1,0) [0|18446744073709551615] "" Vector__XXX

BO_ 2565943808 VDMA_F132_DC_AC_Accessory_Invert: 8 Vector__XXX
 SG_ DC_AC_Accessory_Inverter_5_Feedb : 0|64@1+ (1,0) [0|18446744073709551615] "" Vector__XXX

BO_ 2565944064 VDMA_F133_Engine_Pre_Chamber_Fue: 8 Vector__XXX
 SG_ Engine_Pre_Chamber_Fuel_Valve_Du : 0|64@1+ (1,0) [0|18446744073709551615] "" Vector__XXX

BO_ 2565944320 VDMA_F134_Engine_Pre_Chamber_Fue: 8 Vector__XXX
 SG_ Engine_Pre_Chamber_Fuel_Valve_Du : 0|64@1+ (1,0) [0|18446744073709551615] "" Vector__XXX

BO_ 2565944576 VDMA_F135_Engine_Pre_Chamber_Fue: 8 Vector__XXX
 SG_ Engine_Pre_Chamber_Fuel_Valve_Du : 0|64@1+ (1,0) [0|18446744073709551615] "" Vector__XXX

BO_ 2565944832 VDMA_F136_Engine_Pre_Chamber_Fue: 8 Vector__XXX
 SG_ Engine_Pre_Chamber_Fuel_Valve_Du : 0|64@1+ (1,0) [0|18446744073709551615] "" Vector__XXX

BO_ 2565945088 VDMA_F137_Engine_Pre_Chamber_Fue: 8 Vector__XXX
 SG_ Engine_Pre_Chamber_Fuel_Valve_Du : 0|64@1+ (1,0) [0|18446744073709551615] "" Vector__XXX

BO_ 2565945344 VDMA_F138_Engine_Pre_Chamber_Fue: 8 Vector__XXX
 SG_ Engine_Pre_Chamber_Fuel_Valve_St : 0|64@1+ (1,0) [0|18446744073709551615] "" Vector__XXX

BO_ 2565945600 VDMA_F139_Engine_Pre_Chamber_Fue: 8 Vector__XXX
 SG_ Engine_Pre_Chamber_Fuel_Valve_St : 0|64@1+ (1,0) [0|18446744073709551615] "" Vector__XXX

BO_ 2565945856 VDMA_F13A_Engine_Pre_Chamber_Fue: 8 Vector__XXX
 SG_ Engine_Pre_Chamber_Fuel_Valve_St : 0|64@1+ (1,0) [0|18446744073709551615] "" Vector__XXX

BO_ 2565946112 VDMA_F13B_Engine_Pre_Chamber_Fue: 8 Vector__XXX
 SG_ Engine_Pre_Chamber_Fuel_Valve_St : 0|64@1+ (1,0) [0|18446744073709551615] "" Vector__XXX

BO_ 2565946368 VDMA_F13C_Engine_Pre_Chamber_Fue: 8 Vector__XXX
 SG_ Engine_Pre_Chamber_Fuel_Valve_St : 0|64@1+ (1,0) [0|18446744073709551615] "" Vector__XXX

BO_ 2565946624 VDMA_F13D_Active_Steering_System: 8 Vector__XXX
 SG_ Active_Steering_System_Controls_ : 0|64@1+ (1,0) [0|18446744073709551615] "" Vector__XXX

BO_ 2565946880 VDMA_F13E_Secondary_or_Front_Hit: 8 Vector__XXX
 SG_ Secondary_or_Front_Hitch_Yaw_com : 0|64@1+ (1,0) [0|18446744073709551615] "" Vector__XXX

BO_ 2565947136 VDMA_F13F_Primary_or_Rear_Hitch_: 8 Vector__XXX
 SG_ Primary_or_Rear_Hitch_Yaw_comman : 0|64@1+ (1,0) [0|18446744073709551615] "" Vector__XXX

BO_ 2565947392 VDMA_F140_Stationary_Inverter_Av: 8 Vector__XXX
 SG_ Stationary_Inverter_Average_Basi : 0|64@1+ (1,0) [0|18446744073709551615] "" Vector__XXX

BO_ 2565947648 VDMA_F141_Stationary_Inverter_To: 8 Vector__XXX
 SG_ Stationary_Inverter_Total_AC_Rea : 0|64@1+ (1,0) [0|18446744073709551615] "" Vector__XXX

BO_ 2565947904 VDMA_F142_Stationary_Inverter_To: 8 Vector__XXX
 SG_ Stationary_Inverter_Total_AC_Pow : 0|64@1+ (1,0) [0|18446744073709551615] "" Vector__XXX

BO_ 2565948160 VDMA_F143_Stationary_Inverter_Co: 8 Vector__XXX
 SG_ Stationary_Inverter_Control_RawP : 0|64@1+ (1,0) [0|18446744073709551615] "" Vector__XXX

BO_ 2565948416 VDMA_F144_Stationary_Inverter_to: 8 Vector__XXX
 SG_ Stationary_Inverter_to_Bus_Sync_ : 0|64@1+ (1,0) [0|18446744073709551615] "" Vector__XXX

BO_ 2565948672 VDMA_F145_Engine_Cylinder_1_Comb: 8 Vector__XXX
 SG_ Engine_Cylinder_1_Combustion_Pre : 0|64@1+ (1,0) [0|18446744073709551615] "" Vector__XXX

BO_ 2565948928 VDMA_F146_Engine_Cylinder_2_Comb: 8 Vector__XXX
 SG_ Engine_Cylinder_2_Combustion_Pre : 0|64@1+ (1,0) [0|18446744073709551615] "" Vector__XXX

BO_ 2565949184 VDMA_F147_Engine_Cylinder_3_Comb: 8 Vector__XXX
 SG_ Engine_Cylinder_3_Combustion_Pre : 0|64@1+ (1,0) [0|18446744073709551615] "" Vector__XXX

BO_ 2565949440 VDMA_F148_Engine_Cylinder_4_Comb: 8 Vector__XXX
 SG_ Engine_Cylinder_4_Combustion_Pre : 0|64@1+ (1,0) [0|18446744073709551615] "" Vector__XXX

BO_ 2565949696 VDMA_F149_Engine_Cylinder_5_Comb: 8 Vector__XXX
 SG_ Engine_Cylinder_5_Combustion_Pre : 0|64@1+ (1,0) [0|18446744073709551615] "" Vector__XXX

BO_ 2565949952 VDMA_F14A_Engine_Cylinder_6_Comb: 8 Vector__XXX
 SG_ Engine_Cylinder_6_Combustion_Pre : 0|64@1+ (1,0) [0|18446744073709551615] "" Vector__XXX

BO_ 2565950208 VDMA_F14B_Engine_Cylinder_7_Comb: 8 Vector__XXX
 SG_ Engine_Cylinder_7_Combustion_Pre : 0|64@1+ (1,0) [0|18446744073709551615] "" Vector__XXX

BO_ 2565950464 VDMA_F14C_Engine_Cylinder_8_Comb: 8 Vector__XXX
 SG_ Engine_Cylinder_8_Combustion_Pre : 0|64@1+ (1,0) [0|18446744073709551615] "" Vector__XXX

BO_ 2565950720 VDMA_F14D_Engine_Cylinder_9_Comb: 8 Vector__XXX
 SG_ Engine_Cylinder_9_Combustion_Pre : 0|64@1+ (1,0) [0|18446744073709551615] "" Vector__XXX

BO_ 2565950976 VDMA_F14E_Engine_Cylinder_10_Com: 8 Vector__XXX
 SG_ Engine_Cylinder_10_Combustion_Pr : 0|64@1+ (1,0) [0|18446744073709551615] "" Vector__XXX

BO_ 2565951232 VDMA_F14F_Engine_Cylinder_11_Com: 8 Vector__XXX
 SG_ Engine_Cylinder_11_Combustion_Pr : 0|64@1+ (1,0) [0|18446744073709551615] "" Vector__XXX

BO_ 2565951488 VDMA_F150_Engine_Cylinder_12_Com: 8 Vector__XXX
 SG_ Engine_Cylinder_12_Combustion_Pr : 0|64@1+ (1,0) [0|18446744073709551615] "" Vector__XXX

BO_ 2565951744 VDMA_F151_Engine_Cylinder_13_Com: 8 Vector__XXX
 SG_ Engine_Cylinder_13_Combustion_Pr : 0|64@1+ (1,0) [0|18446744073709551615] "" Vector__XXX

BO_ 2565952000 VDMA_F152_Engine_Cylinder_14_Com: 8 Vector__XXX
 SG_ Engine_Cylinder_14_Combustion_Pr : 0|64@1+ (1,0) [0|18446744073709551615] "" Vector__XXX

BO_ 2565952256 VDMA_F153_Engine_Cylinder_15_Com: 8 Vector__XXX
 SG_ Engine_Cylinder_15_Combustion_Pr : 0|64@1+ (1,0) [0|18446744073709551615] "" Vector__XXX

BO_ 2565952512 VDMA_F154_Engine_Cylinder_16_Com: 8 Vector__XXX
 SG_ Engine_Cylinder_16_Combustion_Pr : 0|64@1+ (1,0) [0|18446744073709551615] "" Vector__XXX

BO_ 2565952768 VDMA_F155_Engine_Cylinder_17_Com: 8 Vector__XXX
 SG_ Engine_Cylinder_17_Combustion_Pr : 0|64@1+ (1,0) [0|18446744073709551615] "" Vector__XXX

BO_ 2565953024 VDMA_F156_Engine_Cylinder_18_Com: 8 Vector__XXX
 SG_ Engine_Cylinder_18_Combustion_Pr : 0|64@1+ (1,0) [0|18446744073709551615] "" Vector__XXX

BO_ 2565953280 VDMA_F157_Engine_Cylinder_19_Com: 8 Vector__XXX
 SG_ Engine_Cylinder_19_Combustion_Pr : 0|64@1+ (1,0) [0|18446744073709551615] "" Vector__XXX

BO_ 2565953536 VDMA_F158_Engine_Cylinder_20_Com: 8 Vector__XXX
 SG_ Engine_Cylinder_20_Combustion_Pr : 0|64@1+ (1,0) [0|18446744073709551615] "" Vector__XXX

BO_ 2565953792 VDMA_F159_Engine_Cylinder_1_Comb: 8 Vector__XXX
 SG_ Engine_Cylinder_1_Combustion_Tim : 0|64@1+ (1,0) [0|18446744073709551615] "" Vector__XXX

BO_ 2565954048 VDMA_F15A_Engine_Cylinder_2_Comb: 8 Vector__XXX
 SG_ Engine_Cylinder_2_Combustion_Tim : 0|64@1+ (1,0) [0|18446744073709551615] "" Vector__XXX

BO_ 2565954304 VDMA_F15B_Engine_Cylinder_3_Comb: 8 Vector__XXX
 SG_ Engine_Cylinder_3_Combustion_Tim : 0|64@1+ (1,0) [0|18446744073709551615] "" Vector__XXX

BO_ 2565954560 VDMA_F15C_Engine_Cylinder_4_Comb: 8 Vector__XXX
 SG_ Engine_Cylinder_4_Combustion_Tim : 0|64@1+ (1,0) [0|18446744073709551615] "" Vector__XXX

BO_ 2565954816 VDMA_F15D_Engine_Cylinder_5_Comb: 8 Vector__XXX
 SG_ Engine_Cylinder_5_Combustion_Tim : 0|64@1+ (1,0) [0|18446744073709551615] "" Vector__XXX

BO_ 2565955072 VDMA_F15E_Engine_Cylinder_6_Comb: 8 Vector__XXX
 SG_ Engine_Cylinder_6_Combustion_Tim : 0|64@1+ (1,0) [0|18446744073709551615] "" Vector__XXX

BO_ 2565955328 VDMA_F15F_Engine_Cylinder_7_Comb: 8 Vector__XXX
 SG_ Engine_Cylinder_7_Combustion_Tim : 0|64@1+ (1,0) [0|18446744073709551615] "" Vector__XXX

BO_ 2565955584 VDMA_F160_Engine_Cylinder_8_Comb: 8 Vector__XXX
 SG_ Engine_Cylinder_8_Combustion_Tim : 0|64@1+ (1,0) [0|18446744073709551615] "" Vector__XXX

BO_ 2565955840 VDMA_F161_Engine_Cylinder_9_Comb: 8 Vector__XXX
 SG_ Engine_Cylinder_9_Combustion_Tim : 0|64@1+ (1,0) [0|18446744073709551615] "" Vector__XXX

BO_ 2565956096 VDMA_F162_Engine_Cylinder_10_Com: 8 Vector__XXX
 SG_ Engine_Cylinder_10_Combustion_Ti : 0|64@1+ (1,0) [0|18446744073709551615] "" Vector__XXX

BO_ 2565956352 VDMA_F163_Engine_Cylinder_11_Com: 8 Vector__XXX
 SG_ Engine_Cylinder_11_Combustion_Ti : 0|64@1+ (1,0) [0|18446744073709551615] "" Vector__XXX

BO_ 2565956608 VDMA_F164_Engine_Cylinder_12_Com: 8 Vector__XXX
 SG_ Engine_Cylinder_12_Combustion_Ti : 0|64@1+ (1,0) [0|18446744073709551615] "" Vector__XXX

BO_ 2565956864 VDMA_F165_Engine_Cylinder_13_Com: 8 Vector__XXX
 SG_ Engine_Cylinder_13_Combustion_Ti : 0|64@1+ (1,0) [0|18446744073709551615] "" Vector__XXX

BO_ 2565957120 VDMA_F166_Engine_Cylinder_14_Com: 8 Vector__XXX
 SG_ Engine_Cylinder_14_Combustion_Ti : 0|64@1+ (1,0) [0|18446744073709551615] "" Vector__XXX

BO_ 2565957376 VDMA_F167_Engine_Cylinder_15_Com: 8 Vector__XXX
 SG_ Engine_Cylinder_15_Combustion_Ti : 0|64@1+ (1,0) [0|18446744073709551615] "" Vector__XXX

BO_ 2565957632 VDMA_F168_Engine_Cylinder_16_Com: 8 Vector__XXX
 SG_ Engine_Cylinder_16_Combustion_Ti : 0|64@1+ (1,0) [0|18446744073709551615] "" Vector__XXX

BO_ 2565957888 VDMA_F169_Engine_Cylinder_17_Com: 8 Vector__XXX
 SG_ Engine_Cylinder_17_Combustion_Ti : 0|64@1+ (1,0) [0|18446744073709551615] "" Vector__XXX

BO_ 2565958144 VDMA_F16A_Engine_Cylinder_18_Com: 8 Vector__XXX
 SG_ Engine_Cylinder_18_Combustion_Ti : 0|64@1+ (1,0) [0|18446744073709551615] "" Vector__XXX

BO_ 2565958400 VDMA_F16B_Engine_Cylinder_19_Com: 8 Vector__XXX
 SG_ Engine_Cylinder_19_Combustion_Ti : 0|64@1+ (1,0) [0|18446744073709551615] "" Vector__XXX

BO_ 2565958656 VDMA_F16C_Engine_Cylinder_20_Com: 8 Vector__XXX
 SG_ Engine_Cylinder_20_Combustion_Ti : 0|64@1+ (1,0) [0|18446744073709551615] "" Vector__XXX

BO_ 2565958912 VDMA_F16D_Engine_Cylinder_1_Comb: 8 Vector__XXX
 SG_ Engine_Cylinder_1_Combustion_Met : 0|64@1+ (1,0) [0|18446744073709551615] "" Vector__XXX

BO_ 2565959168 VDMA_F16E_Engine_Cylinder_2_Comb: 8 Vector__XXX
 SG_ Engine_Cylinder_2_Combustion_Met : 0|64@1+ (1,0) [0|18446744073709551615] "" Vector__XXX

BO_ 2565959424 VDMA_F16F_Engine_Cylinder_3_Comb: 8 Vector__XXX
 SG_ Engine_Cylinder_3_Combustion_Met : 0|64@1+ (1,0) [0|18446744073709551615] "" Vector__XXX

BO_ 2565959680 VDMA_F170_Engine_Cylinder_4_Comb: 8 Vector__XXX
 SG_ Engine_Cylinder_4_Combustion_Met : 0|64@1+ (1,0) [0|18446744073709551615] "" Vector__XXX

BO_ 2565959936 VDMA_F171_Engine_Cylinder_5_Comb: 8 Vector__XXX
 SG_ Engine_Cylinder_5_Combustion_Met : 0|64@1+ (1,0) [0|18446744073709551615] "" Vector__XXX

BO_ 2565960192 VDMA_F172_Engine_Cylinder_6_Comb: 8 Vector__XXX
 SG_ Engine_Cylinder_6_Combustion_Met : 0|64@1+ (1,0) [0|18446744073709551615] "" Vector__XXX

BO_ 2565960448 VDMA_F173_Engine_Cylinder_7_Comb: 8 Vector__XXX
 SG_ Engine_Cylinder_7_Combustion_Met : 0|64@1+ (1,0) [0|18446744073709551615] "" Vector__XXX

BO_ 2565960704 VDMA_F174_Engine_Cylinder_8_Comb: 8 Vector__XXX
 SG_ Engine_Cylinder_8_Combustion_Met : 0|64@1+ (1,0) [0|18446744073709551615] "" Vector__XXX

BO_ 2565960960 VDMA_F175_Engine_Cylinder_9_Comb: 8 Vector__XXX
 SG_ Engine_Cylinder_9_Combustion_Met : 0|64@1+ (1,0) [0|18446744073709551615] "" Vector__XXX

BO_ 2565961216 VDMA_F176_Engine_Cylinder_10_Com: 8 Vector__XXX
 SG_ Engine_Cylinder_10_Combustion_Me : 0|64@1+ (1,0) [0|18446744073709551615] "" Vector__XXX

BO_ 2565961472 VDMA_F177_Engine_Cylinder_11_Com: 8 Vector__XXX
 SG_ Engine_Cylinder_11_Combustion_Me : 0|64@1+ (1,0) [0|18446744073709551615] "" Vector__XXX

BO_ 2565961728 VDMA_F178_Engine_Cylinder_12_Com: 8 Vector__XXX
 SG_ Engine_Cylinder_12_Combustion_Me : 0|64@1+ (1,0) [0|18446744073709551615] "" Vector__XXX

BO_ 2565961984 VDMA_F179_Engine_Cylinder_13_Com: 8 Vector__XXX
 SG_ Engine_Cylinder_13_Combustion_Me : 0|64@1+ (1,0) [0|18446744073709551615] "" Vector__XXX

BO_ 2565962240 VDMA_F17A_Engine_Cylinder_14_Com: 8 Vector__XXX
 SG_ Engine_Cylinder_14_Combustion_Me : 0|64@1+ (1,0) [0|18446744073709551615] "" Vector__XXX

BO_ 2565962496 VDMA_F17B_Engine_Cylinder_15_Com: 8 Vector__XXX
 SG_ Engine_Cylinder_15_Combustion_Me : 0|64@1+ (1,0) [0|18446744073709551615] "" Vector__XXX

BO_ 2565962752 VDMA_F17C_Engine_Cylinder_16_Com: 8 Vector__XXX
 SG_ Engine_Cylinder_16_Combustion_Me : 0|64@1+ (1,0) [0|18446744073709551615] "" Vector__XXX

BO_ 2565963008 VDMA_F17D_Engine_Cylinder_17_Com: 8 Vector__XXX
 SG_ Engine_Cylinder_17_Combustion_Me : 0|64@1+ (1,0) [0|18446744073709551615] "" Vector__XXX

BO_ 2565963264 VDMA_F17E_Engine_Cylinder_18_Com: 8 Vector__XXX
 SG_ Engine_Cylinder_18_Combustion_Me : 0|64@1+ (1,0) [0|18446744073709551615] "" Vector__XXX

BO_ 2565963520 VDMA_F17F_Engine_Cylinder_19_Com: 8 Vector__XXX
 SG_ Engine_Cylinder_19_Combustion_Me : 0|64@1+ (1,0) [0|18446744073709551615] "" Vector__XXX

BO_ 2565963776 VDMA_F180_Engine_Cylinder_20_Com: 8 Vector__XXX
 SG_ Engine_Cylinder_20_Combustion_Me : 0|64@1+ (1,0) [0|18446744073709551615] "" Vector__XXX

BO_ 2565964032 VDMA_F181_Motor_Generator_1_Inve: 8 Vector__XXX
 SG_ Motor_Generator_1_Inverter_Mode_ : 0|64@1+ (1,0) [0|18446744073709551615] "" Vector__XXX

BO_ 2565964288 VDMA_F182_Motor_Generator_1_Inve: 8 Vector__XXX
 SG_ Motor_Generator_1_Inverter_Limit : 0|64@1+ (1,0) [0|18446744073709551615] "" Vector__XXX

BO_ 2565964544 VDMA_F183_Motor_Generator_1_Inve: 8 Vector__XXX
 SG_ Motor_Generator_1_Inverter_Limit : 0|64@1+ (1,0) [0|18446744073709551615] "" Vector__XXX

BO_ 2565964800 VDMA_F184_Motor_Generator_1_Inve: 8 Vector__XXX
 SG_ Motor_Generator_1_Inverter_Limit : 0|64@1+ (1,0) [0|18446744073709551615] "" Vector__XXX

BO_ 2565965056 VDMA_F185_Motor_Generator_1_Inve: 8 Vector__XXX
 SG_ Motor_Generator_1_Inverter_Low_V : 0|64@1+ (1,0) [0|18446744073709551615] "" Vector__XXX

BO_ 2565965312 VDMA_F186_Motor_Generator_2_Inve: 8 Vector__XXX
 SG_ Motor_Generator_2_Inverter_Mode_ : 0|64@1+ (1,0) [0|18446744073709551615] "" Vector__XXX

BO_ 2565965568 VDMA_F187_Motor_Generator_2_Inve: 8 Vector__XXX
 SG_ Motor_Generator_2_Inverter_Limit : 0|64@1+ (1,0) [0|18446744073709551615] "" Vector__XXX

BO_ 2565965824 VDMA_F188_Motor_Generator_2_Inve: 8 Vector__XXX
 SG_ Motor_Generator_2_Inverter_Limit : 0|64@1+ (1,0) [0|18446744073709551615] "" Vector__XXX

BO_ 2565966080 VDMA_F189_Motor_Generator_2_Inve: 8 Vector__XXX
 SG_ Motor_Generator_2_Inverter_Limit : 0|64@1+ (1,0) [0|18446744073709551615] "" Vector__XXX

BO_ 2565966336 VDMA_F18A_Motor_Generator_2_Inve: 8 Vector__XXX
 SG_ Motor_Generator_2_Inverter_Low_V : 0|64@1+ (1,0) [0|18446744073709551615] "" Vector__XXX

BO_ 2565966592 VDMA_F18B_Motor_Generator_1_Inve: 8 Vector__XXX
 SG_ Motor_Generator_1_Inverter_Statu : 0|64@1+ (1,0) [0|18446744073709551615] "" Vector__XXX

BO_ 2565966848 VDMA_F18C_Motor_Generator_1_Inve: 8 Vector__XXX
 SG_ Motor_Generator_1_Inverter_Rate_ : 0|64@1+ (1,0) [0|18446744073709551615] "" Vector__XXX

BO_ 2565967104 VDMA_F18D_Motor_Generator_2_Inve: 8 Vector__XXX
 SG_ Motor_Generator_2_Inverter_Statu : 0|64@1+ (1,0) [0|18446744073709551615] "" Vector__XXX

BO_ 2565967360 VDMA_F18E_Motor_Generator_2_Inve: 8 Vector__XXX
 SG_ Motor_Generator_2_Inverter_Rate_ : 0|64@1+ (1,0) [0|18446744073709551615] "" Vector__XXX

BO_ 2565967616 VDMA_F18F_Impostor_PG_Alert: 8 Vector__XXX
 SG_ Impostor_PG_Alert_RawPayload : 0|64@1+ (1,0) [0|18446744073709551615] "" Vector__XXX

BO_ 2565967872 VDMA_F190_High_Voltage_Energy_St: 8 Vector__XXX
 SG_ High_Voltage_Energy_Storage_Pack : 0|64@1+ (1,0) [0|18446744073709551615] "" Vector__XXX

BO_ 2565968128 VDMA_F191_High_Voltage_Energy_St: 8 Vector__XXX
 SG_ High_Voltage_Energy_Storage_Pack : 0|64@1+ (1,0) [0|18446744073709551615] "" Vector__XXX

BO_ 2565968384 VDMA_F192_High_Voltage_Energy_St: 8 Vector__XXX
 SG_ High_Voltage_Energy_Storage_Pack : 0|64@1+ (1,0) [0|18446744073709551615] "" Vector__XXX

BO_ 2565968640 VDMA_F193_High_Voltage_Energy_St: 8 Vector__XXX
 SG_ High_Voltage_Energy_Storage_Pack : 0|64@1+ (1,0) [0|18446744073709551615] "" Vector__XXX

BO_ 2565968896 VDMA_F194_High_Voltage_Energy_St: 8 Vector__XXX
 SG_ High_Voltage_Energy_Storage_Pack : 0|64@1+ (1,0) [0|18446744073709551615] "" Vector__XXX

BO_ 2565969152 VDMA_F195_High_Voltage_Energy_St: 8 Vector__XXX
 SG_ High_Voltage_Energy_Storage_Pack : 0|64@1+ (1,0) [0|18446744073709551615] "" Vector__XXX

BO_ 2565969408 VDMA_F196_High_Voltage_Energy_St: 8 Vector__XXX
 SG_ High_Voltage_Energy_Storage_Pack : 0|64@1+ (1,0) [0|18446744073709551615] "" Vector__XXX

BO_ 2565969664 VDMA_F197_High_Voltage_Energy_St: 8 Vector__XXX
 SG_ High_Voltage_Energy_Storage_Pack : 0|64@1+ (1,0) [0|18446744073709551615] "" Vector__XXX

BO_ 2565969920 VDMA_F198_High_Voltage_Energy_St: 8 Vector__XXX
 SG_ High_Voltage_Energy_Storage_Pack : 0|64@1+ (1,0) [0|18446744073709551615] "" Vector__XXX

BO_ 2565970176 VDMA_F199_High_Voltage_Energy_St: 8 Vector__XXX
 SG_ High_Voltage_Energy_Storage_Pack : 0|64@1+ (1,0) [0|18446744073709551615] "" Vector__XXX

BO_ 2565970432 VDMA_F19A_High_Voltage_Energy_St: 8 Vector__XXX
 SG_ High_Voltage_Energy_Storage_Pack : 0|64@1+ (1,0) [0|18446744073709551615] "" Vector__XXX

BO_ 2565970688 VDMA_F19B_High_Voltage_Energy_St: 8 Vector__XXX
 SG_ High_Voltage_Energy_Storage_Pack : 0|64@1+ (1,0) [0|18446744073709551615] "" Vector__XXX

BO_ 2565970944 VDMA_F19C_High_Voltage_Energy_St: 8 Vector__XXX
 SG_ High_Voltage_Energy_Storage_Pack : 0|64@1+ (1,0) [0|18446744073709551615] "" Vector__XXX

BO_ 2565971200 VDMA_F19D_High_Voltage_Energy_St: 8 Vector__XXX
 SG_ High_Voltage_Energy_Storage_Pack : 0|64@1+ (1,0) [0|18446744073709551615] "" Vector__XXX

BO_ 2565971456 VDMA_F19E_High_Voltage_Energy_St: 8 Vector__XXX
 SG_ High_Voltage_Energy_Storage_Pack : 0|64@1+ (1,0) [0|18446744073709551615] "" Vector__XXX

BO_ 2565971712 VDMA_F19F_High_Voltage_Energy_St: 8 Vector__XXX
 SG_ High_Voltage_Energy_Storage_Pack : 0|64@1+ (1,0) [0|18446744073709551615] "" Vector__XXX

CM_ BO_ 2565875712  "Source: isobus.net VDMA Data Dictionary (https://www.isobus.net/isobus/pGNAndSPN/2597?type=PGN)";
CM_ BO_ 2565875968  "Source: isobus.net VDMA Data Dictionary (https://www.isobus.net/isobus/pGNAndSPN/2604?type=PGN)";
CM_ BO_ 2565876224  "Source: isobus.net VDMA Data Dictionary (https://www.isobus.net/isobus/pGNAndSPN/2611?type=PGN)";
CM_ BO_ 2565876480  "Source: isobus.net VDMA Data Dictionary (https://www.isobus.net/isobus/pGNAndSPN/2614?type=PGN)";
CM_ BO_ 2565876736  "Source: isobus.net VDMA Data Dictionary (https://www.isobus.net/isobus/pGNAndSPN/2624?type=PGN)";
CM_ BO_ 2565876992  "Source: isobus.net VDMA Data Dictionary (https://www.isobus.net/isobus/pGNAndSPN/2631?type=PGN)";
CM_ BO_ 2565877248  "Source: isobus.net VDMA Data Dictionary (https://www.isobus.net/isobus/pGNAndSPN/2635?type=PGN)";
CM_ BO_ 2565877504  "Source: isobus.net VDMA Data Dictionary (https://www.isobus.net/isobus/pGNAndSPN/2641?type=PGN)";
CM_ BO_ 2565877760  "Source: isobus.net VDMA Data Dictionary (https://www.isobus.net/isobus/pGNAndSPN/2645?type=PGN)";
CM_ BO_ 2565878016  "Source: isobus.net VDMA Data Dictionary (https://www.isobus.net/isobus/pGNAndSPN/2647?type=PGN)";
CM_ BO_ 2565878272  "Source: isobus.net VDMA Data Dictionary (https://www.isobus.net/isobus/pGNAndSPN/2649?type=PGN)";
CM_ BO_ 2565878528  "Source: isobus.net VDMA Data Dictionary (https://www.isobus.net/isobus/pGNAndSPN/2656?type=PGN)";
CM_ BO_ 2565878784  "Source: isobus.net VDMA Data Dictionary (https://www.isobus.net/isobus/pGNAndSPN/2663?type=PGN)";
CM_ BO_ 2565879296  "Source: isobus.net VDMA Data Dictionary (https://www.isobus.net/isobus/pGNAndSPN/2677?type=PGN)";
CM_ BO_ 2565879552  "Source: isobus.net VDMA Data Dictionary (https://www.isobus.net/isobus/pGNAndSPN/2683?type=PGN)";
CM_ BO_ 2565879808  "Source: isobus.net VDMA Data Dictionary (https://www.isobus.net/isobus/pGNAndSPN/2688?type=PGN)";
CM_ BO_ 2565880064  "Source: isobus.net VDMA Data Dictionary (https://www.isobus.net/isobus/pGNAndSPN/2692?type=PGN)";
CM_ BO_ 2565880320  "Source: isobus.net VDMA Data Dictionary (https://www.isobus.net/isobus/pGNAndSPN/2698?type=PGN)";
CM_ BO_ 2565880576  "Source: isobus.net VDMA Data Dictionary (https://www.isobus.net/isobus/pGNAndSPN/2704?type=PGN)";
CM_ BO_ 2565880832  "Source: isobus.net VDMA Data Dictionary (https://www.isobus.net/isobus/pGNAndSPN/2710?type=PGN)";
CM_ BO_ 2565881088  "Source: isobus.net VDMA Data Dictionary (https://www.isobus.net/isobus/pGNAndSPN/2716?type=PGN)";
CM_ BO_ 2565881344  "Source: isobus.net VDMA Data Dictionary (https://www.isobus.net/isobus/pGNAndSPN/2722?type=PGN)";
CM_ BO_ 2565881600  "Source: isobus.net VDMA Data Dictionary (https://www.isobus.net/isobus/pGNAndSPN/2728?type=PGN)";
CM_ BO_ 2565881856  "Source: isobus.net VDMA Data Dictionary (https://www.isobus.net/isobus/pGNAndSPN/2734?type=PGN)";
CM_ BO_ 2565882112  "Source: isobus.net VDMA Data Dictionary (https://www.isobus.net/isobus/pGNAndSPN/2740?type=PGN)";
CM_ BO_ 2565882368  "Source: isobus.net VDMA Data Dictionary (https://www.isobus.net/isobus/pGNAndSPN/2746?type=PGN)";
CM_ BO_ 2565882624  "Source: isobus.net VDMA Data Dictionary (https://www.isobus.net/isobus/pGNAndSPN/2752?type=PGN)";
CM_ BO_ 2565882880  "Source: isobus.net VDMA Data Dictionary (https://www.isobus.net/isobus/pGNAndSPN/2758?type=PGN)";
CM_ BO_ 2565883136  "Source: isobus.net VDMA Data Dictionary (https://www.isobus.net/isobus/pGNAndSPN/2764?type=PGN)";
CM_ BO_ 2565883392  "Source: isobus.net VDMA Data Dictionary (https://www.isobus.net/isobus/pGNAndSPN/2770?type=PGN)";
CM_ BO_ 2565883648  "Source: isobus.net VDMA Data Dictionary (https://www.isobus.net/isobus/pGNAndSPN/2776?type=PGN)";
CM_ BO_ 2565883904  "Source: isobus.net VDMA Data Dictionary (https://www.isobus.net/isobus/pGNAndSPN/2782?type=PGN)";
CM_ BO_ 2565884160  "Source: isobus.net VDMA Data Dictionary (https://www.isobus.net/isobus/pGNAndSPN/2788?type=PGN)";
CM_ BO_ 2565884416  "Source: isobus.net VDMA Data Dictionary (https://www.isobus.net/isobus/pGNAndSPN/2794?type=PGN)";
CM_ BO_ 2565884672  "Source: isobus.net VDMA Data Dictionary (https://www.isobus.net/isobus/pGNAndSPN/2800?type=PGN)";
CM_ BO_ 2565884928  "Source: isobus.net VDMA Data Dictionary (https://www.isobus.net/isobus/pGNAndSPN/2806?type=PGN)";
CM_ BO_ 2565885184  "Source: isobus.net VDMA Data Dictionary (https://www.isobus.net/isobus/pGNAndSPN/2812?type=PGN)";
CM_ BO_ 2565885440  "Source: isobus.net VDMA Data Dictionary (https://www.isobus.net/isobus/pGNAndSPN/2816?type=PGN)";
CM_ BO_ 2565885696  "Source: isobus.net VDMA Data Dictionary (https://www.isobus.net/isobus/pGNAndSPN/2820?type=PGN)";
CM_ BO_ 2565885952  "Source: isobus.net VDMA Data Dictionary (https://www.isobus.net/isobus/pGNAndSPN/2824?type=PGN)";
CM_ BO_ 2565886208  "Source: isobus.net VDMA Data Dictionary (https://www.isobus.net/isobus/pGNAndSPN/2828?type=PGN)";
CM_ BO_ 2565886464  "Source: isobus.net VDMA Data Dictionary (https://www.isobus.net/isobus/pGNAndSPN/2832?type=PGN)";
CM_ BO_ 2565886720  "Source: isobus.net VDMA Data Dictionary (https://www.isobus.net/isobus/pGNAndSPN/2836?type=PGN)";
CM_ BO_ 2565886976  "Source: isobus.net VDMA Data Dictionary (https://www.isobus.net/isobus/pGNAndSPN/2840?type=PGN)";
CM_ BO_ 2565887232  "Source: isobus.net VDMA Data Dictionary (https://www.isobus.net/isobus/pGNAndSPN/2844?type=PGN)";
CM_ BO_ 2565887488  "Source: isobus.net VDMA Data Dictionary (https://www.isobus.net/isobus/pGNAndSPN/2848?type=PGN)";
CM_ BO_ 2565887744  "Source: isobus.net VDMA Data Dictionary (https://www.isobus.net/isobus/pGNAndSPN/2852?type=PGN)";
CM_ BO_ 2565888000  "Source: isobus.net VDMA Data Dictionary (https://www.isobus.net/isobus/pGNAndSPN/2856?type=PGN)";
CM_ BO_ 2565888256  "Source: isobus.net VDMA Data Dictionary (https://www.isobus.net/isobus/pGNAndSPN/2860?type=PGN)";
CM_ BO_ 2565888512  "Source: isobus.net VDMA Data Dictionary (https://www.isobus.net/isobus/pGNAndSPN/2864?type=PGN)";
CM_ BO_ 2565888768  "Source: isobus.net VDMA Data Dictionary (https://www.isobus.net/isobus/pGNAndSPN/2868?type=PGN)";
CM_ BO_ 2565889024  "Source: isobus.net VDMA Data Dictionary (https://www.isobus.net/isobus/pGNAndSPN/2872?type=PGN)";
CM_ BO_ 2565889280  "Source: isobus.net VDMA Data Dictionary (https://www.isobus.net/isobus/pGNAndSPN/2876?type=PGN)";
CM_ BO_ 2565889536  "Source: isobus.net VDMA Data Dictionary (https://www.isobus.net/isobus/pGNAndSPN/2880?type=PGN)";
CM_ BO_ 2565889792  "Source: isobus.net VDMA Data Dictionary (https://www.isobus.net/isobus/pGNAndSPN/2884?type=PGN)";
CM_ BO_ 2565890048  "Source: isobus.net VDMA Data Dictionary (https://www.isobus.net/isobus/pGNAndSPN/2888?type=PGN)";
CM_ BO_ 2565890304  "Source: isobus.net VDMA Data Dictionary (https://www.isobus.net/isobus/pGNAndSPN/2892?type=PGN)";
CM_ BO_ 2565890560  "Source: isobus.net VDMA Data Dictionary (https://www.isobus.net/isobus/pGNAndSPN/2896?type=PGN)";
CM_ BO_ 2565890816  "Source: isobus.net VDMA Data Dictionary (https://www.isobus.net/isobus/pGNAndSPN/2900?type=PGN)";
CM_ BO_ 2565891072  "Source: isobus.net VDMA Data Dictionary (https://www.isobus.net/isobus/pGNAndSPN/2904?type=PGN)";
CM_ BO_ 2565891328  "Source: isobus.net VDMA Data Dictionary (https://www.isobus.net/isobus/pGNAndSPN/2908?type=PGN)";
CM_ BO_ 2565891584  "Source: isobus.net VDMA Data Dictionary (https://www.isobus.net/isobus/pGNAndSPN/2912?type=PGN)";
CM_ BO_ 2565891840  "Source: isobus.net VDMA Data Dictionary (https://www.isobus.net/isobus/pGNAndSPN/2916?type=PGN)";
CM_ BO_ 2565892096  "Source: isobus.net VDMA Data Dictionary (https://www.isobus.net/isobus/pGNAndSPN/2920?type=PGN)";
CM_ BO_ 2565892352  "Source: isobus.net VDMA Data Dictionary (https://www.isobus.net/isobus/pGNAndSPN/2924?type=PGN)";
CM_ BO_ 2565892608  "Source: isobus.net VDMA Data Dictionary (https://www.isobus.net/isobus/pGNAndSPN/2928?type=PGN)";
CM_ BO_ 2565892864  "Source: isobus.net VDMA Data Dictionary (https://www.isobus.net/isobus/pGNAndSPN/2932?type=PGN)";
CM_ BO_ 2565893120  "Source: isobus.net VDMA Data Dictionary (https://www.isobus.net/isobus/pGNAndSPN/2936?type=PGN)";
CM_ BO_ 2565893376  "Source: isobus.net VDMA Data Dictionary (https://www.isobus.net/isobus/pGNAndSPN/2940?type=PGN)";
CM_ BO_ 2565893632  "Source: isobus.net VDMA Data Dictionary (https://www.isobus.net/isobus/pGNAndSPN/2942?type=PGN)";
CM_ BO_ 2565893888  "Source: isobus.net VDMA Data Dictionary (https://www.isobus.net/isobus/pGNAndSPN/2949?type=PGN)";
CM_ BO_ 2565894144  "Source: isobus.net VDMA Data Dictionary (https://www.isobus.net/isobus/pGNAndSPN/2956?type=PGN)";
CM_ BO_ 2565894400  "Source: isobus.net VDMA Data Dictionary (https://www.isobus.net/isobus/pGNAndSPN/2960?type=PGN)";
CM_ BO_ 2565894656  "Source: isobus.net VDMA Data Dictionary (https://www.isobus.net/isobus/pGNAndSPN/2964?type=PGN)";
CM_ BO_ 2565894912  "Source: isobus.net VDMA Data Dictionary (https://www.isobus.net/isobus/pGNAndSPN/2970?type=PGN)";
CM_ BO_ 2565895168  "Source: isobus.net VDMA Data Dictionary (https://www.isobus.net/isobus/pGNAndSPN/2976?type=PGN)";
CM_ BO_ 2565895424  "Source: isobus.net VDMA Data Dictionary (https://www.isobus.net/isobus/pGNAndSPN/2981?type=PGN)";
CM_ BO_ 2565895680  "Source: isobus.net VDMA Data Dictionary (https://www.isobus.net/isobus/pGNAndSPN/2987?type=PGN)";
CM_ BO_ 2565895936  "Source: isobus.net VDMA Data Dictionary (https://www.isobus.net/isobus/pGNAndSPN/2993?type=PGN)";
CM_ BO_ 2565896192  "Source: isobus.net VDMA Data Dictionary (https://www.isobus.net/isobus/pGNAndSPN/2999?type=PGN)";
CM_ BO_ 2565896448  "Source: isobus.net VDMA Data Dictionary (https://www.isobus.net/isobus/pGNAndSPN/3001?type=PGN)";
CM_ BO_ 2565896704  "Source: isobus.net VDMA Data Dictionary (https://www.isobus.net/isobus/pGNAndSPN/3006?type=PGN)";
CM_ BO_ 2565896960  "Source: isobus.net VDMA Data Dictionary (https://www.isobus.net/isobus/pGNAndSPN/3012?type=PGN)";
CM_ BO_ 2565897216  "Source: isobus.net VDMA Data Dictionary (https://www.isobus.net/isobus/pGNAndSPN/3018?type=PGN)";
CM_ BO_ 2565897472  "Source: isobus.net VDMA Data Dictionary (https://www.isobus.net/isobus/pGNAndSPN/3024?type=PGN)";
CM_ BO_ 2565897728  "Source: isobus.net VDMA Data Dictionary (https://www.isobus.net/isobus/pGNAndSPN/3026?type=PGN)";
CM_ BO_ 2565897984  "Source: isobus.net VDMA Data Dictionary (https://www.isobus.net/isobus/pGNAndSPN/3030?type=PGN)";
CM_ BO_ 2565898240  "Source: isobus.net VDMA Data Dictionary (https://www.isobus.net/isobus/pGNAndSPN/3033?type=PGN)";
CM_ BO_ 2565898496  "Source: isobus.net VDMA Data Dictionary (https://www.isobus.net/isobus/pGNAndSPN/3037?type=PGN)";
CM_ BO_ 2565898752  "Source: isobus.net VDMA Data Dictionary (https://www.isobus.net/isobus/pGNAndSPN/3040?type=PGN)";
CM_ BO_ 2565899008  "Source: isobus.net VDMA Data Dictionary (https://www.isobus.net/isobus/pGNAndSPN/3047?type=PGN)";
CM_ BO_ 2565899264  "Source: isobus.net VDMA Data Dictionary (https://www.isobus.net/isobus/pGNAndSPN/3054?type=PGN)";
CM_ BO_ 2565899520  "Source: isobus.net VDMA Data Dictionary (https://www.isobus.net/isobus/pGNAndSPN/3060?type=PGN)";
CM_ BO_ 2565899776  "Source: isobus.net VDMA Data Dictionary (https://www.isobus.net/isobus/pGNAndSPN/3066?type=PGN)";
CM_ BO_ 2565900032  "Source: isobus.net VDMA Data Dictionary (https://www.isobus.net/isobus/pGNAndSPN/3070?type=PGN)";
CM_ BO_ 2565900288  "Source: isobus.net VDMA Data Dictionary (https://www.isobus.net/isobus/pGNAndSPN/3074?type=PGN)";
CM_ BO_ 2565900544  "Source: isobus.net VDMA Data Dictionary (https://www.isobus.net/isobus/pGNAndSPN/3077?type=PGN)";
CM_ BO_ 2565900800  "Source: isobus.net VDMA Data Dictionary (https://www.isobus.net/isobus/pGNAndSPN/3080?type=PGN)";
CM_ BO_ 2565901056  "Source: isobus.net VDMA Data Dictionary (https://www.isobus.net/isobus/pGNAndSPN/3083?type=PGN)";
CM_ BO_ 2565901312  "Source: isobus.net VDMA Data Dictionary (https://www.isobus.net/isobus/pGNAndSPN/3086?type=PGN)";
CM_ BO_ 2565901568  "Source: isobus.net VDMA Data Dictionary (https://www.isobus.net/isobus/pGNAndSPN/3089?type=PGN)";
CM_ BO_ 2565901824  "Source: isobus.net VDMA Data Dictionary (https://www.isobus.net/isobus/pGNAndSPN/3092?type=PGN)";
CM_ BO_ 2565902336  "Source: isobus.net VDMA Data Dictionary (https://www.isobus.net/isobus/pGNAndSPN/3096?type=PGN)";
CM_ BO_ 2565902592  "Source: isobus.net VDMA Data Dictionary (https://www.isobus.net/isobus/pGNAndSPN/3100?type=PGN)";
CM_ BO_ 2565902848  "Source: isobus.net VDMA Data Dictionary (https://www.isobus.net/isobus/pGNAndSPN/3104?type=PGN)";
CM_ BO_ 2565903104  "Source: isobus.net VDMA Data Dictionary (https://www.isobus.net/isobus/pGNAndSPN/3107?type=PGN)";
CM_ BO_ 2565903360  "Source: isobus.net VDMA Data Dictionary (https://www.isobus.net/isobus/pGNAndSPN/3111?type=PGN)";
CM_ BO_ 2565903616  "Source: isobus.net VDMA Data Dictionary (https://www.isobus.net/isobus/pGNAndSPN/3117?type=PGN)";
CM_ BO_ 2565903872  "Source: isobus.net VDMA Data Dictionary (https://www.isobus.net/isobus/pGNAndSPN/3135?type=PGN)";
CM_ BO_ 2565904128  "Source: isobus.net VDMA Data Dictionary (https://www.isobus.net/isobus/pGNAndSPN/3137?type=PGN)";
CM_ BO_ 2565904384  "Source: isobus.net VDMA Data Dictionary (https://www.isobus.net/isobus/pGNAndSPN/3139?type=PGN)";
CM_ BO_ 2565904640  "Source: isobus.net VDMA Data Dictionary (https://www.isobus.net/isobus/pGNAndSPN/3141?type=PGN)";
CM_ BO_ 2565904896  "Source: isobus.net VDMA Data Dictionary (https://www.isobus.net/isobus/pGNAndSPN/3143?type=PGN)";
CM_ BO_ 2565905152  "Source: isobus.net VDMA Data Dictionary (https://www.isobus.net/isobus/pGNAndSPN/3145?type=PGN)";
CM_ BO_ 2565905408  "Source: isobus.net VDMA Data Dictionary (https://www.isobus.net/isobus/pGNAndSPN/3147?type=PGN)";
CM_ BO_ 2565906432  "Source: isobus.net VDMA Data Dictionary (https://www.isobus.net/isobus/pGNAndSPN/3150?type=PGN)";
CM_ BO_ 2565916672  "Source: isobus.net VDMA Data Dictionary (https://www.isobus.net/isobus/pGNAndSPN/3154?type=PGN)";
CM_ BO_ 2565916928  "Source: isobus.net VDMA Data Dictionary (https://www.isobus.net/isobus/pGNAndSPN/3156?type=PGN)";
CM_ BO_ 2565917184  "Source: isobus.net VDMA Data Dictionary (https://www.isobus.net/isobus/pGNAndSPN/3166?type=PGN)";
CM_ BO_ 2565917440  "Source: isobus.net VDMA Data Dictionary (https://www.isobus.net/isobus/pGNAndSPN/3170?type=PGN)";
CM_ BO_ 2565917696  "Source: isobus.net VDMA Data Dictionary (https://www.isobus.net/isobus/pGNAndSPN/3172?type=PGN)";
CM_ BO_ 2565917952  "Source: isobus.net VDMA Data Dictionary (https://www.isobus.net/isobus/pGNAndSPN/3182?type=PGN)";
CM_ BO_ 2565918208  "Source: isobus.net VDMA Data Dictionary (https://www.isobus.net/isobus/pGNAndSPN/3184?type=PGN)";
CM_ BO_ 2565918464  "Source: isobus.net VDMA Data Dictionary (https://www.isobus.net/isobus/pGNAndSPN/3186?type=PGN)";
CM_ BO_ 2565918720  "Source: isobus.net VDMA Data Dictionary (https://www.isobus.net/isobus/pGNAndSPN/3211?type=PGN)";
CM_ BO_ 2565918976  "Source: isobus.net VDMA Data Dictionary (https://www.isobus.net/isobus/pGNAndSPN/3217?type=PGN)";
CM_ BO_ 2565919232  "Source: isobus.net VDMA Data Dictionary (https://www.isobus.net/isobus/pGNAndSPN/3220?type=PGN)";
CM_ BO_ 2565919488  "Source: isobus.net VDMA Data Dictionary (https://www.isobus.net/isobus/pGNAndSPN/3230?type=PGN)";
CM_ BO_ 2565920256  "Source: isobus.net VDMA Data Dictionary (https://www.isobus.net/isobus/pGNAndSPN/3240?type=PGN)";
CM_ BO_ 2565920512  "Source: isobus.net VDMA Data Dictionary (https://www.isobus.net/isobus/pGNAndSPN/3247?type=PGN)";
CM_ BO_ 2565921280  "Source: isobus.net VDMA Data Dictionary (https://www.isobus.net/isobus/pGNAndSPN/3257?type=PGN)";
CM_ BO_ 2565921536  "Source: isobus.net VDMA Data Dictionary (https://www.isobus.net/isobus/pGNAndSPN/3264?type=PGN)";
CM_ BO_ 2565922304  "Source: isobus.net VDMA Data Dictionary (https://www.isobus.net/isobus/pGNAndSPN/3274?type=PGN)";
CM_ BO_ 2565922560  "Source: isobus.net VDMA Data Dictionary (https://www.isobus.net/isobus/pGNAndSPN/3281?type=PGN)";
CM_ BO_ 2565923328  "Source: isobus.net VDMA Data Dictionary (https://www.isobus.net/isobus/pGNAndSPN/3291?type=PGN)";
CM_ BO_ 2565923584  "Source: isobus.net VDMA Data Dictionary (https://www.isobus.net/isobus/pGNAndSPN/3298?type=PGN)";
CM_ BO_ 2565924096  "Source: isobus.net VDMA Data Dictionary (https://www.isobus.net/isobus/pGNAndSPN/3307?type=PGN)";
CM_ BO_ 2565924352  "Source: isobus.net VDMA Data Dictionary (https://www.isobus.net/isobus/pGNAndSPN/3315?type=PGN)";
CM_ BO_ 2565924608  "Source: isobus.net VDMA Data Dictionary (https://www.isobus.net/isobus/pGNAndSPN/3323?type=PGN)";
CM_ BO_ 2565924864  "Source: isobus.net VDMA Data Dictionary (https://www.isobus.net/isobus/pGNAndSPN/3327?type=PGN)";
CM_ BO_ 2565925120  "Source: isobus.net VDMA Data Dictionary (https://www.isobus.net/isobus/pGNAndSPN/3338?type=PGN)";
CM_ BO_ 2565925376  "Source: isobus.net VDMA Data Dictionary (https://www.isobus.net/isobus/pGNAndSPN/3349?type=PGN)";
CM_ BO_ 2565925632  "Source: isobus.net VDMA Data Dictionary (https://www.isobus.net/isobus/pGNAndSPN/3360?type=PGN)";
CM_ BO_ 2565925888  "Source: isobus.net VDMA Data Dictionary (https://www.isobus.net/isobus/pGNAndSPN/3371?type=PGN)";
CM_ BO_ 2565926144  "Source: isobus.net VDMA Data Dictionary (https://www.isobus.net/isobus/pGNAndSPN/3379?type=PGN)";
CM_ BO_ 2565927936  "Source: isobus.net VDMA Data Dictionary (https://www.isobus.net/isobus/pGNAndSPN/3389?type=PGN)";
CM_ BO_ 2565928192  "Source: isobus.net VDMA Data Dictionary (https://www.isobus.net/isobus/pGNAndSPN/3396?type=PGN)";
CM_ BO_ 2565928448  "Source: isobus.net VDMA Data Dictionary (https://www.isobus.net/isobus/pGNAndSPN/3397?type=PGN)";
CM_ BO_ 2565928704  "Source: isobus.net VDMA Data Dictionary (https://www.isobus.net/isobus/pGNAndSPN/3398?type=PGN)";
CM_ BO_ 2565928960  "Source: isobus.net VDMA Data Dictionary (https://www.isobus.net/isobus/pGNAndSPN/3399?type=PGN)";
CM_ BO_ 2565929216  "Source: isobus.net VDMA Data Dictionary (https://www.isobus.net/isobus/pGNAndSPN/3407?type=PGN)";
CM_ BO_ 2565929472  "Source: isobus.net VDMA Data Dictionary (https://www.isobus.net/isobus/pGNAndSPN/3420?type=PGN)";
CM_ BO_ 2565929728  "Source: isobus.net VDMA Data Dictionary (https://www.isobus.net/isobus/pGNAndSPN/3423?type=PGN)";
CM_ BO_ 2565929984  "Source: isobus.net VDMA Data Dictionary (https://www.isobus.net/isobus/pGNAndSPN/3426?type=PGN)";
CM_ BO_ 2565930240  "Source: isobus.net VDMA Data Dictionary (https://www.isobus.net/isobus/pGNAndSPN/3427?type=PGN)";
CM_ BO_ 2565930496  "Source: isobus.net VDMA Data Dictionary (https://www.isobus.net/isobus/pGNAndSPN/3428?type=PGN)";
CM_ BO_ 2565930752  "Source: isobus.net VDMA Data Dictionary (https://www.isobus.net/isobus/pGNAndSPN/3434?type=PGN)";
CM_ BO_ 2565931008  "Source: isobus.net VDMA Data Dictionary (https://www.isobus.net/isobus/pGNAndSPN/3438?type=PGN)";
CM_ BO_ 2565931264  "Source: isobus.net VDMA Data Dictionary (https://www.isobus.net/isobus/pGNAndSPN/3444?type=PGN)";
CM_ BO_ 2565931520  "Source: isobus.net VDMA Data Dictionary (https://www.isobus.net/isobus/pGNAndSPN/3448?type=PGN)";
CM_ BO_ 2565931776  "Source: isobus.net VDMA Data Dictionary (https://www.isobus.net/isobus/pGNAndSPN/3450?type=PGN)";
CM_ BO_ 2565932032  "Source: isobus.net VDMA Data Dictionary (https://www.isobus.net/isobus/pGNAndSPN/3451?type=PGN)";
CM_ BO_ 2565932288  "Source: isobus.net VDMA Data Dictionary (https://www.isobus.net/isobus/pGNAndSPN/3453?type=PGN)";
CM_ BO_ 2565932544  "Source: isobus.net VDMA Data Dictionary (https://www.isobus.net/isobus/pGNAndSPN/3455?type=PGN)";
CM_ BO_ 2565932800  "Source: isobus.net VDMA Data Dictionary (https://www.isobus.net/isobus/pGNAndSPN/3459?type=PGN)";
CM_ BO_ 2565933056  "Source: isobus.net VDMA Data Dictionary (https://www.isobus.net/isobus/pGNAndSPN/3491?type=PGN)";
CM_ BO_ 2565933312  "Source: isobus.net VDMA Data Dictionary (https://www.isobus.net/isobus/pGNAndSPN/3500?type=PGN)";
CM_ BO_ 2565933568  "Source: isobus.net VDMA Data Dictionary (https://www.isobus.net/isobus/pGNAndSPN/3505?type=PGN)";
CM_ BO_ 2565933824  "Source: isobus.net VDMA Data Dictionary (https://www.isobus.net/isobus/pGNAndSPN/3513?type=PGN)";
CM_ BO_ 2565934080  "Source: isobus.net VDMA Data Dictionary (https://www.isobus.net/isobus/pGNAndSPN/3519?type=PGN)";
CM_ BO_ 2565934336  "Source: isobus.net VDMA Data Dictionary (https://www.isobus.net/isobus/pGNAndSPN/3520?type=PGN)";
CM_ BO_ 2565934592  "Source: isobus.net VDMA Data Dictionary (https://www.isobus.net/isobus/pGNAndSPN/3524?type=PGN)";
CM_ BO_ 2565934848  "Source: isobus.net VDMA Data Dictionary (https://www.isobus.net/isobus/pGNAndSPN/3529?type=PGN)";
CM_ BO_ 2565935104  "Source: isobus.net VDMA Data Dictionary (https://www.isobus.net/isobus/pGNAndSPN/3531?type=PGN)";
CM_ BO_ 2565935360  "Source: isobus.net VDMA Data Dictionary (https://www.isobus.net/isobus/pGNAndSPN/3534?type=PGN)";
CM_ BO_ 2565935616  "Source: isobus.net VDMA Data Dictionary (https://www.isobus.net/isobus/pGNAndSPN/3540?type=PGN)";
CM_ BO_ 2565935872  "Source: isobus.net VDMA Data Dictionary (https://www.isobus.net/isobus/pGNAndSPN/3558?type=PGN)";
CM_ BO_ 2565936128  "Source: isobus.net VDMA Data Dictionary (https://www.isobus.net/isobus/pGNAndSPN/3562?type=PGN)";
CM_ BO_ 2565936384  "Source: isobus.net VDMA Data Dictionary (https://www.isobus.net/isobus/pGNAndSPN/3565?type=PGN)";
CM_ BO_ 2565936640  "Source: isobus.net VDMA Data Dictionary (https://www.isobus.net/isobus/pGNAndSPN/3570?type=PGN)";
CM_ BO_ 2565936896  "Source: isobus.net VDMA Data Dictionary (https://www.isobus.net/isobus/pGNAndSPN/3573?type=PGN)";
CM_ BO_ 2565937152  "Source: isobus.net VDMA Data Dictionary (https://www.isobus.net/isobus/pGNAndSPN/3579?type=PGN)";
CM_ BO_ 2565937408  "Source: isobus.net VDMA Data Dictionary (https://www.isobus.net/isobus/pGNAndSPN/3597?type=PGN)";
CM_ BO_ 2565937664  "Source: isobus.net VDMA Data Dictionary (https://www.isobus.net/isobus/pGNAndSPN/3601?type=PGN)";
CM_ BO_ 2565937920  "Source: isobus.net VDMA Data Dictionary (https://www.isobus.net/isobus/pGNAndSPN/3604?type=PGN)";
CM_ BO_ 2565938176  "Source: isobus.net VDMA Data Dictionary (https://www.isobus.net/isobus/pGNAndSPN/3607?type=PGN)";
CM_ BO_ 2565938432  "Source: isobus.net VDMA Data Dictionary (https://www.isobus.net/isobus/pGNAndSPN/3613?type=PGN)";
CM_ BO_ 2565938688  "Source: isobus.net VDMA Data Dictionary (https://www.isobus.net/isobus/pGNAndSPN/3631?type=PGN)";
CM_ BO_ 2565938944  "Source: isobus.net VDMA Data Dictionary (https://www.isobus.net/isobus/pGNAndSPN/3635?type=PGN)";
CM_ BO_ 2565939200  "Source: isobus.net VDMA Data Dictionary (https://www.isobus.net/isobus/pGNAndSPN/3638?type=PGN)";
CM_ BO_ 2565939456  "Source: isobus.net VDMA Data Dictionary (https://www.isobus.net/isobus/pGNAndSPN/3641?type=PGN)";
CM_ BO_ 2565939712  "Source: isobus.net VDMA Data Dictionary (https://www.isobus.net/isobus/pGNAndSPN/3647?type=PGN)";
CM_ BO_ 2565939968  "Source: isobus.net VDMA Data Dictionary (https://www.isobus.net/isobus/pGNAndSPN/3665?type=PGN)";
CM_ BO_ 2565940224  "Source: isobus.net VDMA Data Dictionary (https://www.isobus.net/isobus/pGNAndSPN/3669?type=PGN)";
CM_ BO_ 2565940480  "Source: isobus.net VDMA Data Dictionary (https://www.isobus.net/isobus/pGNAndSPN/3672?type=PGN)";
CM_ BO_ 2565940736  "Source: isobus.net VDMA Data Dictionary (https://www.isobus.net/isobus/pGNAndSPN/3675?type=PGN)";
CM_ BO_ 2565940992  "Source: isobus.net VDMA Data Dictionary (https://www.isobus.net/isobus/pGNAndSPN/3681?type=PGN)";
CM_ BO_ 2565941248  "Source: isobus.net VDMA Data Dictionary (https://www.isobus.net/isobus/pGNAndSPN/3685?type=PGN)";
CM_ BO_ 2565941504  "Source: isobus.net VDMA Data Dictionary (https://www.isobus.net/isobus/pGNAndSPN/3687?type=PGN)";
CM_ BO_ 2565941760  "Source: isobus.net VDMA Data Dictionary (https://www.isobus.net/isobus/pGNAndSPN/3697?type=PGN)";
CM_ BO_ 2565942016  "Source: isobus.net VDMA Data Dictionary (https://www.isobus.net/isobus/pGNAndSPN/3701?type=PGN)";
CM_ BO_ 2565942272  "Source: isobus.net VDMA Data Dictionary (https://www.isobus.net/isobus/pGNAndSPN/3703?type=PGN)";
CM_ BO_ 2565942528  "Source: isobus.net VDMA Data Dictionary (https://www.isobus.net/isobus/pGNAndSPN/3713?type=PGN)";
CM_ BO_ 2565942784  "Source: isobus.net VDMA Data Dictionary (https://www.isobus.net/isobus/pGNAndSPN/3723?type=PGN)";
CM_ BO_ 2565943040  "Source: isobus.net VDMA Data Dictionary (https://www.isobus.net/isobus/pGNAndSPN/3730?type=PGN)";
CM_ BO_ 2565943296  "Source: isobus.net VDMA Data Dictionary (https://www.isobus.net/isobus/pGNAndSPN/3734?type=PGN)";
CM_ BO_ 2565943552  "Source: isobus.net VDMA Data Dictionary (https://www.isobus.net/isobus/pGNAndSPN/3736?type=PGN)";
CM_ BO_ 2565943808  "Source: isobus.net VDMA Data Dictionary (https://www.isobus.net/isobus/pGNAndSPN/3746?type=PGN)";
CM_ BO_ 2565944064  "Source: isobus.net VDMA Data Dictionary (https://www.isobus.net/isobus/pGNAndSPN/3750?type=PGN)";
CM_ BO_ 2565944320  "Source: isobus.net VDMA Data Dictionary (https://www.isobus.net/isobus/pGNAndSPN/3754?type=PGN)";
CM_ BO_ 2565944576  "Source: isobus.net VDMA Data Dictionary (https://www.isobus.net/isobus/pGNAndSPN/3758?type=PGN)";
CM_ BO_ 2565944832  "Source: isobus.net VDMA Data Dictionary (https://www.isobus.net/isobus/pGNAndSPN/3762?type=PGN)";
CM_ BO_ 2565945088  "Source: isobus.net VDMA Data Dictionary (https://www.isobus.net/isobus/pGNAndSPN/3766?type=PGN)";
CM_ BO_ 2565945344  "Source: isobus.net VDMA Data Dictionary (https://www.isobus.net/isobus/pGNAndSPN/3770?type=PGN)";
CM_ BO_ 2565945600  "Source: isobus.net VDMA Data Dictionary (https://www.isobus.net/isobus/pGNAndSPN/3774?type=PGN)";
CM_ BO_ 2565945856  "Source: isobus.net VDMA Data Dictionary (https://www.isobus.net/isobus/pGNAndSPN/3778?type=PGN)";
CM_ BO_ 2565946112  "Source: isobus.net VDMA Data Dictionary (https://www.isobus.net/isobus/pGNAndSPN/3782?type=PGN)";
CM_ BO_ 2565946368  "Source: isobus.net VDMA Data Dictionary (https://www.isobus.net/isobus/pGNAndSPN/3786?type=PGN)";
CM_ BO_ 2565946624  "Source: isobus.net VDMA Data Dictionary (https://www.isobus.net/isobus/pGNAndSPN/3795?type=PGN)";
CM_ BO_ 2565946880  "Source: isobus.net VDMA Data Dictionary (https://www.isobus.net/isobus/pGNAndSPN/3796?type=PGN)";
CM_ BO_ 2565947136  "Source: isobus.net VDMA Data Dictionary (https://www.isobus.net/isobus/pGNAndSPN/3797?type=PGN)";
CM_ BO_ 2565947392  "Source: isobus.net VDMA Data Dictionary (https://www.isobus.net/isobus/pGNAndSPN/3801?type=PGN)";
CM_ BO_ 2565947648  "Source: isobus.net VDMA Data Dictionary (https://www.isobus.net/isobus/pGNAndSPN/3804?type=PGN)";
CM_ BO_ 2565947904  "Source: isobus.net VDMA Data Dictionary (https://www.isobus.net/isobus/pGNAndSPN/3806?type=PGN)";
CM_ BO_ 2565948160  "Source: isobus.net VDMA Data Dictionary (https://www.isobus.net/isobus/pGNAndSPN/3808?type=PGN)";
CM_ BO_ 2565948416  "Source: isobus.net VDMA Data Dictionary (https://www.isobus.net/isobus/pGNAndSPN/3814?type=PGN)";
CM_ BO_ 2565948672  "Source: isobus.net VDMA Data Dictionary (https://www.isobus.net/isobus/pGNAndSPN/3818?type=PGN)";
CM_ BO_ 2565948928  "Source: isobus.net VDMA Data Dictionary (https://www.isobus.net/isobus/pGNAndSPN/3822?type=PGN)";
CM_ BO_ 2565949184  "Source: isobus.net VDMA Data Dictionary (https://www.isobus.net/isobus/pGNAndSPN/3826?type=PGN)";
CM_ BO_ 2565949440  "Source: isobus.net VDMA Data Dictionary (https://www.isobus.net/isobus/pGNAndSPN/3830?type=PGN)";
CM_ BO_ 2565949696  "Source: isobus.net VDMA Data Dictionary (https://www.isobus.net/isobus/pGNAndSPN/3834?type=PGN)";
CM_ BO_ 2565949952  "Source: isobus.net VDMA Data Dictionary (https://www.isobus.net/isobus/pGNAndSPN/3838?type=PGN)";
CM_ BO_ 2565950208  "Source: isobus.net VDMA Data Dictionary (https://www.isobus.net/isobus/pGNAndSPN/3842?type=PGN)";
CM_ BO_ 2565950464  "Source: isobus.net VDMA Data Dictionary (https://www.isobus.net/isobus/pGNAndSPN/3846?type=PGN)";
CM_ BO_ 2565950720  "Source: isobus.net VDMA Data Dictionary (https://www.isobus.net/isobus/pGNAndSPN/3850?type=PGN)";
CM_ BO_ 2565950976  "Source: isobus.net VDMA Data Dictionary (https://www.isobus.net/isobus/pGNAndSPN/3854?type=PGN)";
CM_ BO_ 2565951232  "Source: isobus.net VDMA Data Dictionary (https://www.isobus.net/isobus/pGNAndSPN/3858?type=PGN)";
CM_ BO_ 2565951488  "Source: isobus.net VDMA Data Dictionary (https://www.isobus.net/isobus/pGNAndSPN/3862?type=PGN)";
CM_ BO_ 2565951744  "Source: isobus.net VDMA Data Dictionary (https://www.isobus.net/isobus/pGNAndSPN/3866?type=PGN)";
CM_ BO_ 2565952000  "Source: isobus.net VDMA Data Dictionary (https://www.isobus.net/isobus/pGNAndSPN/3870?type=PGN)";
CM_ BO_ 2565952256  "Source: isobus.net VDMA Data Dictionary (https://www.isobus.net/isobus/pGNAndSPN/3874?type=PGN)";
CM_ BO_ 2565952512  "Source: isobus.net VDMA Data Dictionary (https://www.isobus.net/isobus/pGNAndSPN/3878?type=PGN)";
CM_ BO_ 2565952768  "Source: isobus.net VDMA Data Dictionary (https://www.isobus.net/isobus/pGNAndSPN/3882?type=PGN)";
CM_ BO_ 2565953024  "Source: isobus.net VDMA Data Dictionary (https://www.isobus.net/isobus/pGNAndSPN/3886?type=PGN)";
CM_ BO_ 2565953280  "Source: isobus.net VDMA Data Dictionary (https://www.isobus.net/isobus/pGNAndSPN/3890?type=PGN)";
CM_ BO_ 2565953536  "Source: isobus.net VDMA Data Dictionary (https://www.isobus.net/isobus/pGNAndSPN/3894?type=PGN)";
CM_ BO_ 2565953792  "Source: isobus.net VDMA Data Dictionary (https://www.isobus.net/isobus/pGNAndSPN/3898?type=PGN)";
CM_ BO_ 2565954048  "Source: isobus.net VDMA Data Dictionary (https://www.isobus.net/isobus/pGNAndSPN/3902?type=PGN)";
CM_ BO_ 2565954304  "Source: isobus.net VDMA Data Dictionary (https://www.isobus.net/isobus/pGNAndSPN/3906?type=PGN)";
CM_ BO_ 2565954560  "Source: isobus.net VDMA Data Dictionary (https://www.isobus.net/isobus/pGNAndSPN/3910?type=PGN)";
CM_ BO_ 2565954816  "Source: isobus.net VDMA Data Dictionary (https://www.isobus.net/isobus/pGNAndSPN/3914?type=PGN)";
CM_ BO_ 2565955072  "Source: isobus.net VDMA Data Dictionary (https://www.isobus.net/isobus/pGNAndSPN/3918?type=PGN)";
CM_ BO_ 2565955328  "Source: isobus.net VDMA Data Dictionary (https://www.isobus.net/isobus/pGNAndSPN/3922?type=PGN)";
CM_ BO_ 2565955584  "Source: isobus.net VDMA Data Dictionary (https://www.isobus.net/isobus/pGNAndSPN/3926?type=PGN)";
CM_ BO_ 2565955840  "Source: isobus.net VDMA Data Dictionary (https://www.isobus.net/isobus/pGNAndSPN/3930?type=PGN)";
CM_ BO_ 2565956096  "Source: isobus.net VDMA Data Dictionary (https://www.isobus.net/isobus/pGNAndSPN/3934?type=PGN)";
CM_ BO_ 2565956352  "Source: isobus.net VDMA Data Dictionary (https://www.isobus.net/isobus/pGNAndSPN/3938?type=PGN)";
CM_ BO_ 2565956608  "Source: isobus.net VDMA Data Dictionary (https://www.isobus.net/isobus/pGNAndSPN/3942?type=PGN)";
CM_ BO_ 2565956864  "Source: isobus.net VDMA Data Dictionary (https://www.isobus.net/isobus/pGNAndSPN/3946?type=PGN)";
CM_ BO_ 2565957120  "Source: isobus.net VDMA Data Dictionary (https://www.isobus.net/isobus/pGNAndSPN/3950?type=PGN)";
CM_ BO_ 2565957376  "Source: isobus.net VDMA Data Dictionary (https://www.isobus.net/isobus/pGNAndSPN/3954?type=PGN)";
CM_ BO_ 2565957632  "Source: isobus.net VDMA Data Dictionary (https://www.isobus.net/isobus/pGNAndSPN/3958?type=PGN)";
CM_ BO_ 2565957888  "Source: isobus.net VDMA Data Dictionary (https://www.isobus.net/isobus/pGNAndSPN/3962?type=PGN)";
CM_ BO_ 2565958144  "Source: isobus.net VDMA Data Dictionary (https://www.isobus.net/isobus/pGNAndSPN/3966?type=PGN)";
CM_ BO_ 2565958400  "Source: isobus.net VDMA Data Dictionary (https://www.isobus.net/isobus/pGNAndSPN/3970?type=PGN)";
CM_ BO_ 2565958656  "Source: isobus.net VDMA Data Dictionary (https://www.isobus.net/isobus/pGNAndSPN/3974?type=PGN)";
CM_ BO_ 2565958912  "Source: isobus.net VDMA Data Dictionary (https://www.isobus.net/isobus/pGNAndSPN/3979?type=PGN)";
CM_ BO_ 2565959168  "Source: isobus.net VDMA Data Dictionary (https://www.isobus.net/isobus/pGNAndSPN/3984?type=PGN)";
CM_ BO_ 2565959424  "Source: isobus.net VDMA Data Dictionary (https://www.isobus.net/isobus/pGNAndSPN/3989?type=PGN)";
CM_ BO_ 2565959680  "Source: isobus.net VDMA Data Dictionary (https://www.isobus.net/isobus/pGNAndSPN/3994?type=PGN)";
CM_ BO_ 2565959936  "Source: isobus.net VDMA Data Dictionary (https://www.isobus.net/isobus/pGNAndSPN/3999?type=PGN)";
CM_ BO_ 2565960192  "Source: isobus.net VDMA Data Dictionary (https://www.isobus.net/isobus/pGNAndSPN/4004?type=PGN)";
CM_ BO_ 2565960448  "Source: isobus.net VDMA Data Dictionary (https://www.isobus.net/isobus/pGNAndSPN/4009?type=PGN)";
CM_ BO_ 2565960704  "Source: isobus.net VDMA Data Dictionary (https://www.isobus.net/isobus/pGNAndSPN/4014?type=PGN)";
CM_ BO_ 2565960960  "Source: isobus.net VDMA Data Dictionary (https://www.isobus.net/isobus/pGNAndSPN/4019?type=PGN)";
CM_ BO_ 2565961216  "Source: isobus.net VDMA Data Dictionary (https://www.isobus.net/isobus/pGNAndSPN/4024?type=PGN)";
CM_ BO_ 2565961472  "Source: isobus.net VDMA Data Dictionary (https://www.isobus.net/isobus/pGNAndSPN/4029?type=PGN)";
CM_ BO_ 2565961728  "Source: isobus.net VDMA Data Dictionary (https://www.isobus.net/isobus/pGNAndSPN/4034?type=PGN)";
CM_ BO_ 2565961984  "Source: isobus.net VDMA Data Dictionary (https://www.isobus.net/isobus/pGNAndSPN/4039?type=PGN)";
CM_ BO_ 2565962240  "Source: isobus.net VDMA Data Dictionary (https://www.isobus.net/isobus/pGNAndSPN/4044?type=PGN)";
CM_ BO_ 2565962496  "Source: isobus.net VDMA Data Dictionary (https://www.isobus.net/isobus/pGNAndSPN/4049?type=PGN)";
CM_ BO_ 2565962752  "Source: isobus.net VDMA Data Dictionary (https://www.isobus.net/isobus/pGNAndSPN/4054?type=PGN)";
CM_ BO_ 2565963008  "Source: isobus.net VDMA Data Dictionary (https://www.isobus.net/isobus/pGNAndSPN/4059?type=PGN)";
CM_ BO_ 2565963264  "Source: isobus.net VDMA Data Dictionary (https://www.isobus.net/isobus/pGNAndSPN/4064?type=PGN)";
CM_ BO_ 2565963520  "Source: isobus.net VDMA Data Dictionary (https://www.isobus.net/isobus/pGNAndSPN/4069?type=PGN)";
CM_ BO_ 2565963776  "Source: isobus.net VDMA Data Dictionary (https://www.isobus.net/isobus/pGNAndSPN/4074?type=PGN)";
CM_ BO_ 2565964032  "Source: isobus.net VDMA Data Dictionary (https://www.isobus.net/isobus/pGNAndSPN/4081?type=PGN)";
CM_ BO_ 2565964288  "Source: isobus.net VDMA Data Dictionary (https://www.isobus.net/isobus/pGNAndSPN/4087?type=PGN)";
CM_ BO_ 2565964544  "Source: isobus.net VDMA Data Dictionary (https://www.isobus.net/isobus/pGNAndSPN/4093?type=PGN)";
CM_ BO_ 2565964800  "Source: isobus.net VDMA Data Dictionary (https://www.isobus.net/isobus/pGNAndSPN/4099?type=PGN)";
CM_ BO_ 2565965056  "Source: isobus.net VDMA Data Dictionary (https://www.isobus.net/isobus/pGNAndSPN/4101?type=PGN)";
CM_ BO_ 2565965312  "Source: isobus.net VDMA Data Dictionary (https://www.isobus.net/isobus/pGNAndSPN/4108?type=PGN)";
CM_ BO_ 2565965568  "Source: isobus.net VDMA Data Dictionary (https://www.isobus.net/isobus/pGNAndSPN/4114?type=PGN)";
CM_ BO_ 2565965824  "Source: isobus.net VDMA Data Dictionary (https://www.isobus.net/isobus/pGNAndSPN/4120?type=PGN)";
CM_ BO_ 2565966080  "Source: isobus.net VDMA Data Dictionary (https://www.isobus.net/isobus/pGNAndSPN/4126?type=PGN)";
CM_ BO_ 2565966336  "Source: isobus.net VDMA Data Dictionary (https://www.isobus.net/isobus/pGNAndSPN/4128?type=PGN)";
CM_ BO_ 2565966592  "Source: isobus.net VDMA Data Dictionary (https://www.isobus.net/isobus/pGNAndSPN/4132?type=PGN)";
CM_ BO_ 2565966848  "Source: isobus.net VDMA Data Dictionary (https://www.isobus.net/isobus/pGNAndSPN/4136?type=PGN)";
CM_ BO_ 2565967104  "Source: isobus.net VDMA Data Dictionary (https://www.isobus.net/isobus/pGNAndSPN/4140?type=PGN)";
CM_ BO_ 2565967360  "Source: isobus.net VDMA Data Dictionary (https://www.isobus.net/isobus/pGNAndSPN/4144?type=PGN)";
CM_ BO_ 2565967616  "Source: isobus.net VDMA Data Dictionary (https://www.isobus.net/isobus/pGNAndSPN/4149?type=PGN)";
CM_ BO_ 2565967872  "Source: isobus.net VDMA Data Dictionary (https://www.isobus.net/isobus/pGNAndSPN/4161?type=PGN)";
CM_ BO_ 2565968128  "Source: isobus.net VDMA Data Dictionary (https://www.isobus.net/isobus/pGNAndSPN/4165?type=PGN)";
CM_ BO_ 2565968384  "Source: isobus.net VDMA Data Dictionary (https://www.isobus.net/isobus/pGNAndSPN/4169?type=PGN)";
CM_ BO_ 2565968640  "Source: isobus.net VDMA Data Dictionary (https://www.isobus.net/isobus/pGNAndSPN/4173?type=PGN)";
CM_ BO_ 2565968896  "Source: isobus.net VDMA Data Dictionary (https://www.isobus.net/isobus/pGNAndSPN/4176?type=PGN)";
CM_ BO_ 2565969152  "Source: isobus.net VDMA Data Dictionary (https://www.isobus.net/isobus/pGNAndSPN/4180?type=PGN)";
CM_ BO_ 2565969408  "Source: isobus.net VDMA Data Dictionary (https://www.isobus.net/isobus/pGNAndSPN/4186?type=PGN)";
CM_ BO_ 2565969664  "Source: isobus.net VDMA Data Dictionary (https://www.isobus.net/isobus/pGNAndSPN/4203?type=PGN)";
CM_ BO_ 2565969920  "Source: isobus.net VDMA Data Dictionary (https://www.isobus.net/isobus/pGNAndSPN/4206?type=PGN)";
CM_ BO_ 2565970176  "Source: isobus.net VDMA Data Dictionary (https://www.isobus.net/isobus/pGNAndSPN/4238?type=PGN)";
CM_ BO_ 2565970432  "Source: isobus.net VDMA Data Dictionary (https://www.isobus.net/isobus/pGNAndSPN/4246?type=PGN)";
CM_ BO_ 2565970688  "Source: isobus.net VDMA Data Dictionary (https://www.isobus.net/isobus/pGNAndSPN/4251?type=PGN)";
CM_ BO_ 2565970944  "Source: isobus.net VDMA Data Dictionary (https://www.isobus.net/isobus/pGNAndSPN/4259?type=PGN)";
CM_ BO_ 2565971200  "Source: isobus.net VDMA Data Dictionary (https://www.isobus.net/isobus/pGNAndSPN/4265?type=PGN)";
CM_ BO_ 2565971456  "Source: isobus.net VDMA Data Dictionary (https://www.isobus.net/isobus/pGNAndSPN/4268?type=PGN)";
CM_ BO_ 2565971712  "Source: isobus.net VDMA Data Dictionary (https://www.isobus.net/isobus/pGNAndSPN/4280?type=PGN)";
CM_ SG_ 2565875712 Aftertreatment_2_SCR_Ammonia_Inf "Generic 8-byte raw payload. Detail page: https://www.isobus.net/isobus/pGNAndSPN/2597?type=PGN. Signal-level enrichment via PR welcome  see CONTRIBUTING.md.";
CM_ SG_ 2565875968 Slope_Sensor_Information_2_RawPa "Generic 8-byte raw payload. Detail page: https://www.isobus.net/isobus/pGNAndSPN/2604?type=PGN. Signal-level enrichment via PR welcome  see CONTRIBUTING.md.";
CM_ SG_ 2565876224 Angular_Rate_Information_RawPayl "Generic 8-byte raw payload. Detail page: https://www.isobus.net/isobus/pGNAndSPN/2611?type=PGN. Signal-level enrichment via PR welcome  see CONTRIBUTING.md.";
CM_ SG_ 2565876480 Crash_Notification_RawPayload "Generic 8-byte raw payload. Detail page: https://www.isobus.net/isobus/pGNAndSPN/2614?type=PGN. Signal-level enrichment via PR welcome  see CONTRIBUTING.md.";
CM_ SG_ 2565876736 Magnet_Status_Information_2_RawP "Generic 8-byte raw payload. Detail page: https://www.isobus.net/isobus/pGNAndSPN/2624?type=PGN. Signal-level enrichment via PR welcome  see CONTRIBUTING.md.";
CM_ SG_ 2565876992 Acceleration_Sensor_RawPayload "Generic 8-byte raw payload. Detail page: https://www.isobus.net/isobus/pGNAndSPN/2631?type=PGN. Signal-level enrichment via PR welcome  see CONTRIBUTING.md.";
CM_ SG_ 2565877248 Engine_Turbocharger_Control_1_Ra "Generic 8-byte raw payload. Detail page: https://www.isobus.net/isobus/pGNAndSPN/2635?type=PGN. Signal-level enrichment via PR welcome  see CONTRIBUTING.md.";
CM_ SG_ 2565877504 Advanced_Emergency_Braking_Syste "Generic 8-byte raw payload. Detail page: https://www.isobus.net/isobus/pGNAndSPN/2641?type=PGN. Signal-level enrichment via PR welcome  see CONTRIBUTING.md.";
CM_ SG_ 2565877760 Wireless_Status_RawPayload "Generic 8-byte raw payload. Detail page: https://www.isobus.net/isobus/pGNAndSPN/2645?type=PGN. Signal-level enrichment via PR welcome  see CONTRIBUTING.md.";
CM_ SG_ 2565878016 Wand_Sensor_RawPayload "Generic 8-byte raw payload. Detail page: https://www.isobus.net/isobus/pGNAndSPN/2647?type=PGN. Signal-level enrichment via PR welcome  see CONTRIBUTING.md.";
CM_ SG_ 2565878272 Linear_Displacement_Sensor_RawPa "Generic 8-byte raw payload. Detail page: https://www.isobus.net/isobus/pGNAndSPN/2649?type=PGN. Signal-level enrichment via PR welcome  see CONTRIBUTING.md.";
CM_ SG_ 2565878528 Aftertreatment_1_SCR_Ammonia_Inf "Generic 8-byte raw payload. Detail page: https://www.isobus.net/isobus/pGNAndSPN/2656?type=PGN. Signal-level enrichment via PR welcome  see CONTRIBUTING.md.";
CM_ SG_ 2565878784 Aftertreatment_2_SCR_Ammonia_Inf "Generic 8-byte raw payload. Detail page: https://www.isobus.net/isobus/pGNAndSPN/2663?type=PGN. Signal-level enrichment via PR welcome  see CONTRIBUTING.md.";
CM_ SG_ 2565879296 High_Voltage_Energy_Storage_Syst "Generic 8-byte raw payload. Detail page: https://www.isobus.net/isobus/pGNAndSPN/2677?type=PGN. Signal-level enrichment via PR welcome  see CONTRIBUTING.md.";
CM_ SG_ 2565879552 Engine_Turbocharger_Blowoff_Actu "Generic 8-byte raw payload. Detail page: https://www.isobus.net/isobus/pGNAndSPN/2683?type=PGN. Signal-level enrichment via PR welcome  see CONTRIBUTING.md.";
CM_ SG_ 2565879808 Engine_Torque_Fuel_Request_RawPa "Generic 8-byte raw payload. Detail page: https://www.isobus.net/isobus/pGNAndSPN/2688?type=PGN. Signal-level enrichment via PR welcome  see CONTRIBUTING.md.";
CM_ SG_ 2565880064 Engine_Air_System_Information_Ra "Generic 8-byte raw payload. Detail page: https://www.isobus.net/isobus/pGNAndSPN/2692?type=PGN. Signal-level enrichment via PR welcome  see CONTRIBUTING.md.";
CM_ SG_ 2565880320 Engine_Cylinder_1_Combustion_Inf "Generic 8-byte raw payload. Detail page: https://www.isobus.net/isobus/pGNAndSPN/2698?type=PGN. Signal-level enrichment via PR welcome  see CONTRIBUTING.md.";
CM_ SG_ 2565880576 Engine_Cylinder_2_Combustion_Inf "Generic 8-byte raw payload. Detail page: https://www.isobus.net/isobus/pGNAndSPN/2704?type=PGN. Signal-level enrichment via PR welcome  see CONTRIBUTING.md.";
CM_ SG_ 2565880832 Engine_Cylinder_3_Combustion_Inf "Generic 8-byte raw payload. Detail page: https://www.isobus.net/isobus/pGNAndSPN/2710?type=PGN. Signal-level enrichment via PR welcome  see CONTRIBUTING.md.";
CM_ SG_ 2565881088 Engine_Cylinder_4_Combustion_Inf "Generic 8-byte raw payload. Detail page: https://www.isobus.net/isobus/pGNAndSPN/2716?type=PGN. Signal-level enrichment via PR welcome  see CONTRIBUTING.md.";
CM_ SG_ 2565881344 Engine_Cylinder_5_Combustion_Inf "Generic 8-byte raw payload. Detail page: https://www.isobus.net/isobus/pGNAndSPN/2722?type=PGN. Signal-level enrichment via PR welcome  see CONTRIBUTING.md.";
CM_ SG_ 2565881600 Engine_Cylinder_6_Combustion_Inf "Generic 8-byte raw payload. Detail page: https://www.isobus.net/isobus/pGNAndSPN/2728?type=PGN. Signal-level enrichment via PR welcome  see CONTRIBUTING.md.";
CM_ SG_ 2565881856 Engine_Cylinder_7_Combustion_Inf "Generic 8-byte raw payload. Detail page: https://www.isobus.net/isobus/pGNAndSPN/2734?type=PGN. Signal-level enrichment via PR welcome  see CONTRIBUTING.md.";
CM_ SG_ 2565882112 Engine_Cylinder_8_Combustion_Inf "Generic 8-byte raw payload. Detail page: https://www.isobus.net/isobus/pGNAndSPN/2740?type=PGN. Signal-level enrichment via PR welcome  see CONTRIBUTING.md.";
CM_ SG_ 2565882368 Engine_Cylinder_9_Combustion_Inf "Generic 8-byte raw payload. Detail page: https://www.isobus.net/isobus/pGNAndSPN/2746?type=PGN. Signal-level enrichment via PR welcome  see CONTRIBUTING.md.";
CM_ SG_ 2565882624 Engine_Cylinder_10_Combustion_In "Generic 8-byte raw payload. Detail page: https://www.isobus.net/isobus/pGNAndSPN/2752?type=PGN. Signal-level enrichment via PR welcome  see CONTRIBUTING.md.";
CM_ SG_ 2565882880 Engine_Cylinder_11_Combustion_In "Generic 8-byte raw payload. Detail page: https://www.isobus.net/isobus/pGNAndSPN/2758?type=PGN. Signal-level enrichment via PR welcome  see CONTRIBUTING.md.";
CM_ SG_ 2565883136 Engine_Cylinder_12_Combustion_In "Generic 8-byte raw payload. Detail page: https://www.isobus.net/isobus/pGNAndSPN/2764?type=PGN. Signal-level enrichment via PR welcome  see CONTRIBUTING.md.";
CM_ SG_ 2565883392 Engine_Cylinder_13_Combustion_In "Generic 8-byte raw payload. Detail page: https://www.isobus.net/isobus/pGNAndSPN/2770?type=PGN. Signal-level enrichment via PR welcome  see CONTRIBUTING.md.";
CM_ SG_ 2565883648 Engine_Cylinder_14_Combustion_In "Generic 8-byte raw payload. Detail page: https://www.isobus.net/isobus/pGNAndSPN/2776?type=PGN. Signal-level enrichment via PR welcome  see CONTRIBUTING.md.";
CM_ SG_ 2565883904 Engine_Cylinder_15_Combustion_In "Generic 8-byte raw payload. Detail page: https://www.isobus.net/isobus/pGNAndSPN/2782?type=PGN. Signal-level enrichment via PR welcome  see CONTRIBUTING.md.";
CM_ SG_ 2565884160 Engine_Cylinder_16_Combustion_In "Generic 8-byte raw payload. Detail page: https://www.isobus.net/isobus/pGNAndSPN/2788?type=PGN. Signal-level enrichment via PR welcome  see CONTRIBUTING.md.";
CM_ SG_ 2565884416 Engine_Cylinder_17_Combustion_In "Generic 8-byte raw payload. Detail page: https://www.isobus.net/isobus/pGNAndSPN/2794?type=PGN. Signal-level enrichment via PR welcome  see CONTRIBUTING.md.";
CM_ SG_ 2565884672 Engine_Cylinder_18_Combustion_In "Generic 8-byte raw payload. Detail page: https://www.isobus.net/isobus/pGNAndSPN/2800?type=PGN. Signal-level enrichment via PR welcome  see CONTRIBUTING.md.";
CM_ SG_ 2565884928 Engine_Cylinder_19_Combustion_In "Generic 8-byte raw payload. Detail page: https://www.isobus.net/isobus/pGNAndSPN/2806?type=PGN. Signal-level enrichment via PR welcome  see CONTRIBUTING.md.";
CM_ SG_ 2565885184 Engine_Cylinder_20_Combustion_In "Generic 8-byte raw payload. Detail page: https://www.isobus.net/isobus/pGNAndSPN/2812?type=PGN. Signal-level enrichment via PR welcome  see CONTRIBUTING.md.";
CM_ SG_ 2565885440 Engine_Cylinder_1_Combustion_Ave "Generic 8-byte raw payload. Detail page: https://www.isobus.net/isobus/pGNAndSPN/2816?type=PGN. Signal-level enrichment via PR welcome  see CONTRIBUTING.md.";
CM_ SG_ 2565885696 Engine_Cylinder_2_Combustion_Ave "Generic 8-byte raw payload. Detail page: https://www.isobus.net/isobus/pGNAndSPN/2820?type=PGN. Signal-level enrichment via PR welcome  see CONTRIBUTING.md.";
CM_ SG_ 2565885952 Engine_Cylinder_3_Combustion_Ave "Generic 8-byte raw payload. Detail page: https://www.isobus.net/isobus/pGNAndSPN/2824?type=PGN. Signal-level enrichment via PR welcome  see CONTRIBUTING.md.";
CM_ SG_ 2565886208 Engine_Cylinder_4_Combustion_Ave "Generic 8-byte raw payload. Detail page: https://www.isobus.net/isobus/pGNAndSPN/2828?type=PGN. Signal-level enrichment via PR welcome  see CONTRIBUTING.md.";
CM_ SG_ 2565886464 Engine_Cylinder_5_Combustion_Ave "Generic 8-byte raw payload. Detail page: https://www.isobus.net/isobus/pGNAndSPN/2832?type=PGN. Signal-level enrichment via PR welcome  see CONTRIBUTING.md.";
CM_ SG_ 2565886720 Engine_Cylinder_6_Combustion_Ave "Generic 8-byte raw payload. Detail page: https://www.isobus.net/isobus/pGNAndSPN/2836?type=PGN. Signal-level enrichment via PR welcome  see CONTRIBUTING.md.";
CM_ SG_ 2565886976 Engine_Cylinder_7_Combustion_Ave "Generic 8-byte raw payload. Detail page: https://www.isobus.net/isobus/pGNAndSPN/2840?type=PGN. Signal-level enrichment via PR welcome  see CONTRIBUTING.md.";
CM_ SG_ 2565887232 Engine_Cylinder_8_Combustion_Ave "Generic 8-byte raw payload. Detail page: https://www.isobus.net/isobus/pGNAndSPN/2844?type=PGN. Signal-level enrichment via PR welcome  see CONTRIBUTING.md.";
CM_ SG_ 2565887488 Engine_Cylinder_9_Combustion_Ave "Generic 8-byte raw payload. Detail page: https://www.isobus.net/isobus/pGNAndSPN/2848?type=PGN. Signal-level enrichment via PR welcome  see CONTRIBUTING.md.";
CM_ SG_ 2565887744 Engine_Cylinder_10_Combustion_Av "Generic 8-byte raw payload. Detail page: https://www.isobus.net/isobus/pGNAndSPN/2852?type=PGN. Signal-level enrichment via PR welcome  see CONTRIBUTING.md.";
CM_ SG_ 2565888000 Engine_Cylinder_11_Combustion_Av "Generic 8-byte raw payload. Detail page: https://www.isobus.net/isobus/pGNAndSPN/2856?type=PGN. Signal-level enrichment via PR welcome  see CONTRIBUTING.md.";
CM_ SG_ 2565888256 Engine_Cylinder_12_Combustion_Av "Generic 8-byte raw payload. Detail page: https://www.isobus.net/isobus/pGNAndSPN/2860?type=PGN. Signal-level enrichment via PR welcome  see CONTRIBUTING.md.";
CM_ SG_ 2565888512 Engine_Cylinder_13_Combustion_Av "Generic 8-byte raw payload. Detail page: https://www.isobus.net/isobus/pGNAndSPN/2864?type=PGN. Signal-level enrichment via PR welcome  see CONTRIBUTING.md.";
CM_ SG_ 2565888768 Engine_Cylinder_14_Combustion_Av "Generic 8-byte raw payload. Detail page: https://www.isobus.net/isobus/pGNAndSPN/2868?type=PGN. Signal-level enrichment via PR welcome  see CONTRIBUTING.md.";
CM_ SG_ 2565889024 Engine_Cylinder_15_Combustion_Av "Generic 8-byte raw payload. Detail page: https://www.isobus.net/isobus/pGNAndSPN/2872?type=PGN. Signal-level enrichment via PR welcome  see CONTRIBUTING.md.";
CM_ SG_ 2565889280 Engine_Cylinder_16_Combustion_Av "Generic 8-byte raw payload. Detail page: https://www.isobus.net/isobus/pGNAndSPN/2876?type=PGN. Signal-level enrichment via PR welcome  see CONTRIBUTING.md.";
CM_ SG_ 2565889536 Engine_Cylinder_17_Combustion_Av "Generic 8-byte raw payload. Detail page: https://www.isobus.net/isobus/pGNAndSPN/2880?type=PGN. Signal-level enrichment via PR welcome  see CONTRIBUTING.md.";
CM_ SG_ 2565889792 Engine_Cylinder_18_Combustion_Av "Generic 8-byte raw payload. Detail page: https://www.isobus.net/isobus/pGNAndSPN/2884?type=PGN. Signal-level enrichment via PR welcome  see CONTRIBUTING.md.";
CM_ SG_ 2565890048 Engine_Cylinder_19_Combustion_Av "Generic 8-byte raw payload. Detail page: https://www.isobus.net/isobus/pGNAndSPN/2888?type=PGN. Signal-level enrichment via PR welcome  see CONTRIBUTING.md.";
CM_ SG_ 2565890304 Engine_Cylinder_20_Combustion_Av "Generic 8-byte raw payload. Detail page: https://www.isobus.net/isobus/pGNAndSPN/2892?type=PGN. Signal-level enrichment via PR welcome  see CONTRIBUTING.md.";
CM_ SG_ 2565890560 Electronic_Transmission_Controll "Generic 8-byte raw payload. Detail page: https://www.isobus.net/isobus/pGNAndSPN/2896?type=PGN. Signal-level enrichment via PR welcome  see CONTRIBUTING.md.";
CM_ SG_ 2565890816 Fuel_Information_5_Gaseous_RawPa "Generic 8-byte raw payload. Detail page: https://www.isobus.net/isobus/pGNAndSPN/2900?type=PGN. Signal-level enrichment via PR welcome  see CONTRIBUTING.md.";
CM_ SG_ 2565891072 Engine_Gaseous_Fuel_Valve_Durati "Generic 8-byte raw payload. Detail page: https://www.isobus.net/isobus/pGNAndSPN/2904?type=PGN. Signal-level enrichment via PR welcome  see CONTRIBUTING.md.";
CM_ SG_ 2565891328 Engine_Gaseous_Fuel_Valve_Durati "Generic 8-byte raw payload. Detail page: https://www.isobus.net/isobus/pGNAndSPN/2908?type=PGN. Signal-level enrichment via PR welcome  see CONTRIBUTING.md.";
CM_ SG_ 2565891584 Engine_Gaseous_Fuel_Valve_Durati "Generic 8-byte raw payload. Detail page: https://www.isobus.net/isobus/pGNAndSPN/2912?type=PGN. Signal-level enrichment via PR welcome  see CONTRIBUTING.md.";
CM_ SG_ 2565891840 Engine_Gaseous_Fuel_Valve_Durati "Generic 8-byte raw payload. Detail page: https://www.isobus.net/isobus/pGNAndSPN/2916?type=PGN. Signal-level enrichment via PR welcome  see CONTRIBUTING.md.";
CM_ SG_ 2565892096 Engine_Gaseous_Fuel_Valve_Durati "Generic 8-byte raw payload. Detail page: https://www.isobus.net/isobus/pGNAndSPN/2920?type=PGN. Signal-level enrichment via PR welcome  see CONTRIBUTING.md.";
CM_ SG_ 2565892352 Engine_Gaseous_Fuel_Valve_Start_ "Generic 8-byte raw payload. Detail page: https://www.isobus.net/isobus/pGNAndSPN/2924?type=PGN. Signal-level enrichment via PR welcome  see CONTRIBUTING.md.";
CM_ SG_ 2565892608 Engine_Gaseous_Fuel_Valve_Start_ "Generic 8-byte raw payload. Detail page: https://www.isobus.net/isobus/pGNAndSPN/2928?type=PGN. Signal-level enrichment via PR welcome  see CONTRIBUTING.md.";
CM_ SG_ 2565892864 Engine_Gaseous_Fuel_Valve_Start_ "Generic 8-byte raw payload. Detail page: https://www.isobus.net/isobus/pGNAndSPN/2932?type=PGN. Signal-level enrichment via PR welcome  see CONTRIBUTING.md.";
CM_ SG_ 2565893120 Engine_Gaseous_Fuel_Valve_Start_ "Generic 8-byte raw payload. Detail page: https://www.isobus.net/isobus/pGNAndSPN/2936?type=PGN. Signal-level enrichment via PR welcome  see CONTRIBUTING.md.";
CM_ SG_ 2565893376 Engine_Gaseous_Fuel_Valve_Start_ "Generic 8-byte raw payload. Detail page: https://www.isobus.net/isobus/pGNAndSPN/2940?type=PGN. Signal-level enrichment via PR welcome  see CONTRIBUTING.md.";
CM_ SG_ 2565893632 Fuel_Pump_Actuator_Control_Comma "Generic 8-byte raw payload. Detail page: https://www.isobus.net/isobus/pGNAndSPN/2942?type=PGN. Signal-level enrichment via PR welcome  see CONTRIBUTING.md.";
CM_ SG_ 2565893888 Power_Converter_1_Control_1_RawP "Generic 8-byte raw payload. Detail page: https://www.isobus.net/isobus/pGNAndSPN/2949?type=PGN. Signal-level enrichment via PR welcome  see CONTRIBUTING.md.";
CM_ SG_ 2565894144 Power_Converter_2_Control_1_RawP "Generic 8-byte raw payload. Detail page: https://www.isobus.net/isobus/pGNAndSPN/2956?type=PGN. Signal-level enrichment via PR welcome  see CONTRIBUTING.md.";
CM_ SG_ 2565894400 Power_Converter_1_Rate_Limits_Re "Generic 8-byte raw payload. Detail page: https://www.isobus.net/isobus/pGNAndSPN/2960?type=PGN. Signal-level enrichment via PR welcome  see CONTRIBUTING.md.";
CM_ SG_ 2565894656 Power_Converter_2_Rate_Limits_Re "Generic 8-byte raw payload. Detail page: https://www.isobus.net/isobus/pGNAndSPN/2964?type=PGN. Signal-level enrichment via PR welcome  see CONTRIBUTING.md.";
CM_ SG_ 2565894912 Power_Converter_2_Control_2_RawP "Generic 8-byte raw payload. Detail page: https://www.isobus.net/isobus/pGNAndSPN/2970?type=PGN. Signal-level enrichment via PR welcome  see CONTRIBUTING.md.";
CM_ SG_ 2565895168 Power_Converter_1_Control_2_RawP "Generic 8-byte raw payload. Detail page: https://www.isobus.net/isobus/pGNAndSPN/2976?type=PGN. Signal-level enrichment via PR welcome  see CONTRIBUTING.md.";
CM_ SG_ 2565895424 Power_Converter_1_Mode_Feedback_ "Generic 8-byte raw payload. Detail page: https://www.isobus.net/isobus/pGNAndSPN/2981?type=PGN. Signal-level enrichment via PR welcome  see CONTRIBUTING.md.";
CM_ SG_ 2565895680 Power_Converter_1_Limits_Active_ "Generic 8-byte raw payload. Detail page: https://www.isobus.net/isobus/pGNAndSPN/2987?type=PGN. Signal-level enrichment via PR welcome  see CONTRIBUTING.md.";
CM_ SG_ 2565895936 Power_Converter_1_Limits_Active_ "Generic 8-byte raw payload. Detail page: https://www.isobus.net/isobus/pGNAndSPN/2993?type=PGN. Signal-level enrichment via PR welcome  see CONTRIBUTING.md.";
CM_ SG_ 2565896192 Power_Converter_1_Limits_Active_ "Generic 8-byte raw payload. Detail page: https://www.isobus.net/isobus/pGNAndSPN/2999?type=PGN. Signal-level enrichment via PR welcome  see CONTRIBUTING.md.";
CM_ SG_ 2565896448 Power_Converter_1_Low_Voltage_Ra "Generic 8-byte raw payload. Detail page: https://www.isobus.net/isobus/pGNAndSPN/3001?type=PGN. Signal-level enrichment via PR welcome  see CONTRIBUTING.md.";
CM_ SG_ 2565896704 Power_Converter_2_Mode_Feedback_ "Generic 8-byte raw payload. Detail page: https://www.isobus.net/isobus/pGNAndSPN/3006?type=PGN. Signal-level enrichment via PR welcome  see CONTRIBUTING.md.";
CM_ SG_ 2565896960 Power_Converter_2_Limits_Active_ "Generic 8-byte raw payload. Detail page: https://www.isobus.net/isobus/pGNAndSPN/3012?type=PGN. Signal-level enrichment via PR welcome  see CONTRIBUTING.md.";
CM_ SG_ 2565897216 Power_Converter_2_Limits_Active_ "Generic 8-byte raw payload. Detail page: https://www.isobus.net/isobus/pGNAndSPN/3018?type=PGN. Signal-level enrichment via PR welcome  see CONTRIBUTING.md.";
CM_ SG_ 2565897472 Power_Converter_2_Limits_Active_ "Generic 8-byte raw payload. Detail page: https://www.isobus.net/isobus/pGNAndSPN/3024?type=PGN. Signal-level enrichment via PR welcome  see CONTRIBUTING.md.";
CM_ SG_ 2565897728 Power_Converter_2_Low_Voltage_Ra "Generic 8-byte raw payload. Detail page: https://www.isobus.net/isobus/pGNAndSPN/3026?type=PGN. Signal-level enrichment via PR welcome  see CONTRIBUTING.md.";
CM_ SG_ 2565897984 Power_Converter_1_Status_2_RawPa "Generic 8-byte raw payload. Detail page: https://www.isobus.net/isobus/pGNAndSPN/3030?type=PGN. Signal-level enrichment via PR welcome  see CONTRIBUTING.md.";
CM_ SG_ 2565898240 Power_Converter_1_Rate_Limits_Ac "Generic 8-byte raw payload. Detail page: https://www.isobus.net/isobus/pGNAndSPN/3033?type=PGN. Signal-level enrichment via PR welcome  see CONTRIBUTING.md.";
CM_ SG_ 2565898496 Power_Converter_2_Status_2_RawPa "Generic 8-byte raw payload. Detail page: https://www.isobus.net/isobus/pGNAndSPN/3037?type=PGN. Signal-level enrichment via PR welcome  see CONTRIBUTING.md.";
CM_ SG_ 2565898752 Power_Converter_2_Rate_Limits_Ac "Generic 8-byte raw payload. Detail page: https://www.isobus.net/isobus/pGNAndSPN/3040?type=PGN. Signal-level enrichment via PR welcome  see CONTRIBUTING.md.";
CM_ SG_ 2565899008 Power_Converter_2_Isolation_Inte "Generic 8-byte raw payload. Detail page: https://www.isobus.net/isobus/pGNAndSPN/3047?type=PGN. Signal-level enrichment via PR welcome  see CONTRIBUTING.md.";
CM_ SG_ 2565899264 Power_Converter_1_Isolation_Inte "Generic 8-byte raw payload. Detail page: https://www.isobus.net/isobus/pGNAndSPN/3054?type=PGN. Signal-level enrichment via PR welcome  see CONTRIBUTING.md.";
CM_ SG_ 2565899520 Power_Converter_2_Status_1_RawPa "Generic 8-byte raw payload. Detail page: https://www.isobus.net/isobus/pGNAndSPN/3060?type=PGN. Signal-level enrichment via PR welcome  see CONTRIBUTING.md.";
CM_ SG_ 2565899776 Power_Converter_1_Status_1_RawPa "Generic 8-byte raw payload. Detail page: https://www.isobus.net/isobus/pGNAndSPN/3066?type=PGN. Signal-level enrichment via PR welcome  see CONTRIBUTING.md.";
CM_ SG_ 2565900032 Wireless_Charger_System_Status_1 "Generic 8-byte raw payload. Detail page: https://www.isobus.net/isobus/pGNAndSPN/3070?type=PGN. Signal-level enrichment via PR welcome  see CONTRIBUTING.md.";
CM_ SG_ 2565900288 Wireless_Charger_Alignment_Quali "Generic 8-byte raw payload. Detail page: https://www.isobus.net/isobus/pGNAndSPN/3074?type=PGN. Signal-level enrichment via PR welcome  see CONTRIBUTING.md.";
CM_ SG_ 2565900544 Motor_Generator_1_Inverter_Contr "Generic 8-byte raw payload. Detail page: https://www.isobus.net/isobus/pGNAndSPN/3077?type=PGN. Signal-level enrichment via PR welcome  see CONTRIBUTING.md.";
CM_ SG_ 2565900800 Motor_Generator_2_Inverter_Contr "Generic 8-byte raw payload. Detail page: https://www.isobus.net/isobus/pGNAndSPN/3080?type=PGN. Signal-level enrichment via PR welcome  see CONTRIBUTING.md.";
CM_ SG_ 2565901056 Motor_Generator_3_Inverter_Contr "Generic 8-byte raw payload. Detail page: https://www.isobus.net/isobus/pGNAndSPN/3083?type=PGN. Signal-level enrichment via PR welcome  see CONTRIBUTING.md.";
CM_ SG_ 2565901312 Motor_Generator_4_Inverter_Contr "Generic 8-byte raw payload. Detail page: https://www.isobus.net/isobus/pGNAndSPN/3086?type=PGN. Signal-level enrichment via PR welcome  see CONTRIBUTING.md.";
CM_ SG_ 2565901568 Motor_Generator_5_Inverter_Contr "Generic 8-byte raw payload. Detail page: https://www.isobus.net/isobus/pGNAndSPN/3089?type=PGN. Signal-level enrichment via PR welcome  see CONTRIBUTING.md.";
CM_ SG_ 2565901824 Motor_Generator_6_Inverter_Contr "Generic 8-byte raw payload. Detail page: https://www.isobus.net/isobus/pGNAndSPN/3092?type=PGN. Signal-level enrichment via PR welcome  see CONTRIBUTING.md.";
CM_ SG_ 2565902336 High_Voltage_Energy_Storage_Syst "Generic 8-byte raw payload. Detail page: https://www.isobus.net/isobus/pGNAndSPN/3096?type=PGN. Signal-level enrichment via PR welcome  see CONTRIBUTING.md.";
CM_ SG_ 2565902592 High_Voltage_Energy_Storage_Syst "Generic 8-byte raw payload. Detail page: https://www.isobus.net/isobus/pGNAndSPN/3100?type=PGN. Signal-level enrichment via PR welcome  see CONTRIBUTING.md.";
CM_ SG_ 2565902848 High_Voltage_Energy_Storage_Syst "Generic 8-byte raw payload. Detail page: https://www.isobus.net/isobus/pGNAndSPN/3104?type=PGN. Signal-level enrichment via PR welcome  see CONTRIBUTING.md.";
CM_ SG_ 2565903104 High_Voltage_Energy_Storage_Syst "Generic 8-byte raw payload. Detail page: https://www.isobus.net/isobus/pGNAndSPN/3107?type=PGN. Signal-level enrichment via PR welcome  see CONTRIBUTING.md.";
CM_ SG_ 2565903360 High_Voltage_Energy_Storage_Syst "Generic 8-byte raw payload. Detail page: https://www.isobus.net/isobus/pGNAndSPN/3111?type=PGN. Signal-level enrichment via PR welcome  see CONTRIBUTING.md.";
CM_ SG_ 2565903616 High_Voltage_Energy_Storage_Syst "Generic 8-byte raw payload. Detail page: https://www.isobus.net/isobus/pGNAndSPN/3117?type=PGN. Signal-level enrichment via PR welcome  see CONTRIBUTING.md.";
CM_ SG_ 2565903872 High_Voltage_Energy_Storage_Syst "Generic 8-byte raw payload. Detail page: https://www.isobus.net/isobus/pGNAndSPN/3135?type=PGN. Signal-level enrichment via PR welcome  see CONTRIBUTING.md.";
CM_ SG_ 2565904128 Motor_Generator_1_Inverter_Therm "Generic 8-byte raw payload. Detail page: https://www.isobus.net/isobus/pGNAndSPN/3137?type=PGN. Signal-level enrichment via PR welcome  see CONTRIBUTING.md.";
CM_ SG_ 2565904384 Motor_Generator_2_Inverter_Therm "Generic 8-byte raw payload. Detail page: https://www.isobus.net/isobus/pGNAndSPN/3139?type=PGN. Signal-level enrichment via PR welcome  see CONTRIBUTING.md.";
CM_ SG_ 2565904640 Motor_Generator_3_Inverter_Therm "Generic 8-byte raw payload. Detail page: https://www.isobus.net/isobus/pGNAndSPN/3141?type=PGN. Signal-level enrichment via PR welcome  see CONTRIBUTING.md.";
CM_ SG_ 2565904896 Motor_Generator_4_Inverter_Therm "Generic 8-byte raw payload. Detail page: https://www.isobus.net/isobus/pGNAndSPN/3143?type=PGN. Signal-level enrichment via PR welcome  see CONTRIBUTING.md.";
CM_ SG_ 2565905152 Motor_Generator_5_Inverter_Therm "Generic 8-byte raw payload. Detail page: https://www.isobus.net/isobus/pGNAndSPN/3145?type=PGN. Signal-level enrichment via PR welcome  see CONTRIBUTING.md.";
CM_ SG_ 2565905408 Motor_Generator_6_Inverter_Therm "Generic 8-byte raw payload. Detail page: https://www.isobus.net/isobus/pGNAndSPN/3147?type=PGN. Signal-level enrichment via PR welcome  see CONTRIBUTING.md.";
CM_ SG_ 2565906432 High_Voltage_Energy_Storage_Syst "Generic 8-byte raw payload. Detail page: https://www.isobus.net/isobus/pGNAndSPN/3150?type=PGN. Signal-level enrichment via PR welcome  see CONTRIBUTING.md.";
CM_ SG_ 2565916672 DC_AC_Accessory_Inverter_1_Statu "Generic 8-byte raw payload. Detail page: https://www.isobus.net/isobus/pGNAndSPN/3154?type=PGN. Signal-level enrichment via PR welcome  see CONTRIBUTING.md.";
CM_ SG_ 2565916928 DC_AC_Accessory_Inverter_1_Volta "Generic 8-byte raw payload. Detail page: https://www.isobus.net/isobus/pGNAndSPN/3156?type=PGN. Signal-level enrichment via PR welcome  see CONTRIBUTING.md.";
CM_ SG_ 2565917184 DC_AC_Accessory_Inverter_1_Feedb "Generic 8-byte raw payload. Detail page: https://www.isobus.net/isobus/pGNAndSPN/3166?type=PGN. Signal-level enrichment via PR welcome  see CONTRIBUTING.md.";
CM_ SG_ 2565917440 DC_AC_Accessory_Inverter_2_Statu "Generic 8-byte raw payload. Detail page: https://www.isobus.net/isobus/pGNAndSPN/3170?type=PGN. Signal-level enrichment via PR welcome  see CONTRIBUTING.md.";
CM_ SG_ 2565917696 DC_AC_Accessory_Inverter_2_Volta "Generic 8-byte raw payload. Detail page: https://www.isobus.net/isobus/pGNAndSPN/3172?type=PGN. Signal-level enrichment via PR welcome  see CONTRIBUTING.md.";
CM_ SG_ 2565917952 DC_AC_Accessory_Inverter_2_Feedb "Generic 8-byte raw payload. Detail page: https://www.isobus.net/isobus/pGNAndSPN/3182?type=PGN. Signal-level enrichment via PR welcome  see CONTRIBUTING.md.";
CM_ SG_ 2565918208 Engine_Turbocharger_Control_4_Ra "Generic 8-byte raw payload. Detail page: https://www.isobus.net/isobus/pGNAndSPN/3184?type=PGN. Signal-level enrichment via PR welcome  see CONTRIBUTING.md.";
CM_ SG_ 2565918464 Engine_Turbocharger_Wastegate_Ac "Generic 8-byte raw payload. Detail page: https://www.isobus.net/isobus/pGNAndSPN/3186?type=PGN. Signal-level enrichment via PR welcome  see CONTRIBUTING.md.";
CM_ SG_ 2565918720 Engine_Cylinder_Combustion_Reque "Generic 8-byte raw payload. Detail page: https://www.isobus.net/isobus/pGNAndSPN/3211?type=PGN. Signal-level enrichment via PR welcome  see CONTRIBUTING.md.";
CM_ SG_ 2565918976 Engine_Cylinder_Head_Bypass_Actu "Generic 8-byte raw payload. Detail page: https://www.isobus.net/isobus/pGNAndSPN/3217?type=PGN. Signal-level enrichment via PR welcome  see CONTRIBUTING.md.";
CM_ SG_ 2565919232 Engine_Electronic_Controller_18_ "Generic 8-byte raw payload. Detail page: https://www.isobus.net/isobus/pGNAndSPN/3220?type=PGN. Signal-level enrichment via PR welcome  see CONTRIBUTING.md.";
CM_ SG_ 2565919488 Predictive_Cruise_Control_1_RawP "Generic 8-byte raw payload. Detail page: https://www.isobus.net/isobus/pGNAndSPN/3230?type=PGN. Signal-level enrichment via PR welcome  see CONTRIBUTING.md.";
CM_ SG_ 2565920256 DC_AC_Accessory_Inverter_1_Comma "Generic 8-byte raw payload. Detail page: https://www.isobus.net/isobus/pGNAndSPN/3240?type=PGN. Signal-level enrichment via PR welcome  see CONTRIBUTING.md.";
CM_ SG_ 2565920512 DC_AC_Accessory_Inverter_1_Feedb "Generic 8-byte raw payload. Detail page: https://www.isobus.net/isobus/pGNAndSPN/3247?type=PGN. Signal-level enrichment via PR welcome  see CONTRIBUTING.md.";
CM_ SG_ 2565921280 DC_AC_Accessory_Inverter_2_Comma "Generic 8-byte raw payload. Detail page: https://www.isobus.net/isobus/pGNAndSPN/3257?type=PGN. Signal-level enrichment via PR welcome  see CONTRIBUTING.md.";
CM_ SG_ 2565921536 DC_AC_Accessory_Inverter_2_Feedb "Generic 8-byte raw payload. Detail page: https://www.isobus.net/isobus/pGNAndSPN/3264?type=PGN. Signal-level enrichment via PR welcome  see CONTRIBUTING.md.";
CM_ SG_ 2565922304 DC_AC_Accessory_Inverter_3_Comma "Generic 8-byte raw payload. Detail page: https://www.isobus.net/isobus/pGNAndSPN/3274?type=PGN. Signal-level enrichment via PR welcome  see CONTRIBUTING.md.";
CM_ SG_ 2565922560 DC_AC_Accessory_Inverter_3_Feedb "Generic 8-byte raw payload. Detail page: https://www.isobus.net/isobus/pGNAndSPN/3281?type=PGN. Signal-level enrichment via PR welcome  see CONTRIBUTING.md.";
CM_ SG_ 2565923328 DC_AC_Accessory_Inverter_4_Comma "Generic 8-byte raw payload. Detail page: https://www.isobus.net/isobus/pGNAndSPN/3291?type=PGN. Signal-level enrichment via PR welcome  see CONTRIBUTING.md.";
CM_ SG_ 2565923584 DC_AC_Accessory_Inverter_4_Feedb "Generic 8-byte raw payload. Detail page: https://www.isobus.net/isobus/pGNAndSPN/3298?type=PGN. Signal-level enrichment via PR welcome  see CONTRIBUTING.md.";
CM_ SG_ 2565924096 Engine_Ignition_Timing_Offset_1_ "Generic 8-byte raw payload. Detail page: https://www.isobus.net/isobus/pGNAndSPN/3307?type=PGN. Signal-level enrichment via PR welcome  see CONTRIBUTING.md.";
CM_ SG_ 2565924352 Engine_Ignition_Timing_Offset_2_ "Generic 8-byte raw payload. Detail page: https://www.isobus.net/isobus/pGNAndSPN/3315?type=PGN. Signal-level enrichment via PR welcome  see CONTRIBUTING.md.";
CM_ SG_ 2565924608 Engine_Ignition_Timing_Offset_3_ "Generic 8-byte raw payload. Detail page: https://www.isobus.net/isobus/pGNAndSPN/3323?type=PGN. Signal-level enrichment via PR welcome  see CONTRIBUTING.md.";
CM_ SG_ 2565924864 Engine_Throttle_Fuel_Actuator_Co "Generic 8-byte raw payload. Detail page: https://www.isobus.net/isobus/pGNAndSPN/3327?type=PGN. Signal-level enrichment via PR welcome  see CONTRIBUTING.md.";
CM_ SG_ 2565925120 Aftertreatment_1_Intake_Gas_3_Ra "Generic 8-byte raw payload. Detail page: https://www.isobus.net/isobus/pGNAndSPN/3338?type=PGN. Signal-level enrichment via PR welcome  see CONTRIBUTING.md.";
CM_ SG_ 2565925376 Aftertreatment_1_Outlet_Gas_3_Ra "Generic 8-byte raw payload. Detail page: https://www.isobus.net/isobus/pGNAndSPN/3349?type=PGN. Signal-level enrichment via PR welcome  see CONTRIBUTING.md.";
CM_ SG_ 2565925632 Aftertreatment_2_Intake_Gas_3_Ra "Generic 8-byte raw payload. Detail page: https://www.isobus.net/isobus/pGNAndSPN/3360?type=PGN. Signal-level enrichment via PR welcome  see CONTRIBUTING.md.";
CM_ SG_ 2565925888 Aftertreatment_2_Outlet_Gas_3_Ra "Generic 8-byte raw payload. Detail page: https://www.isobus.net/isobus/pGNAndSPN/3371?type=PGN. Signal-level enrichment via PR welcome  see CONTRIBUTING.md.";
CM_ SG_ 2565926144 Engine_Start_Control_RawPayload "Generic 8-byte raw payload. Detail page: https://www.isobus.net/isobus/pGNAndSPN/3379?type=PGN. Signal-level enrichment via PR welcome  see CONTRIBUTING.md.";
CM_ SG_ 2565927936 Genset_Reactive_Power_and_Suppor "Generic 8-byte raw payload. Detail page: https://www.isobus.net/isobus/pGNAndSPN/3389?type=PGN. Signal-level enrichment via PR welcome  see CONTRIBUTING.md.";
CM_ SG_ 2565928192 Engine_Start_Arbitrator_RawPaylo "Generic 8-byte raw payload. Detail page: https://www.isobus.net/isobus/pGNAndSPN/3396?type=PGN. Signal-level enrichment via PR welcome  see CONTRIBUTING.md.";
CM_ SG_ 2565928448 Advanced_Driver_Assistance_Syste "Generic 8-byte raw payload. Detail page: https://www.isobus.net/isobus/pGNAndSPN/3397?type=PGN. Signal-level enrichment via PR welcome  see CONTRIBUTING.md.";
CM_ SG_ 2565928704 Advanced_Driver_Assistance_Syste "Generic 8-byte raw payload. Detail page: https://www.isobus.net/isobus/pGNAndSPN/3398?type=PGN. Signal-level enrichment via PR welcome  see CONTRIBUTING.md.";
CM_ SG_ 2565928960 Advanced_Driver_Assistance_Syste "Generic 8-byte raw payload. Detail page: https://www.isobus.net/isobus/pGNAndSPN/3399?type=PGN. Signal-level enrichment via PR welcome  see CONTRIBUTING.md.";
CM_ SG_ 2565929216 Engine_Valve_Controller_RawPaylo "Generic 8-byte raw payload. Detail page: https://www.isobus.net/isobus/pGNAndSPN/3407?type=PGN. Signal-level enrichment via PR welcome  see CONTRIBUTING.md.";
CM_ SG_ 2565929472 Electronic_Transmission_Controll "Generic 8-byte raw payload. Detail page: https://www.isobus.net/isobus/pGNAndSPN/3420?type=PGN. Signal-level enrichment via PR welcome  see CONTRIBUTING.md.";
CM_ SG_ 2565929728 Aftertreatment_1_SCR_Dosing_Syst "Generic 8-byte raw payload. Detail page: https://www.isobus.net/isobus/pGNAndSPN/3423?type=PGN. Signal-level enrichment via PR welcome  see CONTRIBUTING.md.";
CM_ SG_ 2565929984 Aftertreatment_2_SCR_Dosing_Syst "Generic 8-byte raw payload. Detail page: https://www.isobus.net/isobus/pGNAndSPN/3426?type=PGN. Signal-level enrichment via PR welcome  see CONTRIBUTING.md.";
CM_ SG_ 2565930240 Aftertreatment_1_SCR_Dosing_Syst "Generic 8-byte raw payload. Detail page: https://www.isobus.net/isobus/pGNAndSPN/3427?type=PGN. Signal-level enrichment via PR welcome  see CONTRIBUTING.md.";
CM_ SG_ 2565930496 Aftertreatment_2_SCR_Dosing_Syst "Generic 8-byte raw payload. Detail page: https://www.isobus.net/isobus/pGNAndSPN/3428?type=PGN. Signal-level enrichment via PR welcome  see CONTRIBUTING.md.";
CM_ SG_ 2565930752 Secondary_or_Front_Hitch_Roll_an "Generic 8-byte raw payload. Detail page: https://www.isobus.net/isobus/pGNAndSPN/3434?type=PGN. Signal-level enrichment via PR welcome  see CONTRIBUTING.md.";
CM_ SG_ 2565931008 Secondary_or_Front_Hitch_Roll_an "Generic 8-byte raw payload. Detail page: https://www.isobus.net/isobus/pGNAndSPN/3438?type=PGN. Signal-level enrichment via PR welcome  see CONTRIBUTING.md.";
CM_ SG_ 2565931264 Primary_or_Rear_Hitch_Roll_and_P "Generic 8-byte raw payload. Detail page: https://www.isobus.net/isobus/pGNAndSPN/3444?type=PGN. Signal-level enrichment via PR welcome  see CONTRIBUTING.md.";
CM_ SG_ 2565931520 Primary_or_Rear_Hitch_Roll_and_P "Generic 8-byte raw payload. Detail page: https://www.isobus.net/isobus/pGNAndSPN/3448?type=PGN. Signal-level enrichment via PR welcome  see CONTRIBUTING.md.";
CM_ SG_ 2565931776 Generator_Trip_Energy_RawPayload "Generic 8-byte raw payload. Detail page: https://www.isobus.net/isobus/pGNAndSPN/3450?type=PGN. Signal-level enrichment via PR welcome  see CONTRIBUTING.md.";
CM_ SG_ 2565932032 Engine_Speed_Sensor_Information_ "Generic 8-byte raw payload. Detail page: https://www.isobus.net/isobus/pGNAndSPN/3451?type=PGN. Signal-level enrichment via PR welcome  see CONTRIBUTING.md.";
CM_ SG_ 2565932288 Hydraulic_Pressure_Displacement_ "Generic 8-byte raw payload. Detail page: https://www.isobus.net/isobus/pGNAndSPN/3453?type=PGN. Signal-level enrichment via PR welcome  see CONTRIBUTING.md.";
CM_ SG_ 2565932544 Well_Stimulation_Pump_System_1_R "Generic 8-byte raw payload. Detail page: https://www.isobus.net/isobus/pGNAndSPN/3455?type=PGN. Signal-level enrichment via PR welcome  see CONTRIBUTING.md.";
CM_ SG_ 2565932800 Well_Stimulation_Pump_System_2_R "Generic 8-byte raw payload. Detail page: https://www.isobus.net/isobus/pGNAndSPN/3459?type=PGN. Signal-level enrichment via PR welcome  see CONTRIBUTING.md.";
CM_ SG_ 2565933056 High_Voltage_Energy_Storage_Syst "Generic 8-byte raw payload. Detail page: https://www.isobus.net/isobus/pGNAndSPN/3491?type=PGN. Signal-level enrichment via PR welcome  see CONTRIBUTING.md.";
CM_ SG_ 2565933312 High_Voltage_Energy_Storage_Syst "Generic 8-byte raw payload. Detail page: https://www.isobus.net/isobus/pGNAndSPN/3500?type=PGN. Signal-level enrichment via PR welcome  see CONTRIBUTING.md.";
CM_ SG_ 2565933568 High_Voltage_Energy_Storage_Syst "Generic 8-byte raw payload. Detail page: https://www.isobus.net/isobus/pGNAndSPN/3505?type=PGN. Signal-level enrichment via PR welcome  see CONTRIBUTING.md.";
CM_ SG_ 2565933824 High_Voltage_Energy_Storage_Syst "Generic 8-byte raw payload. Detail page: https://www.isobus.net/isobus/pGNAndSPN/3513?type=PGN. Signal-level enrichment via PR welcome  see CONTRIBUTING.md.";
CM_ SG_ 2565934080 High_Voltage_Energy_Storage_Syst "Generic 8-byte raw payload. Detail page: https://www.isobus.net/isobus/pGNAndSPN/3519?type=PGN. Signal-level enrichment via PR welcome  see CONTRIBUTING.md.";
CM_ SG_ 2565934336 Fuel_Information_6_Gaseous_RawPa "Generic 8-byte raw payload. Detail page: https://www.isobus.net/isobus/pGNAndSPN/3520?type=PGN. Signal-level enrichment via PR welcome  see CONTRIBUTING.md.";
CM_ SG_ 2565934592 Dump_Truck_Body_Information_RawP "Generic 8-byte raw payload. Detail page: https://www.isobus.net/isobus/pGNAndSPN/3524?type=PGN. Signal-level enrichment via PR welcome  see CONTRIBUTING.md.";
CM_ SG_ 2565934848 Engine_Operating_Information_2_R "Generic 8-byte raw payload. Detail page: https://www.isobus.net/isobus/pGNAndSPN/3529?type=PGN. Signal-level enrichment via PR welcome  see CONTRIBUTING.md.";
CM_ SG_ 2565935104 Brakes_2_RawPayload "Generic 8-byte raw payload. Detail page: https://www.isobus.net/isobus/pGNAndSPN/3531?type=PGN. Signal-level enrichment via PR welcome  see CONTRIBUTING.md.";
CM_ SG_ 2565935360 Gaseous_Fuel_Pressure_3_RawPaylo "Generic 8-byte raw payload. Detail page: https://www.isobus.net/isobus/pGNAndSPN/3534?type=PGN. Signal-level enrichment via PR welcome  see CONTRIBUTING.md.";
CM_ SG_ 2565935616 DC_DC_Converter_1_Control_RawPay "Generic 8-byte raw payload. Detail page: https://www.isobus.net/isobus/pGNAndSPN/3540?type=PGN. Signal-level enrichment via PR welcome  see CONTRIBUTING.md.";
CM_ SG_ 2565935872 DC_DC_Converter_1_Operating_Stat "Generic 8-byte raw payload. Detail page: https://www.isobus.net/isobus/pGNAndSPN/3558?type=PGN. Signal-level enrichment via PR welcome  see CONTRIBUTING.md.";
CM_ SG_ 2565936128 DC_DC_Converter_1_Voltage_and_Cu "Generic 8-byte raw payload. Detail page: https://www.isobus.net/isobus/pGNAndSPN/3562?type=PGN. Signal-level enrichment via PR welcome  see CONTRIBUTING.md.";
CM_ SG_ 2565936384 DC_DC_Converter_1_SLI_Battery_St "Generic 8-byte raw payload. Detail page: https://www.isobus.net/isobus/pGNAndSPN/3565?type=PGN. Signal-level enrichment via PR welcome  see CONTRIBUTING.md.";
CM_ SG_ 2565936640 Well_Stimulation_Pump_System_3_R "Generic 8-byte raw payload. Detail page: https://www.isobus.net/isobus/pGNAndSPN/3570?type=PGN. Signal-level enrichment via PR welcome  see CONTRIBUTING.md.";
CM_ SG_ 2565936896 DC_DC_Converter_1_Status_2_RawPa "Generic 8-byte raw payload. Detail page: https://www.isobus.net/isobus/pGNAndSPN/3573?type=PGN. Signal-level enrichment via PR welcome  see CONTRIBUTING.md.";
CM_ SG_ 2565937152 DC_DC_Converter_2_Control_RawPay "Generic 8-byte raw payload. Detail page: https://www.isobus.net/isobus/pGNAndSPN/3579?type=PGN. Signal-level enrichment via PR welcome  see CONTRIBUTING.md.";
CM_ SG_ 2565937408 DC_DC_Converter_2_Operating_Stat "Generic 8-byte raw payload. Detail page: https://www.isobus.net/isobus/pGNAndSPN/3597?type=PGN. Signal-level enrichment via PR welcome  see CONTRIBUTING.md.";
CM_ SG_ 2565937664 DC_DC_Converter_2_Voltage_and_Cu "Generic 8-byte raw payload. Detail page: https://www.isobus.net/isobus/pGNAndSPN/3601?type=PGN. Signal-level enrichment via PR welcome  see CONTRIBUTING.md.";
CM_ SG_ 2565937920 DC_DC_Converter_2_SLI_Battery_St "Generic 8-byte raw payload. Detail page: https://www.isobus.net/isobus/pGNAndSPN/3604?type=PGN. Signal-level enrichment via PR welcome  see CONTRIBUTING.md.";
CM_ SG_ 2565938176 DC_DC_Converter_2_Status_2_RawPa "Generic 8-byte raw payload. Detail page: https://www.isobus.net/isobus/pGNAndSPN/3607?type=PGN. Signal-level enrichment via PR welcome  see CONTRIBUTING.md.";
CM_ SG_ 2565938432 DC_DC_Converter_3_Control_RawPay "Generic 8-byte raw payload. Detail page: https://www.isobus.net/isobus/pGNAndSPN/3613?type=PGN. Signal-level enrichment via PR welcome  see CONTRIBUTING.md.";
CM_ SG_ 2565938688 DC_DC_Converter_3_Operating_Stat "Generic 8-byte raw payload. Detail page: https://www.isobus.net/isobus/pGNAndSPN/3631?type=PGN. Signal-level enrichment via PR welcome  see CONTRIBUTING.md.";
CM_ SG_ 2565938944 DC_DC_Converter_3_Voltage_and_Cu "Generic 8-byte raw payload. Detail page: https://www.isobus.net/isobus/pGNAndSPN/3635?type=PGN. Signal-level enrichment via PR welcome  see CONTRIBUTING.md.";
CM_ SG_ 2565939200 DC_DC_Converter_3_SLI_Battery_St "Generic 8-byte raw payload. Detail page: https://www.isobus.net/isobus/pGNAndSPN/3638?type=PGN. Signal-level enrichment via PR welcome  see CONTRIBUTING.md.";
CM_ SG_ 2565939456 DC_DC_Converter_3_Status_2_RawPa "Generic 8-byte raw payload. Detail page: https://www.isobus.net/isobus/pGNAndSPN/3641?type=PGN. Signal-level enrichment via PR welcome  see CONTRIBUTING.md.";
CM_ SG_ 2565939712 DC_DC_Converter_4_Control_RawPay "Generic 8-byte raw payload. Detail page: https://www.isobus.net/isobus/pGNAndSPN/3647?type=PGN. Signal-level enrichment via PR welcome  see CONTRIBUTING.md.";
CM_ SG_ 2565939968 DC_DC_Converter_4_Operating_Stat "Generic 8-byte raw payload. Detail page: https://www.isobus.net/isobus/pGNAndSPN/3665?type=PGN. Signal-level enrichment via PR welcome  see CONTRIBUTING.md.";
CM_ SG_ 2565940224 DC_DC_Converter_4_Voltage_and_Cu "Generic 8-byte raw payload. Detail page: https://www.isobus.net/isobus/pGNAndSPN/3669?type=PGN. Signal-level enrichment via PR welcome  see CONTRIBUTING.md.";
CM_ SG_ 2565940480 DC_DC_Converter_4_SLI_Battery_St "Generic 8-byte raw payload. Detail page: https://www.isobus.net/isobus/pGNAndSPN/3672?type=PGN. Signal-level enrichment via PR welcome  see CONTRIBUTING.md.";
CM_ SG_ 2565940736 DC_DC_Converter_4_Status_2_RawPa "Generic 8-byte raw payload. Detail page: https://www.isobus.net/isobus/pGNAndSPN/3675?type=PGN. Signal-level enrichment via PR welcome  see CONTRIBUTING.md.";
CM_ SG_ 2565940992 Slope_Sensor_Information_3_RawPa "Generic 8-byte raw payload. Detail page: https://www.isobus.net/isobus/pGNAndSPN/3681?type=PGN. Signal-level enrichment via PR welcome  see CONTRIBUTING.md.";
CM_ SG_ 2565941248 DC_AC_Accessory_Inverter_3_Statu "Generic 8-byte raw payload. Detail page: https://www.isobus.net/isobus/pGNAndSPN/3685?type=PGN. Signal-level enrichment via PR welcome  see CONTRIBUTING.md.";
CM_ SG_ 2565941504 DC_AC_Accessory_Inverter_3_Volta "Generic 8-byte raw payload. Detail page: https://www.isobus.net/isobus/pGNAndSPN/3687?type=PGN. Signal-level enrichment via PR welcome  see CONTRIBUTING.md.";
CM_ SG_ 2565941760 DC_AC_Accessory_Inverter_3_Feedb "Generic 8-byte raw payload. Detail page: https://www.isobus.net/isobus/pGNAndSPN/3697?type=PGN. Signal-level enrichment via PR welcome  see CONTRIBUTING.md.";
CM_ SG_ 2565942016 DC_AC_Accessory_Inverter_4_Statu "Generic 8-byte raw payload. Detail page: https://www.isobus.net/isobus/pGNAndSPN/3701?type=PGN. Signal-level enrichment via PR welcome  see CONTRIBUTING.md.";
CM_ SG_ 2565942272 DC_AC_Accessory_Inverter_4_Volta "Generic 8-byte raw payload. Detail page: https://www.isobus.net/isobus/pGNAndSPN/3703?type=PGN. Signal-level enrichment via PR welcome  see CONTRIBUTING.md.";
CM_ SG_ 2565942528 DC_AC_Accessory_Inverter_4_Feedb "Generic 8-byte raw payload. Detail page: https://www.isobus.net/isobus/pGNAndSPN/3713?type=PGN. Signal-level enrichment via PR welcome  see CONTRIBUTING.md.";
CM_ SG_ 2565942784 DC_AC_Accessory_Inverter_5_Comma "Generic 8-byte raw payload. Detail page: https://www.isobus.net/isobus/pGNAndSPN/3723?type=PGN. Signal-level enrichment via PR welcome  see CONTRIBUTING.md.";
CM_ SG_ 2565943040 DC_AC_Accessory_Inverter_5_Feedb "Generic 8-byte raw payload. Detail page: https://www.isobus.net/isobus/pGNAndSPN/3730?type=PGN. Signal-level enrichment via PR welcome  see CONTRIBUTING.md.";
CM_ SG_ 2565943296 DC_AC_Accessory_Inverter_5_Statu "Generic 8-byte raw payload. Detail page: https://www.isobus.net/isobus/pGNAndSPN/3734?type=PGN. Signal-level enrichment via PR welcome  see CONTRIBUTING.md.";
CM_ SG_ 2565943552 DC_AC_Accessory_Inverter_5_Volta "Generic 8-byte raw payload. Detail page: https://www.isobus.net/isobus/pGNAndSPN/3736?type=PGN. Signal-level enrichment via PR welcome  see CONTRIBUTING.md.";
CM_ SG_ 2565943808 DC_AC_Accessory_Inverter_5_Feedb "Generic 8-byte raw payload. Detail page: https://www.isobus.net/isobus/pGNAndSPN/3746?type=PGN. Signal-level enrichment via PR welcome  see CONTRIBUTING.md.";
CM_ SG_ 2565944064 Engine_Pre_Chamber_Fuel_Valve_Du "Generic 8-byte raw payload. Detail page: https://www.isobus.net/isobus/pGNAndSPN/3750?type=PGN. Signal-level enrichment via PR welcome  see CONTRIBUTING.md.";
CM_ SG_ 2565944320 Engine_Pre_Chamber_Fuel_Valve_Du "Generic 8-byte raw payload. Detail page: https://www.isobus.net/isobus/pGNAndSPN/3754?type=PGN. Signal-level enrichment via PR welcome  see CONTRIBUTING.md.";
CM_ SG_ 2565944576 Engine_Pre_Chamber_Fuel_Valve_Du "Generic 8-byte raw payload. Detail page: https://www.isobus.net/isobus/pGNAndSPN/3758?type=PGN. Signal-level enrichment via PR welcome  see CONTRIBUTING.md.";
CM_ SG_ 2565944832 Engine_Pre_Chamber_Fuel_Valve_Du "Generic 8-byte raw payload. Detail page: https://www.isobus.net/isobus/pGNAndSPN/3762?type=PGN. Signal-level enrichment via PR welcome  see CONTRIBUTING.md.";
CM_ SG_ 2565945088 Engine_Pre_Chamber_Fuel_Valve_Du "Generic 8-byte raw payload. Detail page: https://www.isobus.net/isobus/pGNAndSPN/3766?type=PGN. Signal-level enrichment via PR welcome  see CONTRIBUTING.md.";
CM_ SG_ 2565945344 Engine_Pre_Chamber_Fuel_Valve_St "Generic 8-byte raw payload. Detail page: https://www.isobus.net/isobus/pGNAndSPN/3770?type=PGN. Signal-level enrichment via PR welcome  see CONTRIBUTING.md.";
CM_ SG_ 2565945600 Engine_Pre_Chamber_Fuel_Valve_St "Generic 8-byte raw payload. Detail page: https://www.isobus.net/isobus/pGNAndSPN/3774?type=PGN. Signal-level enrichment via PR welcome  see CONTRIBUTING.md.";
CM_ SG_ 2565945856 Engine_Pre_Chamber_Fuel_Valve_St "Generic 8-byte raw payload. Detail page: https://www.isobus.net/isobus/pGNAndSPN/3778?type=PGN. Signal-level enrichment via PR welcome  see CONTRIBUTING.md.";
CM_ SG_ 2565946112 Engine_Pre_Chamber_Fuel_Valve_St "Generic 8-byte raw payload. Detail page: https://www.isobus.net/isobus/pGNAndSPN/3782?type=PGN. Signal-level enrichment via PR welcome  see CONTRIBUTING.md.";
CM_ SG_ 2565946368 Engine_Pre_Chamber_Fuel_Valve_St "Generic 8-byte raw payload. Detail page: https://www.isobus.net/isobus/pGNAndSPN/3786?type=PGN. Signal-level enrichment via PR welcome  see CONTRIBUTING.md.";
CM_ SG_ 2565946624 Active_Steering_System_Controls_ "Generic 8-byte raw payload. Detail page: https://www.isobus.net/isobus/pGNAndSPN/3795?type=PGN. Signal-level enrichment via PR welcome  see CONTRIBUTING.md.";
CM_ SG_ 2565946880 Secondary_or_Front_Hitch_Yaw_com "Generic 8-byte raw payload. Detail page: https://www.isobus.net/isobus/pGNAndSPN/3796?type=PGN. Signal-level enrichment via PR welcome  see CONTRIBUTING.md.";
CM_ SG_ 2565947136 Primary_or_Rear_Hitch_Yaw_comman "Generic 8-byte raw payload. Detail page: https://www.isobus.net/isobus/pGNAndSPN/3797?type=PGN. Signal-level enrichment via PR welcome  see CONTRIBUTING.md.";
CM_ SG_ 2565947392 Stationary_Inverter_Average_Basi "Generic 8-byte raw payload. Detail page: https://www.isobus.net/isobus/pGNAndSPN/3801?type=PGN. Signal-level enrichment via PR welcome  see CONTRIBUTING.md.";
CM_ SG_ 2565947648 Stationary_Inverter_Total_AC_Rea "Generic 8-byte raw payload. Detail page: https://www.isobus.net/isobus/pGNAndSPN/3804?type=PGN. Signal-level enrichment via PR welcome  see CONTRIBUTING.md.";
CM_ SG_ 2565947904 Stationary_Inverter_Total_AC_Pow "Generic 8-byte raw payload. Detail page: https://www.isobus.net/isobus/pGNAndSPN/3806?type=PGN. Signal-level enrichment via PR welcome  see CONTRIBUTING.md.";
CM_ SG_ 2565948160 Stationary_Inverter_Control_RawP "Generic 8-byte raw payload. Detail page: https://www.isobus.net/isobus/pGNAndSPN/3808?type=PGN. Signal-level enrichment via PR welcome  see CONTRIBUTING.md.";
CM_ SG_ 2565948416 Stationary_Inverter_to_Bus_Sync_ "Generic 8-byte raw payload. Detail page: https://www.isobus.net/isobus/pGNAndSPN/3814?type=PGN. Signal-level enrichment via PR welcome  see CONTRIBUTING.md.";
CM_ SG_ 2565948672 Engine_Cylinder_1_Combustion_Pre "Generic 8-byte raw payload. Detail page: https://www.isobus.net/isobus/pGNAndSPN/3818?type=PGN. Signal-level enrichment via PR welcome  see CONTRIBUTING.md.";
CM_ SG_ 2565948928 Engine_Cylinder_2_Combustion_Pre "Generic 8-byte raw payload. Detail page: https://www.isobus.net/isobus/pGNAndSPN/3822?type=PGN. Signal-level enrichment via PR welcome  see CONTRIBUTING.md.";
CM_ SG_ 2565949184 Engine_Cylinder_3_Combustion_Pre "Generic 8-byte raw payload. Detail page: https://www.isobus.net/isobus/pGNAndSPN/3826?type=PGN. Signal-level enrichment via PR welcome  see CONTRIBUTING.md.";
CM_ SG_ 2565949440 Engine_Cylinder_4_Combustion_Pre "Generic 8-byte raw payload. Detail page: https://www.isobus.net/isobus/pGNAndSPN/3830?type=PGN. Signal-level enrichment via PR welcome  see CONTRIBUTING.md.";
CM_ SG_ 2565949696 Engine_Cylinder_5_Combustion_Pre "Generic 8-byte raw payload. Detail page: https://www.isobus.net/isobus/pGNAndSPN/3834?type=PGN. Signal-level enrichment via PR welcome  see CONTRIBUTING.md.";
CM_ SG_ 2565949952 Engine_Cylinder_6_Combustion_Pre "Generic 8-byte raw payload. Detail page: https://www.isobus.net/isobus/pGNAndSPN/3838?type=PGN. Signal-level enrichment via PR welcome  see CONTRIBUTING.md.";
CM_ SG_ 2565950208 Engine_Cylinder_7_Combustion_Pre "Generic 8-byte raw payload. Detail page: https://www.isobus.net/isobus/pGNAndSPN/3842?type=PGN. Signal-level enrichment via PR welcome  see CONTRIBUTING.md.";
CM_ SG_ 2565950464 Engine_Cylinder_8_Combustion_Pre "Generic 8-byte raw payload. Detail page: https://www.isobus.net/isobus/pGNAndSPN/3846?type=PGN. Signal-level enrichment via PR welcome  see CONTRIBUTING.md.";
CM_ SG_ 2565950720 Engine_Cylinder_9_Combustion_Pre "Generic 8-byte raw payload. Detail page: https://www.isobus.net/isobus/pGNAndSPN/3850?type=PGN. Signal-level enrichment via PR welcome  see CONTRIBUTING.md.";
CM_ SG_ 2565950976 Engine_Cylinder_10_Combustion_Pr "Generic 8-byte raw payload. Detail page: https://www.isobus.net/isobus/pGNAndSPN/3854?type=PGN. Signal-level enrichment via PR welcome  see CONTRIBUTING.md.";
CM_ SG_ 2565951232 Engine_Cylinder_11_Combustion_Pr "Generic 8-byte raw payload. Detail page: https://www.isobus.net/isobus/pGNAndSPN/3858?type=PGN. Signal-level enrichment via PR welcome  see CONTRIBUTING.md.";
CM_ SG_ 2565951488 Engine_Cylinder_12_Combustion_Pr "Generic 8-byte raw payload. Detail page: https://www.isobus.net/isobus/pGNAndSPN/3862?type=PGN. Signal-level enrichment via PR welcome  see CONTRIBUTING.md.";
CM_ SG_ 2565951744 Engine_Cylinder_13_Combustion_Pr "Generic 8-byte raw payload. Detail page: https://www.isobus.net/isobus/pGNAndSPN/3866?type=PGN. Signal-level enrichment via PR welcome  see CONTRIBUTING.md.";
CM_ SG_ 2565952000 Engine_Cylinder_14_Combustion_Pr "Generic 8-byte raw payload. Detail page: https://www.isobus.net/isobus/pGNAndSPN/3870?type=PGN. Signal-level enrichment via PR welcome  see CONTRIBUTING.md.";
CM_ SG_ 2565952256 Engine_Cylinder_15_Combustion_Pr "Generic 8-byte raw payload. Detail page: https://www.isobus.net/isobus/pGNAndSPN/3874?type=PGN. Signal-level enrichment via PR welcome  see CONTRIBUTING.md.";
CM_ SG_ 2565952512 Engine_Cylinder_16_Combustion_Pr "Generic 8-byte raw payload. Detail page: https://www.isobus.net/isobus/pGNAndSPN/3878?type=PGN. Signal-level enrichment via PR welcome  see CONTRIBUTING.md.";
CM_ SG_ 2565952768 Engine_Cylinder_17_Combustion_Pr "Generic 8-byte raw payload. Detail page: https://www.isobus.net/isobus/pGNAndSPN/3882?type=PGN. Signal-level enrichment via PR welcome  see CONTRIBUTING.md.";
CM_ SG_ 2565953024 Engine_Cylinder_18_Combustion_Pr "Generic 8-byte raw payload. Detail page: https://www.isobus.net/isobus/pGNAndSPN/3886?type=PGN. Signal-level enrichment via PR welcome  see CONTRIBUTING.md.";
CM_ SG_ 2565953280 Engine_Cylinder_19_Combustion_Pr "Generic 8-byte raw payload. Detail page: https://www.isobus.net/isobus/pGNAndSPN/3890?type=PGN. Signal-level enrichment via PR welcome  see CONTRIBUTING.md.";
CM_ SG_ 2565953536 Engine_Cylinder_20_Combustion_Pr "Generic 8-byte raw payload. Detail page: https://www.isobus.net/isobus/pGNAndSPN/3894?type=PGN. Signal-level enrichment via PR welcome  see CONTRIBUTING.md.";
CM_ SG_ 2565953792 Engine_Cylinder_1_Combustion_Tim "Generic 8-byte raw payload. Detail page: https://www.isobus.net/isobus/pGNAndSPN/3898?type=PGN. Signal-level enrichment via PR welcome  see CONTRIBUTING.md.";
CM_ SG_ 2565954048 Engine_Cylinder_2_Combustion_Tim "Generic 8-byte raw payload. Detail page: https://www.isobus.net/isobus/pGNAndSPN/3902?type=PGN. Signal-level enrichment via PR welcome  see CONTRIBUTING.md.";
CM_ SG_ 2565954304 Engine_Cylinder_3_Combustion_Tim "Generic 8-byte raw payload. Detail page: https://www.isobus.net/isobus/pGNAndSPN/3906?type=PGN. Signal-level enrichment via PR welcome  see CONTRIBUTING.md.";
CM_ SG_ 2565954560 Engine_Cylinder_4_Combustion_Tim "Generic 8-byte raw payload. Detail page: https://www.isobus.net/isobus/pGNAndSPN/3910?type=PGN. Signal-level enrichment via PR welcome  see CONTRIBUTING.md.";
CM_ SG_ 2565954816 Engine_Cylinder_5_Combustion_Tim "Generic 8-byte raw payload. Detail page: https://www.isobus.net/isobus/pGNAndSPN/3914?type=PGN. Signal-level enrichment via PR welcome  see CONTRIBUTING.md.";
CM_ SG_ 2565955072 Engine_Cylinder_6_Combustion_Tim "Generic 8-byte raw payload. Detail page: https://www.isobus.net/isobus/pGNAndSPN/3918?type=PGN. Signal-level enrichment via PR welcome  see CONTRIBUTING.md.";
CM_ SG_ 2565955328 Engine_Cylinder_7_Combustion_Tim "Generic 8-byte raw payload. Detail page: https://www.isobus.net/isobus/pGNAndSPN/3922?type=PGN. Signal-level enrichment via PR welcome  see CONTRIBUTING.md.";
CM_ SG_ 2565955584 Engine_Cylinder_8_Combustion_Tim "Generic 8-byte raw payload. Detail page: https://www.isobus.net/isobus/pGNAndSPN/3926?type=PGN. Signal-level enrichment via PR welcome  see CONTRIBUTING.md.";
CM_ SG_ 2565955840 Engine_Cylinder_9_Combustion_Tim "Generic 8-byte raw payload. Detail page: https://www.isobus.net/isobus/pGNAndSPN/3930?type=PGN. Signal-level enrichment via PR welcome  see CONTRIBUTING.md.";
CM_ SG_ 2565956096 Engine_Cylinder_10_Combustion_Ti "Generic 8-byte raw payload. Detail page: https://www.isobus.net/isobus/pGNAndSPN/3934?type=PGN. Signal-level enrichment via PR welcome  see CONTRIBUTING.md.";
CM_ SG_ 2565956352 Engine_Cylinder_11_Combustion_Ti "Generic 8-byte raw payload. Detail page: https://www.isobus.net/isobus/pGNAndSPN/3938?type=PGN. Signal-level enrichment via PR welcome  see CONTRIBUTING.md.";
CM_ SG_ 2565956608 Engine_Cylinder_12_Combustion_Ti "Generic 8-byte raw payload. Detail page: https://www.isobus.net/isobus/pGNAndSPN/3942?type=PGN. Signal-level enrichment via PR welcome  see CONTRIBUTING.md.";
CM_ SG_ 2565956864 Engine_Cylinder_13_Combustion_Ti "Generic 8-byte raw payload. Detail page: https://www.isobus.net/isobus/pGNAndSPN/3946?type=PGN. Signal-level enrichment via PR welcome  see CONTRIBUTING.md.";
CM_ SG_ 2565957120 Engine_Cylinder_14_Combustion_Ti "Generic 8-byte raw payload. Detail page: https://www.isobus.net/isobus/pGNAndSPN/3950?type=PGN. Signal-level enrichment via PR welcome  see CONTRIBUTING.md.";
CM_ SG_ 2565957376 Engine_Cylinder_15_Combustion_Ti "Generic 8-byte raw payload. Detail page: https://www.isobus.net/isobus/pGNAndSPN/3954?type=PGN. Signal-level enrichment via PR welcome  see CONTRIBUTING.md.";
CM_ SG_ 2565957632 Engine_Cylinder_16_Combustion_Ti "Generic 8-byte raw payload. Detail page: https://www.isobus.net/isobus/pGNAndSPN/3958?type=PGN. Signal-level enrichment via PR welcome  see CONTRIBUTING.md.";
CM_ SG_ 2565957888 Engine_Cylinder_17_Combustion_Ti "Generic 8-byte raw payload. Detail page: https://www.isobus.net/isobus/pGNAndSPN/3962?type=PGN. Signal-level enrichment via PR welcome  see CONTRIBUTING.md.";
CM_ SG_ 2565958144 Engine_Cylinder_18_Combustion_Ti "Generic 8-byte raw payload. Detail page: https://www.isobus.net/isobus/pGNAndSPN/3966?type=PGN. Signal-level enrichment via PR welcome  see CONTRIBUTING.md.";
CM_ SG_ 2565958400 Engine_Cylinder_19_Combustion_Ti "Generic 8-byte raw payload. Detail page: https://www.isobus.net/isobus/pGNAndSPN/3970?type=PGN. Signal-level enrichment via PR welcome  see CONTRIBUTING.md.";
CM_ SG_ 2565958656 Engine_Cylinder_20_Combustion_Ti "Generic 8-byte raw payload. Detail page: https://www.isobus.net/isobus/pGNAndSPN/3974?type=PGN. Signal-level enrichment via PR welcome  see CONTRIBUTING.md.";
CM_ SG_ 2565958912 Engine_Cylinder_1_Combustion_Met "Generic 8-byte raw payload. Detail page: https://www.isobus.net/isobus/pGNAndSPN/3979?type=PGN. Signal-level enrichment via PR welcome  see CONTRIBUTING.md.";
CM_ SG_ 2565959168 Engine_Cylinder_2_Combustion_Met "Generic 8-byte raw payload. Detail page: https://www.isobus.net/isobus/pGNAndSPN/3984?type=PGN. Signal-level enrichment via PR welcome  see CONTRIBUTING.md.";
CM_ SG_ 2565959424 Engine_Cylinder_3_Combustion_Met "Generic 8-byte raw payload. Detail page: https://www.isobus.net/isobus/pGNAndSPN/3989?type=PGN. Signal-level enrichment via PR welcome  see CONTRIBUTING.md.";
CM_ SG_ 2565959680 Engine_Cylinder_4_Combustion_Met "Generic 8-byte raw payload. Detail page: https://www.isobus.net/isobus/pGNAndSPN/3994?type=PGN. Signal-level enrichment via PR welcome  see CONTRIBUTING.md.";
CM_ SG_ 2565959936 Engine_Cylinder_5_Combustion_Met "Generic 8-byte raw payload. Detail page: https://www.isobus.net/isobus/pGNAndSPN/3999?type=PGN. Signal-level enrichment via PR welcome  see CONTRIBUTING.md.";
CM_ SG_ 2565960192 Engine_Cylinder_6_Combustion_Met "Generic 8-byte raw payload. Detail page: https://www.isobus.net/isobus/pGNAndSPN/4004?type=PGN. Signal-level enrichment via PR welcome  see CONTRIBUTING.md.";
CM_ SG_ 2565960448 Engine_Cylinder_7_Combustion_Met "Generic 8-byte raw payload. Detail page: https://www.isobus.net/isobus/pGNAndSPN/4009?type=PGN. Signal-level enrichment via PR welcome  see CONTRIBUTING.md.";
CM_ SG_ 2565960704 Engine_Cylinder_8_Combustion_Met "Generic 8-byte raw payload. Detail page: https://www.isobus.net/isobus/pGNAndSPN/4014?type=PGN. Signal-level enrichment via PR welcome  see CONTRIBUTING.md.";
CM_ SG_ 2565960960 Engine_Cylinder_9_Combustion_Met "Generic 8-byte raw payload. Detail page: https://www.isobus.net/isobus/pGNAndSPN/4019?type=PGN. Signal-level enrichment via PR welcome  see CONTRIBUTING.md.";
CM_ SG_ 2565961216 Engine_Cylinder_10_Combustion_Me "Generic 8-byte raw payload. Detail page: https://www.isobus.net/isobus/pGNAndSPN/4024?type=PGN. Signal-level enrichment via PR welcome  see CONTRIBUTING.md.";
CM_ SG_ 2565961472 Engine_Cylinder_11_Combustion_Me "Generic 8-byte raw payload. Detail page: https://www.isobus.net/isobus/pGNAndSPN/4029?type=PGN. Signal-level enrichment via PR welcome  see CONTRIBUTING.md.";
CM_ SG_ 2565961728 Engine_Cylinder_12_Combustion_Me "Generic 8-byte raw payload. Detail page: https://www.isobus.net/isobus/pGNAndSPN/4034?type=PGN. Signal-level enrichment via PR welcome  see CONTRIBUTING.md.";
CM_ SG_ 2565961984 Engine_Cylinder_13_Combustion_Me "Generic 8-byte raw payload. Detail page: https://www.isobus.net/isobus/pGNAndSPN/4039?type=PGN. Signal-level enrichment via PR welcome  see CONTRIBUTING.md.";
CM_ SG_ 2565962240 Engine_Cylinder_14_Combustion_Me "Generic 8-byte raw payload. Detail page: https://www.isobus.net/isobus/pGNAndSPN/4044?type=PGN. Signal-level enrichment via PR welcome  see CONTRIBUTING.md.";
CM_ SG_ 2565962496 Engine_Cylinder_15_Combustion_Me "Generic 8-byte raw payload. Detail page: https://www.isobus.net/isobus/pGNAndSPN/4049?type=PGN. Signal-level enrichment via PR welcome  see CONTRIBUTING.md.";
CM_ SG_ 2565962752 Engine_Cylinder_16_Combustion_Me "Generic 8-byte raw payload. Detail page: https://www.isobus.net/isobus/pGNAndSPN/4054?type=PGN. Signal-level enrichment via PR welcome  see CONTRIBUTING.md.";
CM_ SG_ 2565963008 Engine_Cylinder_17_Combustion_Me "Generic 8-byte raw payload. Detail page: https://www.isobus.net/isobus/pGNAndSPN/4059?type=PGN. Signal-level enrichment via PR welcome  see CONTRIBUTING.md.";
CM_ SG_ 2565963264 Engine_Cylinder_18_Combustion_Me "Generic 8-byte raw payload. Detail page: https://www.isobus.net/isobus/pGNAndSPN/4064?type=PGN. Signal-level enrichment via PR welcome  see CONTRIBUTING.md.";
CM_ SG_ 2565963520 Engine_Cylinder_19_Combustion_Me "Generic 8-byte raw payload. Detail page: https://www.isobus.net/isobus/pGNAndSPN/4069?type=PGN. Signal-level enrichment via PR welcome  see CONTRIBUTING.md.";
CM_ SG_ 2565963776 Engine_Cylinder_20_Combustion_Me "Generic 8-byte raw payload. Detail page: https://www.isobus.net/isobus/pGNAndSPN/4074?type=PGN. Signal-level enrichment via PR welcome  see CONTRIBUTING.md.";
CM_ SG_ 2565964032 Motor_Generator_1_Inverter_Mode_ "Generic 8-byte raw payload. Detail page: https://www.isobus.net/isobus/pGNAndSPN/4081?type=PGN. Signal-level enrichment via PR welcome  see CONTRIBUTING.md.";
CM_ SG_ 2565964288 Motor_Generator_1_Inverter_Limit "Generic 8-byte raw payload. Detail page: https://www.isobus.net/isobus/pGNAndSPN/4087?type=PGN. Signal-level enrichment via PR welcome  see CONTRIBUTING.md.";
CM_ SG_ 2565964544 Motor_Generator_1_Inverter_Limit "Generic 8-byte raw payload. Detail page: https://www.isobus.net/isobus/pGNAndSPN/4093?type=PGN. Signal-level enrichment via PR welcome  see CONTRIBUTING.md.";
CM_ SG_ 2565964800 Motor_Generator_1_Inverter_Limit "Generic 8-byte raw payload. Detail page: https://www.isobus.net/isobus/pGNAndSPN/4099?type=PGN. Signal-level enrichment via PR welcome  see CONTRIBUTING.md.";
CM_ SG_ 2565965056 Motor_Generator_1_Inverter_Low_V "Generic 8-byte raw payload. Detail page: https://www.isobus.net/isobus/pGNAndSPN/4101?type=PGN. Signal-level enrichment via PR welcome  see CONTRIBUTING.md.";
CM_ SG_ 2565965312 Motor_Generator_2_Inverter_Mode_ "Generic 8-byte raw payload. Detail page: https://www.isobus.net/isobus/pGNAndSPN/4108?type=PGN. Signal-level enrichment via PR welcome  see CONTRIBUTING.md.";
CM_ SG_ 2565965568 Motor_Generator_2_Inverter_Limit "Generic 8-byte raw payload. Detail page: https://www.isobus.net/isobus/pGNAndSPN/4114?type=PGN. Signal-level enrichment via PR welcome  see CONTRIBUTING.md.";
CM_ SG_ 2565965824 Motor_Generator_2_Inverter_Limit "Generic 8-byte raw payload. Detail page: https://www.isobus.net/isobus/pGNAndSPN/4120?type=PGN. Signal-level enrichment via PR welcome  see CONTRIBUTING.md.";
CM_ SG_ 2565966080 Motor_Generator_2_Inverter_Limit "Generic 8-byte raw payload. Detail page: https://www.isobus.net/isobus/pGNAndSPN/4126?type=PGN. Signal-level enrichment via PR welcome  see CONTRIBUTING.md.";
CM_ SG_ 2565966336 Motor_Generator_2_Inverter_Low_V "Generic 8-byte raw payload. Detail page: https://www.isobus.net/isobus/pGNAndSPN/4128?type=PGN. Signal-level enrichment via PR welcome  see CONTRIBUTING.md.";
CM_ SG_ 2565966592 Motor_Generator_1_Inverter_Statu "Generic 8-byte raw payload. Detail page: https://www.isobus.net/isobus/pGNAndSPN/4132?type=PGN. Signal-level enrichment via PR welcome  see CONTRIBUTING.md.";
CM_ SG_ 2565966848 Motor_Generator_1_Inverter_Rate_ "Generic 8-byte raw payload. Detail page: https://www.isobus.net/isobus/pGNAndSPN/4136?type=PGN. Signal-level enrichment via PR welcome  see CONTRIBUTING.md.";
CM_ SG_ 2565967104 Motor_Generator_2_Inverter_Statu "Generic 8-byte raw payload. Detail page: https://www.isobus.net/isobus/pGNAndSPN/4140?type=PGN. Signal-level enrichment via PR welcome  see CONTRIBUTING.md.";
CM_ SG_ 2565967360 Motor_Generator_2_Inverter_Rate_ "Generic 8-byte raw payload. Detail page: https://www.isobus.net/isobus/pGNAndSPN/4144?type=PGN. Signal-level enrichment via PR welcome  see CONTRIBUTING.md.";
CM_ SG_ 2565967616 Impostor_PG_Alert_RawPayload "Generic 8-byte raw payload. Detail page: https://www.isobus.net/isobus/pGNAndSPN/4149?type=PGN. Signal-level enrichment via PR welcome  see CONTRIBUTING.md.";
CM_ SG_ 2565967872 High_Voltage_Energy_Storage_Pack "Generic 8-byte raw payload. Detail page: https://www.isobus.net/isobus/pGNAndSPN/4161?type=PGN. Signal-level enrichment via PR welcome  see CONTRIBUTING.md.";
CM_ SG_ 2565968128 High_Voltage_Energy_Storage_Pack "Generic 8-byte raw payload. Detail page: https://www.isobus.net/isobus/pGNAndSPN/4165?type=PGN. Signal-level enrichment via PR welcome  see CONTRIBUTING.md.";
CM_ SG_ 2565968384 High_Voltage_Energy_Storage_Pack "Generic 8-byte raw payload. Detail page: https://www.isobus.net/isobus/pGNAndSPN/4169?type=PGN. Signal-level enrichment via PR welcome  see CONTRIBUTING.md.";
CM_ SG_ 2565968640 High_Voltage_Energy_Storage_Pack "Generic 8-byte raw payload. Detail page: https://www.isobus.net/isobus/pGNAndSPN/4173?type=PGN. Signal-level enrichment via PR welcome  see CONTRIBUTING.md.";
CM_ SG_ 2565968896 High_Voltage_Energy_Storage_Pack "Generic 8-byte raw payload. Detail page: https://www.isobus.net/isobus/pGNAndSPN/4176?type=PGN. Signal-level enrichment via PR welcome  see CONTRIBUTING.md.";
CM_ SG_ 2565969152 High_Voltage_Energy_Storage_Pack "Generic 8-byte raw payload. Detail page: https://www.isobus.net/isobus/pGNAndSPN/4180?type=PGN. Signal-level enrichment via PR welcome  see CONTRIBUTING.md.";
CM_ SG_ 2565969408 High_Voltage_Energy_Storage_Pack "Generic 8-byte raw payload. Detail page: https://www.isobus.net/isobus/pGNAndSPN/4186?type=PGN. Signal-level enrichment via PR welcome  see CONTRIBUTING.md.";
CM_ SG_ 2565969664 High_Voltage_Energy_Storage_Pack "Generic 8-byte raw payload. Detail page: https://www.isobus.net/isobus/pGNAndSPN/4203?type=PGN. Signal-level enrichment via PR welcome  see CONTRIBUTING.md.";
CM_ SG_ 2565969920 High_Voltage_Energy_Storage_Pack "Generic 8-byte raw payload. Detail page: https://www.isobus.net/isobus/pGNAndSPN/4206?type=PGN. Signal-level enrichment via PR welcome  see CONTRIBUTING.md.";
CM_ SG_ 2565970176 High_Voltage_Energy_Storage_Pack "Generic 8-byte raw payload. Detail page: https://www.isobus.net/isobus/pGNAndSPN/4238?type=PGN. Signal-level enrichment via PR welcome  see CONTRIBUTING.md.";
CM_ SG_ 2565970432 High_Voltage_Energy_Storage_Pack "Generic 8-byte raw payload. Detail page: https://www.isobus.net/isobus/pGNAndSPN/4246?type=PGN. Signal-level enrichment via PR welcome  see CONTRIBUTING.md.";
CM_ SG_ 2565970688 High_Voltage_Energy_Storage_Pack "Generic 8-byte raw payload. Detail page: https://www.isobus.net/isobus/pGNAndSPN/4251?type=PGN. Signal-level enrichment via PR welcome  see CONTRIBUTING.md.";
CM_ SG_ 2565970944 High_Voltage_Energy_Storage_Pack "Generic 8-byte raw payload. Detail page: https://www.isobus.net/isobus/pGNAndSPN/4259?type=PGN. Signal-level enrichment via PR welcome  see CONTRIBUTING.md.";
CM_ SG_ 2565971200 High_Voltage_Energy_Storage_Pack "Generic 8-byte raw payload. Detail page: https://www.isobus.net/isobus/pGNAndSPN/4265?type=PGN. Signal-level enrichment via PR welcome  see CONTRIBUTING.md.";
CM_ SG_ 2565971456 High_Voltage_Energy_Storage_Pack "Generic 8-byte raw payload. Detail page: https://www.isobus.net/isobus/pGNAndSPN/4268?type=PGN. Signal-level enrichment via PR welcome  see CONTRIBUTING.md.";
CM_ SG_ 2565971712 High_Voltage_Energy_Storage_Pack "Generic 8-byte raw payload. Detail page: https://www.isobus.net/isobus/pGNAndSPN/4280?type=PGN. Signal-level enrichment via PR welcome  see CONTRIBUTING.md.";

BA_DEF_ BO_ "SystemMessageLongSymbol" STRING;
BA_DEF_ SG_ "SystemSignalLongSymbol" STRING;
BA_ "SystemMessageLongSymbol" BO_ 2565875712 "VDMA_F028_Aftertreatment_2_SCR_Ammonia_Inf";
BA_ "SystemMessageLongSymbol" BO_ 2565875968 "VDMA_F029_Slope_Sensor_Information_2";
BA_ "SystemMessageLongSymbol" BO_ 2565876224 "VDMA_F02A_Angular_Rate_Information";
BA_ "SystemMessageLongSymbol" BO_ 2565876736 "VDMA_F02C_Magnet_Status_Information_2";
BA_ "SystemMessageLongSymbol" BO_ 2565877248 "VDMA_F02E_Engine_Turbocharger_Control_1";
BA_ "SystemMessageLongSymbol" BO_ 2565877504 "VDMA_F02F_Advanced_Emergency_Braking_Syste";
BA_ "SystemMessageLongSymbol" BO_ 2565878272 "VDMA_F032_Linear_Displacement_Sensor";
BA_ "SystemMessageLongSymbol" BO_ 2565878528 "VDMA_F033_Aftertreatment_1_SCR_Ammonia_Inf";
BA_ "SystemMessageLongSymbol" BO_ 2565878784 "VDMA_F034_Aftertreatment_2_SCR_Ammonia_Inf";
BA_ "SystemMessageLongSymbol" BO_ 2565879296 "VDMA_F036_High_Voltage_Energy_Storage_Syst";
BA_ "SystemMessageLongSymbol" BO_ 2565879552 "VDMA_F037_Engine_Turbocharger_Blowoff_Actu";
BA_ "SystemMessageLongSymbol" BO_ 2565879808 "VDMA_F038_Engine_Torque_Fuel_Request";
BA_ "SystemMessageLongSymbol" BO_ 2565880064 "VDMA_F039_Engine_Air_System_Information";
BA_ "SystemMessageLongSymbol" BO_ 2565880320 "VDMA_F03A_Engine_Cylinder_1_Combustion_Inf";
BA_ "SystemMessageLongSymbol" BO_ 2565880576 "VDMA_F03B_Engine_Cylinder_2_Combustion_Inf";
BA_ "SystemMessageLongSymbol" BO_ 2565880832 "VDMA_F03C_Engine_Cylinder_3_Combustion_Inf";
BA_ "SystemMessageLongSymbol" BO_ 2565881088 "VDMA_F03D_Engine_Cylinder_4_Combustion_Inf";
BA_ "SystemMessageLongSymbol" BO_ 2565881344 "VDMA_F03E_Engine_Cylinder_5_Combustion_Inf";
BA_ "SystemMessageLongSymbol" BO_ 2565881600 "VDMA_F03F_Engine_Cylinder_6_Combustion_Inf";
BA_ "SystemMessageLongSymbol" BO_ 2565881856 "VDMA_F040_Engine_Cylinder_7_Combustion_Inf";
BA_ "SystemMessageLongSymbol" BO_ 2565882112 "VDMA_F041_Engine_Cylinder_8_Combustion_Inf";
BA_ "SystemMessageLongSymbol" BO_ 2565882368 "VDMA_F042_Engine_Cylinder_9_Combustion_Inf";
BA_ "SystemMessageLongSymbol" BO_ 2565882624 "VDMA_F043_Engine_Cylinder_10_Combustion_In";
BA_ "SystemMessageLongSymbol" BO_ 2565882880 "VDMA_F044_Engine_Cylinder_11_Combustion_In";
BA_ "SystemMessageLongSymbol" BO_ 2565883136 "VDMA_F045_Engine_Cylinder_12_Combustion_In";
BA_ "SystemMessageLongSymbol" BO_ 2565883392 "VDMA_F046_Engine_Cylinder_13_Combustion_In";
BA_ "SystemMessageLongSymbol" BO_ 2565883648 "VDMA_F047_Engine_Cylinder_14_Combustion_In";
BA_ "SystemMessageLongSymbol" BO_ 2565883904 "VDMA_F048_Engine_Cylinder_15_Combustion_In";
BA_ "SystemMessageLongSymbol" BO_ 2565884160 "VDMA_F049_Engine_Cylinder_16_Combustion_In";
BA_ "SystemMessageLongSymbol" BO_ 2565884416 "VDMA_F04A_Engine_Cylinder_17_Combustion_In";
BA_ "SystemMessageLongSymbol" BO_ 2565884672 "VDMA_F04B_Engine_Cylinder_18_Combustion_In";
BA_ "SystemMessageLongSymbol" BO_ 2565884928 "VDMA_F04C_Engine_Cylinder_19_Combustion_In";
BA_ "SystemMessageLongSymbol" BO_ 2565885184 "VDMA_F04D_Engine_Cylinder_20_Combustion_In";
BA_ "SystemMessageLongSymbol" BO_ 2565885440 "VDMA_F04E_Engine_Cylinder_1_Combustion_Ave";
BA_ "SystemMessageLongSymbol" BO_ 2565885696 "VDMA_F04F_Engine_Cylinder_2_Combustion_Ave";
BA_ "SystemMessageLongSymbol" BO_ 2565885952 "VDMA_F050_Engine_Cylinder_3_Combustion_Ave";
BA_ "SystemMessageLongSymbol" BO_ 2565886208 "VDMA_F051_Engine_Cylinder_4_Combustion_Ave";
BA_ "SystemMessageLongSymbol" BO_ 2565886464 "VDMA_F052_Engine_Cylinder_5_Combustion_Ave";
BA_ "SystemMessageLongSymbol" BO_ 2565886720 "VDMA_F053_Engine_Cylinder_6_Combustion_Ave";
BA_ "SystemMessageLongSymbol" BO_ 2565886976 "VDMA_F054_Engine_Cylinder_7_Combustion_Ave";
BA_ "SystemMessageLongSymbol" BO_ 2565887232 "VDMA_F055_Engine_Cylinder_8_Combustion_Ave";
BA_ "SystemMessageLongSymbol" BO_ 2565887488 "VDMA_F056_Engine_Cylinder_9_Combustion_Ave";
BA_ "SystemMessageLongSymbol" BO_ 2565887744 "VDMA_F057_Engine_Cylinder_10_Combustion_Av";
BA_ "SystemMessageLongSymbol" BO_ 2565888000 "VDMA_F058_Engine_Cylinder_11_Combustion_Av";
BA_ "SystemMessageLongSymbol" BO_ 2565888256 "VDMA_F059_Engine_Cylinder_12_Combustion_Av";
BA_ "SystemMessageLongSymbol" BO_ 2565888512 "VDMA_F05A_Engine_Cylinder_13_Combustion_Av";
BA_ "SystemMessageLongSymbol" BO_ 2565888768 "VDMA_F05B_Engine_Cylinder_14_Combustion_Av";
BA_ "SystemMessageLongSymbol" BO_ 2565889024 "VDMA_F05C_Engine_Cylinder_15_Combustion_Av";
BA_ "SystemMessageLongSymbol" BO_ 2565889280 "VDMA_F05D_Engine_Cylinder_16_Combustion_Av";
BA_ "SystemMessageLongSymbol" BO_ 2565889536 "VDMA_F05E_Engine_Cylinder_17_Combustion_Av";
BA_ "SystemMessageLongSymbol" BO_ 2565889792 "VDMA_F05F_Engine_Cylinder_18_Combustion_Av";
BA_ "SystemMessageLongSymbol" BO_ 2565890048 "VDMA_F060_Engine_Cylinder_19_Combustion_Av";
BA_ "SystemMessageLongSymbol" BO_ 2565890304 "VDMA_F061_Engine_Cylinder_20_Combustion_Av";
BA_ "SystemMessageLongSymbol" BO_ 2565890560 "VDMA_F062_Electronic_Transmission_Controll";
BA_ "SystemMessageLongSymbol" BO_ 2565890816 "VDMA_F063_Fuel_Information_5_Gaseous";
BA_ "SystemMessageLongSymbol" BO_ 2565891072 "VDMA_F064_Engine_Gaseous_Fuel_Valve_Durati";
BA_ "SystemMessageLongSymbol" BO_ 2565891328 "VDMA_F065_Engine_Gaseous_Fuel_Valve_Durati";
BA_ "SystemMessageLongSymbol" BO_ 2565891584 "VDMA_F066_Engine_Gaseous_Fuel_Valve_Durati";
BA_ "SystemMessageLongSymbol" BO_ 2565891840 "VDMA_F067_Engine_Gaseous_Fuel_Valve_Durati";
BA_ "SystemMessageLongSymbol" BO_ 2565892096 "VDMA_F068_Engine_Gaseous_Fuel_Valve_Durati";
BA_ "SystemMessageLongSymbol" BO_ 2565892352 "VDMA_F069_Engine_Gaseous_Fuel_Valve_Start_";
BA_ "SystemMessageLongSymbol" BO_ 2565892608 "VDMA_F06A_Engine_Gaseous_Fuel_Valve_Start_";
BA_ "SystemMessageLongSymbol" BO_ 2565892864 "VDMA_F06B_Engine_Gaseous_Fuel_Valve_Start_";
BA_ "SystemMessageLongSymbol" BO_ 2565893120 "VDMA_F06C_Engine_Gaseous_Fuel_Valve_Start_";
BA_ "SystemMessageLongSymbol" BO_ 2565893376 "VDMA_F06D_Engine_Gaseous_Fuel_Valve_Start_";
BA_ "SystemMessageLongSymbol" BO_ 2565893632 "VDMA_F06E_Fuel_Pump_Actuator_Control_Comma";
BA_ "SystemMessageLongSymbol" BO_ 2565893888 "VDMA_F06F_Power_Converter_1_Control_1";
BA_ "SystemMessageLongSymbol" BO_ 2565894144 "VDMA_F070_Power_Converter_2_Control_1";
BA_ "SystemMessageLongSymbol" BO_ 2565894400 "VDMA_F071_Power_Converter_1_Rate_Limits_Re";
BA_ "SystemMessageLongSymbol" BO_ 2565894656 "VDMA_F072_Power_Converter_2_Rate_Limits_Re";
BA_ "SystemMessageLongSymbol" BO_ 2565894912 "VDMA_F073_Power_Converter_2_Control_2";
BA_ "SystemMessageLongSymbol" BO_ 2565895168 "VDMA_F074_Power_Converter_1_Control_2";
BA_ "SystemMessageLongSymbol" BO_ 2565895424 "VDMA_F075_Power_Converter_1_Mode_Feedback_";
BA_ "SystemMessageLongSymbol" BO_ 2565895680 "VDMA_F076_Power_Converter_1_Limits_Active_";
BA_ "SystemMessageLongSymbol" BO_ 2565895936 "VDMA_F077_Power_Converter_1_Limits_Active_";
BA_ "SystemMessageLongSymbol" BO_ 2565896192 "VDMA_F078_Power_Converter_1_Limits_Active_";
BA_ "SystemMessageLongSymbol" BO_ 2565896448 "VDMA_F079_Power_Converter_1_Low_Voltage";
BA_ "SystemMessageLongSymbol" BO_ 2565896704 "VDMA_F07A_Power_Converter_2_Mode_Feedback_";
BA_ "SystemMessageLongSymbol" BO_ 2565896960 "VDMA_F07B_Power_Converter_2_Limits_Active_";
BA_ "SystemMessageLongSymbol" BO_ 2565897216 "VDMA_F07C_Power_Converter_2_Limits_Active_";
BA_ "SystemMessageLongSymbol" BO_ 2565897472 "VDMA_F07D_Power_Converter_2_Limits_Active_";
BA_ "SystemMessageLongSymbol" BO_ 2565897728 "VDMA_F07E_Power_Converter_2_Low_Voltage";
BA_ "SystemMessageLongSymbol" BO_ 2565897984 "VDMA_F07F_Power_Converter_1_Status_2";
BA_ "SystemMessageLongSymbol" BO_ 2565898240 "VDMA_F080_Power_Converter_1_Rate_Limits_Ac";
BA_ "SystemMessageLongSymbol" BO_ 2565898496 "VDMA_F081_Power_Converter_2_Status_2";
BA_ "SystemMessageLongSymbol" BO_ 2565898752 "VDMA_F082_Power_Converter_2_Rate_Limits_Ac";
BA_ "SystemMessageLongSymbol" BO_ 2565899008 "VDMA_F083_Power_Converter_2_Isolation_Inte";
BA_ "SystemMessageLongSymbol" BO_ 2565899264 "VDMA_F084_Power_Converter_1_Isolation_Inte";
BA_ "SystemMessageLongSymbol" BO_ 2565899520 "VDMA_F085_Power_Converter_2_Status_1";
BA_ "SystemMessageLongSymbol" BO_ 2565899776 "VDMA_F086_Power_Converter_1_Status_1";
BA_ "SystemMessageLongSymbol" BO_ 2565900032 "VDMA_F087_Wireless_Charger_System_Status_1";
BA_ "SystemMessageLongSymbol" BO_ 2565900288 "VDMA_F088_Wireless_Charger_Alignment_Quali";
BA_ "SystemMessageLongSymbol" BO_ 2565900544 "VDMA_F089_Motor_Generator_1_Inverter_Contr";
BA_ "SystemMessageLongSymbol" BO_ 2565900800 "VDMA_F08A_Motor_Generator_2_Inverter_Contr";
BA_ "SystemMessageLongSymbol" BO_ 2565901056 "VDMA_F08B_Motor_Generator_3_Inverter_Contr";
BA_ "SystemMessageLongSymbol" BO_ 2565901312 "VDMA_F08C_Motor_Generator_4_Inverter_Contr";
BA_ "SystemMessageLongSymbol" BO_ 2565901568 "VDMA_F08D_Motor_Generator_5_Inverter_Contr";
BA_ "SystemMessageLongSymbol" BO_ 2565901824 "VDMA_F08E_Motor_Generator_6_Inverter_Contr";
BA_ "SystemMessageLongSymbol" BO_ 2565902336 "VDMA_F090_High_Voltage_Energy_Storage_Syst";
BA_ "SystemMessageLongSymbol" BO_ 2565902592 "VDMA_F091_High_Voltage_Energy_Storage_Syst";
BA_ "SystemMessageLongSymbol" BO_ 2565902848 "VDMA_F092_High_Voltage_Energy_Storage_Syst";
BA_ "SystemMessageLongSymbol" BO_ 2565903104 "VDMA_F093_High_Voltage_Energy_Storage_Syst";
BA_ "SystemMessageLongSymbol" BO_ 2565903360 "VDMA_F094_High_Voltage_Energy_Storage_Syst";
BA_ "SystemMessageLongSymbol" BO_ 2565903616 "VDMA_F095_High_Voltage_Energy_Storage_Syst";
BA_ "SystemMessageLongSymbol" BO_ 2565903872 "VDMA_F096_High_Voltage_Energy_Storage_Syst";
BA_ "SystemMessageLongSymbol" BO_ 2565904128 "VDMA_F097_Motor_Generator_1_Inverter_Therm";
BA_ "SystemMessageLongSymbol" BO_ 2565904384 "VDMA_F098_Motor_Generator_2_Inverter_Therm";
BA_ "SystemMessageLongSymbol" BO_ 2565904640 "VDMA_F099_Motor_Generator_3_Inverter_Therm";
BA_ "SystemMessageLongSymbol" BO_ 2565904896 "VDMA_F09A_Motor_Generator_4_Inverter_Therm";
BA_ "SystemMessageLongSymbol" BO_ 2565905152 "VDMA_F09B_Motor_Generator_5_Inverter_Therm";
BA_ "SystemMessageLongSymbol" BO_ 2565905408 "VDMA_F09C_Motor_Generator_6_Inverter_Therm";
BA_ "SystemMessageLongSymbol" BO_ 2565906432 "VDMA_F0A0_High_Voltage_Energy_Storage_Syst";
BA_ "SystemMessageLongSymbol" BO_ 2565916672 "VDMA_F0C8_DC_AC_Accessory_Inverter_1_Statu";
BA_ "SystemMessageLongSymbol" BO_ 2565916928 "VDMA_F0C9_DC_AC_Accessory_Inverter_1_Volta";
BA_ "SystemMessageLongSymbol" BO_ 2565917184 "VDMA_F0CA_DC_AC_Accessory_Inverter_1_Feedb";
BA_ "SystemMessageLongSymbol" BO_ 2565917440 "VDMA_F0CB_DC_AC_Accessory_Inverter_2_Statu";
BA_ "SystemMessageLongSymbol" BO_ 2565917696 "VDMA_F0CC_DC_AC_Accessory_Inverter_2_Volta";
BA_ "SystemMessageLongSymbol" BO_ 2565917952 "VDMA_F0CD_DC_AC_Accessory_Inverter_2_Feedb";
BA_ "SystemMessageLongSymbol" BO_ 2565918208 "VDMA_F0CE_Engine_Turbocharger_Control_4";
BA_ "SystemMessageLongSymbol" BO_ 2565918464 "VDMA_F0CF_Engine_Turbocharger_Wastegate_Ac";
BA_ "SystemMessageLongSymbol" BO_ 2565918720 "VDMA_F0D0_Engine_Cylinder_Combustion_Reque";
BA_ "SystemMessageLongSymbol" BO_ 2565918976 "VDMA_F0D1_Engine_Cylinder_Head_Bypass_Actu";
BA_ "SystemMessageLongSymbol" BO_ 2565919232 "VDMA_F0D2_Engine_Electronic_Controller_18";
BA_ "SystemMessageLongSymbol" BO_ 2565919488 "VDMA_F0D3_Predictive_Cruise_Control_1";
BA_ "SystemMessageLongSymbol" BO_ 2565920256 "VDMA_F0D6_DC_AC_Accessory_Inverter_1_Comma";
BA_ "SystemMessageLongSymbol" BO_ 2565920512 "VDMA_F0D7_DC_AC_Accessory_Inverter_1_Feedb";
BA_ "SystemMessageLongSymbol" BO_ 2565921280 "VDMA_F0DA_DC_AC_Accessory_Inverter_2_Comma";
BA_ "SystemMessageLongSymbol" BO_ 2565921536 "VDMA_F0DB_DC_AC_Accessory_Inverter_2_Feedb";
BA_ "SystemMessageLongSymbol" BO_ 2565922304 "VDMA_F0DE_DC_AC_Accessory_Inverter_3_Comma";
BA_ "SystemMessageLongSymbol" BO_ 2565922560 "VDMA_F0DF_DC_AC_Accessory_Inverter_3_Feedb";
BA_ "SystemMessageLongSymbol" BO_ 2565923328 "VDMA_F0E2_DC_AC_Accessory_Inverter_4_Comma";
BA_ "SystemMessageLongSymbol" BO_ 2565923584 "VDMA_F0E3_DC_AC_Accessory_Inverter_4_Feedb";
BA_ "SystemMessageLongSymbol" BO_ 2565924096 "VDMA_F0E5_Engine_Ignition_Timing_Offset_1";
BA_ "SystemMessageLongSymbol" BO_ 2565924352 "VDMA_F0E6_Engine_Ignition_Timing_Offset_2";
BA_ "SystemMessageLongSymbol" BO_ 2565924608 "VDMA_F0E7_Engine_Ignition_Timing_Offset_3";
BA_ "SystemMessageLongSymbol" BO_ 2565924864 "VDMA_F0E8_Engine_Throttle_Fuel_Actuator_Co";
BA_ "SystemMessageLongSymbol" BO_ 2565925120 "VDMA_F0E9_Aftertreatment_1_Intake_Gas_3";
BA_ "SystemMessageLongSymbol" BO_ 2565925376 "VDMA_F0EA_Aftertreatment_1_Outlet_Gas_3";
BA_ "SystemMessageLongSymbol" BO_ 2565925632 "VDMA_F0EB_Aftertreatment_2_Intake_Gas_3";
BA_ "SystemMessageLongSymbol" BO_ 2565925888 "VDMA_F0EC_Aftertreatment_2_Outlet_Gas_3";
BA_ "SystemMessageLongSymbol" BO_ 2565927936 "VDMA_F0F4_Genset_Reactive_Power_and_Suppor";
BA_ "SystemMessageLongSymbol" BO_ 2565928192 "VDMA_F0F5_Engine_Start_Arbitrator";
BA_ "SystemMessageLongSymbol" BO_ 2565928448 "VDMA_F0F6_Advanced_Driver_Assistance_Syste";
BA_ "SystemMessageLongSymbol" BO_ 2565928704 "VDMA_F0F7_Advanced_Driver_Assistance_Syste";
BA_ "SystemMessageLongSymbol" BO_ 2565928960 "VDMA_F0F8_Advanced_Driver_Assistance_Syste";
BA_ "SystemMessageLongSymbol" BO_ 2565929216 "VDMA_F0F9_Engine_Valve_Controller";
BA_ "SystemMessageLongSymbol" BO_ 2565929472 "VDMA_F0FA_Electronic_Transmission_Controll";
BA_ "SystemMessageLongSymbol" BO_ 2565929728 "VDMA_F0FB_Aftertreatment_1_SCR_Dosing_Syst";
BA_ "SystemMessageLongSymbol" BO_ 2565929984 "VDMA_F0FC_Aftertreatment_2_SCR_Dosing_Syst";
BA_ "SystemMessageLongSymbol" BO_ 2565930240 "VDMA_F0FD_Aftertreatment_1_SCR_Dosing_Syst";
BA_ "SystemMessageLongSymbol" BO_ 2565930496 "VDMA_F0FE_Aftertreatment_2_SCR_Dosing_Syst";
BA_ "SystemMessageLongSymbol" BO_ 2565930752 "VDMA_F0FF_Secondary_or_Front_Hitch_Roll_an";
BA_ "SystemMessageLongSymbol" BO_ 2565931008 "VDMA_F100_Secondary_or_Front_Hitch_Roll_an";
BA_ "SystemMessageLongSymbol" BO_ 2565931264 "VDMA_F101_Primary_or_Rear_Hitch_Roll_and_P";
BA_ "SystemMessageLongSymbol" BO_ 2565931520 "VDMA_F102_Primary_or_Rear_Hitch_Roll_and_P";
BA_ "SystemMessageLongSymbol" BO_ 2565932032 "VDMA_F104_Engine_Speed_Sensor_Information_";
BA_ "SystemMessageLongSymbol" BO_ 2565932288 "VDMA_F105_Hydraulic_Pressure_Displacement";
BA_ "SystemMessageLongSymbol" BO_ 2565932544 "VDMA_F106_Well_Stimulation_Pump_System_1";
BA_ "SystemMessageLongSymbol" BO_ 2565932800 "VDMA_F107_Well_Stimulation_Pump_System_2";
BA_ "SystemMessageLongSymbol" BO_ 2565933056 "VDMA_F108_High_Voltage_Energy_Storage_Syst";
BA_ "SystemMessageLongSymbol" BO_ 2565933312 "VDMA_F109_High_Voltage_Energy_Storage_Syst";
BA_ "SystemMessageLongSymbol" BO_ 2565933568 "VDMA_F10A_High_Voltage_Energy_Storage_Syst";
BA_ "SystemMessageLongSymbol" BO_ 2565933824 "VDMA_F10B_High_Voltage_Energy_Storage_Syst";
BA_ "SystemMessageLongSymbol" BO_ 2565934080 "VDMA_F10C_High_Voltage_Energy_Storage_Syst";
BA_ "SystemMessageLongSymbol" BO_ 2565934336 "VDMA_F10D_Fuel_Information_6_Gaseous";
BA_ "SystemMessageLongSymbol" BO_ 2565934592 "VDMA_F10E_Dump_Truck_Body_Information";
BA_ "SystemMessageLongSymbol" BO_ 2565934848 "VDMA_F10F_Engine_Operating_Information_2";
BA_ "SystemMessageLongSymbol" BO_ 2565935360 "VDMA_F111_Gaseous_Fuel_Pressure_3";
BA_ "SystemMessageLongSymbol" BO_ 2565935616 "VDMA_F112_DC_DC_Converter_1_Control";
BA_ "SystemMessageLongSymbol" BO_ 2565935872 "VDMA_F113_DC_DC_Converter_1_Operating_Stat";
BA_ "SystemMessageLongSymbol" BO_ 2565936128 "VDMA_F114_DC_DC_Converter_1_Voltage_and_Cu";
BA_ "SystemMessageLongSymbol" BO_ 2565936384 "VDMA_F115_DC_DC_Converter_1_SLI_Battery_St";
BA_ "SystemMessageLongSymbol" BO_ 2565936640 "VDMA_F116_Well_Stimulation_Pump_System_3";
BA_ "SystemMessageLongSymbol" BO_ 2565936896 "VDMA_F117_DC_DC_Converter_1_Status_2";
BA_ "SystemMessageLongSymbol" BO_ 2565937152 "VDMA_F118_DC_DC_Converter_2_Control";
BA_ "SystemMessageLongSymbol" BO_ 2565937408 "VDMA_F119_DC_DC_Converter_2_Operating_Stat";
BA_ "SystemMessageLongSymbol" BO_ 2565937664 "VDMA_F11A_DC_DC_Converter_2_Voltage_and_Cu";
BA_ "SystemMessageLongSymbol" BO_ 2565937920 "VDMA_F11B_DC_DC_Converter_2_SLI_Battery_St";
BA_ "SystemMessageLongSymbol" BO_ 2565938176 "VDMA_F11C_DC_DC_Converter_2_Status_2";
BA_ "SystemMessageLongSymbol" BO_ 2565938432 "VDMA_F11D_DC_DC_Converter_3_Control";
BA_ "SystemMessageLongSymbol" BO_ 2565938688 "VDMA_F11E_DC_DC_Converter_3_Operating_Stat";
BA_ "SystemMessageLongSymbol" BO_ 2565938944 "VDMA_F11F_DC_DC_Converter_3_Voltage_and_Cu";
BA_ "SystemMessageLongSymbol" BO_ 2565939200 "VDMA_F120_DC_DC_Converter_3_SLI_Battery_St";
BA_ "SystemMessageLongSymbol" BO_ 2565939456 "VDMA_F121_DC_DC_Converter_3_Status_2";
BA_ "SystemMessageLongSymbol" BO_ 2565939712 "VDMA_F122_DC_DC_Converter_4_Control";
BA_ "SystemMessageLongSymbol" BO_ 2565939968 "VDMA_F123_DC_DC_Converter_4_Operating_Stat";
BA_ "SystemMessageLongSymbol" BO_ 2565940224 "VDMA_F124_DC_DC_Converter_4_Voltage_and_Cu";
BA_ "SystemMessageLongSymbol" BO_ 2565940480 "VDMA_F125_DC_DC_Converter_4_SLI_Battery_St";
BA_ "SystemMessageLongSymbol" BO_ 2565940736 "VDMA_F126_DC_DC_Converter_4_Status_2";
BA_ "SystemMessageLongSymbol" BO_ 2565940992 "VDMA_F127_Slope_Sensor_Information_3";
BA_ "SystemMessageLongSymbol" BO_ 2565941248 "VDMA_F128_DC_AC_Accessory_Inverter_3_Statu";
BA_ "SystemMessageLongSymbol" BO_ 2565941504 "VDMA_F129_DC_AC_Accessory_Inverter_3_Volta";
BA_ "SystemMessageLongSymbol" BO_ 2565941760 "VDMA_F12A_DC_AC_Accessory_Inverter_3_Feedb";
BA_ "SystemMessageLongSymbol" BO_ 2565942016 "VDMA_F12B_DC_AC_Accessory_Inverter_4_Statu";
BA_ "SystemMessageLongSymbol" BO_ 2565942272 "VDMA_F12C_DC_AC_Accessory_Inverter_4_Volta";
BA_ "SystemMessageLongSymbol" BO_ 2565942528 "VDMA_F12D_DC_AC_Accessory_Inverter_4_Feedb";
BA_ "SystemMessageLongSymbol" BO_ 2565942784 "VDMA_F12E_DC_AC_Accessory_Inverter_5_Comma";
BA_ "SystemMessageLongSymbol" BO_ 2565943040 "VDMA_F12F_DC_AC_Accessory_Inverter_5_Feedb";
BA_ "SystemMessageLongSymbol" BO_ 2565943296 "VDMA_F130_DC_AC_Accessory_Inverter_5_Statu";
BA_ "SystemMessageLongSymbol" BO_ 2565943552 "VDMA_F131_DC_AC_Accessory_Inverter_5_Volta";
BA_ "SystemMessageLongSymbol" BO_ 2565943808 "VDMA_F132_DC_AC_Accessory_Inverter_5_Feedb";
BA_ "SystemMessageLongSymbol" BO_ 2565944064 "VDMA_F133_Engine_Pre_Chamber_Fuel_Valve_Du";
BA_ "SystemMessageLongSymbol" BO_ 2565944320 "VDMA_F134_Engine_Pre_Chamber_Fuel_Valve_Du";
BA_ "SystemMessageLongSymbol" BO_ 2565944576 "VDMA_F135_Engine_Pre_Chamber_Fuel_Valve_Du";
BA_ "SystemMessageLongSymbol" BO_ 2565944832 "VDMA_F136_Engine_Pre_Chamber_Fuel_Valve_Du";
BA_ "SystemMessageLongSymbol" BO_ 2565945088 "VDMA_F137_Engine_Pre_Chamber_Fuel_Valve_Du";
BA_ "SystemMessageLongSymbol" BO_ 2565945344 "VDMA_F138_Engine_Pre_Chamber_Fuel_Valve_St";
BA_ "SystemMessageLongSymbol" BO_ 2565945600 "VDMA_F139_Engine_Pre_Chamber_Fuel_Valve_St";
BA_ "SystemMessageLongSymbol" BO_ 2565945856 "VDMA_F13A_Engine_Pre_Chamber_Fuel_Valve_St";
BA_ "SystemMessageLongSymbol" BO_ 2565946112 "VDMA_F13B_Engine_Pre_Chamber_Fuel_Valve_St";
BA_ "SystemMessageLongSymbol" BO_ 2565946368 "VDMA_F13C_Engine_Pre_Chamber_Fuel_Valve_St";
BA_ "SystemMessageLongSymbol" BO_ 2565946624 "VDMA_F13D_Active_Steering_System_Controls_";
BA_ "SystemMessageLongSymbol" BO_ 2565946880 "VDMA_F13E_Secondary_or_Front_Hitch_Yaw_com";
BA_ "SystemMessageLongSymbol" BO_ 2565947136 "VDMA_F13F_Primary_or_Rear_Hitch_Yaw_comman";
BA_ "SystemMessageLongSymbol" BO_ 2565947392 "VDMA_F140_Stationary_Inverter_Average_Basi";
BA_ "SystemMessageLongSymbol" BO_ 2565947648 "VDMA_F141_Stationary_Inverter_Total_AC_Rea";
BA_ "SystemMessageLongSymbol" BO_ 2565947904 "VDMA_F142_Stationary_Inverter_Total_AC_Pow";
BA_ "SystemMessageLongSymbol" BO_ 2565948160 "VDMA_F143_Stationary_Inverter_Control";
BA_ "SystemMessageLongSymbol" BO_ 2565948416 "VDMA_F144_Stationary_Inverter_to_Bus_Sync_";
BA_ "SystemMessageLongSymbol" BO_ 2565948672 "VDMA_F145_Engine_Cylinder_1_Combustion_Pre";
BA_ "SystemMessageLongSymbol" BO_ 2565948928 "VDMA_F146_Engine_Cylinder_2_Combustion_Pre";
BA_ "SystemMessageLongSymbol" BO_ 2565949184 "VDMA_F147_Engine_Cylinder_3_Combustion_Pre";
BA_ "SystemMessageLongSymbol" BO_ 2565949440 "VDMA_F148_Engine_Cylinder_4_Combustion_Pre";
BA_ "SystemMessageLongSymbol" BO_ 2565949696 "VDMA_F149_Engine_Cylinder_5_Combustion_Pre";
BA_ "SystemMessageLongSymbol" BO_ 2565949952 "VDMA_F14A_Engine_Cylinder_6_Combustion_Pre";
BA_ "SystemMessageLongSymbol" BO_ 2565950208 "VDMA_F14B_Engine_Cylinder_7_Combustion_Pre";
BA_ "SystemMessageLongSymbol" BO_ 2565950464 "VDMA_F14C_Engine_Cylinder_8_Combustion_Pre";
BA_ "SystemMessageLongSymbol" BO_ 2565950720 "VDMA_F14D_Engine_Cylinder_9_Combustion_Pre";
BA_ "SystemMessageLongSymbol" BO_ 2565950976 "VDMA_F14E_Engine_Cylinder_10_Combustion_Pr";
BA_ "SystemMessageLongSymbol" BO_ 2565951232 "VDMA_F14F_Engine_Cylinder_11_Combustion_Pr";
BA_ "SystemMessageLongSymbol" BO_ 2565951488 "VDMA_F150_Engine_Cylinder_12_Combustion_Pr";
BA_ "SystemMessageLongSymbol" BO_ 2565951744 "VDMA_F151_Engine_Cylinder_13_Combustion_Pr";
BA_ "SystemMessageLongSymbol" BO_ 2565952000 "VDMA_F152_Engine_Cylinder_14_Combustion_Pr";
BA_ "SystemMessageLongSymbol" BO_ 2565952256 "VDMA_F153_Engine_Cylinder_15_Combustion_Pr";
BA_ "SystemMessageLongSymbol" BO_ 2565952512 "VDMA_F154_Engine_Cylinder_16_Combustion_Pr";
BA_ "SystemMessageLongSymbol" BO_ 2565952768 "VDMA_F155_Engine_Cylinder_17_Combustion_Pr";
BA_ "SystemMessageLongSymbol" BO_ 2565953024 "VDMA_F156_Engine_Cylinder_18_Combustion_Pr";
BA_ "SystemMessageLongSymbol" BO_ 2565953280 "VDMA_F157_Engine_Cylinder_19_Combustion_Pr";
BA_ "SystemMessageLongSymbol" BO_ 2565953536 "VDMA_F158_Engine_Cylinder_20_Combustion_Pr";
BA_ "SystemMessageLongSymbol" BO_ 2565953792 "VDMA_F159_Engine_Cylinder_1_Combustion_Tim";
BA_ "SystemMessageLongSymbol" BO_ 2565954048 "VDMA_F15A_Engine_Cylinder_2_Combustion_Tim";
BA_ "SystemMessageLongSymbol" BO_ 2565954304 "VDMA_F15B_Engine_Cylinder_3_Combustion_Tim";
BA_ "SystemMessageLongSymbol" BO_ 2565954560 "VDMA_F15C_Engine_Cylinder_4_Combustion_Tim";
BA_ "SystemMessageLongSymbol" BO_ 2565954816 "VDMA_F15D_Engine_Cylinder_5_Combustion_Tim";
BA_ "SystemMessageLongSymbol" BO_ 2565955072 "VDMA_F15E_Engine_Cylinder_6_Combustion_Tim";
BA_ "SystemMessageLongSymbol" BO_ 2565955328 "VDMA_F15F_Engine_Cylinder_7_Combustion_Tim";
BA_ "SystemMessageLongSymbol" BO_ 2565955584 "VDMA_F160_Engine_Cylinder_8_Combustion_Tim";
BA_ "SystemMessageLongSymbol" BO_ 2565955840 "VDMA_F161_Engine_Cylinder_9_Combustion_Tim";
BA_ "SystemMessageLongSymbol" BO_ 2565956096 "VDMA_F162_Engine_Cylinder_10_Combustion_Ti";
BA_ "SystemMessageLongSymbol" BO_ 2565956352 "VDMA_F163_Engine_Cylinder_11_Combustion_Ti";
BA_ "SystemMessageLongSymbol" BO_ 2565956608 "VDMA_F164_Engine_Cylinder_12_Combustion_Ti";
BA_ "SystemMessageLongSymbol" BO_ 2565956864 "VDMA_F165_Engine_Cylinder_13_Combustion_Ti";
BA_ "SystemMessageLongSymbol" BO_ 2565957120 "VDMA_F166_Engine_Cylinder_14_Combustion_Ti";
BA_ "SystemMessageLongSymbol" BO_ 2565957376 "VDMA_F167_Engine_Cylinder_15_Combustion_Ti";
BA_ "SystemMessageLongSymbol" BO_ 2565957632 "VDMA_F168_Engine_Cylinder_16_Combustion_Ti";
BA_ "SystemMessageLongSymbol" BO_ 2565957888 "VDMA_F169_Engine_Cylinder_17_Combustion_Ti";
BA_ "SystemMessageLongSymbol" BO_ 2565958144 "VDMA_F16A_Engine_Cylinder_18_Combustion_Ti";
BA_ "SystemMessageLongSymbol" BO_ 2565958400 "VDMA_F16B_Engine_Cylinder_19_Combustion_Ti";
BA_ "SystemMessageLongSymbol" BO_ 2565958656 "VDMA_F16C_Engine_Cylinder_20_Combustion_Ti";
BA_ "SystemMessageLongSymbol" BO_ 2565958912 "VDMA_F16D_Engine_Cylinder_1_Combustion_Met";
BA_ "SystemMessageLongSymbol" BO_ 2565959168 "VDMA_F16E_Engine_Cylinder_2_Combustion_Met";
BA_ "SystemMessageLongSymbol" BO_ 2565959424 "VDMA_F16F_Engine_Cylinder_3_Combustion_Met";
BA_ "SystemMessageLongSymbol" BO_ 2565959680 "VDMA_F170_Engine_Cylinder_4_Combustion_Met";
BA_ "SystemMessageLongSymbol" BO_ 2565959936 "VDMA_F171_Engine_Cylinder_5_Combustion_Met";
BA_ "SystemMessageLongSymbol" BO_ 2565960192 "VDMA_F172_Engine_Cylinder_6_Combustion_Met";
BA_ "SystemMessageLongSymbol" BO_ 2565960448 "VDMA_F173_Engine_Cylinder_7_Combustion_Met";
BA_ "SystemMessageLongSymbol" BO_ 2565960704 "VDMA_F174_Engine_Cylinder_8_Combustion_Met";
BA_ "SystemMessageLongSymbol" BO_ 2565960960 "VDMA_F175_Engine_Cylinder_9_Combustion_Met";
BA_ "SystemMessageLongSymbol" BO_ 2565961216 "VDMA_F176_Engine_Cylinder_10_Combustion_Me";
BA_ "SystemMessageLongSymbol" BO_ 2565961472 "VDMA_F177_Engine_Cylinder_11_Combustion_Me";
BA_ "SystemMessageLongSymbol" BO_ 2565961728 "VDMA_F178_Engine_Cylinder_12_Combustion_Me";
BA_ "SystemMessageLongSymbol" BO_ 2565961984 "VDMA_F179_Engine_Cylinder_13_Combustion_Me";
BA_ "SystemMessageLongSymbol" BO_ 2565962240 "VDMA_F17A_Engine_Cylinder_14_Combustion_Me";
BA_ "SystemMessageLongSymbol" BO_ 2565962496 "VDMA_F17B_Engine_Cylinder_15_Combustion_Me";
BA_ "SystemMessageLongSymbol" BO_ 2565962752 "VDMA_F17C_Engine_Cylinder_16_Combustion_Me";
BA_ "SystemMessageLongSymbol" BO_ 2565963008 "VDMA_F17D_Engine_Cylinder_17_Combustion_Me";
BA_ "SystemMessageLongSymbol" BO_ 2565963264 "VDMA_F17E_Engine_Cylinder_18_Combustion_Me";
BA_ "SystemMessageLongSymbol" BO_ 2565963520 "VDMA_F17F_Engine_Cylinder_19_Combustion_Me";
BA_ "SystemMessageLongSymbol" BO_ 2565963776 "VDMA_F180_Engine_Cylinder_20_Combustion_Me";
BA_ "SystemMessageLongSymbol" BO_ 2565964032 "VDMA_F181_Motor_Generator_1_Inverter_Mode_";
BA_ "SystemMessageLongSymbol" BO_ 2565964288 "VDMA_F182_Motor_Generator_1_Inverter_Limit";
BA_ "SystemMessageLongSymbol" BO_ 2565964544 "VDMA_F183_Motor_Generator_1_Inverter_Limit";
BA_ "SystemMessageLongSymbol" BO_ 2565964800 "VDMA_F184_Motor_Generator_1_Inverter_Limit";
BA_ "SystemMessageLongSymbol" BO_ 2565965056 "VDMA_F185_Motor_Generator_1_Inverter_Low_V";
BA_ "SystemMessageLongSymbol" BO_ 2565965312 "VDMA_F186_Motor_Generator_2_Inverter_Mode_";
BA_ "SystemMessageLongSymbol" BO_ 2565965568 "VDMA_F187_Motor_Generator_2_Inverter_Limit";
BA_ "SystemMessageLongSymbol" BO_ 2565965824 "VDMA_F188_Motor_Generator_2_Inverter_Limit";
BA_ "SystemMessageLongSymbol" BO_ 2565966080 "VDMA_F189_Motor_Generator_2_Inverter_Limit";
BA_ "SystemMessageLongSymbol" BO_ 2565966336 "VDMA_F18A_Motor_Generator_2_Inverter_Low_V";
BA_ "SystemMessageLongSymbol" BO_ 2565966592 "VDMA_F18B_Motor_Generator_1_Inverter_Statu";
BA_ "SystemMessageLongSymbol" BO_ 2565966848 "VDMA_F18C_Motor_Generator_1_Inverter_Rate_";
BA_ "SystemMessageLongSymbol" BO_ 2565967104 "VDMA_F18D_Motor_Generator_2_Inverter_Statu";
BA_ "SystemMessageLongSymbol" BO_ 2565967360 "VDMA_F18E_Motor_Generator_2_Inverter_Rate_";
BA_ "SystemMessageLongSymbol" BO_ 2565967872 "VDMA_F190_High_Voltage_Energy_Storage_Pack";
BA_ "SystemMessageLongSymbol" BO_ 2565968128 "VDMA_F191_High_Voltage_Energy_Storage_Pack";
BA_ "SystemMessageLongSymbol" BO_ 2565968384 "VDMA_F192_High_Voltage_Energy_Storage_Pack";
BA_ "SystemMessageLongSymbol" BO_ 2565968640 "VDMA_F193_High_Voltage_Energy_Storage_Pack";
BA_ "SystemMessageLongSymbol" BO_ 2565968896 "VDMA_F194_High_Voltage_Energy_Storage_Pack";
BA_ "SystemMessageLongSymbol" BO_ 2565969152 "VDMA_F195_High_Voltage_Energy_Storage_Pack";
BA_ "SystemMessageLongSymbol" BO_ 2565969408 "VDMA_F196_High_Voltage_Energy_Storage_Pack";
BA_ "SystemMessageLongSymbol" BO_ 2565969664 "VDMA_F197_High_Voltage_Energy_Storage_Pack";
BA_ "SystemMessageLongSymbol" BO_ 2565969920 "VDMA_F198_High_Voltage_Energy_Storage_Pack";
BA_ "SystemMessageLongSymbol" BO_ 2565970176 "VDMA_F199_High_Voltage_Energy_Storage_Pack";
BA_ "SystemMessageLongSymbol" BO_ 2565970432 "VDMA_F19A_High_Voltage_Energy_Storage_Pack";
BA_ "SystemMessageLongSymbol" BO_ 2565970688 "VDMA_F19B_High_Voltage_Energy_Storage_Pack";
BA_ "SystemMessageLongSymbol" BO_ 2565970944 "VDMA_F19C_High_Voltage_Energy_Storage_Pack";
BA_ "SystemMessageLongSymbol" BO_ 2565971200 "VDMA_F19D_High_Voltage_Energy_Storage_Pack";
BA_ "SystemMessageLongSymbol" BO_ 2565971456 "VDMA_F19E_High_Voltage_Energy_Storage_Pack";
BA_ "SystemMessageLongSymbol" BO_ 2565971712 "VDMA_F19F_High_Voltage_Energy_Storage_Pack";
