CM_ "AUTOGENERATED FILE, DO NOT EDIT";

CM_ "honda_crv_ex_2017_body.dbc starts here";
BO_ 2465775527 BSM_STATUS_RIGHT: 8 XXX
 SG_ BSM_ALERT : 4|1@0+ (1,0) [0|1] "" XXX
 SG_ BSM_MODE : 6|2@0+ (1,0) [0|3] "" XXX

BO_ 2465775263 BSM_STATUS_LEFT: 8 XXX
 SG_ BSM_ALERT : 4|1@0+ (1,0) [0|1] "" XXX
 SG_ BSM_MODE : 6|2@0+ (1,0) [0|3] "" XXX

VAL_ 2465775527 BSM_MODE 2 "blind_spot" 1 "cross_traffic" 0 "off";
VAL_ 2465775263 BSM_MODE 2 "blind_spot" 1 "cross_traffic" 0 "off";
